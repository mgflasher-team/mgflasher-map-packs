ASAP2_VERSION 1 60
/begin PROJECT MG1CS201_BX8TUE_R4C2H6V5B "MG1CS201"
/begin HEADER "" VERSION "R4C2H6V5B" PROJECT_NO MG1CS201_BX8TUE_R4C2H6V5B /end HEADER
/begin MODULE DIM ""
/begin MOD_COMMON "" BYTE_ORDER MSB_LAST DEPOSIT ABSOLUTE ALIGNMENT_BYTE 1 ALIGNMENT_WORD 2 ALIGNMENT_LONG 4 ALIGNMENT_FLOAT32_IEEE 4 ALIGNMENT_FLOAT64_IEEE 4 /end MOD_COMMON
/begin AXIS_PTS AXX_KF_ASPR_NORM_UESP_PF1 "Nkw" 0x8071A0F8 NO_INPUT_QUANTITY _REC_A1AXS_1_MBSE_S2 65535 caoddzd_oAjpfzb_cAcEEha_1nR_oa0 8 -32768 32767 FORMAT "%5.0" DEPOSIT ABSOLUTE /end AXIS_PTS
/begin AXIS_PTS AXX_KF_DZW_DYN "AXX_KF_DZW_DYN" 0x80730BA8 Nkw _REC_A1AXS_1_MBSE_S2 65535 caoddzd_oAjpfzb_cAcEEha_1nR_oa0 4 -32768 32767 FORMAT "%5.0" DEPOSIT ABSOLUTE /end AXIS_PTS
/begin AXIS_PTS AXX_KF_DZWT_PF1 "AXX_KF_DZWT_PF1" 0x807456CA Nkw _REC_A1AXS_1_MBSE_S2 65535 caoddzd_oAjpfzb_cAcEEha_1nR_oa0 20 -32768 32767 FORMAT "%5.0" DEPOSIT ABSOLUTE /end AXIS_PTS
/begin AXIS_PTS AXX_KF_DZWT_PF2 "AXX_KF_DZWT_PF2" 0x807456A2 Nkw _REC_A1AXS_1_MBSE_S2 65535 caoddzd_oAjpfzb_cAcEEha_1nR_oa0 20 -32768 32767 FORMAT "%5.0" DEPOSIT ABSOLUTE /end AXIS_PTS
/begin AXIS_PTS AXX_KF_DZWT_UESP_PF1 "AXX_KF_DZWT_UESP_PF1" 0x8074568E Nkw _REC_A1AXS_1_MBSE_S2 65535 caoddzd_oAjpfzb_cAcEEha_1nR_oa0 10 -32768 32767 FORMAT "%5.0" DEPOSIT ABSOLUTE /end AXIS_PTS
/begin AXIS_PTS AXX_KF_DZWT_UESP_PF2 "AXX_KF_DZWT_UESP_PF2" 0x8074567A Nkw _REC_A1AXS_1_MBSE_S2 65535 caoddzd_oAjpfzb_cAcEEha_1nR_oa0 10 -32768 32767 FORMAT "%5.0" DEPOSIT ABSOLUTE /end AXIS_PTS
/begin AXIS_PTS AXX_KF_EDA_ANZ_SPORT_MD_EM1_IST "KF_EDA_ANZ_SPORT_MD_EM1_IST" 0x8070C656 NO_INPUT_QUANTITY _REC_A1AXS_1_MBSE_S2 6553.5 BMW_dm_sw_q0p1_Nm 6 -3276.8 3276.7 FORMAT "%7.2" DEPOSIT ABSOLUTE /end AXIS_PTS
/begin AXIS_PTS AXX_KF_EDA_ANZ_SPORT_MDK_IST "KF_EDA_ANZ_SPORT_MDK_IST" 0x8070C662 NO_INPUT_QUANTITY _REC_A1AXS_1_MBSE_S2 6553.5 BMW_dm_sw_q0p1_Nm 6 -3276.8 3276.7 FORMAT "%7.2" DEPOSIT ABSOLUTE /end AXIS_PTS
/begin AXIS_PTS AXX_KF_EHUB_MX "Nkw_ref" 0x8071BFFA NO_INPUT_QUANTITY _REC_A1AXS_1_MBSE_S2 65535 caoddzd_oAjpfzb_cAcEEha_1nR_oa0 6 -32768 32767 FORMAT "%5.0" DEPOSIT ABSOLUTE /end AXIS_PTS
/begin AXIS_PTS AXX_KF_ENA_NREG_GANG_SYN "X-axis for KF_ENA_NREG_GANG_SYN" 0x8074EC4E NO_INPUT_QUANTITY _REC_A1AXS_1_MBSE_U1 255 raChrxc_kBtBrmb_FmDuEFa_n__aa0o 9 0 255 FORMAT "%3.0" DEPOSIT ABSOLUTE /end AXIS_PTS
/begin AXIS_PTS AXX_KF_ESPR_NORM_UESP_PF1 "Nkw" 0x8071AC34 NO_INPUT_QUANTITY _REC_A1AXS_1_MBSE_S2 65535 caoddzd_oAjpfzb_cAcEEha_1nR_oa0 8 -32768 32767 FORMAT "%5.0" DEPOSIT ABSOLUTE /end AXIS_PTS
/begin AXIS_PTS AXX_KF_F_MDIMAX_KR "AXX_KF_F_MDIMAX_KR" 0x8072A554 Nkw_ref _REC_A1AXS_1_MBSE_S2 65535 caoddzd_oAjpfzb_cAcEEha_1nR_oa0 8 -32768 32767 DEPOSIT ABSOLUTE /end AXIS_PTS
/begin AXIS_PTS AXX_KF_FDZW_DYN1 "AXX_KF_FDZW_DYN1" 0x807454F2 Tans _REC_A1AXS_1_MBSE_S2 6553.5 BMW_q0p1_degC 4 -3276.8 3276.7 FORMAT "%6.1" DEPOSIT ABSOLUTE /end AXIS_PTS
/begin AXIS_PTS AXX_KF_FDZW_DYN2 "AXX_KF_FDZW_DYN2" 0x80759830 Gangi _REC_A1AXS_1_MBSE_U1 255 raChrxc_kBtBrmb_FmDuEFa_n__aa0o 10 0 255 FORMAT "%3.0" DEPOSIT ABSOLUTE /end AXIS_PTS
/begin AXIS_PTS AXX_KF_FDZW_DYN3 "AXX_KF_FDZW_DYN3" 0x807454EA Tans _REC_A1AXS_1_MBSE_S2 6553.5 BMW_q0p1_degC 4 -3276.8 3276.7 FORMAT "%6.1" DEPOSIT ABSOLUTE /end AXIS_PTS
/begin AXIS_PTS AXX_KF_FDZW_DYN4 "AXX_KF_FDZW_DYN4" 0x80759826 Gangi _REC_A1AXS_1_MBSE_U1 255 raChrxc_kBtBrmb_FmDuEFa_n__aa0o 10 0 255 FORMAT "%3.0" DEPOSIT ABSOLUTE /end AXIS_PTS
/begin AXIS_PTS AXX_KF_FDZWT_BEST_PF1 "Temperature correction factor for best ignition angle path 1" 0x8073099C Tmot _REC_A1AXS_1_MBSE_S2 655.35 DchEpAd_DBCFgoa_Ckhahgc_q__aoa0 6 -327.68 327.67 FORMAT "%7.2" DEPOSIT ABSOLUTE /end AXIS_PTS
/begin AXIS_PTS AXX_KF_FDZWT_BEST_PF2 "Temperature correction factor for best ignition angle path 2" 0x80730990 Tmot _REC_A1AXS_1_MBSE_S2 655.35 DchEpAd_DBCFgoa_Ckhahgc_q__aoa0 6 -327.68 327.67 FORMAT "%7.2" DEPOSIT ABSOLUTE /end AXIS_PTS
/begin AXIS_PTS AXX_KF_FDZWT_PF1 "AXX_KF_FDZWT_PF1" 0x80730A5C Tmot _REC_A1AXS_1_MBSE_S2 655.35 DchEpAd_DBCFgoa_Ckhahgc_q__aoa0 6 -327.68 327.67 FORMAT "%7.2" DEPOSIT ABSOLUTE /end AXIS_PTS
/begin AXIS_PTS AXX_KF_FDZWT_PF2 "AXX_KF_FDZWT_PF2" 0x80730A50 Tmot _REC_A1AXS_1_MBSE_S2 655.35 DchEpAd_DBCFgoa_Ckhahgc_q__aoa0 6 -327.68 327.67 FORMAT "%7.2" DEPOSIT ABSOLUTE /end AXIS_PTS
/begin AXIS_PTS AXX_KF_FK_FTRANSVL "AXX_KF_FK_FTRANSVL" 0x8074AE36 NO_INPUT_QUANTITY _REC_A1AXS_1_MBSE_S2 65535 caoddzd_oAjpfzb_cAcEEha_1nR_oa0 6 -32768 32767 FORMAT "%5.0" DEPOSIT ABSOLUTE /end AXIS_PTS
/begin AXIS_PTS AXX_KF_FMS_DKPSRPL_MN "Nkw_eisy" 0x8074A4D8 NO_INPUT_QUANTITY _REC_A1AXS_1_MBSE_S2 32767 caoddzd_oAjpfzb_cAcEEha_1nR_oa0 6 0 32767 FORMAT "%5.0" DEPOSIT ABSOLUTE /end AXIS_PTS
/begin AXIS_PTS AXX_KF_FMS_DKPSRPL_MX "Nkw_eisy" 0x8074A4CC NO_INPUT_QUANTITY _REC_A1AXS_1_MBSE_S2 32767 caoddzd_oAjpfzb_cAcEEha_1nR_oa0 6 0 32767 FORMAT "%5.0" DEPOSIT ABSOLUTE /end AXIS_PTS
/begin AXIS_PTS AXX_KF_FMS_HFMPL_MN "Nkw_eisy" 0x80738BB8 NO_INPUT_QUANTITY _REC_A1AXS_1_MBSE_S2 65535 caoddzd_oAjpfzb_cAcEEha_1nR_oa0 6 -32768 32767 FORMAT "%5.0" DEPOSIT ABSOLUTE /end AXIS_PTS
/begin AXIS_PTS AXX_KF_FMS_HFMPL_MX "Nkw_eisy" 0x80738BAC NO_INPUT_QUANTITY _REC_A1AXS_1_MBSE_S2 65535 caoddzd_oAjpfzb_cAcEEha_1nR_oa0 6 -32768 32767 FORMAT "%5.0" DEPOSIT ABSOLUTE /end AXIS_PTS
/begin AXIS_PTS AXX_KF_FTRANSVL "AXX_KF_FTRANSVL" 0x8074AE16 NO_INPUT_QUANTITY _REC_A1AXS_1_MBSE_S2 65535 caoddzd_oAjpfzb_cAcEEha_1nR_oa0 8 -32768 32767 FORMAT "%5.0" DEPOSIT ABSOLUTE /end AXIS_PTS
/begin AXIS_PTS AXX_KF_HUB_GRDMX "Nkw_bls" 0x8071BFEE NO_INPUT_QUANTITY _REC_A1AXS_1_MBSE_S2 65535 caoddzd_oAjpfzb_cAcEEha_1nR_oa0 6 -32768 32767 FORMAT "%5.0" DEPOSIT ABSOLUTE /end AXIS_PTS
/begin AXIS_PTS AXX_KF_HUBESTM "Nkw_10ms" 0x8071DC28 NO_INPUT_QUANTITY _REC_A1AXS_1_MBSE_S2 65535 caoddzd_oAjpfzb_cAcEEha_1nR_oa0 8 -32768 32767 FORMAT "%5.0" DEPOSIT ABSOLUTE /end AXIS_PTS
/begin AXIS_PTS AXX_KF_MDIMAX_FG "AXX_KF_MDIMAX_FG" 0x8072A548 Nkw_ref _REC_A1AXS_1_MBSE_S2 65535 caoddzd_oAjpfzb_cAcEEha_1nR_oa0 6 -32768 32767 DEPOSIT ABSOLUTE /end AXIS_PTS
/begin AXIS_PTS AXX_KF_MDIMAX_SK "AXX_KF_MDIMAX_SK" 0x8072A538 Nkw_ref _REC_A1AXS_1_MBSE_S2 65535 caoddzd_oAjpfzb_cAcEEha_1nR_oa0 8 -32768 32767 DEPOSIT ABSOLUTE /end AXIS_PTS
/begin AXIS_PTS AXX_KF_MDIMAX_TANS "AXX_KF_MDIMAX_TANS" 0x8072A52C Nkw_ref _REC_A1AXS_1_MBSE_S2 65535 caoddzd_oAjpfzb_cAcEEha_1nR_oa0 6 -32768 32767 DEPOSIT ABSOLUTE /end AXIS_PTS
/begin AXIS_PTS AXX_KF_MDIMAX_TVDK "AXX_KF_MDIMAX_TVDK" 0x8072A520 Nkw_ref _REC_A1AXS_1_MBSE_S2 65535 caoddzd_oAjpfzb_cAcEEha_1nR_oa0 6 -32768 32767 DEPOSIT ABSOLUTE /end AXIS_PTS
/begin AXIS_PTS AXX_KF_MDIOP_1_TQE "AXX_KF_MDIOP_1_TQE" 0x807273A2 NO_INPUT_QUANTITY _REC_A1AXS_1_MBSE_S2 655.35 CgkBooc_wkiDfEd_Czglhgc_fR_1a0o 18 -327.68 327.67 FORMAT "%6.2" DEPOSIT ABSOLUTE /end AXIS_PTS
/begin AXIS_PTS AXX_KF_MDK_MAX_GANG_NKW "X-axis (Gang_gb1_ist) for KF_MDK_MAX_GANG_NKW" 0x807561D1 Gang_gb1_ist _REC_A1AXS_1_MBSE_S1 255 raChrxc_kBtBrmb_FmDuEFa_n__aa0o 10 -128 127 FORMAT "%6.0" DEPOSIT ABSOLUTE /end AXIS_PTS
/begin AXIS_PTS AXX_KF_MDR_ABV_SPO "AXX_KF_MDR_ABV_SPO" 0x8072C4D4 NO_INPUT_QUANTITY _REC_A1AXS_1_MBSE_S2 1310.7 Asyaixa_wdvtenb_FCefaCb_n__aa0o 10 -655.36 655.34 DEPOSIT ABSOLUTE /end AXIS_PTS
/begin AXIS_PTS AXX_KF_MDR_ABV_SPO_HS "AXX_KF_MDR_ABV_SPO_HS" 0x8072C498 NO_INPUT_QUANTITY _REC_A1AXS_1_MBSE_S2 1310.7 Asyaixa_wdvtenb_FCefaCb_n__aa0o 10 -655.36 655.34 DEPOSIT ABSOLUTE /end AXIS_PTS
/begin AXIS_PTS AXX_KF_MDR_ABV_SPO2 "AXX_KF_MDR_ABV_SPO2" 0x8072C4C0 NO_INPUT_QUANTITY _REC_A1AXS_1_MBSE_S2 1310.7 Asyaixa_wdvtenb_FCefaCb_n__aa0o 10 -655.36 655.34 DEPOSIT ABSOLUTE /end AXIS_PTS
/begin AXIS_PTS AXX_KF_MDR_ABV_SPO2_HS "AXX_KF_MDR_ABV_SPO2_HS" 0x8072C4AC NO_INPUT_QUANTITY _REC_A1AXS_1_MBSE_S2 1310.7 Asyaixa_wdvtenb_FCefaCb_n__aa0o 10 -655.36 655.34 DEPOSIT ABSOLUTE /end AXIS_PTS
/begin AXIS_PTS AXX_KF_MDRED_T "AXX_KF_MDRED_T" 0x8074462C Tmot_wm _REC_A1AXS_1_MBSE_S2 655.35 DchEpAd_DBCFgoa_Ckhahgc_q__aoa0 6 -327.68 327.67 DEPOSIT ABSOLUTE /end AXIS_PTS
/begin AXIS_PTS AXX_KF_ZW_PF1 "AXX_KF_ZW_PF1" 0x8073089E Nkw _REC_A1AXS_1_MBSE_S2 65535 caoddzd_oAjpfzb_cAcEEha_1nR_oa0 20 -32768 32767 FORMAT "%5.0" DEPOSIT ABSOLUTE /end AXIS_PTS
/begin AXIS_PTS AXX_KF_ZW_PF2 "AXX_KF_ZW_PF2" 0x80730876 Nkw _REC_A1AXS_1_MBSE_S2 65535 caoddzd_oAjpfzb_cAcEEha_1nR_oa0 20 -32768 32767 FORMAT "%5.0" DEPOSIT ABSOLUTE /end AXIS_PTS
/begin AXIS_PTS AXX_KF_ZW_S_PF1 "AXX_KF_ZW_S_PF1" 0x8073084E Nkw _REC_A1AXS_1_MBSE_S2 65535 caoddzd_oAjpfzb_cAcEEha_1nR_oa0 20 -32768 32767 FORMAT "%5.0" DEPOSIT ABSOLUTE /end AXIS_PTS
/begin AXIS_PTS AXX_KF_ZW_S_PF2 "AXX_KF_ZW_S_PF2" 0x80730826 Nkw _REC_A1AXS_1_MBSE_S2 65535 caoddzd_oAjpfzb_cAcEEha_1nR_oa0 20 -32768 32767 FORMAT "%5.0" DEPOSIT ABSOLUTE /end AXIS_PTS
/begin AXIS_PTS AXX_KF_ZW_UESP_PF1 "AXX_KF_ZW_UESP_PF1" 0x80730812 Nkw _REC_A1AXS_1_MBSE_S2 65535 caoddzd_oAjpfzb_cAcEEha_1nR_oa0 10 -32768 32767 FORMAT "%5.0" DEPOSIT ABSOLUTE /end AXIS_PTS
/begin AXIS_PTS AXX_KF_ZW_UESP_PF2 "AXX_KF_ZW_UESP_PF2" 0x807307FE Nkw _REC_A1AXS_1_MBSE_S2 65535 caoddzd_oAjpfzb_cAcEEha_1nR_oa0 10 -32768 32767 FORMAT "%5.0" DEPOSIT ABSOLUTE /end AXIS_PTS
/begin AXIS_PTS AXX_KF_ZW_VP_PF1 "AXX_KF_ZW_VP_PF1" 0x80747C74 Nkw _REC_A1AXS_1_MBSE_S2 65535 caoddzd_oAjpfzb_cAcEEha_1nR_oa0 20 -32768 32767 FORMAT "%5.0" DEPOSIT ABSOLUTE /end AXIS_PTS
/begin AXIS_PTS AXX_KF_ZW_VP_PF2 "AXX_KF_ZW_VP_PF2" 0x80747C4C Nkw _REC_A1AXS_1_MBSE_S2 65535 caoddzd_oAjpfzb_cAcEEha_1nR_oa0 20 -32768 32767 FORMAT "%5.0" DEPOSIT ABSOLUTE /end AXIS_PTS
/begin AXIS_PTS AXX_KL_DKVL "AXX_KL_DKVL" 0x8074ADDE NO_INPUT_QUANTITY _REC_A1AXS_1_MBSE_S2 65535 caoddzd_oAjpfzb_cAcEEha_1nR_oa0 8 -32768 32767 FORMAT "%5.0" DEPOSIT ABSOLUTE /end AXIS_PTS
/begin AXIS_PTS AXX_KL_ENA_NREG_DSC "Axis for KL_ENA_NREG_KUPP_DSC" 0x8074EC48 NO_INPUT_QUANTITY _REC_A1AXS_1_MBSE_U1 255 raChrxc_kBtBrmb_FmDuEFa_n__aa0o 6 0 255 DEPOSIT ABSOLUTE /end AXIS_PTS
/begin AXIS_PTS AXX_KL_FRFMXBS "AXX_KL_FRFMXBS" 0x80715018 NO_INPUT_QUANTITY _REC_A1AXS_1_MBSE_U2 1.99996948242188 Bhvfwhc_bigEubd_BBEupBd_nR_3oa0 4 0 1.99996948242188 FORMAT "%14.5" DEPOSIT ABSOLUTE /end AXIS_PTS
/begin AXIS_PTS AXX_KL_LAMX "Nkw * kl_tasche_aus" 0x8071BAB4 NO_INPUT_QUANTITY _REC_A1AXS_1_MBSE_S2 65535 caoddzd_oAjpfzb_cAcEEha_1nR_oa0 18 -32768 32767 FORMAT "%5.0" DEPOSIT ABSOLUTE /end AXIS_PTS
/begin AXIS_PTS AXX_KL_LAND_MDKMAX_VAR "X-axis for KL_LAND_MDKMAX_VAR1, KL_LAND_MDKMAX_VAR2, KL_LAND_MDKMAX_VAR3 and KL_LAND_MDKMAX_VAR4" 0x8072A1B2 Nkw_ref _REC_A1AXS_1_MBSE_S2 65535 caoddzd_oAjpfzb_cAcEEha_1nR_oa0 18 -32768 32767 DEPOSIT ABSOLUTE /end AXIS_PTS
/begin AXIS_PTS AXX_KL_MD_K_MAX_BST "AXX_KL_MD_K_MAX_BST" 0x8072B802 Nkw_opt _REC_A1AXS_1_MBSE_S2 65535 caoddzd_oAjpfzb_cAcEEha_1nR_oa0 12 -32768 32767 FORMAT "%5.0" DEPOSIT ABSOLUTE /end AXIS_PTS
/begin AXIS_PTS AXX_KL_MD_K_MAX_BST_HS "AXX_KL_MD_K_MAX_BST_HS" 0x8072B7EA Nkw_opt _REC_A1AXS_1_MBSE_S2 65535 caoddzd_oAjpfzb_cAcEEha_1nR_oa0 12 -32768 32767 FORMAT "%5.0" DEPOSIT ABSOLUTE /end AXIS_PTS
/begin AXIS_PTS AXX_KL_MD_K_MAX_BST_STRG_AT "Breakpoint engine speed" 0x80741866 NO_INPUT_QUANTITY _REC_A1AXS_1_MBSE_S2 65535 raChrxc_kBtBrmb_FmDuEFa_n__aa0o 12 -32768 32767 FORMAT "%6.0" DEPOSIT ABSOLUTE /end AXIS_PTS
/begin AXIS_PTS AXX_KL_MD_K_MAX_BST_STRG_HS "Breakpoint engine speed" 0x8074184E NO_INPUT_QUANTITY _REC_A1AXS_1_MBSE_S2 65535 raChrxc_kBtBrmb_FmDuEFa_n__aa0o 12 -32768 32767 FORMAT "%6.0" DEPOSIT ABSOLUTE /end AXIS_PTS
/begin AXIS_PTS AXX_KL_MD_K_MAX_PB "AXX_KL_MD_K_MAX_PB" 0x8072B7D2 Nkw_opt _REC_A1AXS_1_MBSE_S2 65535 caoddzd_oAjpfzb_cAcEEha_1nR_oa0 12 -32768 32767 FORMAT "%5.0" DEPOSIT ABSOLUTE /end AXIS_PTS
/begin AXIS_PTS AXX_KL_MD_K_MAX_PB_STRG_AT "Stuetzstelle Drehzahl" 0x80741836 NO_INPUT_QUANTITY _REC_A1AXS_1_MBSE_S2 65535 raChrxc_kBtBrmb_FmDuEFa_n__aa0o 12 -32768 32767 FORMAT "%6.0" DEPOSIT ABSOLUTE /end AXIS_PTS
/begin AXIS_PTS AXX_KL_MD_K_MAX_RNSTART_STRG_HS "Breakpoint engine speed" 0x8074181E NO_INPUT_QUANTITY _REC_A1AXS_1_MBSE_S2 65535 raChrxc_kBtBrmb_FmDuEFa_n__aa0o 12 -32768 32767 FORMAT "%6.0" DEPOSIT ABSOLUTE /end AXIS_PTS
/begin AXIS_PTS AXX_KL_MD_K_MAX_RST "AXX_KL_MD_K_MAX_RST" 0x8072B7BA Nkw_opt _REC_A1AXS_1_MBSE_S2 65535 caoddzd_oAjpfzb_cAcEEha_1nR_oa0 12 -32768 32767 FORMAT "%5.0" DEPOSIT ABSOLUTE /end AXIS_PTS
/begin AXIS_PTS AXX_KL_MD_K_MAX_RST_HS "AXX_KL_MD_K_MAX_RST_HS" 0x8072B7A2 Nkw_opt _REC_A1AXS_1_MBSE_S2 65535 caoddzd_oAjpfzb_cAcEEha_1nR_oa0 12 -32768 32767 FORMAT "%5.0" DEPOSIT ABSOLUTE /end AXIS_PTS
/begin AXIS_PTS AXX_KL_MD_K_MAX_RST_STRG_AT "Stuetzstelle Drehzahl" 0x80741806 NO_INPUT_QUANTITY _REC_A1AXS_1_MBSE_S2 65535 raChrxc_kBtBrmb_FmDuEFa_n__aa0o 12 -32768 32767 FORMAT "%6.0" DEPOSIT ABSOLUTE /end AXIS_PTS
/begin AXIS_PTS AXX_KL_MD_K_MAX_SGASSE "AXX_KL_MD_K_MAX_SGASSE" 0x8072B78A Nkw_opt _REC_A1AXS_1_MBSE_S2 65535 caoddzd_oAjpfzb_cAcEEha_1nR_oa0 12 -32768 32767 FORMAT "%5.0" DEPOSIT ABSOLUTE /end AXIS_PTS
/begin AXIS_PTS AXX_KL_MD_K_MAX_SGASSE_STRG_AT "Stuetzstelle Drehzahl" 0x807417EE NO_INPUT_QUANTITY _REC_A1AXS_1_MBSE_S2 65535 raChrxc_kBtBrmb_FmDuEFa_n__aa0o 12 -32768 32767 FORMAT "%6.0" DEPOSIT ABSOLUTE /end AXIS_PTS
/begin AXIS_PTS AXX_KL_MD_K_MAX_VL "AXX_KL_MD_K_MAX_VL" 0x8072B772 Nkw_opt _REC_A1AXS_1_MBSE_S2 65535 caoddzd_oAjpfzb_cAcEEha_1nR_oa0 12 -32768 32767 FORMAT "%5.0" DEPOSIT ABSOLUTE /end AXIS_PTS
/begin AXIS_PTS AXX_KL_MD_K_MAX_VL_ECO_STRG_HS "Breakpoint engine speed" 0x807417D6 NO_INPUT_QUANTITY _REC_A1AXS_1_MBSE_S2 65535 raChrxc_kBtBrmb_FmDuEFa_n__aa0o 12 -32768 32767 FORMAT "%6.0" DEPOSIT ABSOLUTE /end AXIS_PTS
/begin AXIS_PTS AXX_KL_MD_K_MAX_VL_HS "AXX_KL_MD_K_MAX_VL_HS" 0x8072B75A Nkw_opt _REC_A1AXS_1_MBSE_S2 65535 caoddzd_oAjpfzb_cAcEEha_1nR_oa0 12 -32768 32767 FORMAT "%5.0" DEPOSIT ABSOLUTE /end AXIS_PTS
/begin AXIS_PTS AXX_KL_MD_K_MAX_VL_STRG_AT "Stuetzstelle Drehzahl" 0x807417BE NO_INPUT_QUANTITY _REC_A1AXS_1_MBSE_S2 65535 raChrxc_kBtBrmb_FmDuEFa_n__aa0o 12 -32768 32767 FORMAT "%6.0" DEPOSIT ABSOLUTE /end AXIS_PTS
/begin AXIS_PTS AXX_KL_MDG_MAX_GANG_AT "Actual gear of gearbox 1 (hybrid axis)" 0x807561EF NO_INPUT_QUANTITY _REC_A1AXS_1_MBSE_S1 255 raChrxc_kBtBrmb_FmDuEFa_n__aa0o 10 -128 127 FORMAT "%3.0" DEPOSIT ABSOLUTE /end AXIS_PTS
/begin AXIS_PTS AXX_KL_MDG_MAX_GANG_HS "Actual gear of gearbox 1 (hybrid axis)" 0x807561E5 NO_INPUT_QUANTITY _REC_A1AXS_1_MBSE_S1 255 raChrxc_kBtBrmb_FmDuEFa_n__aa0o 10 -128 127 FORMAT "%3.0" DEPOSIT ABSOLUTE /end AXIS_PTS
/begin AXIS_PTS AXX_KL_MDI_MAX_GRD_UP "AXX_KL_MDI_MAX_GRD_UP" 0x8072A4CC Mdi_max_diff _REC_A1AXS_1_MBSE_U2 6553.5 BMW_dm_sw_q0p1_Nm 6 0 6553.5 FORMAT "%6.1" DEPOSIT ABSOLUTE /end AXIS_PTS
/begin AXIS_PTS AXX_KL_MDIMX_F_TMOT "AXX_KL_MDIMX_F_TMOT" 0x8072A514 Tmot _REC_A1AXS_1_MBSE_S2 655.35 DchEpAd_DBCFgoa_Ckhahgc_q__aoa0 6 -327.68 327.67 FORMAT "%7.2" DEPOSIT ABSOLUTE /end AXIS_PTS
/begin AXIS_PTS AXX_KL_MDIMX_VL_APPLZ "AXX_KL_MDIMX_VL_APPLZ" 0x8072A4E4 Nkw_ref _REC_A1AXS_1_MBSE_S2 65535 caoddzd_oAjpfzb_cAcEEha_1nR_oa0 18 -32768 32767 DEPOSIT ABSOLUTE /end AXIS_PTS
/begin AXIS_PTS AXX_KL_MDRED_NKW "AXX_KL_MDRED_NKW" 0x8074464C Nkw_wm _REC_A1AXS_1_MBSE_S2 65535 caoddzd_oAjpfzb_cAcEEha_1nR_oa0 6 -32768 32767 DEPOSIT ABSOLUTE /end AXIS_PTS
/begin AXIS_PTS AXX_KL_RF_MAX "Nkw" 0x8071BA78 NO_INPUT_QUANTITY _REC_A1AXS_1_MBSE_S2 65535 caoddzd_oAjpfzb_cAcEEha_1nR_oa0 12 -32768 32767 FORMAT "%5.0" DEPOSIT ABSOLUTE /end AXIS_PTS
/begin AXIS_PTS AXX_KL_RF_MAX_UESP "Nkw" 0x8071BA60 NO_INPUT_QUANTITY _REC_A1AXS_1_MBSE_S2 65535 caoddzd_oAjpfzb_cAcEEha_1nR_oa0 12 -32768 32767 FORMAT "%5.0" DEPOSIT ABSOLUTE /end AXIS_PTS
/begin AXIS_PTS AXX_KL_RFMIN_KRSTSYS "X-axis for KL_RFMIN_KRSTSYS" 0x807398A2 Nkw _REC_A1AXS_1_MBSE_S2 65535 caoddzd_oAjpfzb_cAcEEha_1nR_oa0 8 -32768 32767 FORMAT "%5.0" DEPOSIT ABSOLUTE /end AXIS_PTS
/begin AXIS_PTS AXX_KL_RFVHUBDYNKOR "Nkw" 0x80719F60 NO_INPUT_QUANTITY _REC_A1AXS_1_MBSE_S2 65535 caoddzd_oAjpfzb_cAcEEha_1nR_oa0 20 -32768 32767 FORMAT "%5.0" DEPOSIT ABSOLUTE /end AXIS_PTS
/begin AXIS_PTS AXY_KF_ASPR_NORM_UESP_PF1 "Rfv_vns" 0x8071A0D8 NO_INPUT_QUANTITY _REC_A1AXS_1_MBSE_S2 655.35 CgkBooc_wkiDfEd_Czglhgc_fR_1a0o 8 -327.68 327.67 FORMAT "%9.2" DEPOSIT ABSOLUTE /end AXIS_PTS
/begin AXIS_PTS AXY_KF_DZW_DYN "AXY_KF_DZW_DYN" 0x80730B48 NO_INPUT_QUANTITY _REC_A1AXS_1_MBSE_S2 655.35 CgkBooc_wkiDfEd_Czglhgc_fR_1a0o 4 -327.68 327.67 FORMAT "%9.2" DEPOSIT ABSOLUTE /end AXIS_PTS
/begin AXIS_PTS AXY_KF_DZWT_PF1 "AXY_KF_DZWT_PF1" 0x80745602 NO_INPUT_QUANTITY _REC_A1AXS_1_MBSE_S2 655.35 CgkBooc_wkiDfEd_Czglhgc_fR_1a0o 16 -327.68 327.67 FORMAT "%9.2" DEPOSIT ABSOLUTE /end AXIS_PTS
/begin AXIS_PTS AXY_KF_DZWT_PF2 "AXY_KF_DZWT_PF2" 0x807455E2 NO_INPUT_QUANTITY _REC_A1AXS_1_MBSE_S2 655.35 CgkBooc_wkiDfEd_Czglhgc_fR_1a0o 16 -327.68 327.67 FORMAT "%9.2" DEPOSIT ABSOLUTE /end AXIS_PTS
/begin AXIS_PTS AXY_KF_DZWT_UESP_PF1 "AXY_KF_DZWT_UESP_PF1" 0x807455CA NO_INPUT_QUANTITY _REC_A1AXS_1_MBSE_S2 655.35 CgkBooc_wkiDfEd_Czglhgc_fR_1a0o 12 -327.68 327.67 FORMAT "%9.2" DEPOSIT ABSOLUTE /end AXIS_PTS
/begin AXIS_PTS AXY_KF_DZWT_UESP_PF2 "AXY_KF_DZWT_UESP_PF2" 0x807455B2 NO_INPUT_QUANTITY _REC_A1AXS_1_MBSE_S2 655.35 CgkBooc_wkiDfEd_Czglhgc_fR_1a0o 12 -327.68 327.67 FORMAT "%9.2" DEPOSIT ABSOLUTE /end AXIS_PTS
/begin AXIS_PTS AXY_KF_EDA_ANZ_SPORT_MD_EM1_IST "KF_EDA_ANZ_SPORT_MD_EM1_IST" 0x8070C686 NO_INPUT_QUANTITY _REC_A1AXS_1_MBSE_S2 65535 caoddzd_oAjpfzb_cAcEEha_1nR_oa0 6 -32768 32767 FORMAT "%5.0" DEPOSIT ABSOLUTE /end AXIS_PTS
/begin AXIS_PTS AXY_KF_EDA_ANZ_SPORT_MDK_IST "KF_EDA_ANZ_SPORT_MDK_IST" 0x8070C692 NO_INPUT_QUANTITY _REC_A1AXS_1_MBSE_S2 65535 caoddzd_oAjpfzb_cAcEEha_1nR_oa0 6 -32768 32767 FORMAT "%5.0" DEPOSIT ABSOLUTE /end AXIS_PTS
/begin AXIS_PTS AXY_KF_EHUB_MX "Rfv_hub" 0x8071BFDA NO_INPUT_QUANTITY _REC_A1AXS_1_MBSE_S2 655.35 CgkBooc_wkiDfEd_Czglhgc_fR_1a0o 6 -327.68 327.67 FORMAT "%9.2" DEPOSIT ABSOLUTE /end AXIS_PTS
/begin AXIS_PTS AXY_KF_ENA_NREG_GANG_SYN "Y-axis for KF_ENA_NREG_GANG_SYN" 0x8074EC25 NO_INPUT_QUANTITY _REC_A1AXS_1_MBSE_U1 255 raChrxc_kBtBrmb_FmDuEFa_n__aa0o 9 0 255 FORMAT "%3.0" DEPOSIT ABSOLUTE /end AXIS_PTS
/begin AXIS_PTS AXY_KF_ESPR_NORM_UESP_PF1 "Rfv_vns" 0x8071AC14 NO_INPUT_QUANTITY _REC_A1AXS_1_MBSE_S2 655.35 CgkBooc_wkiDfEd_Czglhgc_fR_1a0o 8 -327.68 327.67 FORMAT "%9.2" DEPOSIT ABSOLUTE /end AXIS_PTS
/begin AXIS_PTS AXY_KF_F_MDIMAX_KR "AXY_KF_F_MDIMAX_KR" 0x8072A4BE NO_INPUT_QUANTITY _REC_A1AXS_1_MBSE_S2 6553.5 BMW_dm_sw_q0p1_Nm 7 -3276.8 3276.7 DEPOSIT ABSOLUTE /end AXIS_PTS
/begin AXIS_PTS AXY_KF_FDZW_DYN1 "AXY_KF_FDZW_DYN1" 0x807454E2 Dzw_annm _REC_A1AXS_1_MBSE_S2 110 BMW_q0p1_deg 4 -50 60 FORMAT "%6.1" DEPOSIT ABSOLUTE /end AXIS_PTS
/begin AXIS_PTS AXY_KF_FDZW_DYN2 "AXY_KF_FDZW_DYN2" 0x807454DA V _REC_A1AXS_1_MBSE_U2 360 AFeDmkb_cAbjmcc_kAkskhd_k__0oa0 4 0 360 FORMAT "%5.0" DEPOSIT ABSOLUTE /end AXIS_PTS
/begin AXIS_PTS AXY_KF_FDZW_DYN3 "AXY_KF_FDZW_DYN3" 0x807454D2 Dzw_annm _REC_A1AXS_1_MBSE_S2 110 BMW_q0p1_deg 4 -50 60 FORMAT "%6.1" DEPOSIT ABSOLUTE /end AXIS_PTS
/begin AXIS_PTS AXY_KF_FDZW_DYN4 "AXY_KF_FDZW_DYN4" 0x807454CA V _REC_A1AXS_1_MBSE_U2 360 AFeDmkb_cAbjmcc_kAkskhd_k__0oa0 4 0 360 FORMAT "%5.0" DEPOSIT ABSOLUTE /end AXIS_PTS
/begin AXIS_PTS AXY_KF_FDZWT_BEST_PF1 "Temperature correction factor for best ignition angle path 1" 0x80730984 Tans _REC_A1AXS_1_MBSE_S2 6553.5 BMW_q0p1_degC 6 -3276.8 3276.7 FORMAT "%6.1" DEPOSIT ABSOLUTE /end AXIS_PTS
/begin AXIS_PTS AXY_KF_FDZWT_BEST_PF2 "Temperature correction factor for best ignition angle path 2" 0x80730978 Tans _REC_A1AXS_1_MBSE_S2 6553.5 BMW_q0p1_degC 6 -3276.8 3276.7 FORMAT "%6.1" DEPOSIT ABSOLUTE /end AXIS_PTS
/begin AXIS_PTS AXY_KF_FDZWT_PF1 "AXY_KF_FDZWT_PF1" 0x80730A44 Tans _REC_A1AXS_1_MBSE_S2 6553.5 BMW_q0p1_degC 6 -3276.8 3276.7 FORMAT "%6.1" DEPOSIT ABSOLUTE /end AXIS_PTS
/begin AXIS_PTS AXY_KF_FDZWT_PF2 "AXY_KF_FDZWT_PF2" 0x80730A38 Tans _REC_A1AXS_1_MBSE_S2 6553.5 BMW_q0p1_degC 6 -3276.8 3276.7 FORMAT "%6.1" DEPOSIT ABSOLUTE /end AXIS_PTS
/begin AXIS_PTS AXY_KF_FK_FTRANSVL "AXY_KF_FK_FTRANSVL" 0x8074AD72 NO_INPUT_QUANTITY _REC_A1AXS_1_MBSE_U2 3.99993896484375 ilxsavd_hkzmBfc_lAzCpAb_nR_1oa0 6 0 3.99993896484375 FORMAT "%14.5" DEPOSIT ABSOLUTE /end AXIS_PTS
/begin AXIS_PTS AXY_KF_FMS_DKPSRPL_MN "Rf_soll" 0x8074A4B4 NO_INPUT_QUANTITY _REC_A1AXS_1_MBSE_S2 327.67 CgkBooc_wkiDfEd_Czglhgc_fR_1a0o 6 0 327.67 FORMAT "%7.2" DEPOSIT ABSOLUTE /end AXIS_PTS
/begin AXIS_PTS AXY_KF_FMS_DKPSRPL_MX "Rf_soll" 0x8074A4A8 NO_INPUT_QUANTITY _REC_A1AXS_1_MBSE_S2 327.67 CgkBooc_wkiDfEd_Czglhgc_fR_1a0o 6 0 327.67 FORMAT "%7.2" DEPOSIT ABSOLUTE /end AXIS_PTS
/begin AXIS_PTS AXY_KF_FMS_HFMPL_MN "Rf_soll" 0x80738BA0 NO_INPUT_QUANTITY _REC_A1AXS_1_MBSE_S2 655.35 CgkBooc_wkiDfEd_Czglhgc_fR_1a0o 6 -327.68 327.67 FORMAT "%7.2" DEPOSIT ABSOLUTE /end AXIS_PTS
/begin AXIS_PTS AXY_KF_FMS_HFMPL_MX "Rf_soll" 0x80738B94 NO_INPUT_QUANTITY _REC_A1AXS_1_MBSE_S2 655.35 CgkBooc_wkiDfEd_Czglhgc_fR_1a0o 6 -327.68 327.67 FORMAT "%7.2" DEPOSIT ABSOLUTE /end AXIS_PTS
/begin AXIS_PTS AXY_KF_FTRANSVL "AXY_KF_FTRANSVL" 0x8074AD52 NO_INPUT_QUANTITY _REC_A1AXS_1_MBSE_U2 0.999984741210938 FzbmlAa_gCtylrb_ckCqxAc_nR_6oa0 8 0 0.999984741210938 FORMAT "%7.5" DEPOSIT ABSOLUTE /end AXIS_PTS
/begin AXIS_PTS AXY_KF_HUB_GRDMX "Hubev_soll_kf" 0x8071BFCE NO_INPUT_QUANTITY _REC_A1AXS_1_MBSE_U2 65.535 ohoxkpc_embkBlb_gscheBc_m__aoa0 6 0 65.535 DEPOSIT ABSOLUTE /end AXIS_PTS
/begin AXIS_PTS AXY_KF_HUBESTM "Tmot_start" 0x8071DB20 NO_INPUT_QUANTITY _REC_A1AXS_1_MBSE_S2 655.35 DchEpAd_DBCFgoa_Ckhahgc_q__aoa0 8 -327.68 327.67 FORMAT "%7.2" DEPOSIT ABSOLUTE /end AXIS_PTS
/begin AXIS_PTS AXY_KF_MDIMAX_FG "AXY_KF_MDIMAX_FG" 0x8072A4B2 Frfmxbsld _REC_A1AXS_1_MBSE_U2 1 Bhvfwhc_bigEubd_BBEupBd_nR_3oa0 6 0 1 FORMAT "%14.5" DEPOSIT ABSOLUTE /end AXIS_PTS
/begin AXIS_PTS AXY_KF_MDIMAX_SK "AXY_KF_MDIMAX_SK" 0x807530AD BMWpim_fac_TqRedn_ub _REC_A1AXS_1_MBSE_U1 0.99609375 BMW_Powertrain_DxECompuMethods_Def_ub_b1_nounit 7 0 0.99609375 DEPOSIT ABSOLUTE /end AXIS_PTS
/begin AXIS_PTS AXY_KF_MDIMAX_TANS "AXY_KF_MDIMAX_TANS" 0x8072A4A6 Tans _REC_A1AXS_1_MBSE_S2 6553.5 BMW_q0p1_degC 6 -3276.8 3276.7 FORMAT "%6.1" DEPOSIT ABSOLUTE /end AXIS_PTS
/begin AXIS_PTS AXY_KF_MDIMAX_TVDK "AXY_KF_MDIMAX_TVDK" 0x8072A49A Tvdk _REC_A1AXS_1_MBSE_S2 6553.5 BMW_q0p1_degC 6 -3276.8 3276.7 FORMAT "%6.1" DEPOSIT ABSOLUTE /end AXIS_PTS
/begin AXIS_PTS AXY_KF_MDIOP_1_TQE "AXY_KF_MDIOP_1_TQE" 0x8072737A NO_INPUT_QUANTITY _REC_A1AXS_1_MBSE_S2 65535 caoddzd_oAjpfzb_cAcEEha_1nR_oa0 20 -32768 32767 FORMAT "%5.0" DEPOSIT ABSOLUTE /end AXIS_PTS
/begin AXIS_PTS AXY_KF_MDK_MAX_GANG_NKW "X-axis (NKW_plaus) for KF_MDK_MAX_GANG_NKW" 0x8074162C Nkw_plaus _REC_A1AXS_1_MBSE_S2 65535 caoddzd_oAjpfzb_cAcEEha_1nR_oa0 8 -32768 32767 FORMAT "%6.0" DEPOSIT ABSOLUTE /end AXIS_PTS
/begin AXIS_PTS AXY_KF_MDR_ABV_SPO "AXY_KF_MDR_ABV_SPO" 0x8072C5DC NO_INPUT_QUANTITY _REC_A1AXS_1_MBSE_S2 1599.9755859375 uvFxekd_wvexlbc_BcFdkDd_nR_1a0o 12 -800 799.9755859375 DEPOSIT ABSOLUTE /end AXIS_PTS
/begin AXIS_PTS AXY_KF_MDR_ABV_SPO_HS "AXY_KF_MDR_ABV_SPO_HS" 0x8072C594 NO_INPUT_QUANTITY _REC_A1AXS_1_MBSE_S2 1599.9755859375 uvFxekd_wvexlbc_BcFdkDd_nR_1a0o 12 -800 799.9755859375 DEPOSIT ABSOLUTE /end AXIS_PTS
/begin AXIS_PTS AXY_KF_MDR_ABV_SPO2 "AXY_KF_MDR_ABV_SPO2" 0x8072C5C4 NO_INPUT_QUANTITY _REC_A1AXS_1_MBSE_S2 1599.9755859375 uvFxekd_wvexlbc_BcFdkDd_nR_1a0o 12 -800 799.9755859375 DEPOSIT ABSOLUTE /end AXIS_PTS
/begin AXIS_PTS AXY_KF_MDR_ABV_SPO2_HS "AXY_KF_MDR_ABV_SPO2_HS" 0x8072C5AC NO_INPUT_QUANTITY _REC_A1AXS_1_MBSE_S2 1599.9755859375 uvFxekd_wvexlbc_BcFdkDd_nR_1a0o 12 -800 799.9755859375 DEPOSIT ABSOLUTE /end AXIS_PTS
/begin AXIS_PTS AXY_KF_MDRED_T "AXY_KF_MDRED_T" 0x807445BC Toel_wm _REC_A1AXS_1_MBSE_S2 6553.5 BMW_q0p1_degC 6 -3276.8 3276.7 DEPOSIT ABSOLUTE /end AXIS_PTS
/begin AXIS_PTS AXY_KF_ZW_PF1 "AXY_KF_ZW_PF1" 0x807307D6 NO_INPUT_QUANTITY _REC_A1AXS_1_MBSE_S2 655.35 CgkBooc_wkiDfEd_Czglhgc_fR_1a0o 20 -327.68 327.67 FORMAT "%9.2" DEPOSIT ABSOLUTE /end AXIS_PTS
/begin AXIS_PTS AXY_KF_ZW_PF2 "AXY_KF_ZW_PF2" 0x807307AE NO_INPUT_QUANTITY _REC_A1AXS_1_MBSE_S2 655.35 CgkBooc_wkiDfEd_Czglhgc_fR_1a0o 20 -327.68 327.67 FORMAT "%9.2" DEPOSIT ABSOLUTE /end AXIS_PTS
/begin AXIS_PTS AXY_KF_ZW_S_PF1 "AXY_KF_ZW_S_PF1" 0x80730786 NO_INPUT_QUANTITY _REC_A1AXS_1_MBSE_S2 655.35 CgkBooc_wkiDfEd_Czglhgc_fR_1a0o 20 -327.68 327.67 FORMAT "%9.2" DEPOSIT ABSOLUTE /end AXIS_PTS
/begin AXIS_PTS AXY_KF_ZW_S_PF2 "AXY_KF_ZW_S_PF2" 0x8073075E NO_INPUT_QUANTITY _REC_A1AXS_1_MBSE_S2 655.35 CgkBooc_wkiDfEd_Czglhgc_fR_1a0o 20 -327.68 327.67 FORMAT "%9.2" DEPOSIT ABSOLUTE /end AXIS_PTS
/begin AXIS_PTS AXY_KF_ZW_UESP_PF1 "AXY_KF_ZW_UESP_PF1" 0x80730742 NO_INPUT_QUANTITY _REC_A1AXS_1_MBSE_S2 655.35 CgkBooc_wkiDfEd_Czglhgc_fR_1a0o 14 -327.68 327.67 FORMAT "%9.2" DEPOSIT ABSOLUTE /end AXIS_PTS
/begin AXIS_PTS AXY_KF_ZW_UESP_PF2 "AXY_KF_ZW_UESP_PF2" 0x80730726 NO_INPUT_QUANTITY _REC_A1AXS_1_MBSE_S2 655.35 CgkBooc_wkiDfEd_Czglhgc_fR_1a0o 14 -327.68 327.67 FORMAT "%9.2" DEPOSIT ABSOLUTE /end AXIS_PTS
/begin AXIS_PTS AXY_KF_ZW_VP_PF1 "AXY_KF_ZW_VP_PF1" 0x80747C2C Rf_zwv _REC_A1AXS_1_MBSE_S2 655.35 CgkBooc_wkiDfEd_Czglhgc_fR_1a0o 16 -327.68 327.67 FORMAT "%9.2" DEPOSIT ABSOLUTE /end AXIS_PTS
/begin AXIS_PTS AXY_KF_ZW_VP_PF2 "AXY_KF_ZW_VP_PF2" 0x80747C0C Rf_zwv _REC_A1AXS_1_MBSE_S2 655.35 CgkBooc_wkiDfEd_Czglhgc_fR_1a0o 16 -327.68 327.67 FORMAT "%9.2" DEPOSIT ABSOLUTE /end AXIS_PTS
/begin AXIS_PTS BMWext_lam_CptPronMinLeanTq_Ax "Exhaust temperature model, lambda component protection minimum lean torque X-axis" 0x80714FC2 Nkw_atm _REC_A1AXS_1_MBSE_S2 65535 caoddzd_oAjpfzb_cAcEEha_1nR_oa0 8 -32768 32767 DEPOSIT ABSOLUTE /end AXIS_PTS
/begin AXIS_PTS BMWext_lam_CptPronMinLeanTq_Ay "Exhaust temperature model, lambda component protection minimum lean torque Y-axis" 0x80714FB2 Rf_atm _REC_A1AXS_1_MBSE_S2 655.35 CgkBooc_wkiDfEd_Czglhgc_fR_1a0o 8 -327.68 327.67 DEPOSIT ABSOLUTE /end AXIS_PTS
/begin AXIS_PTS BMWgpfdiag_rf_LimPclFilMin_Ax "GPF diagnostics, relative filling limit particle filter minimum X-axis" 0x8073B35A Nkw _REC_A1AXS_1_MBSE_S2 65535 caoddzd_oAjpfzb_cAcEEha_1nR_oa0 4 -32768 32767 FORMAT "%5.0" DEPOSIT ABSOLUTE /end AXIS_PTS
/begin AXIS_PTS BMWinjafs_fac_RatAirMax_Ax "Curve axis upper limit Rf for stoichiometric lambda adaptation" 0x8071121E Nkw _REC_A1AXS_1_MBSE_S2 65535 caoddzd_oAjpfzb_cAcEEha_1nR_oa0 6 -32768 32767 FORMAT "%5.0" DEPOSIT ABSOLUTE /end AXIS_PTS
/begin AXIS_PTS BMWlpa_rat_EfpPwm_Ax "Electric fuel pump speed control via PWM X-axis" 0x80716E8E BMWlpa_n_Efp_uw _REC_A1AXS_1_MBSE_U2 65535 caoddzd_oAjpfzb_cAcEEha_1nR_oa0 6 0 65535 FORMAT "%5.0" DEPOSIT ABSOLUTE /end AXIS_PTS
/begin AXIS_PTS BMWls_fac_rf_RednFuOctIntkT_Ax "Breakpoints for filling reduction factor depending on fuel quality" 0x8074DB98 F_octan _REC_A1AXS_1_MBSE_U1 0.99609375 BMW_Powertrain_DxECompuMethods_Def_ub_b1_nounit 6 0 0.99609375 FORMAT "%6.1" DEPOSIT ABSOLUTE /end AXIS_PTS
/begin AXIS_PTS BMWls_fac_rf_RednFuOctIntkT_Ay "Breakpoints for filling reduction factor depending on intake air temperature" 0x8071BA10 Tans _REC_A1AXS_1_MBSE_S2 6553.5 BMW_q0p1_degC 6 -3276.8 3276.7 FORMAT "%6.1" DEPOSIT ABSOLUTE /end AXIS_PTS
/begin AXIS_PTS BMWls_pct_FiMaxCondRisk_Ax "Achse fuer maximale Fuellung ueber Drehzahl aufgrund von Kondesatrisiko am Ladeluftkuehler" 0x8071BA48 NO_INPUT_QUANTITY _REC_A1AXS_1_MBSE_S2 65535 caoddzd_oAjpfzb_cAcEEha_1nR_oa0 12 -32768 32767 FORMAT "%5.0" DEPOSIT ABSOLUTE /end AXIS_PTS
/begin AXIS_PTS BMWls_pct_FiMaxIgOfs_Gx "Curve filling limitation depending on ignition angle retard" 0x8071BA34 Nkw _REC_A1AXS_1_MBSE_S2 65535 caoddzd_oAjpfzb_cAcEEha_1nR_oa0 10 -32768 32767 FORMAT "%5.0" DEPOSIT ABSOLUTE /end AXIS_PTS
/begin AXIS_PTS BMWls_pct_FiMaxIgOfs_Gy "Curve filling limitation depending on ignition angle retard" 0x8071BA00 Dzw_tot_kr _REC_A1AXS_1_MBSE_S2 6553.5 BMW_q0p1_deg 8 -3276.8 3276.7 FORMAT "%6.1" DEPOSIT ABSOLUTE /end AXIS_PTS
/begin AXIS_PTS BMWls_rf_MaxEgT_Ax "Nkw" 0x8071BA28 Nkw _REC_A1AXS_1_MBSE_S2 65535 caoddzd_oAjpfzb_cAcEEha_1nR_oa0 6 -32768 32767 FORMAT "%5.0" DEPOSIT ABSOLUTE /end AXIS_PTS
/begin AXIS_PTS BMWls_rf_MaxEgT_Ay "Nkw" 0x8071BA1C Frfmxbsld _REC_A1AXS_1_MBSE_U2 1.99996948242188 Bhvfwhc_bigEubd_BBEupBd_nR_3oa0 6 0 1.99996948242188 FORMAT "%14.5" DEPOSIT ABSOLUTE /end AXIS_PTS
/begin AXIS_PTS BMWls_rf_MaxFuOctIntkT_Gy "Group breakpoint for filling reduction factor" 0x8071B9F0 BMWls_fac_rf_RedFil_uw _REC_A1AXS_1_MBSE_U2 0.999984741210938 FzbmlAa_gCtylrb_ckCqxAc_nR_6oa0 8 0 0.999984741210938 FORMAT "%7.5" DEPOSIT ABSOLUTE /end AXIS_PTS
/begin AXIS_PTS BMWtchco_fac_FadePl_Ax "AXX_KL_ATLVST_UEB" 0x80720EF4 NO_INPUT_QUANTITY _REC_A1AXS_1_MBSE_U2 7.9998779296875 acriqBc_tfkBqod_ocgjxzc_nR_8oa0 6 0 7.9998779296875 FORMAT "%11.4" DEPOSIT ABSOLUTE /end AXIS_PTS
/begin AXIS_PTS BMWtchctr_fac_Dp_Ax "AXX_KL_FPATLR_D" 0x807217BE BMWtchctr_pwr_Pctl_uw _REC_A1AXS_1_MBSE_U2 127.998046875 jucyrzb_bpFgwfd_uqrfhgc_k__aoa0 6 0 127.998046875 FORMAT "%7.3" DEPOSIT ABSOLUTE /end AXIS_PTS
/begin AXIS_PTS BMWtchctr_fac_DpDyn_Ax "AXX_KL_FPATLR_D" 0x807217CA BMWtchctr_pwr_Pctl_uw _REC_A1AXS_1_MBSE_U2 127.998046875 jucyrzb_bpFgwfd_uqrfhgc_k__aoa0 6 0 127.998046875 FORMAT "%7.3" DEPOSIT ABSOLUTE /end AXIS_PTS
/begin AXIS_PTS BMWtchctr_p_DifCrtnPp_Ax "AXX_KF_PDIFF_ATLR_P" 0x8072173A BMWtchbas_p_Dif_sw _REC_A1AXS_1_MBSE_S2 8191.875 BMW_p_sw_q0p125_hPa 12 -4096 4095.875 FORMAT "%10.3" DEPOSIT ABSOLUTE /end AXIS_PTS
/begin AXIS_PTS BMWtchctr_p_DifCrtnPp_Ay "AXY_KF_PDIFF_ATLR_P" 0x8072172E BMWtchsp_mf_Ex_uw _REC_A1AXS_1_MBSE_U2 2047.96875 CByjozc_eCmpBAb_pljBAmd_k__0oa0 6 0 2047.96875 FORMAT "%10.3" DEPOSIT ABSOLUTE /end AXIS_PTS
/begin AXIS_PTS BMWtchctr_p_DifCrtnPpDyn_Ax "AXX_KF_PDIFF_ATLR_P" 0x8072175E BMWtchbas_p_Dif_sw _REC_A1AXS_1_MBSE_S2 8191.875 BMW_p_sw_q0p125_hPa 12 -4096 4095.875 FORMAT "%10.3" DEPOSIT ABSOLUTE /end AXIS_PTS
/begin AXIS_PTS BMWtchctr_p_DifCrtnPpDyn_Ay "AXY_KF_PDIFF_ATLR_P" 0x80721752 BMWtchsp_mf_Ex_uw _REC_A1AXS_1_MBSE_U2 2047.96875 CByjozc_eCmpBAb_pljBAmd_k__0oa0 6 0 2047.96875 FORMAT "%10.3" DEPOSIT ABSOLUTE /end AXIS_PTS
/begin AXIS_PTS BMWtchctr_pct_WgBasc_Ax "AXX_KF_WGPOS_VST" 0x8074120C NO_INPUT_QUANTITY _REC_A1AXS_1_MBSE_U2 3.99993896484375 ilxsavd_hkzmBfc_lAzCpAb_nR_1oa0 12 0 3.99993896484375 FORMAT "%14.5" DEPOSIT ABSOLUTE /end AXIS_PTS
/begin AXIS_PTS BMWtchctr_pct_WgBasc_Ay "AXY_KF_WGPOS_VST" 0x807411F4 NO_INPUT_QUANTITY _REC_A1AXS_1_MBSE_U2 2047.96875 CByjozc_eCmpBAb_pljBAmd_k__0oa0 12 0 2047.96875 FORMAT "%10.3" DEPOSIT ABSOLUTE /end AXIS_PTS
/begin AXIS_PTS BMWtchctr_pwr_CmprGra_Ax "AXX_KF_PVERD_GRD" 0x80721716 BMWtchsp_rat_p_CmprLim_uw _REC_A1AXS_1_MBSE_U2 7.9998779296875 acriqBc_tfkBqod_ocgjxzc_nR_8oa0 12 0 7.9998779296875 FORMAT "%11.4" DEPOSIT ABSOLUTE /end AXIS_PTS
/begin AXIS_PTS BMWtchctr_pwr_CmprGra_Ay "AXY_KF_PVERD_GRD" 0x807216FE BMWtchsp_mf_CmprNorm_uw _REC_A1AXS_1_MBSE_U2 2047.96875 CByjozc_eCmpBAb_pljBAmd_k__0oa0 12 0 2047.96875 FORMAT "%10.3" DEPOSIT ABSOLUTE /end AXIS_PTS
/begin AXIS_PTS BMWtchctr_pwr_Dp_Ax "AXX_KF_PATLR_D" 0x807216E2 BMWtchbas_p_Dif_sw _REC_A1AXS_1_MBSE_S2 8191.875 BMW_p_sw_q0p125_hPa 14 -4096 4095.875 FORMAT "%10.3" DEPOSIT ABSOLUTE /end AXIS_PTS
/begin AXIS_PTS BMWtchctr_pwr_Dp_Ay "AXY_KF_PATLR_D" 0x807216C6 BMWtchbas_p_DifGra_sw _REC_A1AXS_1_MBSE_S2 8191.875 BMW_p_sw_q0p125_hPa 14 -4096 4095.875 FORMAT "%10.3" DEPOSIT ABSOLUTE /end AXIS_PTS
/begin AXIS_PTS BMWtchctr_pwr_Pctl_Ax "AXX_KF_ATL_PVERD" 0x8072169E BMWtchsp_rat_p_CmprLim_uw _REC_A1AXS_1_MBSE_U2 7.9998779296875 acriqBc_tfkBqod_ocgjxzc_nR_8oa0 20 0 7.9998779296875 FORMAT "%11.4" DEPOSIT ABSOLUTE /end AXIS_PTS
/begin AXIS_PTS BMWtchctr_pwr_Pctl_Ay "AXY_KF_ATL_PVERD" 0x8072167E BMWtchsp_mf_CmprNorm_uw _REC_A1AXS_1_MBSE_U2 2047.96875 CByjozc_eCmpBAb_pljBAmd_k__0oa0 16 0 2047.96875 FORMAT "%10.3" DEPOSIT ABSOLUTE /end AXIS_PTS
/begin AXIS_PTS BMWtchdiag_pct_WgPHi_Ax "AXX_KF_ATLRPID_MN" 0x807218F6 BMWtchbas_p_Dif_sw _REC_A1AXS_1_MBSE_S2 8191.875 BMW_p_sw_q0p125_hPa 4 -4096 4095.875 FORMAT "%10.3" DEPOSIT ABSOLUTE /end AXIS_PTS
/begin AXIS_PTS BMWtchdiag_pct_WgPHi_Ay "AXY_KF_ATLRPID_MN" 0x807218EE BMWtchdiag_fac_pwr_TrbPctl_uw _REC_A1AXS_1_MBSE_U2 7.9998779296875 acriqBc_tfkBqod_ocgjxzc_nR_8oa0 4 0 7.9998779296875 FORMAT "%10.3" DEPOSIT ABSOLUTE /end AXIS_PTS
/begin AXIS_PTS BMWtchdiag_pct_WgPLo_Ax "AXX_KF_ATLRPID_MX" 0x807218E6 NO_INPUT_QUANTITY _REC_A1AXS_1_MBSE_S2 8191.875 BMW_p_sw_q0p125_hPa 4 -4096 4095.875 FORMAT "%10.3" DEPOSIT ABSOLUTE /end AXIS_PTS
/begin AXIS_PTS BMWtchdiag_pct_WgPLo_Ay "AXY_KF_ATLRPID_MX" 0x807218DE BMWtchdiag_fac_pwr_TrbPctl_uw _REC_A1AXS_1_MBSE_U2 7.9998779296875 acriqBc_tfkBqod_ocgjxzc_nR_8oa0 4 0 7.9998779296875 FORMAT "%10.3" DEPOSIT ABSOLUTE /end AXIS_PTS
/begin AXIS_PTS BMWtchout_pct_WgBlwOff_Ax "axis" 0x80721D76 Nkw _REC_A1AXS_1_MBSE_S2 65535 caoddzd_oAjpfzb_cAcEEha_1nR_oa0 4 -32768 32767 FORMAT "%5.0" DEPOSIT ABSOLUTE /end AXIS_PTS
/begin AXIS_PTS BMWtchsp_rf_Liho_Ax "AXX_KL_LAMX" 0x80721EB6 NO_INPUT_QUANTITY _REC_A1AXS_1_MBSE_S2 65535 caoddzd_oAjpfzb_cAcEEha_1nR_oa0 6 -32768 32767 FORMAT "%5.0" DEPOSIT ABSOLUTE /end AXIS_PTS
/begin AXIS_PTS BMWtqe_n_SpdMaxEmiRedn_Ax "Torque engine, speed maximum emission reduction X-axis" 0x8072B274 BMWtqe_fac_EmiRednColdCat _REC_A1AXS_1_MBSE_U2 0.999984741210938 FzbmlAa_gCtylrb_ckCqxAc_nR_6oa0 4 0 0.999984741210938 FORMAT "%14.5" DEPOSIT ABSOLUTE /end AXIS_PTS
/begin AXIS_PTS BMWtqe_tqc_FlApplStg_Ax "Torque engine, crankshaft torque full load application stage X-axis" 0x8072A7EA Nkw_ref _REC_A1AXS_1_MBSE_S2 65535 caoddzd_oAjpfzb_cAcEEha_1nR_oa0 18 -32768 32767 DEPOSIT ABSOLUTE /end AXIS_PTS
/begin AXIS_PTS BMWtqe_tqi_EngLimdEmiThd_Ax "Torque engine, inner torque engine limited emission threshold X-axis" 0x8072A1F8 Nkw_ref _REC_A1AXS_1_MBSE_S2 65535 caoddzd_oAjpfzb_cAcEEha_1nR_oa0 7 -32768 32767 DEPOSIT ABSOLUTE /end AXIS_PTS
/begin AXIS_PTS BMWtqe_tqi_MaxEmiRedn_Ax "BMWtqe_tqi_MaxEmiRedn_T" 0x8072A486 BMWtqe_fac_EmiRednColdCat _REC_A1AXS_1_MBSE_U2 0.999984741210938 FzbmlAa_gCtylrb_ckCqxAc_nR_6oa0 5 0 0.999984741210938 FORMAT "%7.5" DEPOSIT ABSOLUTE /end AXIS_PTS
/begin AXIS_PTS BMWtqe_tqi_MaxEmiRedn_Ay "Torque engine, inner torque maximum emission reduction Y-axis" 0x8072A47C Nkw_ref _REC_A1AXS_1_MBSE_S2 65535 caoddzd_oAjpfzb_cAcEEha_1nR_oa0 5 -32768 32767 FORMAT "%6.0" DEPOSIT ABSOLUTE /end AXIS_PTS
/begin AXIS_PTS GAX_KF_ASPR_NORM_PF1 "Nkw" 0x8071AA5E NO_INPUT_QUANTITY _REC_A1AXS_1_MBSE_S2 65535 caoddzd_oAjpfzb_cAcEEha_1nR_oa0 16 -32768 32767 FORMAT "%5.0" DEPOSIT ABSOLUTE /end AXIS_PTS
/begin AXIS_PTS GAX_KF_ASPR_NORM_PF2 "Nkw" 0x8071AA3E NO_INPUT_QUANTITY _REC_A1AXS_1_MBSE_S2 65535 caoddzd_oAjpfzb_cAcEEha_1nR_oa0 16 -32768 32767 FORMAT "%5.0" DEPOSIT ABSOLUTE /end AXIS_PTS
/begin AXIS_PTS GAX_KF_EHUB_NORM_LAST "Nkw_bls" 0x8071DAF8 NO_INPUT_QUANTITY _REC_A1AXS_1_MBSE_S2 65535 caoddzd_oAjpfzb_cAcEEha_1nR_oa0 20 -32768 32767 FORMAT "%5.0" DEPOSIT ABSOLUTE /end AXIS_PTS
/begin AXIS_PTS GAX_KF_ESPR_NORM_PF1 "Nkw" 0x8071B5A0 NO_INPUT_QUANTITY _REC_A1AXS_1_MBSE_S2 65535 caoddzd_oAjpfzb_cAcEEha_1nR_oa0 16 -32768 32767 FORMAT "%5.0" DEPOSIT ABSOLUTE /end AXIS_PTS
/begin AXIS_PTS GAX_KF_ESPR_NORM_PF2 "Nkw" 0x8071B580 NO_INPUT_QUANTITY _REC_A1AXS_1_MBSE_S2 65535 caoddzd_oAjpfzb_cAcEEha_1nR_oa0 16 -32768 32767 FORMAT "%5.0" DEPOSIT ABSOLUTE /end AXIS_PTS
/begin AXIS_PTS GAY_KF_ASPR_NORM_PF1 "Rfv_vns" 0x8071AA26 NO_INPUT_QUANTITY _REC_A1AXS_1_MBSE_S2 655.35 CgkBooc_wkiDfEd_Czglhgc_fR_1a0o 12 -327.68 327.67 FORMAT "%9.2" DEPOSIT ABSOLUTE /end AXIS_PTS
/begin AXIS_PTS GAY_KF_ASPR_NORM_PF2 "Rfv_vns" 0x8071AA0E NO_INPUT_QUANTITY _REC_A1AXS_1_MBSE_S2 655.35 CgkBooc_wkiDfEd_Czglhgc_fR_1a0o 12 -327.68 327.67 FORMAT "%9.2" DEPOSIT ABSOLUTE /end AXIS_PTS
/begin AXIS_PTS GAY_KF_EHUB_NORM_LAST "Rfv_hub_kor" 0x8071DAC0 NO_INPUT_QUANTITY _REC_A1AXS_1_MBSE_S2 655.35 CgkBooc_wkiDfEd_Czglhgc_fR_1a0o 20 -327.68 327.67 FORMAT "%9.2" DEPOSIT ABSOLUTE /end AXIS_PTS
/begin AXIS_PTS GAY_KF_ESPR_NORM_PF1 "Rfv_vns" 0x8071B568 NO_INPUT_QUANTITY _REC_A1AXS_1_MBSE_S2 655.35 CgkBooc_wkiDfEd_Czglhgc_fR_1a0o 12 -327.68 327.67 FORMAT "%9.2" DEPOSIT ABSOLUTE /end AXIS_PTS
/begin AXIS_PTS GAY_KF_ESPR_NORM_PF2 "Rfv_vns" 0x8071B550 NO_INPUT_QUANTITY _REC_A1AXS_1_MBSE_S2 655.35 CgkBooc_wkiDfEd_Czglhgc_fR_1a0o 12 -327.68 327.67 FORMAT "%9.2" DEPOSIT ABSOLUTE /end AXIS_PTS
/begin AXIS_PTS IKCtl_LoadAdd04_X_AX "Breakpoint distribution relative filling, 4 breakpoints" 0x80792387 rl_msg Axis_Xu8 191.3 rel_ub_q0p75 4 0 191.3 FORMAT "%5.1" DEPOSIT ABSOLUTE /end AXIS_PTS
/begin AXIS_PTS IKCtl_nEngB16_X_AX "KR: Breakpoint distribution engine speed of group B" 0x807923C8 Epm_nEng Axis_Xs16 32767.5 EngN 16 -16384 16383.5 FORMAT "%8.2" DEPOSIT ABSOLUTE /end AXIS_PTS
/begin CHARACTERISTIC BMWinjmon_vol_HppCmpn_C "Injection delivery volume of high-pressure pump for delivery capacity calculation" VALUE 0x80712290 KwUw 65535 kEEdlBb_gsrEhkd_rmDuAhc_uCRoa0o 0 65535 FORMAT "%6.1" /end CHARACTERISTIC
/begin CHARACTERISTIC BMWlpa_fac_AirLimOvrTMin_C "LoPAsst filling limitation due to electric fuel pump over-temperature factor minimum" VALUE 0x8073B210 KwUw 3.99993896484375 ilxsavd_hkzmBfc_lAzCpAb_nR_1oa0 0 3.99993896484375 /end CHARACTERISTIC
/begin CHARACTERISTIC BMWlpa_rat_AirLimGraNeg_C "Filling limitation due to electric fuel pump negative gradient limitation" VALUE 0x8073B216 KwUw 655.35 CgkBooc_wkiDfEd_Czglhgc_fR_1a0o 0 655.35 /end CHARACTERISTIC
/begin CHARACTERISTIC BMWlpa_rat_AirLimMax_C "Filling limitation due to electric fuel pump maximum value" VALUE 0x8073B212 KwUw 655.35 CgkBooc_wkiDfEd_Czglhgc_fR_1a0o 0 655.35 /end CHARACTERISTIC
/begin CHARACTERISTIC BMWlpa_rat_AirLimMin_C "LoPAsst filling limitation due to electric fuel pump minimum value" VALUE 0x8073B220 CurG_Ws16 655.35 CgkBooc_wkiDfEd_Czglhgc_fR_1a0o -327.68 327.67 /end CHARACTERISTIC
/begin CHARACTERISTIC BMWls_vli_MinGraUp_C "Gradientenbegrenzung für Überblendung auf " VALUE 0x8071BEFC KwUw 65.535 ohoxkpc_embkBlb_gscheBc_m__aoa0 0 65.535 FORMAT "%7.3" /end CHARACTERISTIC
/begin CHARACTERISTIC BMWmondmf_swi_StallStru_C "Enable / disable engine stall detection" VALUE 0x8075603F FklWUb 1 fgjpsvb_fDqjECa_acgrbDd_n_dae__ 0 1 /end CHARACTERISTIC
/begin CHARACTERISTIC BMWosc_tq_MaxIdlCtlGbx_C "Maximum torque of idle speed control for forming Mdg_fahrer_vm" VALUE 0x8070B98A CurG_Ws16 6553.5 BMW_dm_sw_q0p1_Nm -3276.8 3276.7 /end CHARACTERISTIC
/begin CHARACTERISTIC BMWtchctr_n_PpLimMax_C "Max RPM limit for activation of P-component limitation during gearbox shift" VALUE 0x80720F36 CurG_Ws16 65535 caoddzd_oAjpfzb_cAcEEha_1nR_oa0 -32768 32767 FORMAT "%5.0" /end CHARACTERISTIC
/begin CHARACTERISTIC BMWtchctr_ti_ToutPpLim_C "Timeout for activation of P-component limitation during gearbox shift" VALUE 0x8074E42D FklWUb 2.55 camcxxd_bxlpdsa_Cshlhgc_sR_1a0o 0 2.55 FORMAT "%5.2" /end CHARACTERISTIC
/begin CHARACTERISTIC BMWtchdiag_rf_SpMin_C "Target filling (from Rf_soll_md, limited between Rf_max and Rf_min)" VALUE 0x807217D8 CurG_Ws16 655.35 CgkBooc_wkiDfEd_Czglhgc_fR_1a0o -327.68 327.67 FORMAT "%6.4" /end CHARACTERISTIC
/begin CHARACTERISTIC BMWtqc_pct_MoPwrRelDifThd_C "Torque coordination, motor power relative difference threshold constant" VALUE 0x8070C50E CurG_Ws16 6.553499999999999 oihanzc_gchDhzc_BADAFBb_nR_1oa0 -3.2768 3.2767 FORMAT "%7.4" /end CHARACTERISTIC
/begin CHARACTERISTIC BMWtqc_pct_MoTqRelDifThd_C "Torque coordination motor torque relative difference threshold constant" VALUE 0x8070C50C CurG_Ws16 6.553499999999999 oihanzc_gchDhzc_BADAFBb_nR_1oa0 -3.2768 3.2767 FORMAT "%7.4" /end CHARACTERISTIC
/begin CHARACTERISTIC BMWtqe_rf_StrTqMaxOfs_C "Torque engine, relative filling start torque maximum offset constant" VALUE 0x8072B02E CurG_Ws16 655.35 ubqeuic_jteCkzd_CDglhgc_nR_1a0o -327.68 327.67 /end CHARACTERISTIC
/begin CHARACTERISTIC CoEng_ratChrgAirCylMaxDesLim_C "Upper limit for filling value requested by the hybrid coordinator" VALUE 0x807818AA KwUw 1535.977 rel_q0p0234 0 1535.977 FORMAT "%8.3" /end CHARACTERISTIC
/begin CHARACTERISTIC EngDa_pwrCrksftMax_C "Maximum engine power at crankshaft level" VALUE 0x8078C1D8 RB_Val_Wr32 16777215.99 DEZ 0.01 16777216 FORMAT "%20.5" /end CHARACTERISTIC
/begin CHARACTERISTIC EngDa_tqCrksftMax_C "Maximum engine torque at crankshaft level" VALUE 0x8078C1DC RB_Val_Wr32 16777215.9 BMW_m_sw_q1p0_Nm 0.1 16777216 FORMAT "%16.5" /end CHARACTERISTIC
/begin CHARACTERISTIC EngDa_tqInnrMax_C "Maximum indicated engine torque" VALUE 0x8078C1E0 RB_Val_Wr32 16777215.9 BMW_m_sw_q1p0_Nm 0.1 16777216 FORMAT "%16.5" /end CHARACTERISTIC
/begin CHARACTERISTIC K_EDA_P_MAX_MOT "Limitation of the calculated engine power" VALUE 0x8070C51C CurG_Ws16 3276.7 oDhhEAa_tuCuntc_ajhfaCa_k__aa0o 0 3276.7 FORMAT "%6.1" /end CHARACTERISTIC
/begin CHARACTERISTIC K_FMDK0_AKT "Maximum k0 torque for activation of k0 torque limitation addition" VALUE 0x8072592E CurG_Ws16 3276.7 BMW_dm_sw_q0p1_Nm 0 3276.7 FORMAT "%4.1" /end CHARACTERISTIC
/begin CHARACTERISTIC K_HFMPLCD_NKW_MX "Mass flow diagnostics release for HFM during coast down, maximum engine speed threshold" VALUE 0x80738AF6 CurG_Ws16 32767 caoddzd_oAjpfzb_cAcEEha_1nR_oa0 0 32767 FORMAT "%5.0" /end CHARACTERISTIC
/begin CHARACTERISTIC K_KSU_INTREG_MX "Maximum value for integral component of PI controller" VALUE 0x80741F50 CurG_Ws16 6553.5 BMW_dm_sw_q0p1_Nm -3276.8 3276.7 /end CHARACTERISTIC
/begin CHARACTERISTIC K_KSU_MDEINGRIFF_MX "Maximum for CltPrt_MdDec" VALUE 0x80741F48 CurG_Ws16 3276.7 BMW_dm_sw_q0p1_Nm 0 3276.7 /end CHARACTERISTIC
/begin CHARACTERISTIC K_KSU_MDEINGRIFFPROP_MN "Minimum for CltPrt_MdDec_P" VALUE 0x80741F4E CurG_Ws16 6553.5 BMW_dm_sw_q0p1_Nm -3276.8 3276.7 /end CHARACTERISTIC
/begin CHARACTERISTIC K_KSU_MDEINGRIFFPROP_MX "Maximum for CltPrt_MdDec_P" VALUE 0x80741F4C CurG_Ws16 6553.5 BMW_dm_sw_q0p1_Nm -3276.8 3276.7 /end CHARACTERISTIC
/begin CHARACTERISTIC K_KSU_MDKBEGKUPDEFEKT "Maximum possible clutch torque with defective sensors or implausible rear axle" VALUE 0x80741F46 CurG_Ws16 3176.7 BMW_dm_sw_q0p1_Nm 100 3276.7 /end CHARACTERISTIC
/begin CHARACTERISTIC K_MDKIST_SOT_MX "Normalization for Mdk_ist_sot_mem_mx" VALUE 0x8070B93C CurG_Ws16 6553.5 BMW_q0p1__ -3276.8 3276.7 FORMAT "%7.1" /end CHARACTERISTIC
/begin CHARACTERISTIC K_NKW_PEMAX "Engine speed at which the engine reaches maximum power" VALUE 0x807230EA CurG_Ws16 10000 caoddzd_oAjpfzb_cAcEEha_1nR_oa0 0 10000 FORMAT "%5.0" /end CHARACTERISTIC
/begin CHARACTERISTIC K_RFMIN_KRSTSYS "Minimum filling limitation from fuel system monitoring" VALUE 0x8071237E CurG_Ws16 655.35 CgkBooc_wkiDfEd_Czglhgc_fR_1a0o -327.68 327.67 FORMAT "%6.2" /end CHARACTERISTIC
/begin CHARACTERISTIC K_RFVIST_MX "MAX limit Rfv_ist from N.N." VALUE 0x8070FE06 CurG_Ws16 655.35 CgkBooc_wkiDfEd_Czglhgc_fR_1a0o -327.68 327.67 FORMAT "%7.2" /end CHARACTERISTIC
/begin CHARACTERISTIC MoF_trqNorm1_C "Maximum indicated engine torque for torque normalization" VALUE 0x8076228A KwUw 32766 BMW_m_sw_q1p0_Nm 1 32767 FORMAT "%8.2" /end CHARACTERISTIC
/begin CHARACTERISTIC MoFETC_tiAccExcddThd_C "Time threshold for exceeded acceleration" VALUE 0x80761F68 KwUw 65535 BMW_q1_millisecond 0 65535 FORMAT "%8.2" /end CHARACTERISTIC
/begin CHARACTERISTIC MoFTrqAct_nThd_C "RPM threshold above which MoFTrqAct_Eng is active" VALUE 0x80762240 CurG_Ws16 32767.5 n_sw_q0p5 -16384 16383.5 FORMAT "%8.2" /end CHARACTERISTIC
/begin CHARACTERISTIC MoFTrqAct_trqPtdInjActv_C "Maximum permitted actual torque, injections active" VALUE 0x80762280 CurG_Ws16 6553.5 BMW_dm_sw_q0p1_Nm -3276.8 3276.7 FORMAT "%8.3" /end CHARACTERISTIC
/begin CHARACTERISTIC MoFTrqPtd_pwrMax_C "Maximum combustion engine power in function monitoring" VALUE 0x80761D9E KwUw 1023.984 leist_q0p015625_kW 0 1023.984 FORMAT "%8.3" /end CHARACTERISTIC
/begin CHARACTERISTIC MoFTrqPtd_tqCluMax_C "Maximum combustion engine torque at clutch in function monitoring" VALUE 0x80761E34 CurG_Ws16 6553.5 BMW_dm_sw_q0p1_Nm -3276.8 3276.7 FORMAT "%8.3" /end CHARACTERISTIC
/begin CHARACTERISTIC S_BSRFMX "Switch for filling limitation at component protection rich running limit" VALUE 0x8074D1B1 FklWUb 1 raChrxc_kBtBrmb_FmDuEFa_n__aa0o 0 1 FORMAT "%3.0" /end CHARACTERISTIC
/begin CHARACTERISTIC S_NMX_VM "Switch for determining N_vm_max (value = 0, 1 or 2)" VALUE 0x80753186 FklWUb 255 raChrxc_kBtBrmb_FmDuEFa_n__aa0o 0 255 FORMAT "%3.0" /end CHARACTERISTIC
/begin CHARACTERISTIC VROHMAX "Maximum permitted raw speed for signal range check" VALUE 0x8078A5C6 KwUw 511.9922 vfzg_uw_b512 0 511.9922 FORMAT "%8.4" /end CHARACTERISTIC
/begin CHARACTERISTIC BMWgpfdiag_rf_LimPclFilMin_T "Lower safeguard for relative filling limit by the GPF. Even with a fully loaded GPF, the filling limit cannot drop below this value." CURVE 0x8073B352 _REC_A1CUR_1_MBSE_S2_S1 655.35 CgkBooc_wkiDfEd_Czglhgc_fR_1a0o -327.68 327.67
 /begin AXIS_DESCR COM_AXIS Nkw caoddzd_oAjpfzb_cAcEEha_1nR_oa0 4 -32768 32767 AXIS_PTS_REF BMWgpfdiag_rf_LimPclFilMin_Ax FORMAT "%5.0" MONOTONY STRICT_INCREASE DEPOSIT ABSOLUTE /end AXIS_DESCR
/end CHARACTERISTIC
/begin CHARACTERISTIC BMWinjafs_fac_RatAirMax_T "Curve upper limit Rf for stoichiometric lambda adaptation" CURVE 0x80711206 _REC_A1CUR_1_MBSE_S2_S1 655.35 ubqeuic_jteCkzd_CDglhgc_nR_1a0o -327.68 327.67
 /begin AXIS_DESCR COM_AXIS Nkw caoddzd_oAjpfzb_cAcEEha_1nR_oa0 6 -32768 32767 AXIS_PTS_REF BMWinjafs_fac_RatAirMax_Ax FORMAT "%5.0" MONOTONY STRICT_INCREASE DEPOSIT ABSOLUTE /end AXIS_DESCR
/end CHARACTERISTIC
/begin CHARACTERISTIC BMWlpa_rat_EfpPwm_T "Electric fuel pump speed control via PWM" CURVE 0x80716D7E _REC_A1CUR_1_MBSE_S2_S1 655.35 ubqeuic_jteCkzd_CDglhgc_nR_1a0o -327.68 327.67 FORMAT "%5.2"
 /begin AXIS_DESCR COM_AXIS BMWlpa_n_Efp_uw caoddzd_oAjpfzb_cAcEEha_1nR_oa0 6 0 65535 AXIS_PTS_REF BMWlpa_rat_EfpPwm_Ax FORMAT "%5.0" MONOTONY STRICT_INCREASE DEPOSIT ABSOLUTE /end AXIS_DESCR
/end CHARACTERISTIC
/begin CHARACTERISTIC BMWls_pct_FiMaxCondRisk_T "Maximale Fuellung ueber Drehzahl aufgrund von Kondesatrisiko am Ladeluftkuehler" CURVE 0x8071B9D8 _REC_A1CUR_1_MBSE_S2_S1 655.35 CgkBooc_wkiDfEd_Czglhgc_fR_1a0o -327.68 327.67 FORMAT "%7.2"
 /begin AXIS_DESCR COM_AXIS NO_INPUT_QUANTITY caoddzd_oAjpfzb_cAcEEha_1nR_oa0 12 -32768 32767 AXIS_PTS_REF BMWls_pct_FiMaxCondRisk_Ax FORMAT "%5.0" MONOTONY MON_INCREASE DEPOSIT ABSOLUTE /end AXIS_DESCR
/end CHARACTERISTIC
/begin CHARACTERISTIC BMWtchco_fac_FadePl_T "Crossfade factor for boost pressure feedforward for part-load operation" CURVE 0x8074E413 _REC_A1CUR_1_MBSE_U1_S1 0.99609375 BMW_Powertrain_DxECompuMethods_Def_ub_b1_nounit 0 0.99609375 FORMAT "%10.3"
 /begin AXIS_DESCR COM_AXIS NO_INPUT_QUANTITY acriqBc_tfkBqod_ocgjxzc_nR_8oa0 6 0 7.9998779296875 AXIS_PTS_REF BMWtchco_fac_FadePl_Ax FORMAT "%11.4" MONOTONY STRICT_INCREASE DEPOSIT ABSOLUTE /end AXIS_DESCR
/end CHARACTERISTIC
/begin CHARACTERISTIC BMWtchctr_fac_Dp_T "Correction factor for D-component of power-based boost pressure controller" CURVE 0x80721666 _REC_A1CUR_1_MBSE_U2_S1 15.999755859375 BumqDkc_mryszAa_EcglxAc_nR_4oa0 0 15.999755859375 FORMAT "%10.3"
 /begin AXIS_DESCR COM_AXIS BMWtchctr_pwr_Pctl_uw jucyrzb_bpFgwfd_uqrfhgc_k__aoa0 6 0 127.998046875 AXIS_PTS_REF BMWtchctr_fac_Dp_Ax FORMAT "%7.3" MONOTONY STRICT_INCREASE DEPOSIT ABSOLUTE /end AXIS_DESCR
/end CHARACTERISTIC
/begin CHARACTERISTIC BMWtchctr_fac_DpDyn_T "Correction factor for D-component of power-based boost pressure controller" CURVE 0x80721672 _REC_A1CUR_1_MBSE_U2_S1 15.999755859375 BumqDkc_mryszAa_EcglxAc_nR_4oa0 0 15.999755859375 FORMAT "%10.3"
 /begin AXIS_DESCR COM_AXIS BMWtchctr_pwr_Pctl_uw jucyrzb_bpFgwfd_uqrfhgc_k__aoa0 6 0 127.998046875 AXIS_PTS_REF BMWtchctr_fac_DpDyn_Ax FORMAT "%7.3" MONOTONY STRICT_INCREASE DEPOSIT ABSOLUTE /end AXIS_DESCR
/end CHARACTERISTIC
/begin CHARACTERISTIC BMWtchout_pct_WgBlwOff_T "Setpoint for wastegate position during blow-off valve active" CURVE 0x80721D6E _REC_A1CUR_1_MBSE_U2_S1 99.9984741210938 Ejmqric_wgjqjja_AvCkvxb_fR_6o0o 0 99.9984741210938 FORMAT "%10.3"
 /begin AXIS_DESCR COM_AXIS Nkw caoddzd_oAjpfzb_cAcEEha_1nR_oa0 4 -32768 32767 AXIS_PTS_REF BMWtchout_pct_WgBlwOff_Ax FORMAT "%5.0" MONOTONY STRICT_INCREASE DEPOSIT ABSOLUTE /end AXIS_DESCR
/end CHARACTERISTIC
/begin CHARACTERISTIC BMWtchsp_rf_Liho_T "Relative filling limitation for turbocharger variants in fault condition (b_atlerr_md)" CURVE 0x80721E72 _REC_A1CUR_1_MBSE_S2_S1 655.35 CgkBooc_wkiDfEd_Czglhgc_fR_1a0o -327.68 327.67
 /begin AXIS_DESCR COM_AXIS NO_INPUT_QUANTITY caoddzd_oAjpfzb_cAcEEha_1nR_oa0 6 -32768 32767 AXIS_PTS_REF BMWtchsp_rf_Liho_Ax FORMAT "%5.0" MONOTONY STRICT_INCREASE DEPOSIT ABSOLUTE /end AXIS_DESCR
/end CHARACTERISTIC
/begin CHARACTERISTIC BMWtqe_n_SpdMaxEmiRedn_T "Torque engine, speed maximum emission reduction curve" CURVE 0x8072B20E _REC_A1CUR_1_MBSE_S2_S1 65535 caoddzd_oAjpfzb_cAcEEha_1nR_oa0 -32768 32767 FORMAT "%6.0"
 /begin AXIS_DESCR COM_AXIS BMWtqe_fac_EmiRednColdCat FzbmlAa_gCtylrb_ckCqxAc_nR_6oa0 4 0 0.999984741210938 AXIS_PTS_REF BMWtqe_n_SpdMaxEmiRedn_Ax FORMAT "%14.5" MONOTONY STRICT_INCREASE DEPOSIT ABSOLUTE /end AXIS_DESCR
/end CHARACTERISTIC
/begin CHARACTERISTIC BMWtqe_tqc_FlApplStgNorm_T "Torque engine crankshaft full load application stage normal curve" CURVE 0x8072A7C6 _REC_A1CUR_1_MBSE_S2_S1 6553.5 BMW_dm_sw_q0p1_Nm -3276.8 3276.7 FORMAT "%6.1"
 /begin AXIS_DESCR COM_AXIS Nkw_ref caoddzd_oAjpfzb_cAcEEha_1nR_oa0 18 -32768 32767 AXIS_PTS_REF BMWtqe_tqc_FlApplStg_Ax MONOTONY STRICT_INCREASE DEPOSIT ABSOLUTE /end AXIS_DESCR
/end CHARACTERISTIC
/begin CHARACTERISTIC BMWtqe_tqc_FlApplStgPwr1_T "Torque engine, crankshaft torque full load application stage power 1 curve" CURVE 0x8072A7A2 _REC_A1CUR_1_MBSE_S2_S1 6553.5 BMW_dm_sw_q0p1_Nm -3276.8 3276.7 FORMAT "%6.1"
 /begin AXIS_DESCR COM_AXIS Nkw_ref caoddzd_oAjpfzb_cAcEEha_1nR_oa0 18 -32768 32767 AXIS_PTS_REF BMWtqe_tqc_FlApplStg_Ax MONOTONY STRICT_INCREASE DEPOSIT ABSOLUTE /end AXIS_DESCR
/end CHARACTERISTIC
/begin CHARACTERISTIC BMWtqe_tqc_FlApplStgPwr2_T "Torque engine, crankshaft torque full load application stage power 2 curve" CURVE 0x8072A77E _REC_A1CUR_1_MBSE_S2_S1 6553.5 BMW_dm_sw_q0p1_Nm -3276.8 3276.7 FORMAT "%6.1"
 /begin AXIS_DESCR COM_AXIS Nkw_ref caoddzd_oAjpfzb_cAcEEha_1nR_oa0 18 -32768 32767 AXIS_PTS_REF BMWtqe_tqc_FlApplStg_Ax MONOTONY STRICT_INCREASE DEPOSIT ABSOLUTE /end AXIS_DESCR
/end CHARACTERISTIC
/begin CHARACTERISTIC BMWtqe_tqc_FlApplStgPwrHi_T "Torque Engine(Moment Verbrennungsmotor) torque crank shaft(Drehmoment Kurbelwelle) fulload(Vollast) application(Anwendung) Stage(Stufe) power(Kraft, Leistung) high(hoch) curve, table(Kennlinie)" CURVE 0x8072A75A _REC_A1CUR_1_MBSE_S2_S1 6553.5 BMW_dm_sw_q0p1_Nm -3276.8 3276.7 FORMAT "%6.1"
 /begin AXIS_DESCR COM_AXIS Nkw_ref caoddzd_oAjpfzb_cAcEEha_1nR_oa0 18 -32768 32767 AXIS_PTS_REF BMWtqe_tqc_FlApplStg_Ax MONOTONY STRICT_INCREASE DEPOSIT ABSOLUTE /end AXIS_DESCR
/end CHARACTERISTIC
/begin CHARACTERISTIC BMWtqe_tqi_EngLimdEmiThd_T "Torque engine, inner torque engine limited emission threshold curve" CURVE 0x8072A1EA _REC_A1CUR_1_MBSE_S2_S1 6553.5 BMW_dm_sw_q0p1_Nm -3276.8 3276.7 FORMAT "%6.1"
 /begin AXIS_DESCR COM_AXIS Nkw_ref caoddzd_oAjpfzb_cAcEEha_1nR_oa0 7 -32768 32767 AXIS_PTS_REF BMWtqe_tqi_EngLimdEmiThd_Ax MONOTONY STRICT_INCREASE DEPOSIT ABSOLUTE /end AXIS_DESCR
/end CHARACTERISTIC
/begin CHARACTERISTIC KL_DKVL "Maximum value for throttle setpoint (only for S_WDKSVL_VAR=1)" CURVE 0x8074ACAE _REC_A1CUR_1_MBSE_U2_S1 100 vfyBdwd_ftexgja_BcFdiDd_fR_1a0o 0 100 FORMAT "%7.2"
 /begin AXIS_DESCR COM_AXIS NO_INPUT_QUANTITY caoddzd_oAjpfzb_cAcEEha_1nR_oa0 8 -32768 32767 AXIS_PTS_REF AXX_KL_DKVL FORMAT "%5.0" MONOTONY MON_INCREASE DEPOSIT ABSOLUTE /end AXIS_DESCR
/end CHARACTERISTIC
/begin CHARACTERISTIC KL_ENA_NREG_DSC "Curves DSC mode" CURVE 0x8074EB66 _REC_A1CUR_1_MBSE_U1_S1 255 raChrxc_kBtBrmb_FmDuEFa_n__aa0o 0 255
 /begin AXIS_DESCR COM_AXIS NO_INPUT_QUANTITY raChrxc_kBtBrmb_FmDuEFa_n__aa0o 6 0 255 AXIS_PTS_REF AXX_KL_ENA_NREG_DSC MONOTONY STRICT_INCREASE DEPOSIT ABSOLUTE /end AXIS_DESCR
/end CHARACTERISTIC
/begin CHARACTERISTIC KL_FRFMXBS "Curve factor for filling intervention at component protection rich running limit" CURVE 0x80714F42 _REC_A1CUR_1_MBSE_U2_S1 1.99996948242188 Bhvfwhc_bigEubd_BBEupBd_nR_3oa0 0 1.99996948242188 FORMAT "%14.5"
 /begin AXIS_DESCR COM_AXIS NO_INPUT_QUANTITY Bhvfwhc_bigEubd_BBEupBd_nR_3oa0 4 0 1.99996948242188 AXIS_PTS_REF AXX_KL_FRFMXBS FORMAT "%14.5" MONOTONY STRICT_INCREASE DEPOSIT ABSOLUTE /end AXIS_DESCR
/end CHARACTERISTIC
/begin CHARACTERISTIC KL_LAMX "Maximum relative filling" CURVE 0x8071BA90 _REC_A1CUR_1_MBSE_S2_S1 327.67 CgkBooc_wkiDfEd_Czglhgc_fR_1a0o 0 327.67 FORMAT "%7.2"
 /begin AXIS_DESCR COM_AXIS NO_INPUT_QUANTITY caoddzd_oAjpfzb_cAcEEha_1nR_oa0 18 -32768 32767 AXIS_PTS_REF AXX_KL_LAMX FORMAT "%5.0" MONOTONY MON_INCREASE DEPOSIT ABSOLUTE /end AXIS_DESCR
/end CHARACTERISTIC
/begin CHARACTERISTIC KL_LAND_MDKMAX_VAR1 "Torque limitation for country variant 1" CURVE 0x8072A186 _REC_A1CUR_1_MBSE_S2_S1 6553.5 BMW_dm_sw_q0p1_Nm -3276.8 3276.7 FORMAT "%7.1"
 /begin AXIS_DESCR COM_AXIS Nkw_ref caoddzd_oAjpfzb_cAcEEha_1nR_oa0 18 -32768 32767 AXIS_PTS_REF AXX_KL_LAND_MDKMAX_VAR MONOTONY STRICT_INCREASE DEPOSIT ABSOLUTE /end AXIS_DESCR
/end CHARACTERISTIC
/begin CHARACTERISTIC KL_LAND_MDKMAX_VAR2 "Torque limitation for country variant 2" CURVE 0x8072A162 _REC_A1CUR_1_MBSE_S2_S1 6553.5 BMW_dm_sw_q0p1_Nm -3276.8 3276.7 FORMAT "%7.1"
 /begin AXIS_DESCR COM_AXIS Nkw_ref caoddzd_oAjpfzb_cAcEEha_1nR_oa0 18 -32768 32767 AXIS_PTS_REF AXX_KL_LAND_MDKMAX_VAR MONOTONY STRICT_INCREASE DEPOSIT ABSOLUTE /end AXIS_DESCR
/end CHARACTERISTIC
/begin CHARACTERISTIC KL_LAND_MDKMAX_VAR3 "Torque limitation for country variant 3" CURVE 0x8072A13E _REC_A1CUR_1_MBSE_S2_S1 6553.5 BMW_dm_sw_q0p1_Nm -3276.8 3276.7 FORMAT "%7.1"
 /begin AXIS_DESCR COM_AXIS Nkw_ref caoddzd_oAjpfzb_cAcEEha_1nR_oa0 18 -32768 32767 AXIS_PTS_REF AXX_KL_LAND_MDKMAX_VAR MONOTONY STRICT_INCREASE DEPOSIT ABSOLUTE /end AXIS_DESCR
/end CHARACTERISTIC
/begin CHARACTERISTIC KL_LAND_MDKMAX_VAR4 "Torque limitation for country variant 4" CURVE 0x8072A11A _REC_A1CUR_1_MBSE_S2_S1 6553.5 BMW_dm_sw_q0p1_Nm -3276.8 3276.7 FORMAT "%7.1"
 /begin AXIS_DESCR COM_AXIS Nkw_ref caoddzd_oAjpfzb_cAcEEha_1nR_oa0 18 -32768 32767 AXIS_PTS_REF AXX_KL_LAND_MDKMAX_VAR MONOTONY STRICT_INCREASE DEPOSIT ABSOLUTE /end AXIS_DESCR
/end CHARACTERISTIC
/begin CHARACTERISTIC KL_LAND_MDKMAX_VAR5 "Torque limitation for country variant 5" CURVE 0x8072A0F6 _REC_A1CUR_1_MBSE_S2_S1 6553.5 BMW_dm_sw_q0p1_Nm -3276.8 3276.7 FORMAT "%7.1"
 /begin AXIS_DESCR COM_AXIS Nkw_ref caoddzd_oAjpfzb_cAcEEha_1nR_oa0 18 -32768 32767 AXIS_PTS_REF AXX_KL_LAND_MDKMAX_VAR MONOTONY STRICT_INCREASE DEPOSIT ABSOLUTE /end AXIS_DESCR
/end CHARACTERISTIC
/begin CHARACTERISTIC KL_LAND_MDKMAX_VAR6 "Torque limitation for country variant 6" CURVE 0x8072A0D2 _REC_A1CUR_1_MBSE_S2_S1 6553.5 BMW_dm_sw_q0p1_Nm -3276.8 3276.7 FORMAT "%7.1"
 /begin AXIS_DESCR COM_AXIS Nkw_ref caoddzd_oAjpfzb_cAcEEha_1nR_oa0 18 -32768 32767 AXIS_PTS_REF AXX_KL_LAND_MDKMAX_VAR MONOTONY STRICT_INCREASE DEPOSIT ABSOLUTE /end AXIS_DESCR
/end CHARACTERISTIC
/begin CHARACTERISTIC KL_LAND_MDKMAX_VAR7 "Torque limitation for country variant 7" CURVE 0x8072A0AE _REC_A1CUR_1_MBSE_S2_S1 6553.5 BMW_dm_sw_q0p1_Nm -3276.8 3276.7 FORMAT "%7.1"
 /begin AXIS_DESCR COM_AXIS Nkw_ref caoddzd_oAjpfzb_cAcEEha_1nR_oa0 18 -32768 32767 AXIS_PTS_REF AXX_KL_LAND_MDKMAX_VAR MONOTONY STRICT_INCREASE DEPOSIT ABSOLUTE /end AXIS_DESCR
/end CHARACTERISTIC
/begin CHARACTERISTIC KL_MD_K_MAX_BST "Speed-dependent boost curve of the combustion engine (Nkw_opt)" CURVE 0x8072B6DA _REC_A1CUR_1_MBSE_S2_S1 65535 lFwocba_tlxgpab_wmDuExd_NCRoa0o -32768 32767
 /begin AXIS_DESCR COM_AXIS Nkw_opt caoddzd_oAjpfzb_cAcEEha_1nR_oa0 12 -32768 32767 AXIS_PTS_REF AXX_KL_MD_K_MAX_BST FORMAT "%5.0" MONOTONY STRICT_INCREASE DEPOSIT ABSOLUTE /end AXIS_DESCR
/end CHARACTERISTIC
/begin CHARACTERISTIC KL_MD_K_MAX_BST_HS "Speed-dependent boost curve of the combustion engine (Nkw_opt) for manual transmission" CURVE 0x8072B6C2 _REC_A1CUR_1_MBSE_S2_S1 65535 lFwocba_tlxgpab_wmDuExd_NCRoa0o -32768 32767
 /begin AXIS_DESCR COM_AXIS Nkw_opt caoddzd_oAjpfzb_cAcEEha_1nR_oa0 12 -32768 32767 AXIS_PTS_REF AXX_KL_MD_K_MAX_BST_HS FORMAT "%5.0" MONOTONY STRICT_INCREASE DEPOSIT ABSOLUTE /end AXIS_DESCR
/end CHARACTERISTIC
/begin CHARACTERISTIC KL_MD_K_MAX_BST_STRG_AT "Speed-dependent strategic gearbox input limit during boost for automatic transmission" CURVE 0x807417A6 _REC_A1CUR_1_MBSE_S2_S1 6553.5 BMW_dm_sw_q0p1_Nm -3276.8 3276.7 FORMAT "%4.1"
 /begin AXIS_DESCR COM_AXIS NO_INPUT_QUANTITY raChrxc_kBtBrmb_FmDuEFa_n__aa0o 12 -32768 32767 AXIS_PTS_REF AXX_KL_MD_K_MAX_BST_STRG_AT FORMAT "%6.0" MONOTONY STRICT_INCREASE DEPOSIT ABSOLUTE /end AXIS_DESCR
/end CHARACTERISTIC
/begin CHARACTERISTIC KL_MD_K_MAX_BST_STRG_AT_VAR "Drehzahlabhängige strategische Getriebeeingangbegrenzung während Boosten für Automat" CURVE 0x8074178E _REC_A1CUR_1_MBSE_S2_S1 6553.5 BMW_dm_sw_q0p1_Nm -3276.8 3276.7 FORMAT "%4.1"
 /begin AXIS_DESCR COM_AXIS NO_INPUT_QUANTITY raChrxc_kBtBrmb_FmDuEFa_n__aa0o 12 -32768 32767 AXIS_PTS_REF AXX_KL_MD_K_MAX_BST_STRG_AT FORMAT "%6.0" MONOTONY STRICT_INCREASE DEPOSIT ABSOLUTE /end AXIS_DESCR
/end CHARACTERISTIC
/begin CHARACTERISTIC KL_MD_K_MAX_BST_STRG_HS "Speed-dependent strategic gearbox input limit during boost for manual transmission" CURVE 0x80741776 _REC_A1CUR_1_MBSE_S2_S1 6553.5 BMW_dm_sw_q0p1_Nm -3276.8 3276.7 FORMAT "%4.1"
 /begin AXIS_DESCR COM_AXIS NO_INPUT_QUANTITY raChrxc_kBtBrmb_FmDuEFa_n__aa0o 12 -32768 32767 AXIS_PTS_REF AXX_KL_MD_K_MAX_BST_STRG_HS FORMAT "%6.0" MONOTONY STRICT_INCREASE DEPOSIT ABSOLUTE /end AXIS_DESCR
/end CHARACTERISTIC
/begin CHARACTERISTIC KL_MD_K_MAX_PB "Drehzahlabhängige PowerBoost-Kennlinie des Verbrennungsmotors (Nkw_opt)" CURVE 0x8072B6AA _REC_A1CUR_1_MBSE_S2_S1 65535 lFwocba_tlxgpab_wmDuExd_NCRoa0o -32768 32767
 /begin AXIS_DESCR COM_AXIS Nkw_opt caoddzd_oAjpfzb_cAcEEha_1nR_oa0 12 -32768 32767 AXIS_PTS_REF AXX_KL_MD_K_MAX_PB FORMAT "%5.0" MONOTONY STRICT_INCREASE DEPOSIT ABSOLUTE /end AXIS_DESCR
/end CHARACTERISTIC
/begin CHARACTERISTIC KL_MD_K_MAX_PB_STRG_AT "Drehzahlabhängige strategische Getriebeeingangbegrenzung während Powerboost für Automat" CURVE 0x8074175E _REC_A1CUR_1_MBSE_S2_S1 6553.5 BMW_dm_sw_q0p1_Nm -3276.8 3276.7 FORMAT "%4.1"
 /begin AXIS_DESCR COM_AXIS NO_INPUT_QUANTITY raChrxc_kBtBrmb_FmDuEFa_n__aa0o 12 -32768 32767 AXIS_PTS_REF AXX_KL_MD_K_MAX_PB_STRG_AT FORMAT "%6.0" MONOTONY STRICT_INCREASE DEPOSIT ABSOLUTE /end AXIS_DESCR
/end CHARACTERISTIC
/begin CHARACTERISTIC KL_MD_K_MAX_PB_STRG_AT_VAR "Drehzahlabhängige strategische Getriebeeingangbegrenzung während Powerboost für Automat" CURVE 0x80741746 _REC_A1CUR_1_MBSE_S2_S1 6553.5 BMW_dm_sw_q0p1_Nm -3276.8 3276.7 FORMAT "%4.1"
 /begin AXIS_DESCR COM_AXIS NO_INPUT_QUANTITY raChrxc_kBtBrmb_FmDuEFa_n__aa0o 12 -32768 32767 AXIS_PTS_REF AXX_KL_MD_K_MAX_PB_STRG_AT FORMAT "%6.0" MONOTONY STRICT_INCREASE DEPOSIT ABSOLUTE /end AXIS_DESCR
/end CHARACTERISTIC
/begin CHARACTERISTIC KL_MD_K_MAX_RNSTART_STRG_HS "Speed-dependent strategic gearbox input limit during launch control for manual transmission" CURVE 0x8074172E _REC_A1CUR_1_MBSE_S2_S1 6553.5 BMW_dm_sw_q0p1_Nm -3276.8 3276.7 FORMAT "%4.1"
 /begin AXIS_DESCR COM_AXIS NO_INPUT_QUANTITY raChrxc_kBtBrmb_FmDuEFa_n__aa0o 12 -32768 32767 AXIS_PTS_REF AXX_KL_MD_K_MAX_RNSTART_STRG_HS FORMAT "%6.0" MONOTONY STRICT_INCREASE DEPOSIT ABSOLUTE /end AXIS_DESCR
/end CHARACTERISTIC
/begin CHARACTERISTIC KL_MD_K_MAX_RST "Speed-dependent launch control curve of the combustion engine (Nkw_opt)" CURVE 0x8072B692 _REC_A1CUR_1_MBSE_S2_S1 65535 lFwocba_tlxgpab_wmDuExd_NCRoa0o -32768 32767
 /begin AXIS_DESCR COM_AXIS Nkw_opt caoddzd_oAjpfzb_cAcEEha_1nR_oa0 12 -32768 32767 AXIS_PTS_REF AXX_KL_MD_K_MAX_RST FORMAT "%5.0" MONOTONY STRICT_INCREASE DEPOSIT ABSOLUTE /end AXIS_DESCR
/end CHARACTERISTIC
/begin CHARACTERISTIC KL_MD_K_MAX_RST_HS "Speed-dependent launch control curve of the combustion engine (Nkw_opt) for manual transmission" CURVE 0x8072B67A _REC_A1CUR_1_MBSE_S2_S1 65535 lFwocba_tlxgpab_wmDuExd_NCRoa0o -32768 32767
 /begin AXIS_DESCR COM_AXIS Nkw_opt caoddzd_oAjpfzb_cAcEEha_1nR_oa0 12 -32768 32767 AXIS_PTS_REF AXX_KL_MD_K_MAX_RST_HS FORMAT "%5.0" MONOTONY STRICT_INCREASE DEPOSIT ABSOLUTE /end AXIS_DESCR
/end CHARACTERISTIC
/begin CHARACTERISTIC KL_MD_K_MAX_RST_STRG_AT "Drehzahlabhängige strategische Getriebeeingangbegrenzung während Rennstart für Automat" CURVE 0x80741716 _REC_A1CUR_1_MBSE_S2_S1 6553.5 BMW_dm_sw_q0p1_Nm -3276.8 3276.7 FORMAT "%4.1"
 /begin AXIS_DESCR COM_AXIS NO_INPUT_QUANTITY raChrxc_kBtBrmb_FmDuEFa_n__aa0o 12 -32768 32767 AXIS_PTS_REF AXX_KL_MD_K_MAX_RST_STRG_AT FORMAT "%6.0" MONOTONY STRICT_INCREASE DEPOSIT ABSOLUTE /end AXIS_DESCR
/end CHARACTERISTIC
/begin CHARACTERISTIC KL_MD_K_MAX_RST_STRG_AT_VAR "Drehzahlabhängige strategische Getriebeeingangbegrenzung während Rennstart für Automat" CURVE 0x807416FE _REC_A1CUR_1_MBSE_S2_S1 6553.5 BMW_dm_sw_q0p1_Nm -3276.8 3276.7 FORMAT "%4.1"
 /begin AXIS_DESCR COM_AXIS NO_INPUT_QUANTITY raChrxc_kBtBrmb_FmDuEFa_n__aa0o 12 -32768 32767 AXIS_PTS_REF AXX_KL_MD_K_MAX_RST_STRG_AT FORMAT "%6.0" MONOTONY STRICT_INCREASE DEPOSIT ABSOLUTE /end AXIS_DESCR
/end CHARACTERISTIC
/begin CHARACTERISTIC KL_MD_K_MAX_SGASSE "Drehzahlabhängige PowerBoost-Kennlinie des Verbrennungsmotors (Nkw_opt)" CURVE 0x8072B662 _REC_A1CUR_1_MBSE_S2_S1 65535 lFwocba_tlxgpab_wmDuExd_NCRoa0o -32768 32767
 /begin AXIS_DESCR COM_AXIS Nkw_opt caoddzd_oAjpfzb_cAcEEha_1nR_oa0 12 -32768 32767 AXIS_PTS_REF AXX_KL_MD_K_MAX_SGASSE FORMAT "%5.0" MONOTONY STRICT_INCREASE DEPOSIT ABSOLUTE /end AXIS_DESCR
/end CHARACTERISTIC
/begin CHARACTERISTIC KL_MD_K_MAX_SGASSE_STRG_AT "Drehzahlabhängige strategische Getriebeeingangbegrenzung während SGASSE für Automat" CURVE 0x807416E6 _REC_A1CUR_1_MBSE_S2_S1 6553.5 BMW_dm_sw_q0p1_Nm -3276.8 3276.7 FORMAT "%4.1"
 /begin AXIS_DESCR COM_AXIS NO_INPUT_QUANTITY raChrxc_kBtBrmb_FmDuEFa_n__aa0o 12 -32768 32767 AXIS_PTS_REF AXX_KL_MD_K_MAX_SGASSE_STRG_AT FORMAT "%6.0" MONOTONY STRICT_INCREASE DEPOSIT ABSOLUTE /end AXIS_DESCR
/end CHARACTERISTIC
/begin CHARACTERISTIC KL_MD_K_MAX_SGASSE_STRG_AT_VAR "Drehzahlabhängige strategische Getriebeeingangbegrenzung während SGASSE für Automat" CURVE 0x807416CE _REC_A1CUR_1_MBSE_S2_S1 6553.5 BMW_dm_sw_q0p1_Nm -3276.8 3276.7 FORMAT "%4.1"
 /begin AXIS_DESCR COM_AXIS NO_INPUT_QUANTITY raChrxc_kBtBrmb_FmDuEFa_n__aa0o 12 -32768 32767 AXIS_PTS_REF AXX_KL_MD_K_MAX_SGASSE_STRG_AT FORMAT "%6.0" MONOTONY STRICT_INCREASE DEPOSIT ABSOLUTE /end AXIS_DESCR
/end CHARACTERISTIC
/begin CHARACTERISTIC KL_MD_K_MAX_VL "Speed-dependent full load curve of the combustion engine (Nkw_opt)" CURVE 0x8072B64A _REC_A1CUR_1_MBSE_S2_S1 65535 lFwocba_tlxgpab_wmDuExd_NCRoa0o -32768 32767
 /begin AXIS_DESCR COM_AXIS Nkw_opt caoddzd_oAjpfzb_cAcEEha_1nR_oa0 12 -32768 32767 AXIS_PTS_REF AXX_KL_MD_K_MAX_VL FORMAT "%5.0" MONOTONY STRICT_INCREASE DEPOSIT ABSOLUTE /end AXIS_DESCR
/end CHARACTERISTIC
/begin CHARACTERISTIC KL_MD_K_MAX_VL_ECO_STRG_HS "Speed-dependent strategic gearbox input limit during eco for manual transmission" CURVE 0x807416B6 _REC_A1CUR_1_MBSE_S2_S1 6553.5 BMW_dm_sw_q0p1_Nm -3276.8 3276.7 FORMAT "%4.1"
 /begin AXIS_DESCR COM_AXIS NO_INPUT_QUANTITY raChrxc_kBtBrmb_FmDuEFa_n__aa0o 12 -32768 32767 AXIS_PTS_REF AXX_KL_MD_K_MAX_VL_ECO_STRG_HS FORMAT "%6.0" MONOTONY STRICT_INCREASE DEPOSIT ABSOLUTE /end AXIS_DESCR
/end CHARACTERISTIC
/begin CHARACTERISTIC KL_MD_K_MAX_VL_HS "Speed-dependent full load curve of the combustion engine (Nkw_opt) for manual transmission" CURVE 0x8072B632 _REC_A1CUR_1_MBSE_S2_S1 65535 lFwocba_tlxgpab_wmDuExd_NCRoa0o -32768 32767
 /begin AXIS_DESCR COM_AXIS Nkw_opt caoddzd_oAjpfzb_cAcEEha_1nR_oa0 12 -32768 32767 AXIS_PTS_REF AXX_KL_MD_K_MAX_VL_HS FORMAT "%5.0" MONOTONY STRICT_INCREASE DEPOSIT ABSOLUTE /end AXIS_DESCR
/end CHARACTERISTIC
/begin CHARACTERISTIC KL_MD_K_MAX_VL_STRG_AT "Drehzahlabhängige strategische Getriebeeingangbegrenzung während Eco für Automat" CURVE 0x8074169E _REC_A1CUR_1_MBSE_S2_S1 6553.5 BMW_dm_sw_q0p1_Nm -3276.8 3276.7 FORMAT "%4.1"
 /begin AXIS_DESCR COM_AXIS NO_INPUT_QUANTITY raChrxc_kBtBrmb_FmDuEFa_n__aa0o 12 -32768 32767 AXIS_PTS_REF AXX_KL_MD_K_MAX_VL_STRG_AT FORMAT "%6.0" MONOTONY STRICT_INCREASE DEPOSIT ABSOLUTE /end AXIS_DESCR
/end CHARACTERISTIC
/begin CHARACTERISTIC KL_MD_K_MAX_VL_STRG_AT_VAR "Drehzahlabhängige strategische Getriebeeingangbegrenzung während Eco für Automat" CURVE 0x80741686 _REC_A1CUR_1_MBSE_S2_S1 6553.5 BMW_dm_sw_q0p1_Nm -3276.8 3276.7 FORMAT "%4.1"
 /begin AXIS_DESCR COM_AXIS NO_INPUT_QUANTITY raChrxc_kBtBrmb_FmDuEFa_n__aa0o 12 -32768 32767 AXIS_PTS_REF AXX_KL_MD_K_MAX_VL_STRG_AT FORMAT "%6.0" MONOTONY STRICT_INCREASE DEPOSIT ABSOLUTE /end AXIS_DESCR
/end CHARACTERISTIC
/begin CHARACTERISTIC KL_MDG_MAX_GANG_AT "Gear-dependent gearbox input limit for automatic transmission" CURVE 0x807418B4 _REC_A1CUR_1_MBSE_S2_S1 6553.5 BMW_dm_sw_q0p1_Nm -3276.8 3276.7 FORMAT "%4.1"
 /begin AXIS_DESCR COM_AXIS NO_INPUT_QUANTITY raChrxc_kBtBrmb_FmDuEFa_n__aa0o 10 -128 127 AXIS_PTS_REF AXX_KL_MDG_MAX_GANG_AT FORMAT "%3.0" MONOTONY STRICT_INCREASE DEPOSIT ABSOLUTE /end AXIS_DESCR
/end CHARACTERISTIC
/begin CHARACTERISTIC KL_MDG_MAX_GANG_HS "Gear-dependent gearbox input limit for manual transmission" CURVE 0x807418A0 _REC_A1CUR_1_MBSE_S2_S1 6553.5 BMW_dm_sw_q0p1_Nm -3276.8 3276.7 FORMAT "%4.1"
 /begin AXIS_DESCR COM_AXIS NO_INPUT_QUANTITY raChrxc_kBtBrmb_FmDuEFa_n__aa0o 10 -128 127 AXIS_PTS_REF AXX_KL_MDG_MAX_GANG_HS FORMAT "%3.0" MONOTONY STRICT_INCREASE DEPOSIT ABSOLUTE /end AXIS_DESCR
/end CHARACTERISTIC
/begin CHARACTERISTIC KL_MDI_MAX_GRD_UP "Curve for the up-gradient of the rate limiter of Mdi_max" CURVE 0x8072A428 _REC_A1CUR_1_MBSE_U2_S1 6553.5 oFojrkc_kDqhmtb_jroomtd_N0__1o0 0 6553.5 FORMAT "%6.1"
 /begin AXIS_DESCR COM_AXIS Mdi_max_diff BMW_dm_sw_q0p1_Nm 6 0 6553.5 AXIS_PTS_REF AXX_KL_MDI_MAX_GRD_UP FORMAT "%6.1" MONOTONY STRICT_INCREASE DEPOSIT ABSOLUTE /end AXIS_DESCR
/end CHARACTERISTIC
/begin CHARACTERISTIC KL_MDIMX_F_TMOT "Factor for limiting Mdi_max depending on engine temperature" CURVE 0x8072A470 _REC_A1CUR_1_MBSE_U2_S1 1 Bhvfwhc_bigEubd_BBEupBd_nR_3oa0 0 1 FORMAT "%7.4"
 /begin AXIS_DESCR COM_AXIS Tmot DchEpAd_DBCFgoa_Ckhahgc_q__aoa0 6 -327.68 327.67 AXIS_PTS_REF AXX_KL_MDIMX_F_TMOT FORMAT "%7.2" MONOTONY STRICT_INCREASE DEPOSIT ABSOLUTE /end AXIS_DESCR
/end CHARACTERISTIC
/begin CHARACTERISTIC KL_MDIMX_VL_APPLZ "KL_MDIMX_VL_APPLZ" CURVE 0x8072A440 _REC_A1CUR_1_MBSE_S2_S1 6553.5 BMW_dm_sw_q0p1_Nm -3276.8 3276.7 FORMAT "%6.1"
 /begin AXIS_DESCR COM_AXIS Nkw_ref caoddzd_oAjpfzb_cAcEEha_1nR_oa0 18 -32768 32767 AXIS_PTS_REF AXX_KL_MDIMX_VL_APPLZ MONOTONY STRICT_INCREASE DEPOSIT ABSOLUTE /end AXIS_DESCR
/end CHARACTERISTIC
/begin CHARACTERISTIC KL_MDRED_NKW "Factor for reducing engine target torque depending on engine speed" CURVE 0x8075851A _REC_A1CUR_1_MBSE_U1_S1 1.9921875 BMW_Powertrain_DxECompuMethods_Def_ub_b2_nounit 0 1.9921875
 /begin AXIS_DESCR COM_AXIS Nkw_wm caoddzd_oAjpfzb_cAcEEha_1nR_oa0 6 -32768 32767 AXIS_PTS_REF AXX_KL_MDRED_NKW MONOTONY STRICT_INCREASE DEPOSIT ABSOLUTE /end AXIS_DESCR
/end CHARACTERISTIC
/begin CHARACTERISTIC KL_RF_MAX "Curve maximum permissible filling over engine speed" CURVE 0x8071B658 _REC_A1CUR_1_MBSE_S2_S1 655.35 CgkBooc_wkiDfEd_Czglhgc_fR_1a0o -327.68 327.67 FORMAT "%7.2"
 /begin AXIS_DESCR COM_AXIS NO_INPUT_QUANTITY caoddzd_oAjpfzb_cAcEEha_1nR_oa0 12 -32768 32767 AXIS_PTS_REF AXX_KL_RF_MAX FORMAT "%5.0" MONOTONY MON_INCREASE DEPOSIT ABSOLUTE /end AXIS_DESCR
/end CHARACTERISTIC
/begin CHARACTERISTIC KL_RF_MAX_UESP "Curve maximum permissible filling over engine speed during scavenging" CURVE 0x8071B640 _REC_A1CUR_1_MBSE_S2_S1 655.35 CgkBooc_wkiDfEd_Czglhgc_fR_1a0o -327.68 327.67 FORMAT "%7.2"
 /begin AXIS_DESCR COM_AXIS NO_INPUT_QUANTITY caoddzd_oAjpfzb_cAcEEha_1nR_oa0 12 -32768 32767 AXIS_PTS_REF AXX_KL_RF_MAX_UESP FORMAT "%5.0" MONOTONY MON_INCREASE DEPOSIT ABSOLUTE /end AXIS_DESCR
/end CHARACTERISTIC
/begin CHARACTERISTIC KL_RFMIN_KRSTSYS "Minimum filling for filling limitation from injection monitoring" CURVE 0x80739892 _REC_A1CUR_1_MBSE_S2_S1 655.35 CgkBooc_wkiDfEd_Czglhgc_fR_1a0o -327.68 327.67 FORMAT "%6.2"
 /begin AXIS_DESCR COM_AXIS Nkw caoddzd_oAjpfzb_cAcEEha_1nR_oa0 8 -32768 32767 AXIS_PTS_REF AXX_KL_RFMIN_KRSTSYS FORMAT "%5.0" MONOTONY STRICT_INCREASE DEPOSIT ABSOLUTE /end AXIS_DESCR
/end CHARACTERISTIC
/begin CHARACTERISTIC KL_RFVHUBDYNKOR "Curve Rfv_hub setpoint at F_rfv_dyn=0" CURVE 0x80719F08 _REC_A1CUR_1_MBSE_S2_S1 327.67 CgkBooc_wkiDfEd_Czglhgc_fR_1a0o 0 327.67 FORMAT "%7.2"
 /begin AXIS_DESCR COM_AXIS NO_INPUT_QUANTITY caoddzd_oAjpfzb_cAcEEha_1nR_oa0 20 -32768 32767 AXIS_PTS_REF AXX_KL_RFVHUBDYNKOR FORMAT "%5.0" MONOTONY MON_INCREASE DEPOSIT ABSOLUTE /end AXIS_DESCR
/end CHARACTERISTIC
/begin CHARACTERISTIC BMWext_lam_CptPronMinLeanTq_M "Lambda lean best torque for limiting the component protection lambda" MAP 0x80714E90 _REC_A1CUR_1_MBSE_U2_S1 15.999755859375 BumqDkc_mryszAa_EcglxAc_nR_4oa0 0 15.999755859375
 /begin AXIS_DESCR COM_AXIS Nkw_atm caoddzd_oAjpfzb_cAcEEha_1nR_oa0 8 -32768 32767 AXIS_PTS_REF BMWext_lam_CptPronMinLeanTq_Ax MONOTONY STRICT_INCREASE DEPOSIT ABSOLUTE /end AXIS_DESCR
 /begin AXIS_DESCR COM_AXIS Rf_atm CgkBooc_wkiDfEd_Czglhgc_fR_1a0o 8 -327.68 327.67 AXIS_PTS_REF BMWext_lam_CptPronMinLeanTq_Ay MONOTONY STRICT_INCREASE DEPOSIT ABSOLUTE /end AXIS_DESCR
/end CHARACTERISTIC
/begin CHARACTERISTIC BMWls_fac_rf_RednFuOctIntkT_M "Base value for the filling reduction factor depending on fuel quality and intake air temperature" MAP 0x8074DB4C _REC_A1CUR_1_MBSE_U1_S1 1 ggDviCc_uydFbsa_CDgnhgc_nR_2a0o 0 1 FORMAT "%6.4"
 /begin AXIS_DESCR COM_AXIS F_octan BMW_Powertrain_DxECompuMethods_Def_ub_b1_nounit 6 0 0.99609375 AXIS_PTS_REF BMWls_fac_rf_RednFuOctIntkT_Ax FORMAT "%6.1" MONOTONY STRICT_INCREASE DEPOSIT ABSOLUTE /end AXIS_DESCR
 /begin AXIS_DESCR COM_AXIS Tans BMW_q0p1_degC 6 -3276.8 3276.7 AXIS_PTS_REF BMWls_fac_rf_RednFuOctIntkT_Ay FORMAT "%6.1" MONOTONY STRICT_INCREASE DEPOSIT ABSOLUTE /end AXIS_DESCR
/end CHARACTERISTIC
/begin CHARACTERISTIC BMWls_pct_FiMaxIgOfs_M "Curve filling limitation depending on ignition angle retard" MAP 0x8071B898 _REC_A1CUR_1_MBSE_S2_S1 655.35 CgkBooc_wkiDfEd_Czglhgc_fR_1a0o -327.68 327.67 FORMAT "%7.2"
 /begin AXIS_DESCR COM_AXIS Nkw caoddzd_oAjpfzb_cAcEEha_1nR_oa0 10 -32768 32767 AXIS_PTS_REF BMWls_pct_FiMaxIgOfs_Gx FORMAT "%5.0" MONOTONY STRICT_INCREASE DEPOSIT ABSOLUTE /end AXIS_DESCR
 /begin AXIS_DESCR COM_AXIS Dzw_tot_kr BMW_q0p1_deg 8 -3276.8 3276.7 AXIS_PTS_REF BMWls_pct_FiMaxIgOfs_Gy FORMAT "%6.1" MONOTONY STRICT_INCREASE DEPOSIT ABSOLUTE /end AXIS_DESCR
/end CHARACTERISTIC
/begin CHARACTERISTIC BMWls_pct_FiMaxIgOfsSpt_M "Curve filling limitation depending on ignition angle retard in sport mode" MAP 0x8071B938 _REC_A1CUR_1_MBSE_S2_S1 655.35 CgkBooc_wkiDfEd_Czglhgc_fR_1a0o -327.68 327.67 FORMAT "%7.2"
 /begin AXIS_DESCR COM_AXIS Nkw caoddzd_oAjpfzb_cAcEEha_1nR_oa0 10 -32768 32767 AXIS_PTS_REF BMWls_pct_FiMaxIgOfs_Gx FORMAT "%5.0" MONOTONY STRICT_INCREASE DEPOSIT ABSOLUTE /end AXIS_DESCR
 /begin AXIS_DESCR COM_AXIS Dzw_tot_kr BMW_q0p1_deg 8 -3276.8 3276.7 AXIS_PTS_REF BMWls_pct_FiMaxIgOfs_Gy FORMAT "%6.1" MONOTONY STRICT_INCREASE DEPOSIT ABSOLUTE /end AXIS_DESCR
/end CHARACTERISTIC
/begin CHARACTERISTIC BMWls_rf_MaxEgT_M "Maximum filling when limited by the component protection controller" MAP 0x8071B850 _REC_A1CUR_1_MBSE_S2_S1 655.35 ubqeuic_jteCkzd_CDglhgc_nR_1a0o -327.68 327.67 FORMAT "%7.2"
 /begin AXIS_DESCR COM_AXIS Nkw caoddzd_oAjpfzb_cAcEEha_1nR_oa0 6 -32768 32767 AXIS_PTS_REF BMWls_rf_MaxEgT_Ax FORMAT "%5.0" MONOTONY STRICT_INCREASE DEPOSIT ABSOLUTE /end AXIS_DESCR
 /begin AXIS_DESCR COM_AXIS Frfmxbsld Bhvfwhc_bigEubd_BBEupBd_nR_3oa0 6 0 1.99996948242188 AXIS_PTS_REF BMWls_rf_MaxEgT_Ay FORMAT "%14.5" MONOTONY STRICT_INCREASE DEPOSIT ABSOLUTE /end AXIS_DESCR
/end CHARACTERISTIC
/begin CHARACTERISTIC BMWls_rf_MaxFuOctIntkT_M "Maximum filling depending on engine speed and filling reduction factor at late combustion center positions due to poor fuel and high manifold temperatures" MAP 0x8071B710 _REC_A1CUR_1_MBSE_S2_S1 655.35 CgkBooc_wkiDfEd_Czglhgc_fR_1a0o -327.68 327.67 FORMAT "%7.2"
 /begin AXIS_DESCR COM_AXIS Nkw caoddzd_oAjpfzb_cAcEEha_1nR_oa0 10 -32768 32767 AXIS_PTS_REF BMWls_pct_FiMaxIgOfs_Gx FORMAT "%5.0" MONOTONY STRICT_INCREASE DEPOSIT ABSOLUTE /end AXIS_DESCR
 /begin AXIS_DESCR COM_AXIS BMWls_fac_rf_RedFil_uw FzbmlAa_gCtylrb_ckCqxAc_nR_6oa0 8 0 0.999984741210938 AXIS_PTS_REF BMWls_rf_MaxFuOctIntkT_Gy FORMAT "%7.5" MONOTONY STRICT_INCREASE DEPOSIT ABSOLUTE /end AXIS_DESCR
/end CHARACTERISTIC
/begin CHARACTERISTIC BMWls_rf_MaxFuOctIntkTSpt_M "Maximum filling depending on engine speed and filling reduction factor at late combustion center positions due to poor fuel and high manifold temperatures in sport mode" MAP 0x8071B7B0 _REC_A1CUR_1_MBSE_S2_S1 655.35 CgkBooc_wkiDfEd_Czglhgc_fR_1a0o -327.68 327.67 FORMAT "%7.2"
 /begin AXIS_DESCR COM_AXIS Nkw caoddzd_oAjpfzb_cAcEEha_1nR_oa0 10 -32768 32767 AXIS_PTS_REF BMWls_pct_FiMaxIgOfs_Gx FORMAT "%5.0" MONOTONY STRICT_INCREASE DEPOSIT ABSOLUTE /end AXIS_DESCR
 /begin AXIS_DESCR COM_AXIS BMWls_fac_rf_RedFil_uw FzbmlAa_gCtylrb_ckCqxAc_nR_6oa0 8 0 0.999984741210938 AXIS_PTS_REF BMWls_rf_MaxFuOctIntkT_Gy FORMAT "%7.5" MONOTONY STRICT_INCREASE DEPOSIT ABSOLUTE /end AXIS_DESCR
/end CHARACTERISTIC
/begin CHARACTERISTIC BMWls_rf_MaxModEng_M "Filling cap for temporary limitation during launch control" MAP 0x8071B670 _REC_A1CUR_1_MBSE_S2_S1 655.35 CgkBooc_wkiDfEd_Czglhgc_fR_1a0o -327.68 327.67 FORMAT "%7.2"
 /begin AXIS_DESCR COM_AXIS Nkw caoddzd_oAjpfzb_cAcEEha_1nR_oa0 10 -32768 32767 AXIS_PTS_REF BMWls_pct_FiMaxIgOfs_Gx FORMAT "%5.0" MONOTONY STRICT_INCREASE DEPOSIT ABSOLUTE /end AXIS_DESCR
 /begin AXIS_DESCR COM_AXIS Dzw_tot_kr BMW_q0p1_deg 8 -3276.8 3276.7 AXIS_PTS_REF BMWls_pct_FiMaxIgOfs_Gy FORMAT "%6.1" MONOTONY STRICT_INCREASE DEPOSIT ABSOLUTE /end AXIS_DESCR
/end CHARACTERISTIC
/begin CHARACTERISTIC BMWtchctr_p_DifCrtnPp_M "Pressure difference correction for P-component of power-based boost pressure controller" MAP 0x8072146E _REC_A1CUR_1_MBSE_S2_S1 8191.875 BMW_p_sw_q0p125_hPa -4096 4095.875 FORMAT "%10.3"
 /begin AXIS_DESCR COM_AXIS BMWtchbas_p_Dif_sw BMW_p_sw_q0p125_hPa 12 -4096 4095.875 AXIS_PTS_REF BMWtchctr_p_DifCrtnPp_Ax FORMAT "%10.3" MONOTONY MON_INCREASE DEPOSIT ABSOLUTE /end AXIS_DESCR
 /begin AXIS_DESCR COM_AXIS BMWtchsp_mf_Ex_uw CByjozc_eCmpBAb_pljBAmd_k__0oa0 6 0 2047.96875 AXIS_PTS_REF BMWtchctr_p_DifCrtnPp_Ay FORMAT "%10.3" MONOTONY STRICT_INCREASE DEPOSIT ABSOLUTE /end AXIS_DESCR
/end CHARACTERISTIC
/begin CHARACTERISTIC BMWtchctr_p_DifCrtnPpDyn_M "Pressure difference correction for P-component of power-based boost pressure controller" MAP 0x807214FE _REC_A1CUR_1_MBSE_S2_S1 8191.875 BMW_p_sw_q0p125_hPa -4096 4095.875 FORMAT "%10.3"
 /begin AXIS_DESCR COM_AXIS BMWtchbas_p_Dif_sw BMW_p_sw_q0p125_hPa 12 -4096 4095.875 AXIS_PTS_REF BMWtchctr_p_DifCrtnPpDyn_Ax FORMAT "%10.3" MONOTONY MON_INCREASE DEPOSIT ABSOLUTE /end AXIS_DESCR
 /begin AXIS_DESCR COM_AXIS BMWtchsp_mf_Ex_uw CByjozc_eCmpBAb_pljBAmd_k__0oa0 6 0 2047.96875 AXIS_PTS_REF BMWtchctr_p_DifCrtnPpDyn_Ay FORMAT "%10.3" MONOTONY STRICT_INCREASE DEPOSIT ABSOLUTE /end AXIS_DESCR
/end CHARACTERISTIC
/begin CHARACTERISTIC BMWtchctr_pct_WgBasc_M "Wastegate position - for feedforward control" MAP 0x80740F3C _REC_A1CUR_1_MBSE_U2_S1 99.9984741210938 wDDoctd_cCDyaFa_AvCkvFb_nR_6o0o 0 99.9984741210938 FORMAT "%10.3"
 /begin AXIS_DESCR COM_AXIS NO_INPUT_QUANTITY ilxsavd_hkzmBfc_lAzCpAb_nR_1oa0 12 0 3.99993896484375 AXIS_PTS_REF BMWtchctr_pct_WgBasc_Ax FORMAT "%14.5" MONOTONY STRICT_INCREASE DEPOSIT ABSOLUTE /end AXIS_DESCR
 /begin AXIS_DESCR COM_AXIS NO_INPUT_QUANTITY CByjozc_eCmpBAb_pljBAmd_k__0oa0 12 0 2047.96875 AXIS_PTS_REF BMWtchctr_pct_WgBasc_Ay FORMAT "%10.3" MONOTONY STRICT_INCREASE DEPOSIT ABSOLUTE /end AXIS_DESCR
/end CHARACTERISTIC
/begin CHARACTERISTIC BMWtchctr_pwr_CmprGra_M "P-component of power-based boost pressure controller. Compressor power gradient by pressure ratio." MAP 0x8072134E _REC_A1CUR_1_MBSE_U2_S1 31.99951171875 lfnAAcd_rfigwsd_gtuuDBc_k__aoa0 0 31.99951171875 FORMAT "%11.4"
 /begin AXIS_DESCR COM_AXIS BMWtchsp_rat_p_CmprLim_uw acriqBc_tfkBqod_ocgjxzc_nR_8oa0 12 0 7.9998779296875 AXIS_PTS_REF BMWtchctr_pwr_CmprGra_Ax FORMAT "%11.4" MONOTONY STRICT_INCREASE DEPOSIT ABSOLUTE /end AXIS_DESCR
 /begin AXIS_DESCR COM_AXIS BMWtchsp_mf_CmprNorm_uw CByjozc_eCmpBAb_pljBAmd_k__0oa0 12 0 2047.96875 AXIS_PTS_REF BMWtchctr_pwr_CmprGra_Ay FORMAT "%10.3" MONOTONY STRICT_INCREASE DEPOSIT ABSOLUTE /end AXIS_DESCR
/end CHARACTERISTIC
/begin CHARACTERISTIC BMWtchctr_pwr_Dp_M "D-component of the power-based boost pressure controller" MAP 0x807211C6 _REC_A1CUR_1_MBSE_S2_S1 127.998046875 jucyrzb_bpFgwfd_uqrfhgc_k__aoa0 -64 63.998046875 FORMAT "%10.3"
 /begin AXIS_DESCR COM_AXIS BMWtchbas_p_Dif_sw BMW_p_sw_q0p125_hPa 14 -4096 4095.875 AXIS_PTS_REF BMWtchctr_pwr_Dp_Ax FORMAT "%10.3" MONOTONY STRICT_INCREASE DEPOSIT ABSOLUTE /end AXIS_DESCR
 /begin AXIS_DESCR COM_AXIS BMWtchbas_p_DifGra_sw BMW_p_sw_q0p125_hPa 14 -4096 4095.875 AXIS_PTS_REF BMWtchctr_pwr_Dp_Ay FORMAT "%10.3" MONOTONY STRICT_INCREASE DEPOSIT ABSOLUTE /end AXIS_DESCR
/end CHARACTERISTIC
/begin CHARACTERISTIC BMWtchctr_pwr_Pctl_M "Compressor map with required compressor / turbine power" MAP 0x80720F46 _REC_A1CUR_1_MBSE_U2_S1 127.998046875 jucyrzb_bpFgwfd_uqrfhgc_k__aoa0 0 127.998046875 FORMAT "%11.4"
 /begin AXIS_DESCR COM_AXIS BMWtchsp_rat_p_CmprLim_uw acriqBc_tfkBqod_ocgjxzc_nR_8oa0 20 0 7.9998779296875 AXIS_PTS_REF BMWtchctr_pwr_Pctl_Ax FORMAT "%11.4" MONOTONY MON_INCREASE DEPOSIT ABSOLUTE /end AXIS_DESCR
 /begin AXIS_DESCR COM_AXIS BMWtchsp_mf_CmprNorm_uw CByjozc_eCmpBAb_pljBAmd_k__0oa0 16 0 2047.96875 AXIS_PTS_REF BMWtchctr_pwr_Pctl_Ay FORMAT "%10.3" MONOTONY STRICT_INCREASE DEPOSIT ABSOLUTE /end AXIS_DESCR
/end CHARACTERISTIC
/begin CHARACTERISTIC BMWtchdiag_pct_WgPHi_M "Controlled variable lower threshold" MAP 0x80721846 _REC_A1CUR_1_MBSE_S2_S1 199.9969482421875 ucttBvd_Byeweeb_zcCvaDc_fR_8a0o -100 99.9969482421875 FORMAT "%10.3"
 /begin AXIS_DESCR COM_AXIS BMWtchbas_p_Dif_sw BMW_p_sw_q0p125_hPa 4 -4096 4095.875 AXIS_PTS_REF BMWtchdiag_pct_WgPHi_Ax FORMAT "%10.3" MONOTONY STRICT_INCREASE DEPOSIT ABSOLUTE /end AXIS_DESCR
 /begin AXIS_DESCR COM_AXIS BMWtchdiag_fac_pwr_TrbPctl_uw acriqBc_tfkBqod_ocgjxzc_nR_8oa0 4 0 7.9998779296875 AXIS_PTS_REF BMWtchdiag_pct_WgPHi_Ay FORMAT "%10.3" MONOTONY STRICT_INCREASE DEPOSIT ABSOLUTE /end AXIS_DESCR
/end CHARACTERISTIC
/begin CHARACTERISTIC BMWtchdiag_pct_WgPLo_M "Controlled variable upper threshold" MAP 0x80721826 _REC_A1CUR_1_MBSE_S2_S1 199.9969482421875 ucttBvd_Byeweeb_zcCvaDc_fR_8a0o -100 99.9969482421875 FORMAT "%10.3"
 /begin AXIS_DESCR COM_AXIS NO_INPUT_QUANTITY BMW_p_sw_q0p125_hPa 4 -4096 4095.875 AXIS_PTS_REF BMWtchdiag_pct_WgPLo_Ax FORMAT "%10.3" MONOTONY STRICT_INCREASE DEPOSIT ABSOLUTE /end AXIS_DESCR
 /begin AXIS_DESCR COM_AXIS BMWtchdiag_fac_pwr_TrbPctl_uw acriqBc_tfkBqod_ocgjxzc_nR_8oa0 4 0 7.9998779296875 AXIS_PTS_REF BMWtchdiag_pct_WgPLo_Ay FORMAT "%10.3" MONOTONY STRICT_INCREASE DEPOSIT ABSOLUTE /end AXIS_DESCR
/end CHARACTERISTIC
/begin CHARACTERISTIC BMWtqe_tqi_MaxEmiRedn_M "Torque engine, inner torque maximum emission reduction map" MAP 0x8072A3CE _REC_A1CUR_1_MBSE_S2_S1 6553.5 BMW_dm_sw_q0p1_Nm -3276.8 3276.7 FORMAT "%6.1"
 /begin AXIS_DESCR COM_AXIS BMWtqe_fac_EmiRednColdCat FzbmlAa_gCtylrb_ckCqxAc_nR_6oa0 5 0 0.999984741210938 AXIS_PTS_REF BMWtqe_tqi_MaxEmiRedn_Ax FORMAT "%7.5" MONOTONY STRICT_INCREASE DEPOSIT ABSOLUTE /end AXIS_DESCR
 /begin AXIS_DESCR COM_AXIS Nkw_ref caoddzd_oAjpfzb_cAcEEha_1nR_oa0 5 -32768 32767 AXIS_PTS_REF BMWtqe_tqi_MaxEmiRedn_Ay FORMAT "%6.0" MONOTONY STRICT_INCREASE DEPOSIT ABSOLUTE /end AXIS_DESCR
/end CHARACTERISTIC
/begin CHARACTERISTIC GKF_ASPR_NORM_KALT_PF1 "Map exhaust spread setpoint (normal operation, cold, path 1)" MAP 0x8071A82A _REC_A1CUR_1_MBSE_U2_S1 204 BMW_q0p1_deg 0 204 FORMAT "%5.2"
 /begin AXIS_DESCR COM_AXIS NO_INPUT_QUANTITY caoddzd_oAjpfzb_cAcEEha_1nR_oa0 16 -32768 32767 AXIS_PTS_REF GAX_KF_ASPR_NORM_PF1 FORMAT "%5.0" MONOTONY MON_INCREASE DEPOSIT ABSOLUTE /end AXIS_DESCR
 /begin AXIS_DESCR COM_AXIS NO_INPUT_QUANTITY CgkBooc_wkiDfEd_Czglhgc_fR_1a0o 12 -327.68 327.67 AXIS_PTS_REF GAY_KF_ASPR_NORM_PF1 FORMAT "%9.2" MONOTONY MON_INCREASE DEPOSIT ABSOLUTE /end AXIS_DESCR
/end CHARACTERISTIC
/begin CHARACTERISTIC GKF_ASPR_NORM_KALT_PF2 "Map exhaust spread setpoint (normal operation, cold, load, path 2)" MAP 0x8071A6AA _REC_A1CUR_1_MBSE_U2_S1 204 BMW_q0p1_deg 0 204 FORMAT "%5.2"
 /begin AXIS_DESCR COM_AXIS NO_INPUT_QUANTITY caoddzd_oAjpfzb_cAcEEha_1nR_oa0 16 -32768 32767 AXIS_PTS_REF GAX_KF_ASPR_NORM_PF2 FORMAT "%5.0" MONOTONY MON_INCREASE DEPOSIT ABSOLUTE /end AXIS_DESCR
 /begin AXIS_DESCR COM_AXIS NO_INPUT_QUANTITY CgkBooc_wkiDfEd_Czglhgc_fR_1a0o 12 -327.68 327.67 AXIS_PTS_REF GAY_KF_ASPR_NORM_PF2 FORMAT "%9.2" MONOTONY MON_INCREASE DEPOSIT ABSOLUTE /end AXIS_DESCR
/end CHARACTERISTIC
/begin CHARACTERISTIC GKF_ASPR_NORM_WARM_PF1 "Map exhaust spread setpoint (normal operation, warm, path 1)" MAP 0x8071A52A _REC_A1CUR_1_MBSE_U2_S1 204 BMW_q0p1_deg 0 204 FORMAT "%5.2"
 /begin AXIS_DESCR COM_AXIS NO_INPUT_QUANTITY caoddzd_oAjpfzb_cAcEEha_1nR_oa0 16 -32768 32767 AXIS_PTS_REF GAX_KF_ASPR_NORM_PF1 FORMAT "%5.0" MONOTONY MON_INCREASE DEPOSIT ABSOLUTE /end AXIS_DESCR
 /begin AXIS_DESCR COM_AXIS NO_INPUT_QUANTITY CgkBooc_wkiDfEd_Czglhgc_fR_1a0o 12 -327.68 327.67 AXIS_PTS_REF GAY_KF_ASPR_NORM_PF1 FORMAT "%9.2" MONOTONY MON_INCREASE DEPOSIT ABSOLUTE /end AXIS_DESCR
/end CHARACTERISTIC
/begin CHARACTERISTIC GKF_ASPR_NORM_WARM_PF2 "Map exhaust spread setpoint (normal operation, warm, path 2)" MAP 0x8071A3AA _REC_A1CUR_1_MBSE_U2_S1 204 BMW_q0p1_deg 0 204 FORMAT "%5.2"
 /begin AXIS_DESCR COM_AXIS NO_INPUT_QUANTITY caoddzd_oAjpfzb_cAcEEha_1nR_oa0 16 -32768 32767 AXIS_PTS_REF GAX_KF_ASPR_NORM_PF2 FORMAT "%5.0" MONOTONY MON_INCREASE DEPOSIT ABSOLUTE /end AXIS_DESCR
 /begin AXIS_DESCR COM_AXIS NO_INPUT_QUANTITY CgkBooc_wkiDfEd_Czglhgc_fR_1a0o 12 -327.68 327.67 AXIS_PTS_REF GAY_KF_ASPR_NORM_PF2 FORMAT "%9.2" MONOTONY MON_INCREASE DEPOSIT ABSOLUTE /end AXIS_DESCR
/end CHARACTERISTIC
/begin CHARACTERISTIC GKF_EHUB_NORM_WARM_LAST "Map intake valve lift setpoint in normal operation, warm, load" MAP 0x8071D468 _REC_A1CUR_1_MBSE_U2_S1 65.535 owanCxd_goxcCAa_gsclFBc_nR_1oa0 0 65.535
 /begin AXIS_DESCR COM_AXIS NO_INPUT_QUANTITY caoddzd_oAjpfzb_cAcEEha_1nR_oa0 20 -32768 32767 AXIS_PTS_REF GAX_KF_EHUB_NORM_LAST FORMAT "%5.0" MONOTONY MON_INCREASE DEPOSIT ABSOLUTE /end AXIS_DESCR
 /begin AXIS_DESCR COM_AXIS NO_INPUT_QUANTITY CgkBooc_wkiDfEd_Czglhgc_fR_1a0o 20 -327.68 327.67 AXIS_PTS_REF GAY_KF_EHUB_NORM_LAST FORMAT "%9.2" MONOTONY MON_INCREASE DEPOSIT ABSOLUTE /end AXIS_DESCR
/end CHARACTERISTIC
/begin CHARACTERISTIC GKF_ESPR_NORM_KALT_PF1 "Map intake spread setpoint (normal operation, cold, load, path 1)" MAP 0x8071B36C _REC_A1CUR_1_MBSE_U2_S1 204 BMW_q0p1_deg 0 204 FORMAT "%5.2"
 /begin AXIS_DESCR COM_AXIS NO_INPUT_QUANTITY caoddzd_oAjpfzb_cAcEEha_1nR_oa0 16 -32768 32767 AXIS_PTS_REF GAX_KF_ESPR_NORM_PF1 FORMAT "%5.0" MONOTONY STRICT_INCREASE DEPOSIT ABSOLUTE /end AXIS_DESCR
 /begin AXIS_DESCR COM_AXIS NO_INPUT_QUANTITY CgkBooc_wkiDfEd_Czglhgc_fR_1a0o 12 -327.68 327.67 AXIS_PTS_REF GAY_KF_ESPR_NORM_PF1 FORMAT "%9.2" MONOTONY STRICT_INCREASE DEPOSIT ABSOLUTE /end AXIS_DESCR
/end CHARACTERISTIC
/begin CHARACTERISTIC GKF_ESPR_NORM_KALT_PF2 "Map intake spread setpoint (normal operation, cold, load, path 2)" MAP 0x8071B1EC _REC_A1CUR_1_MBSE_U2_S1 204 BMW_q0p1_deg 0 204 FORMAT "%5.2"
 /begin AXIS_DESCR COM_AXIS NO_INPUT_QUANTITY caoddzd_oAjpfzb_cAcEEha_1nR_oa0 16 -32768 32767 AXIS_PTS_REF GAX_KF_ESPR_NORM_PF2 FORMAT "%5.0" MONOTONY STRICT_INCREASE DEPOSIT ABSOLUTE /end AXIS_DESCR
 /begin AXIS_DESCR COM_AXIS NO_INPUT_QUANTITY CgkBooc_wkiDfEd_Czglhgc_fR_1a0o 12 -327.68 327.67 AXIS_PTS_REF GAY_KF_ESPR_NORM_PF2 FORMAT "%9.2" MONOTONY STRICT_INCREASE DEPOSIT ABSOLUTE /end AXIS_DESCR
/end CHARACTERISTIC
/begin CHARACTERISTIC GKF_ESPR_NORM_WARM_PF1 "Map intake spread setpoint (normal operation, warm, load, path 1)" MAP 0x8071B06C _REC_A1CUR_1_MBSE_U2_S1 204 BMW_q0p1_deg 0 204 FORMAT "%5.2"
 /begin AXIS_DESCR COM_AXIS NO_INPUT_QUANTITY caoddzd_oAjpfzb_cAcEEha_1nR_oa0 16 -32768 32767 AXIS_PTS_REF GAX_KF_ESPR_NORM_PF1 FORMAT "%5.0" MONOTONY STRICT_INCREASE DEPOSIT ABSOLUTE /end AXIS_DESCR
 /begin AXIS_DESCR COM_AXIS NO_INPUT_QUANTITY CgkBooc_wkiDfEd_Czglhgc_fR_1a0o 12 -327.68 327.67 AXIS_PTS_REF GAY_KF_ESPR_NORM_PF1 FORMAT "%9.2" MONOTONY STRICT_INCREASE DEPOSIT ABSOLUTE /end AXIS_DESCR
/end CHARACTERISTIC
/begin CHARACTERISTIC GKF_ESPR_NORM_WARM_PF2 "Map intake spread setpoint (normal operation, warm, load, path 2)" MAP 0x8071AEEC _REC_A1CUR_1_MBSE_U2_S1 204 BMW_q0p1_deg 0 204 FORMAT "%5.2"
 /begin AXIS_DESCR COM_AXIS NO_INPUT_QUANTITY caoddzd_oAjpfzb_cAcEEha_1nR_oa0 16 -32768 32767 AXIS_PTS_REF GAX_KF_ESPR_NORM_PF2 FORMAT "%5.0" MONOTONY STRICT_INCREASE DEPOSIT ABSOLUTE /end AXIS_DESCR
 /begin AXIS_DESCR COM_AXIS NO_INPUT_QUANTITY CgkBooc_wkiDfEd_Czglhgc_fR_1a0o 12 -327.68 327.67 AXIS_PTS_REF GAY_KF_ESPR_NORM_PF2 FORMAT "%9.2" MONOTONY STRICT_INCREASE DEPOSIT ABSOLUTE /end AXIS_DESCR
/end CHARACTERISTIC
/begin CHARACTERISTIC IKCtl_facKnkRtdtCyl0_M "Retard per knock event for cylinder 0" MAP 0x80793BAE RB_Map_S16U8_S8 6 kw_q0p75 -6 0 FORMAT "%5.3"
 /begin AXIS_DESCR STD_AXIS Epm_nEng EngN 8 -16384 16383.5 FORMAT "%8.2" DEPOSIT ABSOLUTE /end AXIS_DESCR
 /begin AXIS_DESCR STD_AXIS IKCtl_facKnkInten_u8 fak_ub_b16 4 0 15.94 FORMAT "%5.2" DEPOSIT ABSOLUTE /end AXIS_DESCR
/end CHARACTERISTIC
/begin CHARACTERISTIC IKCtl_facKnkRtdtCyl1_M "Retard per knock event for cylinder 1" MAP 0x80793BE6 RB_Map_S16U8_S8 6 kw_q0p75 -6 0 FORMAT "%5.3"
 /begin AXIS_DESCR STD_AXIS Epm_nEng EngN 8 -16384 16383.5 FORMAT "%8.2" DEPOSIT ABSOLUTE /end AXIS_DESCR
 /begin AXIS_DESCR STD_AXIS IKCtl_facKnkInten_u8 fak_ub_b16 4 0 15.94 FORMAT "%5.2" DEPOSIT ABSOLUTE /end AXIS_DESCR
/end CHARACTERISTIC
/begin CHARACTERISTIC IKCtl_facKnkRtdtCyl2_M "Retard per knock event for cylinder 2" MAP 0x80793C1E RB_Map_S16U8_S8 6 kw_q0p75 -6 0 FORMAT "%5.3"
 /begin AXIS_DESCR STD_AXIS Epm_nEng EngN 8 -16384 16383.5 FORMAT "%8.2" DEPOSIT ABSOLUTE /end AXIS_DESCR
 /begin AXIS_DESCR STD_AXIS IKCtl_facKnkInten_u8 fak_ub_b16 4 0 15.94 FORMAT "%5.2" DEPOSIT ABSOLUTE /end AXIS_DESCR
/end CHARACTERISTIC
/begin CHARACTERISTIC IKCtl_facKnkRtdtCyl3_M "Retard per knock event for cylinder 3" MAP 0x80793C56 RB_Map_S16U8_S8 6 kw_q0p75 -6 0 FORMAT "%5.3"
 /begin AXIS_DESCR STD_AXIS Epm_nEng EngN 8 -16384 16383.5 FORMAT "%8.2" DEPOSIT ABSOLUTE /end AXIS_DESCR
 /begin AXIS_DESCR STD_AXIS IKCtl_facKnkInten_u8 fak_ub_b16 4 0 15.94 FORMAT "%5.2" DEPOSIT ABSOLUTE /end AXIS_DESCR
/end CHARACTERISTIC
/begin CHARACTERISTIC IKCtl_facKnkRtdtCyl4_M "Retard per knock event for cylinder 4" MAP 0x80793C8E RB_Map_S16U8_S8 6 kw_q0p75 -6 0 FORMAT "%5.3"
 /begin AXIS_DESCR STD_AXIS Epm_nEng EngN 8 -16384 16383.5 FORMAT "%8.2" DEPOSIT ABSOLUTE /end AXIS_DESCR
 /begin AXIS_DESCR STD_AXIS IKCtl_facKnkInten_u8 fak_ub_b16 4 0 15.94 FORMAT "%5.2" DEPOSIT ABSOLUTE /end AXIS_DESCR
/end CHARACTERISTIC
/begin CHARACTERISTIC IKCtl_facKnkRtdtCyl5_M "Retard per knock event for cylinder 5" MAP 0x80793CC6 RB_Map_S16U8_S8 6 kw_q0p75 -6 0 FORMAT "%5.3"
 /begin AXIS_DESCR STD_AXIS Epm_nEng EngN 8 -16384 16383.5 FORMAT "%8.2" DEPOSIT ABSOLUTE /end AXIS_DESCR
 /begin AXIS_DESCR STD_AXIS IKCtl_facKnkInten_u8 fak_ub_b16 4 0 15.94 FORMAT "%5.2" DEPOSIT ABSOLUTE /end AXIS_DESCR
/end CHARACTERISTIC
/begin CHARACTERISTIC IKCtl_FacKnockDetThd0_GM "Knock detection factor map cylinder counter 0" MAP 0x807933F2 FklWUb 3.438 fak_ub_b16 0.0625 3.5 FORMAT "%5.3"
 /begin AXIS_DESCR COM_AXIS Epm_nEng EngN 16 -16384 16383.5 AXIS_PTS_REF IKCtl_nEngB16_X_AX FORMAT "%8.2" DEPOSIT ABSOLUTE /end AXIS_DESCR
 /begin AXIS_DESCR COM_AXIS rl_msg rel_ub_q0p75 4 0 191.3 AXIS_PTS_REF IKCtl_LoadAdd04_X_AX FORMAT "%5.1" DEPOSIT ABSOLUTE /end AXIS_DESCR
/end CHARACTERISTIC
/begin CHARACTERISTIC IKCtl_FacKnockDetThd1_GM "Knock detection factor map cylinder counter 1" MAP 0x80793432 FklWUb 3.438 fak_ub_b16 0.0625 3.5 FORMAT "%5.3"
 /begin AXIS_DESCR COM_AXIS Epm_nEng EngN 16 -16384 16383.5 AXIS_PTS_REF IKCtl_nEngB16_X_AX FORMAT "%8.2" DEPOSIT ABSOLUTE /end AXIS_DESCR
 /begin AXIS_DESCR COM_AXIS rl_msg rel_ub_q0p75 4 0 191.3 AXIS_PTS_REF IKCtl_LoadAdd04_X_AX FORMAT "%5.1" DEPOSIT ABSOLUTE /end AXIS_DESCR
/end CHARACTERISTIC
/begin CHARACTERISTIC IKCtl_FacKnockDetThd2_GM "Knock detection factor map cylinder counter 2" MAP 0x80793472 FklWUb 3.438 fak_ub_b16 0.0625 3.5 FORMAT "%5.3"
 /begin AXIS_DESCR COM_AXIS Epm_nEng EngN 16 -16384 16383.5 AXIS_PTS_REF IKCtl_nEngB16_X_AX FORMAT "%8.2" DEPOSIT ABSOLUTE /end AXIS_DESCR
 /begin AXIS_DESCR COM_AXIS rl_msg rel_ub_q0p75 4 0 191.3 AXIS_PTS_REF IKCtl_LoadAdd04_X_AX FORMAT "%5.1" DEPOSIT ABSOLUTE /end AXIS_DESCR
/end CHARACTERISTIC
/begin CHARACTERISTIC IKCtl_FacKnockDetThd3_GM "Knock detection factor map cylinder counter 3" MAP 0x807934B2 FklWUb 3.438 fak_ub_b16 0.0625 3.5 FORMAT "%5.3"
 /begin AXIS_DESCR COM_AXIS Epm_nEng EngN 16 -16384 16383.5 AXIS_PTS_REF IKCtl_nEngB16_X_AX FORMAT "%8.2" DEPOSIT ABSOLUTE /end AXIS_DESCR
 /begin AXIS_DESCR COM_AXIS rl_msg rel_ub_q0p75 4 0 191.3 AXIS_PTS_REF IKCtl_LoadAdd04_X_AX FORMAT "%5.1" DEPOSIT ABSOLUTE /end AXIS_DESCR
/end CHARACTERISTIC
/begin CHARACTERISTIC IKCtl_FacKnockDetThd4_GM "Knock detection factor map cylinder counter 4" MAP 0x807934F2 FklWUb 3.438 fak_ub_b16 0.0625 3.5 FORMAT "%5.3"
 /begin AXIS_DESCR COM_AXIS Epm_nEng EngN 16 -16384 16383.5 AXIS_PTS_REF IKCtl_nEngB16_X_AX FORMAT "%8.2" DEPOSIT ABSOLUTE /end AXIS_DESCR
 /begin AXIS_DESCR COM_AXIS rl_msg rel_ub_q0p75 4 0 191.3 AXIS_PTS_REF IKCtl_LoadAdd04_X_AX FORMAT "%5.1" DEPOSIT ABSOLUTE /end AXIS_DESCR
/end CHARACTERISTIC
/begin CHARACTERISTIC IKCtl_FacKnockDetThd5_GM "Knock detection factor map cylinder counter 5" MAP 0x80793532 FklWUb 3.438 fak_ub_b16 0.0625 3.5 FORMAT "%5.3"
 /begin AXIS_DESCR COM_AXIS Epm_nEng EngN 16 -16384 16383.5 AXIS_PTS_REF IKCtl_nEngB16_X_AX FORMAT "%8.2" DEPOSIT ABSOLUTE /end AXIS_DESCR
 /begin AXIS_DESCR COM_AXIS rl_msg rel_ub_q0p75 4 0 191.3 AXIS_PTS_REF IKCtl_LoadAdd04_X_AX FORMAT "%5.1" DEPOSIT ABSOLUTE /end AXIS_DESCR
/end CHARACTERISTIC
/begin CHARACTERISTIC KF_ASPR_NORM_UESP_PF1 "Map exhaust spread setpoint (during scavenging, path 1)" MAP 0x8071A048 _REC_A1CUR_1_MBSE_U2_S1 204 BMW_q0p1_deg 0 204 FORMAT "%5.2"
 /begin AXIS_DESCR COM_AXIS NO_INPUT_QUANTITY caoddzd_oAjpfzb_cAcEEha_1nR_oa0 8 -32768 32767 AXIS_PTS_REF AXX_KF_ASPR_NORM_UESP_PF1 FORMAT "%5.0" MONOTONY MON_INCREASE DEPOSIT ABSOLUTE /end AXIS_DESCR
 /begin AXIS_DESCR COM_AXIS NO_INPUT_QUANTITY CgkBooc_wkiDfEd_Czglhgc_fR_1a0o 8 -327.68 327.67 AXIS_PTS_REF AXY_KF_ASPR_NORM_UESP_PF1 FORMAT "%9.2" MONOTONY MON_INCREASE DEPOSIT ABSOLUTE /end AXIS_DESCR
/end CHARACTERISTIC
/begin CHARACTERISTIC KF_DZW_DYN "Delta ignition angle dynamic correction" MAP 0x80754097 _REC_A1CUR_1_MBSE_S1_S1 127.5 aAwkuzc_BFpgCmb_tmDukma_q__aa0o -64 63.5 FORMAT "%4.1"
 /begin AXIS_DESCR COM_AXIS Nkw caoddzd_oAjpfzb_cAcEEha_1nR_oa0 4 -32768 32767 AXIS_PTS_REF AXX_KF_DZW_DYN FORMAT "%5.0" MONOTONY STRICT_INCREASE DEPOSIT ABSOLUTE /end AXIS_DESCR
 /begin AXIS_DESCR COM_AXIS NO_INPUT_QUANTITY CgkBooc_wkiDfEd_Czglhgc_fR_1a0o 4 -327.68 327.67 AXIS_PTS_REF AXY_KF_DZW_DYN FORMAT "%9.2" MONOTONY STRICT_INCREASE DEPOSIT ABSOLUTE /end AXIS_DESCR
/end CHARACTERISTIC
/begin CHARACTERISTIC KF_DZWT_PF1 "Temperature correction ignition angle knock limit path 1" MAP 0x80759DDA _REC_A1CUR_1_MBSE_S1_S1 127.5 aAwkuzc_BFpgCmb_tmDukma_q__aa0o -64 63.5 FORMAT "%4.1"
 /begin AXIS_DESCR COM_AXIS Nkw caoddzd_oAjpfzb_cAcEEha_1nR_oa0 20 -32768 32767 AXIS_PTS_REF AXX_KF_DZWT_PF1 FORMAT "%5.0" MONOTONY MON_INCREASE DEPOSIT ABSOLUTE /end AXIS_DESCR
 /begin AXIS_DESCR COM_AXIS NO_INPUT_QUANTITY CgkBooc_wkiDfEd_Czglhgc_fR_1a0o 16 -327.68 327.67 AXIS_PTS_REF AXY_KF_DZWT_PF1 FORMAT "%9.2" MONOTONY MON_INCREASE DEPOSIT ABSOLUTE /end AXIS_DESCR
/end CHARACTERISTIC
/begin CHARACTERISTIC KF_DZWT_PF2 "Temperature correction ignition angle knock limit path 2" MAP 0x80759C9A _REC_A1CUR_1_MBSE_S1_S1 127.5 aAwkuzc_BFpgCmb_tmDukma_q__aa0o -64 63.5 FORMAT "%4.1"
 /begin AXIS_DESCR COM_AXIS Nkw caoddzd_oAjpfzb_cAcEEha_1nR_oa0 20 -32768 32767 AXIS_PTS_REF AXX_KF_DZWT_PF2 FORMAT "%5.0" MONOTONY MON_INCREASE DEPOSIT ABSOLUTE /end AXIS_DESCR
 /begin AXIS_DESCR COM_AXIS NO_INPUT_QUANTITY CgkBooc_wkiDfEd_Czglhgc_fR_1a0o 16 -327.68 327.67 AXIS_PTS_REF AXY_KF_DZWT_PF2 FORMAT "%9.2" MONOTONY MON_INCREASE DEPOSIT ABSOLUTE /end AXIS_DESCR
/end CHARACTERISTIC
/begin CHARACTERISTIC KF_DZWT_UESP_PF1 "Temperature correction ignition angle knock limit path 1 scavenging" MAP 0x80759C22 _REC_A1CUR_1_MBSE_S1_S1 127.5 aAwkuzc_BFpgCmb_tmDukma_q__aa0o -64 63.5 FORMAT "%4.1"
 /begin AXIS_DESCR COM_AXIS Nkw caoddzd_oAjpfzb_cAcEEha_1nR_oa0 10 -32768 32767 AXIS_PTS_REF AXX_KF_DZWT_UESP_PF1 FORMAT "%5.0" MONOTONY STRICT_INCREASE DEPOSIT ABSOLUTE /end AXIS_DESCR
 /begin AXIS_DESCR COM_AXIS NO_INPUT_QUANTITY CgkBooc_wkiDfEd_Czglhgc_fR_1a0o 12 -327.68 327.67 AXIS_PTS_REF AXY_KF_DZWT_UESP_PF1 FORMAT "%9.2" MONOTONY STRICT_INCREASE DEPOSIT ABSOLUTE /end AXIS_DESCR
/end CHARACTERISTIC
/begin CHARACTERISTIC KF_DZWT_UESP_PF2 "Temperature correction ignition angle knock limit path 2 scavenging" MAP 0x80759BAA _REC_A1CUR_1_MBSE_S1_S1 127.5 aAwkuzc_BFpgCmb_tmDukma_q__aa0o -64 63.5 FORMAT "%4.1"
 /begin AXIS_DESCR COM_AXIS Nkw caoddzd_oAjpfzb_cAcEEha_1nR_oa0 10 -32768 32767 AXIS_PTS_REF AXX_KF_DZWT_UESP_PF2 FORMAT "%5.0" MONOTONY STRICT_INCREASE DEPOSIT ABSOLUTE /end AXIS_DESCR
 /begin AXIS_DESCR COM_AXIS NO_INPUT_QUANTITY CgkBooc_wkiDfEd_Czglhgc_fR_1a0o 12 -327.68 327.67 AXIS_PTS_REF AXY_KF_DZWT_UESP_PF2 FORMAT "%9.2" MONOTONY STRICT_INCREASE DEPOSIT ABSOLUTE /end AXIS_DESCR
/end CHARACTERISTIC
/begin CHARACTERISTIC KF_EDA_ANZ_SPORT_MD_EM1_IST "Torque adjustment for the performance display" MAP 0x8070C5BA _REC_A1CUR_1_MBSE_S2_S1 6553.5 BMW_dm_sw_q0p1_Nm -3276.8 3276.7 FORMAT "%7.2"
 /begin AXIS_DESCR COM_AXIS NO_INPUT_QUANTITY BMW_dm_sw_q0p1_Nm 6 -3276.8 3276.7 AXIS_PTS_REF AXX_KF_EDA_ANZ_SPORT_MD_EM1_IST FORMAT "%7.2" MONOTONY STRICT_INCREASE DEPOSIT ABSOLUTE /end AXIS_DESCR
 /begin AXIS_DESCR COM_AXIS NO_INPUT_QUANTITY caoddzd_oAjpfzb_cAcEEha_1nR_oa0 6 -32768 32767 AXIS_PTS_REF AXY_KF_EDA_ANZ_SPORT_MD_EM1_IST FORMAT "%5.0" MONOTONY STRICT_INCREASE DEPOSIT ABSOLUTE /end AXIS_DESCR
/end CHARACTERISTIC
/begin CHARACTERISTIC KF_EDA_ANZ_SPORT_MDK_IST "Torque adjustment for the performance display" MAP 0x8070C602 _REC_A1CUR_1_MBSE_S2_S1 6553.5 BMW_dm_sw_q0p1_Nm -3276.8 3276.7 FORMAT "%7.2"
 /begin AXIS_DESCR COM_AXIS NO_INPUT_QUANTITY BMW_dm_sw_q0p1_Nm 6 -3276.8 3276.7 AXIS_PTS_REF AXX_KF_EDA_ANZ_SPORT_MDK_IST FORMAT "%7.2" MONOTONY MON_INCREASE DEPOSIT ABSOLUTE /end AXIS_DESCR
 /begin AXIS_DESCR COM_AXIS NO_INPUT_QUANTITY caoddzd_oAjpfzb_cAcEEha_1nR_oa0 6 -32768 32767 AXIS_PTS_REF AXY_KF_EDA_ANZ_SPORT_MDK_IST FORMAT "%5.0" MONOTONY MON_INCREASE DEPOSIT ABSOLUTE /end AXIS_DESCR
/end CHARACTERISTIC
/begin CHARACTERISTIC KF_EHUB_MX "Map maximum intake valve lift" MAP 0x8071BF4E _REC_A1CUR_1_MBSE_U2_S1 65.535 ohoxkpc_embkBlb_gscheBc_m__aoa0 0 65.535
 /begin AXIS_DESCR COM_AXIS NO_INPUT_QUANTITY caoddzd_oAjpfzb_cAcEEha_1nR_oa0 6 -32768 32767 AXIS_PTS_REF AXX_KF_EHUB_MX FORMAT "%5.0" MONOTONY MON_INCREASE DEPOSIT ABSOLUTE /end AXIS_DESCR
 /begin AXIS_DESCR COM_AXIS NO_INPUT_QUANTITY CgkBooc_wkiDfEd_Czglhgc_fR_1a0o 6 -327.68 327.67 AXIS_PTS_REF AXY_KF_EHUB_MX FORMAT "%9.2" MONOTONY MON_INCREASE DEPOSIT ABSOLUTE /end AXIS_DESCR
/end CHARACTERISTIC
/begin CHARACTERISTIC KF_ENA_NREG_GANG_SYN "Release depending on Gang_syn_engaged and Gang_alt" MAP 0x8074EBBD _REC_A1CUR_1_MBSE_U1_S1 1 raChrxc_kBtBrmb_FmDuEFa_n__aa0o 0 1
 /begin AXIS_DESCR COM_AXIS NO_INPUT_QUANTITY raChrxc_kBtBrmb_FmDuEFa_n__aa0o 9 0 255 AXIS_PTS_REF AXX_KF_ENA_NREG_GANG_SYN FORMAT "%3.0" MONOTONY STRICT_INCREASE DEPOSIT ABSOLUTE /end AXIS_DESCR
 /begin AXIS_DESCR COM_AXIS NO_INPUT_QUANTITY raChrxc_kBtBrmb_FmDuEFa_n__aa0o 9 0 255 AXIS_PTS_REF AXY_KF_ENA_NREG_GANG_SYN FORMAT "%3.0" MONOTONY STRICT_INCREASE DEPOSIT ABSOLUTE /end AXIS_DESCR
/end CHARACTERISTIC
/begin CHARACTERISTIC KF_ESPR_NORM_UESP_PF1 "Map intake spread setpoint (during scavenging, path 1)" MAP 0x8071AB84 _REC_A1CUR_1_MBSE_U2_S1 204 BMW_q0p1_deg 0 204 FORMAT "%5.2"
 /begin AXIS_DESCR COM_AXIS NO_INPUT_QUANTITY caoddzd_oAjpfzb_cAcEEha_1nR_oa0 8 -32768 32767 AXIS_PTS_REF AXX_KF_ESPR_NORM_UESP_PF1 FORMAT "%5.0" MONOTONY MON_INCREASE DEPOSIT ABSOLUTE /end AXIS_DESCR
 /begin AXIS_DESCR COM_AXIS NO_INPUT_QUANTITY CgkBooc_wkiDfEd_Czglhgc_fR_1a0o 8 -327.68 327.67 AXIS_PTS_REF AXY_KF_ESPR_NORM_UESP_PF1 FORMAT "%9.2" MONOTONY MON_INCREASE DEPOSIT ABSOLUTE /end AXIS_DESCR
/end CHARACTERISTIC
/begin CHARACTERISTIC KF_F_MDIMAX_KR "Inner torque limitation factor from knock control (optimal ignition angle cannot be achieved)" MAP 0x8072A35E _REC_A1CUR_1_MBSE_U2_S1 1 Bhvfwhc_bigEubd_BBEupBd_nR_3oa0 0 1
 /begin AXIS_DESCR COM_AXIS Nkw_ref caoddzd_oAjpfzb_cAcEEha_1nR_oa0 8 -32768 32767 AXIS_PTS_REF AXX_KF_F_MDIMAX_KR MONOTONY STRICT_INCREASE DEPOSIT ABSOLUTE /end AXIS_DESCR
 /begin AXIS_DESCR COM_AXIS NO_INPUT_QUANTITY BMW_dm_sw_q0p1_Nm 7 -3276.8 3276.7 AXIS_PTS_REF AXY_KF_F_MDIMAX_KR MONOTONY STRICT_INCREASE DEPOSIT ABSOLUTE /end AXIS_DESCR
/end CHARACTERISTIC
/begin CHARACTERISTIC KF_FDZW_DYN1 "Weighting factor dynamic correction via intake air temp and Dzw_annm for manual transmission" MAP 0x80759816 _REC_A1CUR_1_MBSE_U1_S1 0.99609375 BMW_Powertrain_DxECompuMethods_Def_ub_b1_nounit 0 0.99609375
 /begin AXIS_DESCR COM_AXIS Tans BMW_q0p1_degC 4 -3276.8 3276.7 AXIS_PTS_REF AXX_KF_FDZW_DYN1 FORMAT "%6.1" MONOTONY STRICT_INCREASE DEPOSIT ABSOLUTE /end AXIS_DESCR
 /begin AXIS_DESCR COM_AXIS Dzw_annm BMW_q0p1_deg 4 -50 60 AXIS_PTS_REF AXY_KF_FDZW_DYN1 FORMAT "%6.1" MONOTONY STRICT_INCREASE DEPOSIT ABSOLUTE /end AXIS_DESCR
/end CHARACTERISTIC
/begin CHARACTERISTIC KF_FDZW_DYN2 "Weighting factor dynamic correction via speed and gear for manual transmission" MAP 0x807597EE _REC_A1CUR_1_MBSE_U1_S1 0.99609375 BMW_Powertrain_DxECompuMethods_Def_ub_b1_nounit 0 0.99609375
 /begin AXIS_DESCR COM_AXIS Gangi raChrxc_kBtBrmb_FmDuEFa_n__aa0o 10 0 255 AXIS_PTS_REF AXX_KF_FDZW_DYN2 FORMAT "%3.0" MONOTONY MON_INCREASE DEPOSIT ABSOLUTE /end AXIS_DESCR
 /begin AXIS_DESCR COM_AXIS V AFeDmkb_cAbjmcc_kAkskhd_k__0oa0 4 0 360 AXIS_PTS_REF AXY_KF_FDZW_DYN2 FORMAT "%5.0" MONOTONY STRICT_INCREASE DEPOSIT ABSOLUTE /end AXIS_DESCR
/end CHARACTERISTIC
/begin CHARACTERISTIC KF_FDZW_DYN3 "Weighting factor dynamic correction via intake air temp and Dzw_annm for automatic transmission" MAP 0x807597DE _REC_A1CUR_1_MBSE_U1_S1 0.99609375 BMW_Powertrain_DxECompuMethods_Def_ub_b1_nounit 0 0.99609375
 /begin AXIS_DESCR COM_AXIS Tans BMW_q0p1_degC 4 -3276.8 3276.7 AXIS_PTS_REF AXX_KF_FDZW_DYN3 FORMAT "%6.1" MONOTONY STRICT_INCREASE DEPOSIT ABSOLUTE /end AXIS_DESCR
 /begin AXIS_DESCR COM_AXIS Dzw_annm BMW_q0p1_deg 4 -50 60 AXIS_PTS_REF AXY_KF_FDZW_DYN3 FORMAT "%6.1" MONOTONY STRICT_INCREASE DEPOSIT ABSOLUTE /end AXIS_DESCR
/end CHARACTERISTIC
/begin CHARACTERISTIC KF_FDZW_DYN4 "Weighting factor dynamic correction via speed and gear for automatic transmission" MAP 0x807597B6 _REC_A1CUR_1_MBSE_U1_S1 0.99609375 BMW_Powertrain_DxECompuMethods_Def_ub_b1_nounit 0 0.99609375
 /begin AXIS_DESCR COM_AXIS Gangi raChrxc_kBtBrmb_FmDuEFa_n__aa0o 10 0 255 AXIS_PTS_REF AXX_KF_FDZW_DYN4 FORMAT "%3.0" MONOTONY MON_INCREASE DEPOSIT ABSOLUTE /end AXIS_DESCR
 /begin AXIS_DESCR COM_AXIS V AFeDmkb_cAbjmcc_kAkskhd_k__0oa0 4 0 360 AXIS_PTS_REF AXY_KF_FDZW_DYN4 FORMAT "%5.0" MONOTONY STRICT_INCREASE DEPOSIT ABSOLUTE /end AXIS_DESCR
/end CHARACTERISTIC
/begin CHARACTERISTIC KF_FDZWT_BEST_PF1 "Temperature correction factor for best ignition angle path 1" MAP 0x80730930 _REC_A1CUR_1_MBSE_S2_S1 3.99993896484375 ilxsavd_hkzmBfc_lAzCpAb_nR_1oa0 -2 1.99993896484375 FORMAT "%14.5"
 /begin AXIS_DESCR COM_AXIS Tmot DchEpAd_DBCFgoa_Ckhahgc_q__aoa0 6 -327.68 327.67 AXIS_PTS_REF AXX_KF_FDZWT_BEST_PF1 FORMAT "%7.2" MONOTONY STRICT_INCREASE DEPOSIT ABSOLUTE /end AXIS_DESCR
 /begin AXIS_DESCR COM_AXIS Tans BMW_q0p1_degC 6 -3276.8 3276.7 AXIS_PTS_REF AXY_KF_FDZWT_BEST_PF1 FORMAT "%6.1" MONOTONY STRICT_INCREASE DEPOSIT ABSOLUTE /end AXIS_DESCR
/end CHARACTERISTIC
/begin CHARACTERISTIC KF_FDZWT_BEST_PF2 "Temperature correction factor for best ignition angle path 2" MAP 0x807308E8 _REC_A1CUR_1_MBSE_S2_S1 3.99993896484375 ilxsavd_hkzmBfc_lAzCpAb_nR_1oa0 -2 1.99993896484375 FORMAT "%14.5"
 /begin AXIS_DESCR COM_AXIS Tmot DchEpAd_DBCFgoa_Ckhahgc_q__aoa0 6 -327.68 327.67 AXIS_PTS_REF AXX_KF_FDZWT_BEST_PF2 FORMAT "%7.2" MONOTONY STRICT_INCREASE DEPOSIT ABSOLUTE /end AXIS_DESCR
 /begin AXIS_DESCR COM_AXIS Tans BMW_q0p1_degC 6 -3276.8 3276.7 AXIS_PTS_REF AXY_KF_FDZWT_BEST_PF2 FORMAT "%6.1" MONOTONY STRICT_INCREASE DEPOSIT ABSOLUTE /end AXIS_DESCR
/end CHARACTERISTIC
/begin CHARACTERISTIC KF_FDZWT_PF1 "Temperature correction factor for ignition angle knock limit path 1" MAP 0x807309F0 _REC_A1CUR_1_MBSE_S2_S1 3.9998779296875 ilxsavd_hkzmBfc_lAzCpAb_nR_1oa0 -2 1.9998779296875 FORMAT "%14.5"
 /begin AXIS_DESCR COM_AXIS Tmot DchEpAd_DBCFgoa_Ckhahgc_q__aoa0 6 -327.68 327.67 AXIS_PTS_REF AXX_KF_FDZWT_PF1 FORMAT "%7.2" MONOTONY STRICT_INCREASE DEPOSIT ABSOLUTE /end AXIS_DESCR
 /begin AXIS_DESCR COM_AXIS Tans BMW_q0p1_degC 6 -3276.8 3276.7 AXIS_PTS_REF AXY_KF_FDZWT_PF1 FORMAT "%6.1" MONOTONY STRICT_INCREASE DEPOSIT ABSOLUTE /end AXIS_DESCR
/end CHARACTERISTIC
/begin CHARACTERISTIC KF_FDZWT_PF2 "Temperature correction factor for ignition angle knock limit path 2" MAP 0x807309A8 _REC_A1CUR_1_MBSE_S2_S1 3.9998779296875 ilxsavd_hkzmBfc_lAzCpAb_nR_1oa0 -2 1.9998779296875 FORMAT "%14.5"
 /begin AXIS_DESCR COM_AXIS Tmot DchEpAd_DBCFgoa_Ckhahgc_q__aoa0 6 -327.68 327.67 AXIS_PTS_REF AXX_KF_FDZWT_PF2 FORMAT "%7.2" MONOTONY STRICT_INCREASE DEPOSIT ABSOLUTE /end AXIS_DESCR
 /begin AXIS_DESCR COM_AXIS Tans BMW_q0p1_degC 6 -3276.8 3276.7 AXIS_PTS_REF AXY_KF_FDZWT_PF2 FORMAT "%6.1" MONOTONY STRICT_INCREASE DEPOSIT ABSOLUTE /end AXIS_DESCR
/end CHARACTERISTIC
/begin CHARACTERISTIC KF_FK_FTRANSVL "Map filter constant for F_transvl (= crossfade factor Wdk_soll to KL_DKVL)" MAP 0x8074A8CA _REC_A1CUR_1_MBSE_U2_S1 0.999984741210938 FzbmlAa_gCtylrb_ckCqxAc_nR_6oa0 0 0.999984741210938 FORMAT "%14.5"
 /begin AXIS_DESCR COM_AXIS NO_INPUT_QUANTITY caoddzd_oAjpfzb_cAcEEha_1nR_oa0 6 -32768 32767 AXIS_PTS_REF AXX_KF_FK_FTRANSVL FORMAT "%5.0" MONOTONY MON_INCREASE DEPOSIT ABSOLUTE /end AXIS_DESCR
 /begin AXIS_DESCR COM_AXIS NO_INPUT_QUANTITY ilxsavd_hkzmBfc_lAzCpAb_nR_1oa0 6 0 3.99993896484375 AXIS_PTS_REF AXY_KF_FK_FTRANSVL FORMAT "%14.5" MONOTONY MON_INCREASE DEPOSIT ABSOLUTE /end AXIS_DESCR
/end CHARACTERISTIC
/begin CHARACTERISTIC KF_FMS_DKPSRPL_MN "Lower mass flow ratio for diagnostics of mass flow in intake manifold Msev_diag versus Msdk_diag" MAP 0x8074A454 _REC_A1CUR_1_MBSE_U2_S1 1.99996948242188 Bhvfwhc_bigEubd_BBEupBd_nR_3oa0 0 1.99996948242188 FORMAT "%7.4"
 /begin AXIS_DESCR COM_AXIS NO_INPUT_QUANTITY caoddzd_oAjpfzb_cAcEEha_1nR_oa0 6 0 32767 AXIS_PTS_REF AXX_KF_FMS_DKPSRPL_MN FORMAT "%5.0" MONOTONY MON_INCREASE DEPOSIT ABSOLUTE /end AXIS_DESCR
 /begin AXIS_DESCR COM_AXIS NO_INPUT_QUANTITY CgkBooc_wkiDfEd_Czglhgc_fR_1a0o 6 0 327.67 AXIS_PTS_REF AXY_KF_FMS_DKPSRPL_MN FORMAT "%7.2" MONOTONY MON_INCREASE DEPOSIT ABSOLUTE /end AXIS_DESCR
/end CHARACTERISTIC
/begin CHARACTERISTIC KF_FMS_DKPSRPL_MX "Upper mass flow ratio for diagnostics of mass flow in intake manifold Msev_diag versus Msdk_diag" MAP 0x8074A40C _REC_A1CUR_1_MBSE_U2_S1 1.99996948242188 Bhvfwhc_bigEubd_BBEupBd_nR_3oa0 0 1.99996948242188 FORMAT "%7.4"
 /begin AXIS_DESCR COM_AXIS NO_INPUT_QUANTITY caoddzd_oAjpfzb_cAcEEha_1nR_oa0 6 0 32767 AXIS_PTS_REF AXX_KF_FMS_DKPSRPL_MX FORMAT "%5.0" MONOTONY MON_INCREASE DEPOSIT ABSOLUTE /end AXIS_DESCR
 /begin AXIS_DESCR COM_AXIS NO_INPUT_QUANTITY CgkBooc_wkiDfEd_Czglhgc_fR_1a0o 6 0 327.67 AXIS_PTS_REF AXY_KF_FMS_DKPSRPL_MX FORMAT "%7.2" MONOTONY MON_INCREASE DEPOSIT ABSOLUTE /end AXIS_DESCR
/end CHARACTERISTIC
/begin CHARACTERISTIC KF_FMS_HFMPL_MN "Lower mass flow ratio for HFM diagnostics Mshfm vs. Mszyl_diag" MAP 0x80738B4C _REC_A1CUR_1_MBSE_U2_S1 1.99996948242188 Bhvfwhc_bigEubd_BBEupBd_nR_3oa0 0 1.99996948242188 FORMAT "%7.4"
 /begin AXIS_DESCR COM_AXIS NO_INPUT_QUANTITY caoddzd_oAjpfzb_cAcEEha_1nR_oa0 6 -32768 32767 AXIS_PTS_REF AXX_KF_FMS_HFMPL_MN FORMAT "%5.0" MONOTONY MON_INCREASE DEPOSIT ABSOLUTE /end AXIS_DESCR
 /begin AXIS_DESCR COM_AXIS NO_INPUT_QUANTITY CgkBooc_wkiDfEd_Czglhgc_fR_1a0o 6 -327.68 327.67 AXIS_PTS_REF AXY_KF_FMS_HFMPL_MN FORMAT "%7.2" MONOTONY MON_INCREASE DEPOSIT ABSOLUTE /end AXIS_DESCR
/end CHARACTERISTIC
/begin CHARACTERISTIC KF_FMS_HFMPL_MX "Upper mass flow ratio for HFM diagnostics Mshfm vs. Mszyl_diag" MAP 0x80738B04 _REC_A1CUR_1_MBSE_U2_S1 1.99996948242188 Bhvfwhc_bigEubd_BBEupBd_nR_3oa0 0 1.99996948242188 FORMAT "%7.4"
 /begin AXIS_DESCR COM_AXIS NO_INPUT_QUANTITY caoddzd_oAjpfzb_cAcEEha_1nR_oa0 6 -32768 32767 AXIS_PTS_REF AXX_KF_FMS_HFMPL_MX FORMAT "%5.0" MONOTONY MON_INCREASE DEPOSIT ABSOLUTE /end AXIS_DESCR
 /begin AXIS_DESCR COM_AXIS NO_INPUT_QUANTITY CgkBooc_wkiDfEd_Czglhgc_fR_1a0o 6 -327.68 327.67 AXIS_PTS_REF AXY_KF_FMS_HFMPL_MX FORMAT "%7.2" MONOTONY MON_INCREASE DEPOSIT ABSOLUTE /end AXIS_DESCR
/end CHARACTERISTIC
/begin CHARACTERISTIC KF_FTRANSVL "Map setpoint F_transvl (= crossfade factor Wdk_soll to KL_DKVL)" MAP 0x8074A7CA _REC_A1CUR_1_MBSE_U2_S1 0.999984741210938 FzbmlAa_gCtylrb_ckCqxAc_nR_6oa0 0 0.999984741210938 FORMAT "%7.5"
 /begin AXIS_DESCR COM_AXIS NO_INPUT_QUANTITY caoddzd_oAjpfzb_cAcEEha_1nR_oa0 8 -32768 32767 AXIS_PTS_REF AXX_KF_FTRANSVL FORMAT "%5.0" MONOTONY MON_INCREASE DEPOSIT ABSOLUTE /end AXIS_DESCR
 /begin AXIS_DESCR COM_AXIS NO_INPUT_QUANTITY FzbmlAa_gCtylrb_ckCqxAc_nR_6oa0 8 0 0.999984741210938 AXIS_PTS_REF AXY_KF_FTRANSVL FORMAT "%7.5" MONOTONY MON_INCREASE DEPOSIT ABSOLUTE /end AXIS_DESCR
/end CHARACTERISTIC
/begin CHARACTERISTIC KF_HUB_GRDMX "Map maximum intake valve lift increase per 10ms" MAP 0x8071BF06 _REC_A1CUR_1_MBSE_U2_S1 65.535 ohoxkpc_embkBlb_gscheBc_m__aoa0 0 65.535
 /begin AXIS_DESCR COM_AXIS NO_INPUT_QUANTITY caoddzd_oAjpfzb_cAcEEha_1nR_oa0 6 -32768 32767 AXIS_PTS_REF AXX_KF_HUB_GRDMX FORMAT "%5.0" MONOTONY MON_INCREASE DEPOSIT ABSOLUTE /end AXIS_DESCR
 /begin AXIS_DESCR COM_AXIS NO_INPUT_QUANTITY ohoxkpc_embkBlb_gscheBc_m__aoa0 6 0 65.535 AXIS_PTS_REF AXY_KF_HUB_GRDMX MONOTONY MON_INCREASE DEPOSIT ABSOLUTE /end AXIS_DESCR
/end CHARACTERISTIC
/begin CHARACTERISTIC KF_HUBESTM "Map intake valve lift setpoint during engine start" MAP 0x8071C328 _REC_A1CUR_1_MBSE_U2_S1 65.535 ohoxkpc_embkBlb_gscheBc_m__aoa0 0 65.535
 /begin AXIS_DESCR COM_AXIS NO_INPUT_QUANTITY caoddzd_oAjpfzb_cAcEEha_1nR_oa0 8 -32768 32767 AXIS_PTS_REF AXX_KF_HUBESTM FORMAT "%5.0" MONOTONY MON_INCREASE DEPOSIT ABSOLUTE /end AXIS_DESCR
 /begin AXIS_DESCR COM_AXIS NO_INPUT_QUANTITY DchEpAd_DBCFgoa_Ckhahgc_q__aoa0 8 -327.68 327.67 AXIS_PTS_REF AXY_KF_HUBESTM FORMAT "%7.2" MONOTONY MON_INCREASE DEPOSIT ABSOLUTE /end AXIS_DESCR
/end CHARACTERISTIC
/begin CHARACTERISTIC KF_MDIMAX_FG "Inner torque limitation due to component protection at rich running limit" MAP 0x8072A316 _REC_A1CUR_1_MBSE_S2_S1 6553.5 BMW_dm_sw_q0p1_Nm -3276.8 3276.7 FORMAT "%6.1"
 /begin AXIS_DESCR COM_AXIS Nkw_ref caoddzd_oAjpfzb_cAcEEha_1nR_oa0 6 -32768 32767 AXIS_PTS_REF AXX_KF_MDIMAX_FG MONOTONY STRICT_INCREASE DEPOSIT ABSOLUTE /end AXIS_DESCR
 /begin AXIS_DESCR COM_AXIS Frfmxbsld Bhvfwhc_bigEubd_BBEupBd_nR_3oa0 6 0 1 AXIS_PTS_REF AXY_KF_MDIMAX_FG FORMAT "%14.5" MONOTONY STRICT_INCREASE DEPOSIT ABSOLUTE /end AXIS_DESCR
/end CHARACTERISTIC
/begin CHARACTERISTIC KF_MDIMAX_SK "Inner torque limitation after pre-ignition events (super-knock)" MAP 0x8072A2A6 _REC_A1CUR_1_MBSE_S2_S1 6553.5 BMW_dm_sw_q0p1_Nm -3276.8 3276.7 FORMAT "%6.1"
 /begin AXIS_DESCR COM_AXIS Nkw_ref caoddzd_oAjpfzb_cAcEEha_1nR_oa0 8 -32768 32767 AXIS_PTS_REF AXX_KF_MDIMAX_SK MONOTONY STRICT_INCREASE DEPOSIT ABSOLUTE /end AXIS_DESCR
 /begin AXIS_DESCR COM_AXIS BMWpim_fac_TqRedn_ub BMW_Powertrain_DxECompuMethods_Def_ub_b1_nounit 7 0 0.99609375 AXIS_PTS_REF AXY_KF_MDIMAX_SK MONOTONY STRICT_INCREASE DEPOSIT ABSOLUTE /end AXIS_DESCR
/end CHARACTERISTIC
/begin CHARACTERISTIC KF_MDIMAX_TANS "Max. inner torque limitation via intake air temperature" MAP 0x8072A25E _REC_A1CUR_1_MBSE_S2_S1 6553.5 BMW_dm_sw_q0p1_Nm -3276.8 3276.7 FORMAT "%6.1"
 /begin AXIS_DESCR COM_AXIS Nkw_ref caoddzd_oAjpfzb_cAcEEha_1nR_oa0 6 -32768 32767 AXIS_PTS_REF AXX_KF_MDIMAX_TANS MONOTONY STRICT_INCREASE DEPOSIT ABSOLUTE /end AXIS_DESCR
 /begin AXIS_DESCR COM_AXIS Tans BMW_q0p1_degC 6 -3276.8 3276.7 AXIS_PTS_REF AXY_KF_MDIMAX_TANS FORMAT "%6.1" MONOTONY STRICT_INCREASE DEPOSIT ABSOLUTE /end AXIS_DESCR
/end CHARACTERISTIC
/begin CHARACTERISTIC KF_MDIMAX_TVDK "Max. inner torque limitation via temperature before throttle" MAP 0x8072A216 _REC_A1CUR_1_MBSE_S2_S1 6553.5 BMW_dm_sw_q0p1_Nm -3276.8 3276.7 FORMAT "%6.1"
 /begin AXIS_DESCR COM_AXIS Nkw_ref caoddzd_oAjpfzb_cAcEEha_1nR_oa0 6 -32768 32767 AXIS_PTS_REF AXX_KF_MDIMAX_TVDK MONOTONY STRICT_INCREASE DEPOSIT ABSOLUTE /end AXIS_DESCR
 /begin AXIS_DESCR COM_AXIS Tvdk BMW_q0p1_degC 6 -3276.8 3276.7 AXIS_PTS_REF AXY_KF_MDIMAX_TVDK FORMAT "%6.1" MONOTONY STRICT_INCREASE DEPOSIT ABSOLUTE /end AXIS_DESCR
/end CHARACTERISTIC
/begin CHARACTERISTIC KF_MDIOP_1_TQE "optimales Referenz-Moment aus Füllung und Drehzahl" MAP 0x807270AA _REC_A1CUR_1_MBSE_S2_S1 6553.5 BMW_dm_sw_q0p1_Nm -3276.8 3276.7
 /begin AXIS_DESCR COM_AXIS NO_INPUT_QUANTITY CgkBooc_wkiDfEd_Czglhgc_fR_1a0o 18 -327.68 327.67 AXIS_PTS_REF AXX_KF_MDIOP_1_TQE FORMAT "%6.2" MONOTONY STRICT_INCREASE DEPOSIT ABSOLUTE /end AXIS_DESCR
 /begin AXIS_DESCR COM_AXIS NO_INPUT_QUANTITY caoddzd_oAjpfzb_cAcEEha_1nR_oa0 20 -32768 32767 AXIS_PTS_REF AXY_KF_MDIOP_1_TQE FORMAT "%5.0" MONOTONY STRICT_INCREASE DEPOSIT ABSOLUTE /end AXIS_DESCR
/end CHARACTERISTIC
/begin CHARACTERISTIC KF_MDK_MAX_GANG_NKW "KF_MDK_MAX_GANG_NKW" MAP 0x8074158C _REC_A1CUR_1_MBSE_S2_S1 6553.5 BMW_dm_sw_q0p1_Nm -3276.8 3276.7 FORMAT "%6.2"
 /begin AXIS_DESCR COM_AXIS Gang_gb1_ist raChrxc_kBtBrmb_FmDuEFa_n__aa0o 10 -128 127 AXIS_PTS_REF AXX_KF_MDK_MAX_GANG_NKW FORMAT "%6.0" MONOTONY STRICT_INCREASE DEPOSIT ABSOLUTE /end AXIS_DESCR
 /begin AXIS_DESCR COM_AXIS Nkw_plaus caoddzd_oAjpfzb_cAcEEha_1nR_oa0 8 -32768 32767 AXIS_PTS_REF AXY_KF_MDK_MAX_GANG_NKW FORMAT "%6.0" MONOTONY STRICT_INCREASE DEPOSIT ABSOLUTE /end AXIS_DESCR
/end CHARACTERISTIC
/begin CHARACTERISTIC KF_MDR_ABV_SPO "Relative desired torque for drivetrain in sport mode" MAP 0x8072BBCC _REC_A1CUR_1_MBSE_U2_S1 255.99609375 BMW_Powertrain_DxECompuMethods_Def_ub_b1_nounit 0 255.99609375
 /begin AXIS_DESCR COM_AXIS NO_INPUT_QUANTITY Asyaixa_wdvtenb_FCefaCb_n__aa0o 10 -655.36 655.34 AXIS_PTS_REF AXX_KF_MDR_ABV_SPO MONOTONY STRICT_INCREASE DEPOSIT ABSOLUTE /end AXIS_DESCR
 /begin AXIS_DESCR COM_AXIS NO_INPUT_QUANTITY uvFxekd_wvexlbc_BcFdkDd_nR_1a0o 12 -800 799.9755859375 AXIS_PTS_REF AXY_KF_MDR_ABV_SPO MONOTONY STRICT_INCREASE DEPOSIT ABSOLUTE /end AXIS_DESCR
/end CHARACTERISTIC
/begin CHARACTERISTIC KF_MDR_ABV_SPO_HS "Relative desired torque for drivetrain in sport mode (manual transmission)" MAP 0x8072B8FC _REC_A1CUR_1_MBSE_U2_S1 255.99609375 BMW_Powertrain_DxECompuMethods_Def_ub_b1_nounit 0 255.99609375
 /begin AXIS_DESCR COM_AXIS NO_INPUT_QUANTITY Asyaixa_wdvtenb_FCefaCb_n__aa0o 10 -655.36 655.34 AXIS_PTS_REF AXX_KF_MDR_ABV_SPO_HS MONOTONY STRICT_INCREASE DEPOSIT ABSOLUTE /end AXIS_DESCR
 /begin AXIS_DESCR COM_AXIS NO_INPUT_QUANTITY uvFxekd_wvexlbc_BcFdkDd_nR_1a0o 12 -800 799.9755859375 AXIS_PTS_REF AXY_KF_MDR_ABV_SPO_HS MONOTONY STRICT_INCREASE DEPOSIT ABSOLUTE /end AXIS_DESCR
/end CHARACTERISTIC
/begin CHARACTERISTIC KF_MDR_ABV_SPO2 "Relative desired torque for drivetrain in sport mode (2)" MAP 0x8072BADC _REC_A1CUR_1_MBSE_U2_S1 255.99609375 BMW_Powertrain_DxECompuMethods_Def_ub_b1_nounit 0 255.99609375
 /begin AXIS_DESCR COM_AXIS NO_INPUT_QUANTITY Asyaixa_wdvtenb_FCefaCb_n__aa0o 10 -655.36 655.34 AXIS_PTS_REF AXX_KF_MDR_ABV_SPO2 MONOTONY STRICT_INCREASE DEPOSIT ABSOLUTE /end AXIS_DESCR
 /begin AXIS_DESCR COM_AXIS NO_INPUT_QUANTITY uvFxekd_wvexlbc_BcFdkDd_nR_1a0o 12 -800 799.9755859375 AXIS_PTS_REF AXY_KF_MDR_ABV_SPO2 MONOTONY STRICT_INCREASE DEPOSIT ABSOLUTE /end AXIS_DESCR
/end CHARACTERISTIC
/begin CHARACTERISTIC KF_MDR_ABV_SPO2_HS "Relative desired torque for drivetrain in sport mode (manual transmission)" MAP 0x8072B9EC _REC_A1CUR_1_MBSE_U2_S1 255.99609375 BMW_Powertrain_DxECompuMethods_Def_ub_b1_nounit 0 255.99609375
 /begin AXIS_DESCR COM_AXIS NO_INPUT_QUANTITY Asyaixa_wdvtenb_FCefaCb_n__aa0o 10 -655.36 655.34 AXIS_PTS_REF AXX_KF_MDR_ABV_SPO2_HS MONOTONY STRICT_INCREASE DEPOSIT ABSOLUTE /end AXIS_DESCR
 /begin AXIS_DESCR COM_AXIS NO_INPUT_QUANTITY uvFxekd_wvexlbc_BcFdkDd_nR_1a0o 12 -800 799.9755859375 AXIS_PTS_REF AXY_KF_MDR_ABV_SPO2_HS MONOTONY STRICT_INCREASE DEPOSIT ABSOLUTE /end AXIS_DESCR
/end CHARACTERISTIC
/begin CHARACTERISTIC KF_MDRED_T "Factor for reducing engine target torque depending on temperatures" MAP 0x807584D8 _REC_A1CUR_1_MBSE_U1_S1 0.99609375 BMW_Powertrain_DxECompuMethods_Def_ub_b1_nounit 0 0.99609375
 /begin AXIS_DESCR COM_AXIS Tmot_wm DchEpAd_DBCFgoa_Ckhahgc_q__aoa0 6 -327.68 327.67 AXIS_PTS_REF AXX_KF_MDRED_T MONOTONY STRICT_INCREASE DEPOSIT ABSOLUTE /end AXIS_DESCR
 /begin AXIS_DESCR COM_AXIS Toel_wm BMW_q0p1_degC 6 -3276.8 3276.7 AXIS_PTS_REF AXY_KF_MDRED_T MONOTONY STRICT_INCREASE DEPOSIT ABSOLUTE /end AXIS_DESCR
/end CHARACTERISTIC
/begin CHARACTERISTIC KF_POELSOLL "Oil pressure setpoint specification for regulated oil pump" MAP 0x80701058 _REC_S5MAP_52_KF_U2_S2_S2 65535 doAbvic_Aaltzwd_vyCuowa_hCRoa0o 0 65535
 /begin AXIS_DESCR STD_AXIS Nkw caoddzd_oAjpfzb_cAcEEha_1nR_oa0 10 -32768 32767 FORMAT "%5.0" MONOTONY STRICT_INCREASE DEPOSIT ABSOLUTE /end AXIS_DESCR
 /begin AXIS_DESCR STD_AXIS Tpoel_reg BMW_q0p1_degC 6 -3276.8 3276.7 FORMAT "%6.1" MONOTONY STRICT_INCREASE DEPOSIT ABSOLUTE /end AXIS_DESCR
/end CHARACTERISTIC
/begin CHARACTERISTIC KF_POELSOLL_ADP "Load-dependent oil pressure setpoint offset" MAP 0x80700F24 _REC_S5MAP_52_KF_U2_S2_U2 65535 doAbvic_Aaltzwd_vyCuowa_hCRoa0o 0 65535
 /begin AXIS_DESCR STD_AXIS Nkw caoddzd_oAjpfzb_cAcEEha_1nR_oa0 10 -32768 32767 FORMAT "%5.0" MONOTONY STRICT_INCREASE DEPOSIT ABSOLUTE /end AXIS_DESCR
 /begin AXIS_DESCR STD_AXIS Mdi_poel_n FzbmlAa_gCtylrb_ckCqxAc_nR_6oa0 6 0 0.999984741210938 MONOTONY STRICT_INCREASE DEPOSIT ABSOLUTE /end AXIS_DESCR
/end CHARACTERISTIC
/begin CHARACTERISTIC KF_POELSOLL_ADP_FAK "Speed and oil temperature dependent factor for considering the oil pressure offset" MAP 0x80700EE6 _REC_S5MAP_52_KF_U1_S2_S2 7.96875 fqCirwd_flsbrkc_xChfaCb_n__aa0o 0 7.96875
 /begin AXIS_DESCR STD_AXIS Nkw caoddzd_oAjpfzb_cAcEEha_1nR_oa0 6 -32768 32767 FORMAT "%5.0" MONOTONY STRICT_INCREASE DEPOSIT ABSOLUTE /end AXIS_DESCR
 /begin AXIS_DESCR STD_AXIS Tpoel_reg BMW_q0p1_degC 6 -3276.8 3276.7 FORMAT "%6.1" MONOTONY STRICT_INCREASE DEPOSIT ABSOLUTE /end AXIS_DESCR
/end CHARACTERISTIC
/begin CHARACTERISTIC KF_ZW_PF1 "Base ignition angle path 1" MAP 0x80753EFF _REC_A1CUR_1_MBSE_S1_S1 127.5 aAwkuzc_BFpgCmb_tmDukma_q__aa0o -64 63.5 FORMAT "%4.1"
 /begin AXIS_DESCR COM_AXIS Nkw caoddzd_oAjpfzb_cAcEEha_1nR_oa0 20 -32768 32767 AXIS_PTS_REF AXX_KF_ZW_PF1 FORMAT "%5.0" MONOTONY STRICT_INCREASE DEPOSIT ABSOLUTE /end AXIS_DESCR
 /begin AXIS_DESCR COM_AXIS NO_INPUT_QUANTITY CgkBooc_wkiDfEd_Czglhgc_fR_1a0o 20 -327.68 327.67 AXIS_PTS_REF AXY_KF_ZW_PF1 FORMAT "%9.2" MONOTONY STRICT_INCREASE DEPOSIT ABSOLUTE /end AXIS_DESCR
/end CHARACTERISTIC
/begin CHARACTERISTIC KF_ZW_PF2 "Base ignition angle path 2" MAP 0x80753D6F _REC_A1CUR_1_MBSE_S1_S1 127.5 aAwkuzc_BFpgCmb_tmDukma_q__aa0o -64 63.5 FORMAT "%4.1"
 /begin AXIS_DESCR COM_AXIS Nkw caoddzd_oAjpfzb_cAcEEha_1nR_oa0 20 -32768 32767 AXIS_PTS_REF AXX_KF_ZW_PF2 FORMAT "%5.0" MONOTONY STRICT_INCREASE DEPOSIT ABSOLUTE /end AXIS_DESCR
 /begin AXIS_DESCR COM_AXIS NO_INPUT_QUANTITY CgkBooc_wkiDfEd_Czglhgc_fR_1a0o 20 -327.68 327.67 AXIS_PTS_REF AXY_KF_ZW_PF2 FORMAT "%9.2" MONOTONY STRICT_INCREASE DEPOSIT ABSOLUTE /end AXIS_DESCR
/end CHARACTERISTIC
/begin CHARACTERISTIC KF_ZW_S_PF1 "Base ignition angle path 1 safe" MAP 0x80753BDF _REC_A1CUR_1_MBSE_S1_S1 127.5 aAwkuzc_BFpgCmb_tmDukma_q__aa0o -64 63.5 FORMAT "%4.1"
 /begin AXIS_DESCR COM_AXIS Nkw caoddzd_oAjpfzb_cAcEEha_1nR_oa0 20 -32768 32767 AXIS_PTS_REF AXX_KF_ZW_S_PF1 FORMAT "%5.0" MONOTONY STRICT_INCREASE DEPOSIT ABSOLUTE /end AXIS_DESCR
 /begin AXIS_DESCR COM_AXIS NO_INPUT_QUANTITY CgkBooc_wkiDfEd_Czglhgc_fR_1a0o 20 -327.68 327.67 AXIS_PTS_REF AXY_KF_ZW_S_PF1 FORMAT "%9.2" MONOTONY STRICT_INCREASE DEPOSIT ABSOLUTE /end AXIS_DESCR
/end CHARACTERISTIC
/begin CHARACTERISTIC KF_ZW_S_PF2 "Base ignition angle path 2 safe" MAP 0x80753A4F _REC_A1CUR_1_MBSE_S1_S1 127.5 aAwkuzc_BFpgCmb_tmDukma_q__aa0o -64 63.5 FORMAT "%4.1"
 /begin AXIS_DESCR COM_AXIS Nkw caoddzd_oAjpfzb_cAcEEha_1nR_oa0 20 -32768 32767 AXIS_PTS_REF AXX_KF_ZW_S_PF2 FORMAT "%5.0" MONOTONY STRICT_INCREASE DEPOSIT ABSOLUTE /end AXIS_DESCR
 /begin AXIS_DESCR COM_AXIS NO_INPUT_QUANTITY CgkBooc_wkiDfEd_Czglhgc_fR_1a0o 20 -327.68 327.67 AXIS_PTS_REF AXY_KF_ZW_S_PF2 FORMAT "%9.2" MONOTONY STRICT_INCREASE DEPOSIT ABSOLUTE /end AXIS_DESCR
/end CHARACTERISTIC
/begin CHARACTERISTIC KF_ZW_UESP_PF1 "Base ignition angle scavenging path 1" MAP 0x807539C3 _REC_A1CUR_1_MBSE_S1_S1 127.5 aAwkuzc_BFpgCmb_tmDukma_q__aa0o -64 63.5 FORMAT "%4.1"
 /begin AXIS_DESCR COM_AXIS Nkw caoddzd_oAjpfzb_cAcEEha_1nR_oa0 10 -32768 32767 AXIS_PTS_REF AXX_KF_ZW_UESP_PF1 FORMAT "%5.0" MONOTONY STRICT_INCREASE DEPOSIT ABSOLUTE /end AXIS_DESCR
 /begin AXIS_DESCR COM_AXIS NO_INPUT_QUANTITY CgkBooc_wkiDfEd_Czglhgc_fR_1a0o 14 -327.68 327.67 AXIS_PTS_REF AXY_KF_ZW_UESP_PF1 FORMAT "%9.2" MONOTONY STRICT_INCREASE DEPOSIT ABSOLUTE /end AXIS_DESCR
/end CHARACTERISTIC
/begin CHARACTERISTIC KF_ZW_UESP_PF2 "Base ignition angle scavenging path 2" MAP 0x80753937 _REC_A1CUR_1_MBSE_S1_S1 127.5 aAwkuzc_BFpgCmb_tmDukma_q__aa0o -64 63.5 FORMAT "%4.1"
 /begin AXIS_DESCR COM_AXIS Nkw caoddzd_oAjpfzb_cAcEEha_1nR_oa0 10 -32768 32767 AXIS_PTS_REF AXX_KF_ZW_UESP_PF2 FORMAT "%5.0" MONOTONY STRICT_INCREASE DEPOSIT ABSOLUTE /end AXIS_DESCR
 /begin AXIS_DESCR COM_AXIS NO_INPUT_QUANTITY CgkBooc_wkiDfEd_Czglhgc_fR_1a0o 14 -327.68 327.67 AXIS_PTS_REF AXY_KF_ZW_UESP_PF2 FORMAT "%9.2" MONOTONY STRICT_INCREASE DEPOSIT ABSOLUTE /end AXIS_DESCR
/end CHARACTERISTIC
/begin CHARACTERISTIC KF_ZW_VP_PF1 "Map for ignition angle with VANOS at stop F_basis=1 path 1" MAP 0x8075A874 _REC_A1CUR_1_MBSE_S1_S1 127.5 aAwkuzc_BFpgCmb_tmDukma_q__aa0o -64 63.5 FORMAT "%4.1"
 /begin AXIS_DESCR COM_AXIS Nkw caoddzd_oAjpfzb_cAcEEha_1nR_oa0 20 -32768 32767 AXIS_PTS_REF AXX_KF_ZW_VP_PF1 FORMAT "%5.0" MONOTONY STRICT_INCREASE DEPOSIT ABSOLUTE /end AXIS_DESCR
 /begin AXIS_DESCR COM_AXIS Rf_zwv CgkBooc_wkiDfEd_Czglhgc_fR_1a0o 16 -327.68 327.67 AXIS_PTS_REF AXY_KF_ZW_VP_PF1 FORMAT "%9.2" MONOTONY STRICT_INCREASE DEPOSIT ABSOLUTE /end AXIS_DESCR
/end CHARACTERISTIC
/begin CHARACTERISTIC KF_ZW_VP_PF2 "Map for ignition angle with VANOS at stop F_basis=1 path 2" MAP 0x8075A734 _REC_A1CUR_1_MBSE_S1_S1 127.5 aAwkuzc_BFpgCmb_tmDukma_q__aa0o -64 63.5 FORMAT "%4.1"
 /begin AXIS_DESCR COM_AXIS Nkw caoddzd_oAjpfzb_cAcEEha_1nR_oa0 20 -32768 32767 AXIS_PTS_REF AXX_KF_ZW_VP_PF2 FORMAT "%5.0" MONOTONY STRICT_INCREASE DEPOSIT ABSOLUTE /end AXIS_DESCR
 /begin AXIS_DESCR COM_AXIS Rf_zwv CgkBooc_wkiDfEd_Czglhgc_fR_1a0o 16 -327.68 327.67 AXIS_PTS_REF AXY_KF_ZW_VP_PF2 FORMAT "%9.2" MONOTONY STRICT_INCREASE DEPOSIT ABSOLUTE /end AXIS_DESCR
/end CHARACTERISTIC
/begin MEASUREMENT Anz_b_sound "Counter for activation of B_sound_bmw" UBYTE raChrxc_kBtBrmb_FmDuEFa_n__aa0o 1 100 0 255 FORMAT "%5.0" ECU_ADDRESS 0x6003429C /end MEASUREMENT
/begin MEASUREMENT BMW_mod_EngDynSp "mode(Modus) engine(Verbrennungsmotor) dynamic(dynamisch) setpoint(Sollwert): B0 = keine Dyn optimierter Verbrauch, B1 = erhoehte Dyn, B2 = max Dyn, B3 = Volllastanhebung ohne Anzahlbegrenzung, B4 = Volllastanhebung mit Anzahlbegrenzung" UBYTE raChrxc_kBtBrmb_FmDuEFa_n__aa0o 1 100 0 255 FORMAT "%3.0" ECU_ADDRESS 0x50006633 /end MEASUREMENT
/begin MEASUREMENT BMWchst_t_Eng_sw "Motortemperatur zur Verwendung im Katheizmanager (umschaltbar zwischen Kühlwassertemperatur Tmot und Bauteiltemperatur Tbt_mot)" SWORD DchEpAd_DBCFgoa_Ckhahgc_q__aoa0 1 100 -327.68 327.67 FORMAT "%6.2" ECU_ADDRESS 0x7000210E /end MEASUREMENT
/begin MEASUREMENT BMWinj_t_Eng_sw "Engine temperature injection" SWORD DchEpAd_DBCFgoa_Ckhahgc_q__aoa0 1 100 -327.68 327.67 FORMAT "%7.2" ECU_ADDRESS 0x600039E2 /end MEASUREMENT
/begin MEASUREMENT BMWlpa_n_Efp_uw "Electric fuel pump speed setpoint" UWORD caoddzd_oAjpfzb_cAcEEha_1nR_oa0 1 100 0 65535 FORMAT "%5.0" ECU_ADDRESS 0x600021EA /end MEASUREMENT
/begin MEASUREMENT BMWlpi_p_HiPAbs "absoluter Kraftstoffhochdruck" UWORD bukAcFc_hypjrAa_CBhougc_MCRooa0 1 100 0 131.07 ECU_ADDRESS 0x600021F0 /end MEASUREMENT
/begin MEASUREMENT BMWlpi_p_HiPAbsSp "absoluter Kraftstoffhochdrucksollwert" UWORD bukAcFc_hypjrAa_CBhougc_MCRooa0 1 100 0 131.07 ECU_ADDRESS 0x600021F2 /end MEASUREMENT
/begin MEASUREMENT BMWlpi_t_Fu_sw "Fuel temperature low-pressure system before high-pressure pump" SWORD DchEpAd_DBCFgoa_Ckhahgc_q__aoa0 1 100 -327.68 327.67 FORMAT "%5.2" ECU_ADDRESS 0x600021F8 /end MEASUREMENT
/begin MEASUREMENT BMWlpi_volf_Fu_sw "Kraftstoffvolumenstrom" SWORD zBcBzad_vmoivka_mFzjCgc_lCRooa0 1 100 -327.68 327.67 FORMAT "%5.2" ECU_ADDRESS 0x600021FC /end MEASUREMENT
/begin MEASUREMENT BMWlpsc_p_DeSp_sw "Niederdruckkreislauf Druckabweichung vom Sollwert" SWORD rgduxyd_mlihaBb_gsCghzb_bCRa0a0 1 100 -32.768 32.767 FORMAT "%5.3" ECU_ADDRESS 0x60002202 /end MEASUREMENT
/begin MEASUREMENT BMWlpsc_p_EfpSpCtld_uw "Electric fuel pump pressure value controlled" UWORD rgduxyd_mlihaBb_gsCghzb_bCRa0a0 1 100 0 65.535 FORMAT "%5.3" ECU_ADDRESS 0x60002204 /end MEASUREMENT
/begin MEASUREMENT BMWlpsc_st_TankCod_ub "Tank coding" UBYTE raChrxc_kBtBrmb_FmDuEFa_n__aa0o 1 100 0 255 FORMAT "%3.0" ECU_ADDRESS 0x600043A0 /end MEASUREMENT
/begin MEASUREMENT BMWls_fac_rf_RedFil_uw "Filling reduction factor after filtering" UWORD FzbmlAa_gCtylrb_ckCqxAc_nR_6oa0 1 100 0 0.999984741210938 FORMAT "%7.5" ECU_ADDRESS 0x60001C90 /end MEASUREMENT
/begin MEASUREMENT BMWpim_fac_TqRedn_ub "Pre-ignition management, torque reduction factor" UBYTE BMW_Powertrain_DxECompuMethods_Def_ub_b1_nounit 1 100 0 0.99609375 ECU_ADDRESS 0x60004232 /end MEASUREMENT
/begin MEASUREMENT BMWrail_p_RpsActVal "Raildruck" UWORD bukAcFc_hypjrAa_CBhougc_MCRooa0 1 100 0 131.07 FORMAT "%8.3" ECU_ADDRESS 0x60002876 /end MEASUREMENT
/begin MEASUREMENT BMWrailco_rat_VabHom_sw "Input value for common-rail pressure maps (Rf_soll or Rk_soll_h). It can also consider predicted values (Rk_pre or Rf_pre_h)." SWORD zyyxBpb_rEsnvtc_gktukCa_fR_5a0o 1 100 -1600 1599.951171875 FORMAT "%8.3" ECU_ADDRESS 0x600023BE /end MEASUREMENT
/begin MEASUREMENT BMWtchbas_p_Dif_sw "Pld_diff (Soll-Ladedruck minus Ist-Ladedruck)" SWORD BMW_p_sw_q0p125_hPa 1 100 -4096 4095.875 FORMAT "%10.3" ECU_ADDRESS 0x600024D4 /end MEASUREMENT
/begin MEASUREMENT BMWtchbas_p_DifGra_sw "Normalized control deviation gradient - bank-specific" SWORD BMW_p_sw_q0p125_hPa 1 100 -4096 4095.875 FORMAT "%10.3" ECU_ADDRESS 0x600024D0 /end MEASUREMENT
/begin MEASUREMENT BMWtchctr_pwr_Pctl_uw "Turbine power from compressor map" UWORD jucyrzb_bpFgwfd_uqrfhgc_k__aoa0 1 100 0 127.998046875 FORMAT "%7.3" ECU_ADDRESS 0x6000252A /end MEASUREMENT
/begin MEASUREMENT BMWtchdiag_fac_pwr_TrbPctl_uw "AXY_KF_ATLRPID_MX" UWORD acriqBc_tfkBqod_ocgjxzc_nR_8oa0 1 100 0 7.9998779296875 FORMAT "%10.3" ECU_ADDRESS 0x5002C850 /end MEASUREMENT
/begin MEASUREMENT BMWtchsp_mf_CmprNorm_uw "Target mass flow corrected for boost pressure control" UWORD CByjozc_eCmpBAb_pljBAmd_k__0oa0 1 100 0 2047.96875 FORMAT "%10.3" ECU_ADDRESS 0x60002550 /end MEASUREMENT
/begin MEASUREMENT BMWtchsp_mf_Ex_uw "Target mass flow at exhaust manifold - inflow" UWORD CByjozc_eCmpBAb_pljBAmd_k__0oa0 1 100 0 2047.96875 FORMAT "%10.3" ECU_ADDRESS 0x60002552 /end MEASUREMENT
/begin MEASUREMENT BMWtchsp_rat_p_CmprLim_uw "Target charge factor - target boost pressure to pressure before compressor" UWORD acriqBc_tfkBqod_ocgjxzc_nR_8oa0 1 100 0 7.9998779296875 FORMAT "%11.4" ECU_ADDRESS 0x60002546 /end MEASUREMENT
/begin MEASUREMENT BMWtchtbc_t_BefCmpr_sw "Temperature before turbocharger - model or sensor value" SWORD BMW_q0p1_degC 1 100 -3276.8 3276.7 FORMAT "%6.1" ECU_ADDRESS 0x6002473A /end MEASUREMENT
/begin MEASUREMENT BMWtqe_fac_EmiRednColdCat "Factor for reducing combustion engine torque with cold catalyst" UWORD FzbmlAa_gCtylrb_ckCqxAc_nR_6oa0 1 100 0 0.999984741210938 FORMAT "%14.5" ECU_ADDRESS 0x50005E82 /end MEASUREMENT
/begin MEASUREMENT BMWtqe_fac_EngTqLimd "Reduzierungsfaktor Momentenbegrenzung Verbrennungsmotor" UBYTE BMW_Powertrain_DxECompuMethods_Def_ub_b1_nounit 1 100 0 0.99609375 ECU_ADDRESS 0x60004708 /end MEASUREMENT
/begin MEASUREMENT Drf_s2spred "Dynamic Rf_soll damping (Rf_soll_md_pred minus Rf_soll_md)" UWORD CgkBooc_wkiDfEd_Czglhgc_fR_1a0o 1 100 0 655.35 ECU_ADDRESS 0x60001C5A /end MEASUREMENT
/begin MEASUREMENT Dtans_tumg_wm "Difference between ambient temperature and intake air temperature in warm-up coordinator" SWORD BMW_q0p1_degC 1 100 -3276.8 3276.7 ECU_ADDRESS 0x5002CA86 /end MEASUREMENT
/begin MEASUREMENT Dtkwsoll_tka_f "gefiltere Kuehleraustriffs-Temperaturdifferenz Ist-Soll" SWORD DchEpAd_DBCFgoa_Ckhahgc_q__aoa0 1 100 -327.68 327.67 FORMAT "%6.2" ECU_ADDRESS 0x5002CAC0 /end MEASUREMENT
/begin MEASUREMENT Dtmot_tkwsoll "Engine temperature difference: actual - setpoint" SWORD DchEpAd_DBCFgoa_Ckhahgc_q__aoa0 1 100 -327.68 327.67 ECU_ADDRESS 0x7000F22A /end MEASUREMENT
/begin MEASUREMENT Dtmot_tkwsoll_f "Filtered coolant difference actual - setpoint" SWORD DchEpAd_DBCFgoa_Ckhahgc_q__aoa0 1 100 -327.68 327.67 FORMAT "%6.2" ECU_ADDRESS 0x5002CAC2 /end MEASUREMENT
/begin MEASUREMENT Dzw_annm "Reference value for B_kftkr" SWORD BMW_q0p1_deg 1 100 -3276.8 3276.7 FORMAT "%6.1" ECU_ADDRESS 0x7000F3C2 /end MEASUREMENT
/begin MEASUREMENT Dzw_tot_kr "Total retard angle from best ignition angle" SWORD BMW_q0p1_deg 1 100 -3276.8 3276.7 FORMAT "%6.1" ECU_ADDRESS 0x600036A2 /end MEASUREMENT
/begin MEASUREMENT EngPrt_NMAXSgangsis_mp "MP: Current gear" SBYTE BMW_ba_poel__ 1 100 -128 127 FORMAT "%5.1" ECU_ADDRESS 0x70011165 /end MEASUREMENT
/begin MEASUREMENT EngPrt_t1_mp "MP: Coolant temperature at engine outlet" UBYTE temp_ub_q0p75_o48 1 100 -48 143.3 FORMAT "%5.1" ECU_ADDRESS 0x70011164 /end MEASUREMENT
/begin MEASUREMENT EngPrt_t2_mp "MP: Engine oil temperature, output in degrees C, internally in Kelvin" UWORD temp_q0p0234_o273 1 100 -273.15 1262.827 FORMAT "%8.3" ECU_ADDRESS 0x70011162 /end MEASUREMENT
/begin MEASUREMENT Epm_nEng "Average engine speed over one cylinder segment" SWORD EngN 1 100 -16384 16383.5 FORMAT "%8.2" ECU_ADDRESS 0x50001DBA /end MEASUREMENT
/begin MEASUREMENT Epm_nEngLRes "Engine speed with low resolution" UBYTE EngN_LRes 1 100 0 10200 FORMAT "%5.0" ECU_ADDRESS 0x50001EC0 /end MEASUREMENT
/begin MEASUREMENT F_octan "Adapted fuel quality factor (0=RON98 / 1.0=RON91)" UBYTE BMW_Powertrain_DxECompuMethods_Def_ub_b1_nounit 1 100 0 0.99609375 FORMAT "%6.1" ECU_ADDRESS 0x60034186 /end MEASUREMENT
/begin MEASUREMENT F_pld_wm_f "Target charge factor - target boost pressure to pressure before compressor as filtered average in warm-up coordinator" UWORD acriqBc_tfkBqod_ocgjxzc_nR_8oa0 1 100 0 7.9998779296875 ECU_ADDRESS 0x5002CAE8 /end MEASUREMENT
/begin MEASUREMENT Frfmxbsld "Filling limitation factor due to component protection at rich running limit" UWORD Bhvfwhc_bigEubd_BBEupBd_nR_3oa0 1 100 0 1.99996948242188 FORMAT "%14.5" ECU_ADDRESS 0x600246C0 /end MEASUREMENT
/begin MEASUREMENT FupHi_nEngLResHDR "Wichtungsfaktor PI-Regler-Parameter HDR; P-Anteil" UBYTE nmot_q40 1 100 0 10200 FORMAT "%5.0" ECU_ADDRESS 0x6001218F /end MEASUREMENT
/begin MEASUREMENT FuPHi_pHpRglnDeLoc "Temporary variable for FuPHi_pHpRglnDe" SWORD RBPtCel_p_0p002_1 1 100 -65.536 65.534 FORMAT "%8.5" ECU_ADDRESS 0x60010530 /end MEASUREMENT
/begin MEASUREMENT Gang_gb1_ist "Actual gear gearbox 1" SBYTE raChrxc_kBtBrmb_FmDuEFa_n__aa0o 1 100 -128 127 FORMAT "%6.0" ECU_ADDRESS 0x60004A90 /end MEASUREMENT
/begin MEASUREMENT gangakr "Local gear information, limited to positive values" UBYTE DEZ 1 100 0 127 FORMAT "%5.1" ECU_ADDRESS 0x70009D55 /end MEASUREMENT
/begin MEASUREMENT Gangi "Current gear internal (incl. neutral and reverse)" UBYTE raChrxc_kBtBrmb_FmDuEFa_n__aa0o 1 100 0 255 FORMAT "%3.0" ECU_ADDRESS 0x50004431 /end MEASUREMENT
/begin MEASUREMENT IKCtl_facKnkInten_u8 "Integrator / reference level ratio for knock control" UBYTE fak_ub_b16 1 100 0 15.94 FORMAT "%5.2" ECU_ADDRESS 0x50023065 /end MEASUREMENT
/begin MEASUREMENT Mdi_max_diff "Absolute difference between Mdi_max before and after rate limiter" UWORD BMW_dm_sw_q0p1_Nm 1 100 0 3276.7 FORMAT "%6.1" ECU_ADDRESS 0x6000267A /end MEASUREMENT
/begin MEASUREMENT Mdi_poel_n "Normalized torque for oil pressure control" UWORD FzbmlAa_gCtylrb_ckCqxAc_nR_6oa0 1 100 0 0.999984741210938 ECU_ADDRESS 0x50005454 /end MEASUREMENT
/begin MEASUREMENT Nelueft_klima_wm "Electric fan speed request from air conditioning in warm-up coordinator" UBYTE BMW_q0p3906_PERC 1 100 0 99.609375 ECU_ADDRESS 0x7000F843 /end MEASUREMENT
/begin MEASUREMENT Nkw "Engine speed" SWORD caoddzd_oAjpfzb_cAcEEha_1nR_oa0 1 100 -32768 32767 ECU_ADDRESS 0x60003C96 /end MEASUREMENT
/begin MEASUREMENT Nkw_10ms "Drehzahl im 10ms Ratser über 1 Zylindersegment gemittelt" SWORD caoddzd_oAjpfzb_cAcEEha_1nR_oa0 1 100 -32768 32767 ECU_ADDRESS 0x60002920 /end MEASUREMENT
/begin MEASUREMENT Nkw_atm "Crankshaft speed ATM" SWORD caoddzd_oAjpfzb_cAcEEha_1nR_oa0 1 100 -32768 32767 ECU_ADDRESS 0x60001F56 /end MEASUREMENT
/begin MEASUREMENT Nkw_opt "Engine speed for optimal gear ratio (Almo)" SWORD caoddzd_oAjpfzb_cAcEEha_1nR_oa0 1 100 -32768 32767 FORMAT "%5.0" ECU_ADDRESS 0x60002E1C /end MEASUREMENT
/begin MEASUREMENT Nkw_plaus "Plausibility-checked crankshaft speed of the combustion engine" SWORD caoddzd_oAjpfzb_cAcEEha_1nR_oa0 1 100 -32768 32767 FORMAT "%6.0" ECU_ADDRESS 0x60002C7E /end MEASUREMENT
/begin MEASUREMENT Nkw_ref "ASD. Calculated crankshaft speed reference." SWORD caoddzd_oAjpfzb_cAcEEha_1nR_oa0 1 100 -32768 32767 ECU_ADDRESS 0x60003A38 /end MEASUREMENT
/begin MEASUREMENT Nkw_wm "Combustion engine speed in warm-up coordinator" SWORD caoddzd_oAjpfzb_cAcEEha_1nR_oa0 1 100 -32768 32767 ECU_ADDRESS 0x7000F214 /end MEASUREMENT
/begin MEASUREMENT Pumg "Umgebungsdruck" UWORD BMW_p_sw_q0p125_hPa 1 100 0 8191.875 ECU_ADDRESS 0x6002477C /end MEASUREMENT
/begin MEASUREMENT Rf "Relative air filling" SWORD CgkBooc_wkiDfEd_Czglhgc_fR_1a0o 1 100 -327.68 327.67 FORMAT "%7.2" ECU_ADDRESS 0x60003422 /end MEASUREMENT
/begin MEASUREMENT Rf_atm "Relative air filling ATM" SWORD CgkBooc_wkiDfEd_Czglhgc_fR_1a0o 1 100 -327.68 327.67 ECU_ADDRESS 0x7000214E /end MEASUREMENT
/begin MEASUREMENT Rf_zwv "Relative actual filling or actual volume for ignition angle calculation" SWORD CgkBooc_wkiDfEd_Czglhgc_fR_1a0o 1 100 -327.68 327.67 FORMAT "%9.2" ECU_ADDRESS 0x600036B2 /end MEASUREMENT
/begin MEASUREMENT rl_msg "Relative air filling" UBYTE rel_ub_q0p75 1 100 0 191.3 FORMAT "%5.1" ECU_ADDRESS 0x600133B2 /end MEASUREMENT
/begin MEASUREMENT St_dsc_can "St_dsc_can" UBYTE raChrxc_kBtBrmb_FmDuEFa_n__aa0o 1 100 0 255 FORMAT "%3.0" ECU_ADDRESS 0x60004C4E /end MEASUREMENT
/begin MEASUREMENT Status_usecase_antr "Status usecase drivetrain: ASM output for gb2; eBS; FP; EGS" UBYTE raChrxc_kBtBrmb_FmDuEFa_n__aa0o 1 100 0 255 ECU_ADDRESS 0x50004420 /end MEASUREMENT
/begin MEASUREMENT T_opf_in_wm "Abgastemperatur in der Mitte des Partikelfilters" SWORD BMW_q0p1_degC 1 100 -3276.8 3276.7 ECU_ADDRESS 0x5002C88C /end MEASUREMENT
/begin MEASUREMENT Tabg_wm "Plausibility-checked exhaust gas temperature in warm-up coordinator" SWORD BMW_q0p1_degC 1 100 -3276.8 3276.7 ECU_ADDRESS 0x7000F202 /end MEASUREMENT
/begin MEASUREMENT Tans "Intake air temperature average" SWORD BMW_q0p1_degC 1 100 -3276.8 3276.7 ECU_ADDRESS 0x60024784 /end MEASUREMENT
/begin MEASUREMENT Tdme_wm "DME ECU temperature in warm-up coordinator" SWORD DchEpAd_DBCFgoa_Ckhahgc_q__aoa0 1 100 -327.68 327.67 ECU_ADDRESS 0x5002C892 /end MEASUREMENT
/begin MEASUREMENT Tegs_wm "EGS ECU temperature in warm-up coordinator" SWORD BufnDdb_jpjgsgc_jmDugsa_qCRoa0o 1 100 -32768 32767 ECU_ADDRESS 0x5002C896 /end MEASUREMENT
/begin MEASUREMENT tfuelsq_msg "Kraftstofftemperatur (Sensor-, Modell o. fester Ersatzwert)" UBYTE temp_ub_q0p75_o48 1 100 -48 143.3 FORMAT "%5.1" ECU_ADDRESS 0x600133E3 /end MEASUREMENT
/begin MEASUREMENT Tget_wm "Getriebeoeltemperatur im WMK" SWORD DchEpAd_DBCFgoa_Ckhahgc_q__aoa0 1 100 -327.68 327.67 ECU_ADDRESS 0x7000F21C /end MEASUREMENT
/begin MEASUREMENT Tka_wm "Plausibility-checked coolant radiator outlet temperature in warm-up coordinator" SWORD DchEpAd_DBCFgoa_Ckhahgc_q__aoa0 1 100 -327.68 327.67 ECU_ADDRESS 0x5002CA84 /end MEASUREMENT
/begin MEASUREMENT Tmot "Coolant temperature" SWORD DchEpAd_DBCFgoa_Ckhahgc_q__aoa0 1 100 -327.68 327.67 ECU_ADDRESS 0x60002966 /end MEASUREMENT
/begin MEASUREMENT Tmot_wm "Combustion engine coolant temperature in warm-up coordinator" SWORD DchEpAd_DBCFgoa_Ckhahgc_q__aoa0 1 100 -327.68 327.67 ECU_ADDRESS 0x7000F222 /end MEASUREMENT
/begin MEASUREMENT Tn_start_10 "Time after start end in 10ms resolution" UWORD camcxxd_bxlpdsa_Cshlhgc_sR_1a0o 1 100 0 655.35 ECU_ADDRESS 0x60003CD6 /end MEASUREMENT
/begin MEASUREMENT Toel_wm "Engine oil temperature in warm-up coordinator" SWORD BMW_q0p1_degC 1 100 -3276.8 3276.7 ECU_ADDRESS 0x7000F224 /end MEASUREMENT
/begin MEASUREMENT Tpoel_reg "Input temperature for Poel_reg" SWORD BMW_q0p1_degC 1 100 -3276.8 3276.7 FORMAT "%6.1" ECU_ADDRESS 0x6002CC56 /end MEASUREMENT
/begin MEASUREMENT Tumg "Umgebungstemperatur" SWORD BMW_q0p1_degC 1 100 -3276.8 3276.7 ECU_ADDRESS 0x60024788 /end MEASUREMENT
/begin MEASUREMENT Tumg_wm "Ambient temperature in warm-up coordinator (without considering internal fault reaction)" SWORD BMW_q0p1_degC 1 100 -3276.8 3276.7 ECU_ADDRESS 0x7000F20E /end MEASUREMENT
/begin MEASUREMENT Tvdk "Temperature before throttle average" SWORD BMW_q0p1_degC 1 100 -3276.8 3276.7 ECU_ADDRESS 0x6002478C /end MEASUREMENT
/begin MEASUREMENT Tw_r1 "Pipe wall temperature 1" SWORD BMW_q0p1_degC 1 100 -3276.8 3276.7 FORMAT "%6.1" ECU_ADDRESS 0x600246EA /end MEASUREMENT
/begin MEASUREMENT V "Fahrzeuggeschwindigkeit" UWORD AFeDmkb_cAbjmcc_kAkskhd_k__0oa0 1 100 0 65535 ECU_ADDRESS 0x60003CD8 /end MEASUREMENT
/begin MEASUREMENT V_fzg_plaus "Plausibility-checked vehicle speed" SWORD jgbhAma_smpAegb_hlEBAmd_k__0oa0 1 100 -655.36 655.34 FORMAT "%6.2" ECU_ADDRESS 0x60002C74 /end MEASUREMENT
/begin MEASUREMENT V_wm "Vehicle speed in warm-up coordinator" UWORD BMW_q0p1_kilometer_per_hour 1 100 0 6553.5 ECU_ADDRESS 0x7000F210 /end MEASUREMENT
/begin MEASUREMENT Vskr_mw_wm "mittlerer Kraftstoffverbrauch im WMK" UWORD fpBesqd_hAxmiba_AAwtged_u__0oa0 1 100 0 65535 ECU_ADDRESS 0x7000F206 /end MEASUREMENT
/begin FUNCTION Ignition "Timing targets"
 /begin DEF_CHARACTERISTIC KF_FDZWT_BEST_PF2 KF_FDZWT_BEST_PF1 KF_ZW_UESP_PF2 KF_ZW_UESP_PF1 KF_ZW_S_PF2 KF_ZW_S_PF1 KF_ZW_PF2 KF_ZW_PF1 KF_DZW_DYN KF_FDZW_DYN4 KF_FDZW_DYN3 KF_FDZW_DYN2 KF_FDZW_DYN1 KF_DZWT_UESP_PF2 KF_DZWT_UESP_PF1 KF_DZWT_PF2 KF_DZWT_PF1 KF_ZW_VP_PF2 KF_ZW_VP_PF1 /end DEF_CHARACTERISTIC
/end FUNCTION
/begin FUNCTION Knock "Knock factors and corrections"
 /begin DEF_CHARACTERISTIC KF_FDZWT_PF2 KF_FDZWT_PF1 IKCtl_FacKnockDetThd0_GM IKCtl_FacKnockDetThd1_GM IKCtl_FacKnockDetThd2_GM IKCtl_FacKnockDetThd3_GM IKCtl_FacKnockDetThd4_GM IKCtl_FacKnockDetThd5_GM IKCtl_facKnkRtdtCyl0_M IKCtl_facKnkRtdtCyl1_M IKCtl_facKnkRtdtCyl2_M IKCtl_facKnkRtdtCyl3_M IKCtl_facKnkRtdtCyl4_M IKCtl_facKnkRtdtCyl5_M /end DEF_CHARACTERISTIC
/end FUNCTION
/begin FUNCTION Limits "General limiters"
 /begin DEF_CHARACTERISTIC BMWinjmon_vol_HppCmpn_C KF_MDK_MAX_GANG_NKW MoFETC_tiAccExcddThd_C VROHMAX /end DEF_CHARACTERISTIC
/end FUNCTION
/begin FUNCTION LoadControl "Load targets and limiters"
 /begin DEF_CHARACTERISTIC KF_EDA_ANZ_SPORT_MD_EM1_IST K_RFVIST_MX BMWinjafs_fac_RatAirMax_T K_RFMIN_KRSTSYS BMWext_lam_CptPronMinLeanTq_M KL_FRFMXBS KL_RFVHUBDYNKOR KL_RF_MAX_UESP KL_RF_MAX BMWls_rf_MaxModEng_M BMWls_rf_MaxFuOctIntkT_M BMWls_rf_MaxFuOctIntkTSpt_M BMWls_rf_MaxEgT_M BMWls_pct_FiMaxIgOfs_M BMWls_pct_FiMaxIgOfsSpt_M BMWls_pct_FiMaxCondRisk_T KL_LAMX BMWtchdiag_rf_SpMin_C BMWtchsp_rf_Liho_T KF_MDIOP_1_TQE KL_RFMIN_KRSTSYS BMWgpfdiag_rf_LimPclFilMin_T S_BSRFMX BMWls_fac_rf_RednFuOctIntkT_M CoEng_ratChrgAirCylMaxDesLim_C /end DEF_CHARACTERISTIC
/end FUNCTION
/begin FUNCTION LowPressureFuelPump "LPFP targets and limiters"
 /begin DEF_CHARACTERISTIC BMWlpa_rat_EfpPwm_T BMWlpa_fac_AirLimOvrTMin_C BMWlpa_rat_AirLimMax_C BMWlpa_rat_AirLimGraNeg_C BMWlpa_rat_AirLimMin_C /end DEF_CHARACTERISTIC
/end FUNCTION
/begin FUNCTION MAFSensor "Mass air flow quotient"
 /begin DEF_CHARACTERISTIC K_HFMPLCD_NKW_MX KF_FMS_HFMPL_MX KF_FMS_HFMPL_MN KF_FMS_DKPSRPL_MX KF_FMS_DKPSRPL_MN /end DEF_CHARACTERISTIC
/end FUNCTION
/begin FUNCTION MaxCooling "" /begin SUB_FUNCTION MaxCooling_Codewords /end SUB_FUNCTION /end FUNCTION
/begin FUNCTION MaxCooling_Codewords "" /end FUNCTION
/begin FUNCTION OilPressure "Oil Pressure" /begin DEF_CHARACTERISTIC KF_POELSOLL_ADP_FAK KF_POELSOLL_ADP KF_POELSOLL /end DEF_CHARACTERISTIC /end FUNCTION
/begin FUNCTION RadiatorFlap "" /begin SUB_FUNCTION RadiatorFlapOnTheFly_Codewords /end SUB_FUNCTION /end FUNCTION
/begin FUNCTION RadiatorFlapOnTheFly_Codewords "" /end FUNCTION
/begin FUNCTION SwitchableMaps ""
 /begin SUB_FUNCTION SwitchableMaps_General_Codewords SwitchableMaps_Map_Codewords SwitchableMaps_Slot0 SwitchableMaps_Slot1 SwitchableMaps_Slot2 SwitchableMaps_Slot3 SwitchableMaps_Slot4 /end SUB_FUNCTION
/end FUNCTION
/begin FUNCTION SwitchableMaps_General_Codewords "" /end FUNCTION
/begin FUNCTION SwitchableMaps_Map_Codewords "" /end FUNCTION
/begin FUNCTION SwitchableMaps_Slot0 "" /end FUNCTION
/begin FUNCTION SwitchableMaps_Slot1 "" /begin SUB_FUNCTION SwitchableMaps_Slot1_Codewords /end SUB_FUNCTION /end FUNCTION
/begin FUNCTION SwitchableMaps_Slot1_Codewords "" /end FUNCTION
/begin FUNCTION SwitchableMaps_Slot2 "" /begin SUB_FUNCTION SwitchableMaps_Slot2_Codewords /end SUB_FUNCTION /end FUNCTION
/begin FUNCTION SwitchableMaps_Slot2_Codewords "" /end FUNCTION
/begin FUNCTION SwitchableMaps_Slot3 "" /begin SUB_FUNCTION SwitchableMaps_Slot3_Codewords /end SUB_FUNCTION /end FUNCTION
/begin FUNCTION SwitchableMaps_Slot3_Codewords "" /end FUNCTION
/begin FUNCTION SwitchableMaps_Slot4 "" /begin SUB_FUNCTION SwitchableMaps_Slot4_Codewords /end SUB_FUNCTION /end FUNCTION
/begin FUNCTION SwitchableMaps_Slot4_Codewords "" /end FUNCTION
/begin FUNCTION TcuTorqueLimiter "" /begin SUB_FUNCTION TcuTorqueLimiter_Codewords /end SUB_FUNCTION /end FUNCTION
/begin FUNCTION TcuTorqueLimiter_Codewords "" /end FUNCTION
/begin FUNCTION ThrottleControl "Throttle targets and limiters"
 /begin DEF_CHARACTERISTIC KF_MDR_ABV_SPO_HS KF_MDR_ABV_SPO2_HS KF_MDR_ABV_SPO2 KF_MDR_ABV_SPO KF_FTRANSVL KF_FK_FTRANSVL KL_DKVL KF_ENA_NREG_GANG_SYN /end DEF_CHARACTERISTIC
/end FUNCTION
/begin FUNCTION TorqueLimiters "Torque limits"
 /begin DEF_CHARACTERISTIC K_MDKIST_SOT_MX BMWosc_tq_MaxIdlCtlGbx_C BMWtqc_pct_MoTqRelDifThd_C BMWtqc_pct_MoPwrRelDifThd_C K_EDA_P_MAX_MOT KF_EDA_ANZ_SPORT_MDK_IST K_NKW_PEMAX K_FMDK0_AKT KL_LAND_MDKMAX_VAR7 KL_LAND_MDKMAX_VAR6 KL_LAND_MDKMAX_VAR5 KL_LAND_MDKMAX_VAR4 KL_LAND_MDKMAX_VAR3 KL_LAND_MDKMAX_VAR2 KL_LAND_MDKMAX_VAR1 BMWtqe_tqi_EngLimdEmiThd_T KF_MDIMAX_TVDK KF_MDIMAX_TANS KF_MDIMAX_SK KF_MDIMAX_FG KF_F_MDIMAX_KR BMWtqe_tqi_MaxEmiRedn_M KL_MDI_MAX_GRD_UP KL_MDIMX_VL_APPLZ KL_MDIMX_F_TMOT BMWtqe_tqc_FlApplStgPwrHi_T BMWtqe_tqc_FlApplStgPwr2_T BMWtqe_tqc_FlApplStgPwr1_T BMWtqe_tqc_FlApplStgNorm_T BMWtqe_rf_StrTqMaxOfs_C BMWtqe_n_SpdMaxEmiRedn_T KL_MD_K_MAX_VL_HS KL_MD_K_MAX_VL KL_MD_K_MAX_SGASSE KL_MD_K_MAX_RST_HS KL_MD_K_MAX_RST KL_MD_K_MAX_PB KL_MD_K_MAX_BST_HS KL_MD_K_MAX_BST KL_MD_K_MAX_VL_STRG_AT_VAR KL_MD_K_MAX_VL_STRG_AT KL_MD_K_MAX_VL_ECO_STRG_HS KL_MD_K_MAX_SGASSE_STRG_AT_VAR KL_MD_K_MAX_SGASSE_STRG_AT KL_MD_K_MAX_RST_STRG_AT_VAR KL_MD_K_MAX_RST_STRG_AT KL_MD_K_MAX_RNSTART_STRG_HS KL_MD_K_MAX_PB_STRG_AT_VAR KL_MD_K_MAX_PB_STRG_AT KL_MD_K_MAX_BST_STRG_HS KL_MD_K_MAX_BST_STRG_AT_VAR KL_MD_K_MAX_BST_STRG_AT KL_MDG_MAX_GANG_HS KL_MDG_MAX_GANG_AT K_KSU_MDKBEGKUPDEFEKT K_KSU_MDEINGRIFF_MX K_KSU_MDEINGRIFFPROP_MX K_KSU_MDEINGRIFFPROP_MN K_KSU_INTREG_MX KL_ENA_NREG_DSC S_NMX_VM BMWmondmf_swi_StallStru_C KF_MDRED_T KL_MDRED_NKW MoF_trqNorm1_C EngDa_pwrCrksftMax_C EngDa_tqCrksftMax_C EngDa_tqInnrMax_C /end DEF_CHARACTERISTIC
/end FUNCTION
/begin FUNCTION TorqueMonitoring "Torque monitoring"
 /begin DEF_CHARACTERISTIC MoFTrqPtd_pwrMax_C MoFTrqPtd_tqCluMax_C MoFTrqAct_nThd_C MoFTrqAct_trqPtdInjActv_C /end DEF_CHARACTERISTIC
/end FUNCTION
/begin FUNCTION Valet "" /begin SUB_FUNCTION Valet_Codewords /end SUB_FUNCTION /end FUNCTION
/begin FUNCTION Valet_Codewords "" /end FUNCTION
/begin FUNCTION Vanos "Vanos targets and limiters"
 /begin DEF_CHARACTERISTIC KF_ASPR_NORM_UESP_PF1 GKF_ASPR_NORM_WARM_PF2 GKF_ASPR_NORM_WARM_PF1 GKF_ASPR_NORM_KALT_PF2 GKF_ASPR_NORM_KALT_PF1 KF_ESPR_NORM_UESP_PF1 GKF_ESPR_NORM_WARM_PF2 GKF_ESPR_NORM_WARM_PF1 GKF_ESPR_NORM_KALT_PF2 GKF_ESPR_NORM_KALT_PF1 BMWls_vli_MinGraUp_C KF_HUB_GRDMX KF_EHUB_MX KF_HUBESTM GKF_EHUB_NORM_WARM_LAST /end DEF_CHARACTERISTIC
/end FUNCTION
/begin FUNCTION WastegateControl "WGDC PIDs"
 /begin DEF_CHARACTERISTIC BMWtchctr_n_PpLimMax_C BMWtchctr_pwr_Pctl_M BMWtchctr_pwr_Dp_M BMWtchctr_pwr_CmprGra_M BMWtchctr_p_DifCrtnPp_M BMWtchctr_p_DifCrtnPpDyn_M BMWtchctr_fac_Dp_T BMWtchctr_fac_DpDyn_T BMWtchdiag_pct_WgPLo_M BMWtchdiag_pct_WgPHi_M BMWtchout_pct_WgBlwOff_T BMWtchctr_pct_WgBasc_M BMWtchco_fac_FadePl_T BMWtchctr_ti_ToutPpLim_C /end DEF_CHARACTERISTIC
/end FUNCTION
/begin COMPU_METHOD aAwkuzc_BFpgCmb_tmDukma_q__aa0o "aAwkuzc_BFpgCmb_tmDukma_q__aa0o" RAT_FUNC "%6.3" "°" COEFFS 0 2 0 0 0 1 /end COMPU_METHOD
/begin COMPU_METHOD acriqBc_tfkBqod_ocgjxzc_nR_8oa0 "acriqBc_tfkBqod_ocgjxzc_nR_8oa0" RAT_FUNC "%6.3" "-" COEFFS 0 8192 0 0 0 1 /end COMPU_METHOD
/begin COMPU_METHOD AFeDmkb_cAbjmcc_kAkskhd_k__0oa0 "AFeDmkb_cAbjmcc_kAkskhd_k__0oa0" RAT_FUNC "%6.3" "km/h" COEFFS 0 1 0 0 0 1 /end COMPU_METHOD
/begin COMPU_METHOD Asyaixa_wdvtenb_FCefaCb_n__aa0o "Asyaixa_wdvtenb_FCefaCb_n__aa0o" RAT_FUNC "%6.3" "-" COEFFS 0 50 0 0 0 1 /end COMPU_METHOD
/begin COMPU_METHOD Bhvfwhc_bigEubd_BBEupBd_nR_3oa0 "Bhvfwhc_bigEubd_BBEupBd_nR_3oa0" RAT_FUNC "%6.3" "-" COEFFS 0 32768 0 0 0 1 /end COMPU_METHOD
/begin COMPU_METHOD BMW_ba_poel__ "" RAT_FUNC "%6.2" "-" COEFFS 0 1 0 0 0 1 /end COMPU_METHOD
/begin COMPU_METHOD BMW_dm_sw_q0p1_Nm "" RAT_FUNC "%6.3" "Nm" COEFFS 0 10 0 0 0 1 /end COMPU_METHOD
/begin COMPU_METHOD BMW_m_sw_q1p0_Nm "" RAT_FUNC "%6.2" "Nm" COEFFS 0 1 0 0 0 1 /end COMPU_METHOD
/begin COMPU_METHOD BMW_p_sw_q0p125_hPa "" RAT_FUNC "%6.3" "hPa" COEFFS 0 8 0 0 0 1 /end COMPU_METHOD
/begin COMPU_METHOD BMW_Powertrain_DxECompuMethods_Def_ub_b1_nounit "Def_ub_b1" RAT_FUNC "%6.3" "-" COEFFS 0 256 0 0 0 1 /end COMPU_METHOD
/begin COMPU_METHOD BMW_Powertrain_DxECompuMethods_Def_ub_b2_nounit "Def_ub_b2" RAT_FUNC "%6.3" "-" COEFFS 0 128 0 0 0 1 /end COMPU_METHOD
/begin COMPU_METHOD BMW_q0p1__ "" RAT_FUNC "%6.3" "-" COEFFS 0 10 0 0 0 1 /end COMPU_METHOD
/begin COMPU_METHOD BMW_q0p1_deg "" RAT_FUNC "%6.3" "°" COEFFS 0 10 0 0 0 1 /end COMPU_METHOD
/begin COMPU_METHOD BMW_q0p1_degC "" RAT_FUNC "%6.3" "°C" COEFFS 0 10 0 0 0 1 /end COMPU_METHOD
/begin COMPU_METHOD BMW_q0p1_kilometer_per_hour "" RAT_FUNC "%6.3" "km/h" COEFFS 0 10 0 0 0 1 /end COMPU_METHOD
/begin COMPU_METHOD BMW_q0p3906_PERC "" RAT_FUNC "%6.3" "%" COEFFS 0 64 0 0 0 25 /end COMPU_METHOD
/begin COMPU_METHOD BMW_q1_millisecond "" RAT_FUNC "%6.2" "ms" COEFFS 0 1 0 0 0 1 /end COMPU_METHOD
/begin COMPU_METHOD BufnDdb_jpjgsgc_jmDugsa_qCRoa0o "Def_q1" RAT_FUNC "%6.3" "°C" COEFFS 0 1 0 0 0 1 /end COMPU_METHOD
/begin COMPU_METHOD bukAcFc_hypjrAa_CBhougc_MCRooa0 "bukAcFc_hypjrAa_CBhougc_MCRooa0" RAT_FUNC "%6.3" "MPa" COEFFS 0 500 0 0 0 1 /end COMPU_METHOD
/begin COMPU_METHOD BumqDkc_mryszAa_EcglxAc_nR_4oa0 "BumqDkc_mryszAa_EcglxAc_nR_4oa0" RAT_FUNC "%6.3" "-" COEFFS 0 4096 0 0 0 1 /end COMPU_METHOD
/begin COMPU_METHOD camcxxd_bxlpdsa_Cshlhgc_sR_1a0o "Def_q0p01" RAT_FUNC "%6.3" "s" COEFFS 0 100 0 0 0 1 /end COMPU_METHOD
/begin COMPU_METHOD caoddzd_oAjpfzb_cAcEEha_1nR_oa0 "Def_q1" RAT_FUNC "%6.3" "1/min" COEFFS 0 1 0 0 0 1 /end COMPU_METHOD
/begin COMPU_METHOD CByjozc_eCmpBAb_pljBAmd_k__0oa0 "CByjozc_eCmpBAb_pljBAmd_k__0oa0" RAT_FUNC "%6.3" "kg/h" COEFFS 0 32 0 0 0 1 /end COMPU_METHOD
/begin COMPU_METHOD CgkBooc_wkiDfEd_Czglhgc_fR_1a0o "Def_q0p01" RAT_FUNC "%6.3" "%" COEFFS 0 100 0 0 0 1 /end COMPU_METHOD
/begin COMPU_METHOD DchEpAd_DBCFgoa_Ckhahgc_q__aoa0 "DchEpAd_DBCFgoa_Ckhahgc_q__aoa0" RAT_FUNC "%6.3" "°C" COEFFS 0 100 0 0 0 1 /end COMPU_METHOD
/begin COMPU_METHOD DEZ "" RAT_FUNC "%6.2" "" COEFFS 0 1 0 0 0 1 /end COMPU_METHOD
/begin COMPU_METHOD doAbvic_Aaltzwd_vyCuowa_hCRoa0o "doAbvic_Aaltzwd_vyCuowa_hCRoa0o" RAT_FUNC "%6.3" "hPa" COEFFS 0 1 0 0 0 1 /end COMPU_METHOD
/begin COMPU_METHOD Ejmqric_wgjqjja_AvCkvxb_fR_6o0o "Ejmqric_wgjqjja_AvCkvxb_fR_6o0o" RAT_FUNC "%6.3" "%" COEFFS 0 16384 0 0 0 25 /end COMPU_METHOD
/begin COMPU_METHOD EngN "" RAT_FUNC "%6.3" "rpm" COEFFS 0 2 0 0 0 1 /end COMPU_METHOD
/begin COMPU_METHOD EngN_LRes "" RAT_FUNC "%6.1" "rpm" COEFFS 0 0.025 0 0 0 1 /end COMPU_METHOD
/begin COMPU_METHOD fak_ub_b16 "" RAT_FUNC "%6.4" "-" COEFFS 0 256 0 0 0 16 /end COMPU_METHOD
/begin COMPU_METHOD fgjpsvb_fDqjECa_acgrbDd_n_dae__ "Def_bool" TAB_VERB "%6.3" "-" COMPU_TAB_REF Cmxqxpb_zopwEwb_acgrjwd___dae__ /end COMPU_METHOD
/begin COMPU_METHOD fpBesqd_hAxmiba_AAwtged_u__0oa0 "fpBesqd_hAxmiba_AAwtged_u__0oa0" RAT_FUNC "%6.3" "ul/s" COEFFS 0 1 0 0 0 1 /end COMPU_METHOD
/begin COMPU_METHOD fqCirwd_flsbrkc_xChfaCb_n__aa0o "fqCirwd_flsbrkc_xChfaCb_n__aa0o" RAT_FUNC "%6.3" "-" COEFFS 0 32 0 0 0 1 /end COMPU_METHOD
/begin COMPU_METHOD FzbmlAa_gCtylrb_ckCqxAc_nR_6oa0 "FzbmlAa_gCtylrb_ckCqxAc_nR_6oa0" RAT_FUNC "%6.3" "-" COEFFS 0 65536 0 0 0 1 /end COMPU_METHOD
/begin COMPU_METHOD ggDviCc_uydFbsa_CDgnhgc_nR_2a0o "ggDviCc_uydFbsa_CDgnhgc_nR_2a0o" RAT_FUNC "%6.3" "-" COEFFS 0 200 0 0 0 1 /end COMPU_METHOD
/begin COMPU_METHOD ilxsavd_hkzmBfc_lAzCpAb_nR_1oa0 "ilxsavd_hkzmBfc_lAzCpAb_nR_1oa0" RAT_FUNC "%6.3" "-" COEFFS 0 16384 0 0 0 1 /end COMPU_METHOD
/begin COMPU_METHOD jgbhAma_smpAegb_hlEBAmd_k__0oa0 "jgbhAma_smpAegb_hlEBAmd_k__0oa0" RAT_FUNC "%6.3" "km/h" COEFFS 0 50 0 0 0 1 /end COMPU_METHOD
/begin COMPU_METHOD jucyrzb_bpFgwfd_uqrfhgc_k__aoa0 "jucyrzb_bpFgwfd_uqrfhgc_k__aoa0" RAT_FUNC "%6.3" "kW" COEFFS 0 512 0 0 0 1 /end COMPU_METHOD
/begin COMPU_METHOD kEEdlBb_gsrEhkd_rmDuAhc_uCRoa0o "kEEdlBb_gsrEhkd_rmDuAhc_uCRoa0o" RAT_FUNC "%6.3" "ul" COEFFS 0 1 0 0 0 1 /end COMPU_METHOD
/begin COMPU_METHOD kw_q0p75 "" RAT_FUNC "%6.3" "Grad KW" COEFFS 0 4 0 0 0 3 /end COMPU_METHOD
/begin COMPU_METHOD leist_q0p015625_kW "" RAT_FUNC "%6.4" "kW" COEFFS 0 64 0 0 0 1 /end COMPU_METHOD
/begin COMPU_METHOD lfnAAcd_rfigwsd_gtuuDBc_k__aoa0 "lfnAAcd_rfigwsd_gtuuDBc_k__aoa0" RAT_FUNC "%6.3" "kW" COEFFS 0 2048 0 0 0 1 /end COMPU_METHOD
/begin COMPU_METHOD lFwocba_tlxgpab_wmDuExd_NCRoa0o "lFwocba_tlxgpab_wmDuExd_NCRoa0o" RAT_FUNC "%6.3" "Nm" COEFFS 0 1 0 0 0 1 /end COMPU_METHOD
/begin COMPU_METHOD n_sw_q0p5 "" RAT_FUNC "%6.3" "1/min" COEFFS 0 2 0 0 0 1 /end COMPU_METHOD
/begin COMPU_METHOD nmot_q40 "" RAT_FUNC "%6.1" "1/min" COEFFS 0 1 0 0 0 40 /end COMPU_METHOD
/begin COMPU_METHOD oDhhEAa_tuCuntc_ajhfaCa_k__aa0o "oDhhEAa_tuCuntc_ajhfaCa_k__aa0o" RAT_FUNC "%6.3" "kW" COEFFS 0 10 0 0 0 1 /end COMPU_METHOD
/begin COMPU_METHOD oFojrkc_kDqhmtb_jroomtd_N0__1o0 "oFojrkc_kDqhmtb_jroomtd_N0__1o0" RAT_FUNC "%6.3" "Nm/10ms" COEFFS 0 10 0 0 0 1 /end COMPU_METHOD
/begin COMPU_METHOD ohoxkpc_embkBlb_gscheBc_m__aoa0 "ohoxkpc_embkBlb_gscheBc_m__aoa0" RAT_FUNC "%6.3" "mm" COEFFS 0 1000 0 0 0 1 /end COMPU_METHOD
/begin COMPU_METHOD oihanzc_gchDhzc_BADAFBb_nR_1oa0 "Def_q0p0001" RAT_FUNC "%6.3" "-" COEFFS 0 10000 0 0 0 1 /end COMPU_METHOD
/begin COMPU_METHOD owanCxd_goxcCAa_gsclFBc_nR_1oa0 "Def_q0p001" RAT_FUNC "%6.3" "-" COEFFS 0 1000 0 0 0 1 /end COMPU_METHOD
/begin COMPU_METHOD raChrxc_kBtBrmb_FmDuEFa_n__aa0o "Def_q1" RAT_FUNC "%6.3" "-" COEFFS 0 1 0 0 0 1 /end COMPU_METHOD
/begin COMPU_METHOD RBPtCel_p_0p002_1 "" RAT_FUNC "%6.4" "MPa" COEFFS 0 1000 0 0 0 2 /end COMPU_METHOD
/begin COMPU_METHOD rel_q0p0234 "" RAT_FUNC "%6.4" "%" COEFFS 0 128 0 0 0 3 /end COMPU_METHOD
/begin COMPU_METHOD rel_ub_q0p75 "" RAT_FUNC "%6.3" "%" COEFFS 0 1 0 0 0 0.75 /end COMPU_METHOD
/begin COMPU_METHOD rgduxyd_mlihaBb_gsCghzb_bCRa0a0 "rgduxyd_mlihaBb_gsCghzb_bCRa0a0" RAT_FUNC "%6.3" "bar" COEFFS 0 1000 0 0 0 1 /end COMPU_METHOD
/begin COMPU_METHOD temp_q0p0234_o273 "" RAT_FUNC "%6.1" "Grad C" COEFFS 0 1 273.15 0 0 0.0234375 /end COMPU_METHOD
/begin COMPU_METHOD temp_ub_q0p75_o48 "" RAT_FUNC "%6.2" "Grad C" COEFFS 0 1 48 0 0 0.75 /end COMPU_METHOD
/begin COMPU_METHOD ubqeuic_jteCkzd_CDglhgc_nR_1a0o "Def_q0p01" RAT_FUNC "%6.3" "-" COEFFS 0 100 0 0 0 1 /end COMPU_METHOD
/begin COMPU_METHOD ucttBvd_Byeweeb_zcCvaDc_fR_8a0o "ucttBvd_Byeweeb_zcCvaDc_fR_8a0o" RAT_FUNC "%6.3" "%" COEFFS 0 8192 0 0 0 25 /end COMPU_METHOD
/begin COMPU_METHOD uvFxekd_wvexlbc_BcFdkDd_nR_1a0o "uvFxekd_wvexlbc_BcFdkDd_nR_1a0o" RAT_FUNC "%6.3" "-" COEFFS 0 1024 0 0 0 25 /end COMPU_METHOD
/begin COMPU_METHOD vfyBdwd_ftexgja_BcFdiDd_fR_1a0o "Def_q0p0244" RAT_FUNC "%6.3" "%" COEFFS 0 1024 0 0 0 25 /end COMPU_METHOD
/begin COMPU_METHOD vfzg_uw_b512 "" RAT_FUNC "%6.4" "km/h" COEFFS 0 65536 0 0 0 512 /end COMPU_METHOD
/begin COMPU_METHOD wDDoctd_cCDyaFa_AvCkvFb_nR_6o0o "wDDoctd_cCDyaFa_AvCkvFb_nR_6o0o" RAT_FUNC "%6.3" "-" COEFFS 0 16384 0 0 0 25 /end COMPU_METHOD
/begin COMPU_METHOD zBcBzad_vmoivka_mFzjCgc_lCRooa0 "zBcBzad_vmoivka_mFzjCgc_lCRooa0" RAT_FUNC "%6.3" "l/h" COEFFS 0 100 0 0 0 1 /end COMPU_METHOD
/begin COMPU_METHOD zyyxBpb_rEsnvtc_gktukCa_fR_5a0o "zyyxBpb_rEsnvtc_gktukCa_fR_5a0o" RAT_FUNC "%6.3" "%" COEFFS 0 512 0 0 0 25 /end COMPU_METHOD
/begin COMPU_VTAB Cmxqxpb_zopwEwb_acgrjwd___dae__ "Cmxqxpb_zopwEwb_acgrjwd___dae__" TAB_VERB 2 0 "false" 1 "true" DEFAULT_VALUE "Zustand nicht definiert" /end COMPU_VTAB
/begin RECORD_LAYOUT _REC_A1AXS_1_MBSE_S1 ALIGNMENT_BYTE 1 ALIGNMENT_WORD 2 ALIGNMENT_LONG 4 ALIGNMENT_FLOAT32_IEEE 4 ALIGNMENT_FLOAT64_IEEE 4 AXIS_PTS_X 1 SBYTE INDEX_INCR DIRECT /end RECORD_LAYOUT
/begin RECORD_LAYOUT _REC_A1AXS_1_MBSE_S2 ALIGNMENT_BYTE 1 ALIGNMENT_WORD 2 ALIGNMENT_LONG 4 ALIGNMENT_FLOAT32_IEEE 4 ALIGNMENT_FLOAT64_IEEE 4 AXIS_PTS_X 1 SWORD INDEX_INCR DIRECT /end RECORD_LAYOUT
/begin RECORD_LAYOUT _REC_A1AXS_1_MBSE_U1 ALIGNMENT_BYTE 1 ALIGNMENT_WORD 2 ALIGNMENT_LONG 4 ALIGNMENT_FLOAT32_IEEE 4 ALIGNMENT_FLOAT64_IEEE 4 AXIS_PTS_X 1 UBYTE INDEX_INCR DIRECT /end RECORD_LAYOUT
/begin RECORD_LAYOUT _REC_A1AXS_1_MBSE_U2 ALIGNMENT_BYTE 1 ALIGNMENT_WORD 2 ALIGNMENT_LONG 4 ALIGNMENT_FLOAT32_IEEE 4 ALIGNMENT_FLOAT64_IEEE 4 AXIS_PTS_X 1 UWORD INDEX_INCR DIRECT /end RECORD_LAYOUT
/begin RECORD_LAYOUT _REC_A1CUR_1_MBSE_S1_S1 ALIGNMENT_BYTE 1 ALIGNMENT_WORD 2 ALIGNMENT_LONG 4 ALIGNMENT_FLOAT32_IEEE 4 ALIGNMENT_FLOAT64_IEEE 4 FNC_VALUES 1 SBYTE ROW_DIR DIRECT /end RECORD_LAYOUT
/begin RECORD_LAYOUT _REC_A1CUR_1_MBSE_S2_S1 ALIGNMENT_BYTE 1 ALIGNMENT_WORD 2 ALIGNMENT_LONG 4 ALIGNMENT_FLOAT32_IEEE 4 ALIGNMENT_FLOAT64_IEEE 4 FNC_VALUES 1 SWORD ROW_DIR DIRECT /end RECORD_LAYOUT
/begin RECORD_LAYOUT _REC_A1CUR_1_MBSE_U1_S1 ALIGNMENT_BYTE 1 ALIGNMENT_WORD 2 ALIGNMENT_LONG 4 ALIGNMENT_FLOAT32_IEEE 4 ALIGNMENT_FLOAT64_IEEE 4 FNC_VALUES 1 UBYTE ROW_DIR DIRECT /end RECORD_LAYOUT
/begin RECORD_LAYOUT _REC_A1CUR_1_MBSE_U2_S1 ALIGNMENT_BYTE 1 ALIGNMENT_WORD 2 ALIGNMENT_LONG 4 ALIGNMENT_FLOAT32_IEEE 4 ALIGNMENT_FLOAT64_IEEE 4 FNC_VALUES 1 UWORD ROW_DIR DIRECT /end RECORD_LAYOUT
/begin RECORD_LAYOUT _REC_S5MAP_52_KF_U1_S2_S2 ALIGNMENT_BYTE 1 ALIGNMENT_WORD 2 ALIGNMENT_LONG 4 ALIGNMENT_FLOAT32_IEEE 4 ALIGNMENT_FLOAT64_IEEE 4 NO_AXIS_PTS_X 1 UBYTE NO_AXIS_PTS_Y 2 UBYTE AXIS_PTS_X 3 SWORD INDEX_INCR DIRECT AXIS_PTS_Y 4 SWORD INDEX_INCR DIRECT FNC_VALUES 5 UBYTE COLUMN_DIR DIRECT /end RECORD_LAYOUT
/begin RECORD_LAYOUT _REC_S5MAP_52_KF_U2_S2_S2 ALIGNMENT_BYTE 1 ALIGNMENT_WORD 2 ALIGNMENT_LONG 4 ALIGNMENT_FLOAT32_IEEE 4 ALIGNMENT_FLOAT64_IEEE 4 NO_AXIS_PTS_X 1 UBYTE NO_AXIS_PTS_Y 2 UBYTE AXIS_PTS_X 3 SWORD INDEX_INCR DIRECT AXIS_PTS_Y 4 SWORD INDEX_INCR DIRECT FNC_VALUES 5 UWORD COLUMN_DIR DIRECT /end RECORD_LAYOUT
/begin RECORD_LAYOUT _REC_S5MAP_52_KF_U2_S2_U2 ALIGNMENT_BYTE 1 ALIGNMENT_WORD 2 ALIGNMENT_LONG 4 ALIGNMENT_FLOAT32_IEEE 4 ALIGNMENT_FLOAT64_IEEE 4 NO_AXIS_PTS_X 1 UBYTE NO_AXIS_PTS_Y 2 UBYTE AXIS_PTS_X 3 SWORD INDEX_INCR DIRECT AXIS_PTS_Y 4 UWORD INDEX_INCR DIRECT FNC_VALUES 5 UWORD COLUMN_DIR DIRECT /end RECORD_LAYOUT
/begin RECORD_LAYOUT Axis_Xs16 ALIGNMENT_BYTE 1 ALIGNMENT_WORD 2 ALIGNMENT_LONG 4 ALIGNMENT_FLOAT32_IEEE 4 ALIGNMENT_FLOAT64_IEEE 4 NO_AXIS_PTS_X 1 SWORD AXIS_PTS_X 2 SWORD INDEX_INCR DIRECT /end RECORD_LAYOUT
/begin RECORD_LAYOUT Axis_Xu8 ALIGNMENT_BYTE 1 ALIGNMENT_WORD 2 ALIGNMENT_LONG 4 ALIGNMENT_FLOAT32_IEEE 4 ALIGNMENT_FLOAT64_IEEE 4 NO_AXIS_PTS_X 1 UBYTE AXIS_PTS_X 2 UBYTE INDEX_INCR DIRECT /end RECORD_LAYOUT
/begin RECORD_LAYOUT CurG_Ws16 ALIGNMENT_BYTE 1 ALIGNMENT_WORD 2 ALIGNMENT_LONG 4 ALIGNMENT_FLOAT32_IEEE 4 ALIGNMENT_FLOAT64_IEEE 4 FNC_VALUES 1 SWORD COLUMN_DIR DIRECT /end RECORD_LAYOUT
/begin RECORD_LAYOUT FklWUb ALIGNMENT_BYTE 1 ALIGNMENT_WORD 2 ALIGNMENT_LONG 4 ALIGNMENT_FLOAT32_IEEE 4 ALIGNMENT_FLOAT64_IEEE 4 FNC_VALUES 1 UBYTE COLUMN_DIR DIRECT /end RECORD_LAYOUT
/begin RECORD_LAYOUT KwUw ALIGNMENT_BYTE 1 ALIGNMENT_WORD 2 ALIGNMENT_LONG 4 ALIGNMENT_FLOAT32_IEEE 4 ALIGNMENT_FLOAT64_IEEE 4 FNC_VALUES 1 UWORD COLUMN_DIR DIRECT /end RECORD_LAYOUT
/begin RECORD_LAYOUT RB_Map_S16U8_S8 ALIGNMENT_BYTE 1 ALIGNMENT_WORD 2 ALIGNMENT_LONG 4 ALIGNMENT_FLOAT32_IEEE 4 ALIGNMENT_FLOAT64_IEEE 4 NO_AXIS_PTS_X 1 SWORD NO_AXIS_PTS_Y 2 SWORD AXIS_PTS_X 3 SWORD INDEX_INCR DIRECT AXIS_PTS_Y 4 UBYTE INDEX_INCR DIRECT FNC_VALUES 5 SBYTE COLUMN_DIR DIRECT /end RECORD_LAYOUT
/begin RECORD_LAYOUT RB_Val_Wr32 ALIGNMENT_BYTE 1 ALIGNMENT_WORD 2 ALIGNMENT_LONG 4 ALIGNMENT_FLOAT32_IEEE 4 ALIGNMENT_FLOAT64_IEEE 4 FNC_VALUES 1 FLOAT32_IEEE COLUMN_DIR DIRECT /end RECORD_LAYOUT
/end MODULE
/end PROJECT
