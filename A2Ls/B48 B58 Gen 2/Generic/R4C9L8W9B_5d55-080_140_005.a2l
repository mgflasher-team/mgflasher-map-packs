/*
The MG Flasher Team
4/2/2026
Created with optimization mode
*/
ASAP2_VERSION 1 60
/begin PROJECT MG1CS201_BX8TUE_R4C2L8W9B "MG1CS201"
/begin HEADER "" VERSION "R4C2L8W9B" PROJECT_NO MG1CS201_BX8TUE_R4C2L8W9B /end HEADER
/begin MODULE DIM ""
/begin MOD_PAR "MG1CS201" VERSION "R4C2L8W9B" CUSTOMER_NO "11" USER "APPLICATOR" ECU "MG1CS201" CPU_TYPE "IFX" EPK "56/1/MG1CS201/11/MG1CS201_BX8TUE_R4C2L8W9B//R4C2L8W9B///" ADDR_EPK 0x80764BFD
 /begin MEMORY_SEGMENT Pst80000000 "" RESERVED FLASH INTERN 0x80000000 0x20 -1 -1 -1 -1 -1 /end MEMORY_SEGMENT
 /begin MEMORY_SEGMENT Pst80000020 "" RESERVED FLASH INTERN 0x80000020 0xBFE0 -1 -1 -1 -1 -1 /end MEMORY_SEGMENT
 /begin MEMORY_SEGMENT Pst80010000 "" RESERVED FLASH INTERN 0x80010000 0x8000 -1 -1 -1 -1 -1 /end MEMORY_SEGMENT
 /begin MEMORY_SEGMENT Pst80080000 "" CODE FLASH INTERN 0x80080000 0x67F7E0 -1 -1 -1 -1 -1
  /begin IF_DATA ETK_XETK
   /begin ETK_XETK_ACCESS SERIAL_INTERFACE /end ETK_XETK_ACCESS
  /end IF_DATA
  /begin IF_DATA XCPplus 0x0102
   /begin SEGMENT 0x0 0x1 0x0 0x0 0x0 /begin CHECKSUM XCP_CRC_32 /end CHECKSUM
    /begin PAGE 0x0 ECU_ACCESS_WITH_XCP_ONLY XCP_READ_ACCESS_WITH_ECU_ONLY XCP_WRITE_ACCESS_NOT_ALLOWED /end PAGE
   /end SEGMENT
  /end IF_DATA
 /end MEMORY_SEGMENT
 /begin MEMORY_SEGMENT Pst806FF7E0 "" RESERVED FLASH INTERN 0x806FF7E0 0x520 -1 -1 -1 -1 -1 /end MEMORY_SEGMENT
 /begin MEMORY_SEGMENT Pst807FF7E0 "" RESERVED FLASH INTERN 0x807FF7E0 0x520 -1 -1 -1 -1 -1
  /begin IF_DATA ETK_XETK WRITE_AT_DATA_UPDATE USE_FILE ETK_XETK_REF 1 2 3 4 5 /end IF_DATA
 /end MEMORY_SEGMENT
 /begin MEMORY_SEGMENT Pst80028000 "" CODE FLASH INTERN 0x80028000 0x37D00 -1 -1 -1 -1 -1
  /begin IF_DATA ETK_XETK
   /begin ETK_XETK_ACCESS SERIAL_INTERFACE /end ETK_XETK_ACCESS
  /end IF_DATA
  /begin IF_DATA XCPplus 0x0102
   /begin SEGMENT 0x2 0x1 0x0 0x0 0x0 /begin CHECKSUM XCP_CRC_32 /end CHECKSUM
    /begin PAGE 0x0 ECU_ACCESS_WITH_XCP_ONLY XCP_READ_ACCESS_WITH_ECU_ONLY XCP_WRITE_ACCESS_NOT_ALLOWED /end PAGE
   /end SEGMENT
  /end IF_DATA
 /end MEMORY_SEGMENT
 /begin MEMORY_SEGMENT Pst80018100 "" RESERVED FLASH INTERN 0x80018100 0x3F00 -1 -1 -1 -1 -1 /end MEMORY_SEGMENT
 /begin MEMORY_SEGMENT Pst80060100 "" RESERVED FLASH INTERN 0x80060100 0x1FF00 -1 -1 -1 -1 -1 /end MEMORY_SEGMENT
 /begin MEMORY_SEGMENT Pst80018000 "" RESERVED FLASH INTERN 0x80018000 0x100 -1 -1 -1 -1 -1 /end MEMORY_SEGMENT
 /begin MEMORY_SEGMENT Pst80060000 "" RESERVED FLASH INTERN 0x80060000 0x100 -1 -1 -1 -1 -1 /end MEMORY_SEGMENT
 /begin MEMORY_SEGMENT Pst80020000 "" RESERVED FLASH INTERN 0x80020000 0x300 -1 -1 -1 -1 -1 /end MEMORY_SEGMENT
 /begin MEMORY_SEGMENT Pst8005FD00 "" RESERVED FLASH INTERN 0x8005FD00 0x300 -1 -1 -1 -1 -1 /end MEMORY_SEGMENT
 /begin MEMORY_SEGMENT Pst806FFD00 "" RESERVED FLASH INTERN 0x806FFD00 0x300 -1 -1 -1 -1 -1 /end MEMORY_SEGMENT
 /begin MEMORY_SEGMENT Pst807FFD08 "" RESERVED FLASH INTERN 0x807FFD08 0x104 -1 -1 -1 -1 -1 /end MEMORY_SEGMENT
 /begin MEMORY_SEGMENT Pst807FFFDC "" RESERVED FLASH INTERN 0x807FFFDC 0x24 -1 -1 -1 -1 -1 /end MEMORY_SEGMENT
 /begin MEMORY_SEGMENT Dst80700000 "" DATA FLASH INTERN 0x80700000 0xFF7E0 -1 -1 -1 -1 -1
  /begin IF_DATA ETK_XETK
   /begin ETK_XETK_ACCESS SERIAL_INTERFACE /end ETK_XETK_ACCESS
  /end IF_DATA
  /begin IF_DATA XCPplus 0x0102
   /begin SEGMENT 0x1 0x2 0x0 0x0 0x0 /begin CHECKSUM XCP_CRC_32 /end CHECKSUM
    /begin PAGE 0x0 ECU_ACCESS_DONT_CARE XCP_READ_ACCESS_DONT_CARE XCP_WRITE_ACCESS_NOT_ALLOWED /end PAGE
    /begin PAGE 0x1 ECU_ACCESS_DONT_CARE XCP_READ_ACCESS_DONT_CARE XCP_WRITE_ACCESS_WITH_ECU_ONLY /end PAGE
   /end SEGMENT
  /end IF_DATA
 /end MEMORY_SEGMENT
 /begin MEMORY_SEGMENT Dst807FFD00 "" DATA FLASH INTERN 0x807FFD00 0x8 -1 -1 -1 -1 -1
  /begin IF_DATA ETK_XETK
   /begin ETK_XETK_ACCESS SERIAL_INTERFACE /end ETK_XETK_ACCESS
  /end IF_DATA
  /begin IF_DATA XCPplus 0x0102
   /begin SEGMENT 0x3 0x2 0x0 0x0 0x0 /begin CHECKSUM XCP_CRC_32 /end CHECKSUM
    /begin PAGE 0x0 ECU_ACCESS_DONT_CARE XCP_READ_ACCESS_DONT_CARE XCP_WRITE_ACCESS_NOT_ALLOWED /end PAGE
    /begin PAGE 0x1 ECU_ACCESS_DONT_CARE XCP_READ_ACCESS_DONT_CARE XCP_WRITE_ACCESS_WITH_ECU_ONLY /end PAGE
   /end SEGMENT
  /end IF_DATA
 /end MEMORY_SEGMENT
 /begin MEMORY_SEGMENT Dst807FFE0C "" DATA FLASH INTERN 0x807FFE0C 0x1D0 -1 -1 -1 -1 -1
  /begin IF_DATA ETK_XETK
   /begin ETK_XETK_ACCESS SERIAL_INTERFACE /end ETK_XETK_ACCESS
  /end IF_DATA
  /begin IF_DATA XCPplus 0x0102
   /begin SEGMENT 0x4 0x2 0x0 0x0 0x0 /begin CHECKSUM XCP_CRC_32 /end CHECKSUM
    /begin PAGE 0x0 ECU_ACCESS_DONT_CARE XCP_READ_ACCESS_DONT_CARE XCP_WRITE_ACCESS_NOT_ALLOWED /end PAGE
    /begin PAGE 0x1 ECU_ACCESS_DONT_CARE XCP_READ_ACCESS_DONT_CARE XCP_WRITE_ACCESS_WITH_ECU_ONLY /end PAGE
   /end SEGMENT
  /end IF_DATA
 /end MEMORY_SEGMENT
 /begin MEMORY_SEGMENT RamAFE70000 "" VARIABLES RAM INTERN 0xAFE70000 0x8000 -1 -1 -1 -1 -1
  /begin IF_DATA ETK_XETK
   /begin ETK_XETK_ACCESS SERIAL_INTERFACE /end ETK_XETK_ACCESS
  /end IF_DATA
  /begin IF_DATA XCPplus 0x0102
   /begin SEGMENT 0x5 0x0 0x0 0x0 0x0 /end SEGMENT
  /end IF_DATA
 /end MEMORY_SEGMENT
 /begin MEMORY_SEGMENT RamB0000000 "" VARIABLES RAM INTERN 0xB0000000 0x8000 -1 -1 -1 -1 -1
  /begin IF_DATA ETK_XETK
   /begin ETK_XETK_ACCESS SERIAL_INTERFACE /end ETK_XETK_ACCESS
  /end IF_DATA
  /begin IF_DATA XCPplus 0x0102
   /begin SEGMENT 0x6 0x0 0x0 0x0 0x0 /end SEGMENT
  /end IF_DATA
 /end MEMORY_SEGMENT
 /begin MEMORY_SEGMENT Ram70100000 "" VARIABLES RAM INTERN 0x70100000 0x8000 -1 -1 -1 -1 -1
  /begin IF_DATA ETK_XETK
   /begin ETK_XETK_ACCESS SERIAL_INTERFACE /end ETK_XETK_ACCESS
  /end IF_DATA
  /begin IF_DATA XCPplus 0x0102
   /begin SEGMENT 0x7 0x0 0x0 0x0 0x0 /end SEGMENT
  /end IF_DATA
 /end MEMORY_SEGMENT
 /begin MEMORY_SEGMENT Ram60100000 "" VARIABLES RAM INTERN 0x60100000 0x8000 -1 -1 -1 -1 -1
  /begin IF_DATA ETK_XETK
   /begin ETK_XETK_ACCESS SERIAL_INTERFACE /end ETK_XETK_ACCESS
  /end IF_DATA
  /begin IF_DATA XCPplus 0x0102
   /begin SEGMENT 0x8 0x0 0x0 0x0 0x0 /end SEGMENT
  /end IF_DATA
 /end MEMORY_SEGMENT
 /begin MEMORY_SEGMENT Ram50100000 "" VARIABLES RAM INTERN 0x50100000 0x8000 -1 -1 -1 -1 -1
  /begin IF_DATA ETK_XETK
   /begin ETK_XETK_ACCESS SERIAL_INTERFACE /end ETK_XETK_ACCESS
  /end IF_DATA
  /begin IF_DATA XCPplus 0x0102
   /begin SEGMENT 0x9 0x0 0x0 0x0 0x0 /end SEGMENT
  /end IF_DATA
 /end MEMORY_SEGMENT
 /begin MEMORY_SEGMENT Ram70000000 "" VARIABLES RAM INTERN 0x70000000 0x1E000 -1 -1 -1 -1 -1
  /begin IF_DATA ETK_XETK
   /begin ETK_XETK_ACCESS SERIAL_INTERFACE /end ETK_XETK_ACCESS
  /end IF_DATA
  /begin IF_DATA XCPplus 0x0102
   /begin SEGMENT 0xA 0x0 0x0 0x0 0x0 /end SEGMENT
  /end IF_DATA
 /end MEMORY_SEGMENT
 /begin MEMORY_SEGMENT Ram60000000 "" VARIABLES RAM INTERN 0x60000000 0x3C000 -1 -1 -1 -1 -1
  /begin IF_DATA ETK_XETK
   /begin ETK_XETK_ACCESS SERIAL_INTERFACE /end ETK_XETK_ACCESS
  /end IF_DATA
  /begin IF_DATA XCPplus 0x0102
   /begin SEGMENT 0xB 0x0 0x0 0x0 0x0 /end SEGMENT
  /end IF_DATA
 /end MEMORY_SEGMENT
 /begin MEMORY_SEGMENT Ram50000000 "" VARIABLES RAM INTERN 0x50000000 0x3C000 -1 -1 -1 -1 -1
  /begin IF_DATA ETK_XETK
   /begin ETK_XETK_ACCESS SERIAL_INTERFACE /end ETK_XETK_ACCESS
  /end IF_DATA
  /begin IF_DATA XCPplus 0x0102
   /begin SEGMENT 0xC 0x0 0x0 0x0 0x0 /end SEGMENT
  /end IF_DATA
 /end MEMORY_SEGMENT
 /begin MEMORY_SEGMENT RamBF1F0E70 "" VARIABLES RAM INTERN 0xBF1F0E70 0xF190 -1 -1 -1 -1 -1
  /begin IF_DATA ETK_XETK
   /begin ETK_XETK_ACCESS SERIAL_INTERFACE /end ETK_XETK_ACCESS
  /end IF_DATA
  /begin IF_DATA XCPplus 0x0102
   /begin SEGMENT 0xD 0x0 0x0 0x0 0x0 /end SEGMENT
  /end IF_DATA
 /end MEMORY_SEGMENT
 /begin MEMORY_SEGMENT RamBF1E0000 "" CALIBRATION_VARIABLES RAM INTERN 0xBF1E0000 0x10E70 -1 -1 -1 -1 -1
  /begin IF_DATA ETK_XETK
   /begin ETK_XETK_ACCESS SERIAL_INTERFACE /end ETK_XETK_ACCESS
  /end IF_DATA
  /begin IF_DATA XCPplus 0x0102
   /begin SEGMENT 0xE 0x0 0x0 0x0 0x0 /end SEGMENT
  /end IF_DATA
 /end MEMORY_SEGMENT
/end MOD_PAR
/begin MOD_COMMON "" BYTE_ORDER MSB_LAST DEPOSIT ABSOLUTE ALIGNMENT_BYTE 1 ALIGNMENT_WORD 2 ALIGNMENT_LONG 4 ALIGNMENT_FLOAT32_IEEE 4 ALIGNMENT_FLOAT64_IEEE 4 /end MOD_COMMON
/begin AXIS_PTS AXX_KF_BSLGF "AXX_KF_BSLGF" 0x8071A388 Nkw_atm _REC_A1AXS_1_MBSE_S2 65535 caoddzd_oAjpfzb_cAcEEha_1nR_oa0 4 -32768 32767 DEPOSIT ABSOLUTE /end AXIS_PTS
/begin AXIS_PTS AXX_KF_DLAMBSVST_TABG "AXX_KF_DLAMBSVST_TABG" 0x8071A694 Nkw_atm _REC_A1AXS_1_MBSE_S2 65535 caoddzd_oAjpfzb_cAcEEha_1nR_oa0 8 -32768 32767 DEPOSIT ABSOLUTE /end AXIS_PTS
/begin AXIS_PTS AXX_KF_DPLDS_PRED "Nkw" 0x80746AC0 Nkw _REC_A1AXS_1_MBSE_S2 32767 caoddzd_oAjpfzb_cAcEEha_1nR_oa0 6 0 32767 FORMAT "%5.0" DEPOSIT ABSOLUTE /end AXIS_PTS
/begin AXIS_PTS AXX_KF_DPLDSOLL_SPORT "Nkw" 0x807238C2 NO_INPUT_QUANTITY _REC_A1AXS_1_MBSE_S2 32767 caoddzd_oAjpfzb_cAcEEha_1nR_oa0 6 0 32767 FORMAT "%5.0" DEPOSIT ABSOLUTE /end AXIS_PTS
/begin AXIS_PTS AXX_KF_DZWMIN_NORMAL_SOT "AXX_KF_DZWMIN_NORMAL_SOT" 0x80737B72 Nkw _REC_A1AXS_1_MBSE_S2 65535 caoddzd_oAjpfzb_cAcEEha_1nR_oa0 6 -32768 32767 FORMAT "%5.0" DEPOSIT ABSOLUTE /end AXIS_PTS
/begin AXIS_PTS AXX_KF_DZWMIN_SPORT_SOT "AXX_KF_DZWMIN_SPORT_SOT" 0x80737B56 Nkw _REC_A1AXS_1_MBSE_S2 65535 caoddzd_oAjpfzb_cAcEEha_1nR_oa0 6 -32768 32767 FORMAT "%5.0" DEPOSIT ABSOLUTE /end AXIS_PTS
/begin AXIS_PTS AXX_KF_FRKKORRF_1 "AXX_KF_FRKKORRF_1" 0x80714FE8 Nkw _REC_A1AXS_1_MBSE_S2 65535 caoddzd_oAjpfzb_cAcEEha_1nR_oa0 16 -32768 32767 FORMAT "%5.0" DEPOSIT ABSOLUTE /end AXIS_PTS
/begin AXIS_PTS AXX_KF_KLIMA_KKS "AXX_KF_KLIMA_KKS" 0x80760CD2 Nelueft_klima_wm _REC_A1AXS_1_MBSE_U1 99.609375 BMW_q0p3906_PERC 6 0 99.609375 DEPOSIT ABSOLUTE /end AXIS_PTS
/begin AXIS_PTS AXX_KF_KOEFF_B_LA "AXX_KF_KOEFF_B_LA" 0x80737516 Nkw _REC_A1AXS_1_MBSE_S2 65535 caoddzd_oAjpfzb_cAcEEha_1nR_oa0 6 -32768 32767 FORMAT "%5.0" DEPOSIT ABSOLUTE /end AXIS_PTS
/begin AXIS_PTS AXX_KF_LA_BEZ "AXX_KF_LA_BEZ" 0x8073750A Nkw _REC_A1AXS_1_MBSE_S2 65535 caoddzd_oAjpfzb_cAcEEha_1nR_oa0 6 -32768 32767 FORMAT "%5.0" DEPOSIT ABSOLUTE /end AXIS_PTS
/begin AXIS_PTS AXX_KF_LA_EZA "AXX_KF_LA_EZA" 0x8071EF7C Nkw _REC_A1AXS_1_MBSE_S2 65535 caoddzd_oAjpfzb_cAcEEha_1nR_oa0 6 -32768 32767 FORMAT "%5.0" DEPOSIT ABSOLUTE /end AXIS_PTS
/begin AXIS_PTS AXX_KF_LAMIN_H "AXX_KF_LAMIN_H" 0x8071F016 Nkw _REC_A1AXS_1_MBSE_S2 65535 caoddzd_oAjpfzb_cAcEEha_1nR_oa0 6 -32768 32767 FORMAT "%5.0" DEPOSIT ABSOLUTE /end AXIS_PTS
/begin AXIS_PTS AXX_KF_MD_RES_NST_KEY "AXX_KF_MD_RES_NST_KEY" 0x80731630 Tn_start_10 _REC_A1AXS_1_MBSE_U2 655.35 camcxxd_bxlpdsa_Cshlhgc_sR_1a0o 4 0 655.35 FORMAT "%7.2" DEPOSIT ABSOLUTE /end AXIS_PTS
/begin AXIS_PTS AXX_KF_N_GASSTOSS_UND_ANFAHR "KF_N_GASSTOSS_UND_ANFAHR" 0x80728A94 NO_INPUT_QUANTITY _REC_A1AXS_1_MBSE_S2 1310.7 jgbhAma_smpAegb_hlEBAmd_k__0oa0 6 -655.36 655.34 FORMAT "%7.2" DEPOSIT ABSOLUTE /end AXIS_PTS
/begin AXIS_PTS AXX_KF_NEL_OPF_V "AXX_KF_NEL_OPF_V" 0x8074B3E6 T_opf_in_wm _REC_A1AXS_1_MBSE_S2 6553.5 BMW_q0p1_degC 10 -3276.8 3276.7 DEPOSIT ABSOLUTE /end AXIS_PTS
/begin AXIS_PTS AXX_KF_NEL_TABG "AXX_KF_NEL_TABG" 0x8074B3DE Tabg_wm _REC_A1AXS_1_MBSE_S2 6553.5 BMW_q0p1_degC 4 -3276.8 3276.7 FORMAT "%6.1" DEPOSIT ABSOLUTE /end AXIS_PTS
/begin AXIS_PTS AXX_KF_NEL_TANS "AXX_KF_NEL_TANS" 0x8074B3D6 Dtans_tumg_wm _REC_A1AXS_1_MBSE_S2 6553.5 BMW_q0p1_degC 4 -3276.8 3276.7 FORMAT "%6.1" DEPOSIT ABSOLUTE /end AXIS_PTS
/begin AXIS_PTS AXX_KF_NEL_TGET "AXX_KF_NEL_TGET" 0x8074B36A Tget_wm _REC_A1AXS_1_MBSE_S2 655.35 DchEpAd_DBCFgoa_Ckhahgc_q__aoa0 8 -327.68 327.67 FORMAT "%6.2" DEPOSIT ABSOLUTE /end AXIS_PTS
/begin AXIS_PTS AXX_KF_NEL_TMOT_TKA "AXX_KF_NEL_TMOT_TKA" 0x8074B352 Dtmot_tkwsoll_f _REC_A1AXS_1_MBSE_S2 655.35 DchEpAd_DBCFgoa_Ckhahgc_q__aoa0 12 -327.68 327.67 FORMAT "%6.2" DEPOSIT ABSOLUTE /end AXIS_PTS
/begin AXIS_PTS AXX_KF_NEL_VSKR "AXX_KF_NEL_VSKR" 0x8074B46A Vskr_mw_wm _REC_A1AXS_1_MBSE_U2 65535 fpBesqd_hAxmiba_AAwtged_u__0oa0 6 0 65535 DEPOSIT ABSOLUTE /end AXIS_PTS
/begin AXIS_PTS AXX_KF_NEWP_LLK_TANS "AXX_KF_NEWP_LLK_TANS" 0x8074BC2A Dtans_tumg_wm _REC_A1AXS_1_MBSE_S2 6553.5 BMW_q0p1_degC 6 -3276.8 3276.7 DEPOSIT ABSOLUTE /end AXIS_PTS
/begin AXIS_PTS AXX_KF_NMAX_ANFAHR_MODE_0 "KF_NMAX_ANFAHR_MODE_0" 0x80728FE8 NO_INPUT_QUANTITY _REC_A1AXS_1_MBSE_S2 1310.7 jgbhAma_smpAegb_hlEBAmd_k__0oa0 6 -655.36 655.34 FORMAT "%7.2" DEPOSIT ABSOLUTE /end AXIS_PTS
/begin AXIS_PTS AXX_KF_NMAX_ANFAHR_MODE_1 "KF_NMAX_ANFAHR_MODE_1" 0x80728FDC NO_INPUT_QUANTITY _REC_A1AXS_1_MBSE_S2 1310.7 jgbhAma_smpAegb_hlEBAmd_k__0oa0 6 -655.36 655.34 FORMAT "%7.2" DEPOSIT ABSOLUTE /end AXIS_PTS
/begin AXIS_PTS AXX_KF_NMAX_ANFAHR_MODE_2 "KF_NMAX_ANFAHR_MODE_2" 0x80728FD0 NO_INPUT_QUANTITY _REC_A1AXS_1_MBSE_S2 1310.7 jgbhAma_smpAegb_hlEBAmd_k__0oa0 6 -655.36 655.34 FORMAT "%7.2" DEPOSIT ABSOLUTE /end AXIS_PTS
/begin AXIS_PTS AXX_KF_PHA_H_E1 "AXX_KF_PHA_H_E1" 0x807193CE Nkw _REC_A1AXS_1_MBSE_S2 65535 caoddzd_oAjpfzb_cAcEEha_1nR_oa0 8 -32768 32767 FORMAT "%5.0" DEPOSIT ABSOLUTE /end AXIS_PTS
/begin AXIS_PTS AXX_KF_PRAIL_H "AXX_KF_PRAIL_H" 0x80725F10 Nkw _REC_A1AXS_1_MBSE_S2 65535 caoddzd_oAjpfzb_cAcEEha_1nR_oa0 8 -32768 32767 FORMAT "%5.0" DEPOSIT ABSOLUTE /end AXIS_PTS
/begin AXIS_PTS AXX_KF_PRAIL_H_K "AXX_KF_PRAIL_H_K" 0x80725ED0 Nkw _REC_A1AXS_1_MBSE_S2 65535 caoddzd_oAjpfzb_cAcEEha_1nR_oa0 8 -32768 32767 FORMAT "%5.0" DEPOSIT ABSOLUTE /end AXIS_PTS
/begin AXIS_PTS AXX_KF_PRAIL_HDPWARM "Achse" 0x80725F00 Nkw _REC_A1AXS_1_MBSE_S2 65535 caoddzd_oAjpfzb_cAcEEha_1nR_oa0 8 -32768 32767 FORMAT "%5.0" DEPOSIT ABSOLUTE /end AXIS_PTS
/begin AXIS_PTS AXX_KF_PRAIL_HGD "Achse" 0x80725EF0 Nkw _REC_A1AXS_1_MBSE_S2 65535 caoddzd_oAjpfzb_cAcEEha_1nR_oa0 8 -32768 32767 FORMAT "%5.0" DEPOSIT ABSOLUTE /end AXIS_PTS
/begin AXIS_PTS AXX_KF_PRAIL_HGD_K "Achse" 0x80725EE0 Nkw _REC_A1AXS_1_MBSE_S2 65535 caoddzd_oAjpfzb_cAcEEha_1nR_oa0 8 -32768 32767 FORMAT "%5.0" DEPOSIT ABSOLUTE /end AXIS_PTS
/begin AXIS_PTS AXX_KF_ST_RKBAS_GD "AXX_KF_ST_RKBAS_GD" 0x8074FA5C Nkw _REC_A1AXS_1_MBSE_S2 65535 caoddzd_oAjpfzb_cAcEEha_1nR_oa0 10 -32768 32767 FORMAT "%5.0" DEPOSIT ABSOLUTE /end AXIS_PTS
/begin AXIS_PTS AXX_KF_ST_RKBAS_VVT "AXX_KF_ST_RKBAS_VVT" 0x8074F32A Nkw _REC_A1AXS_1_MBSE_S2 65535 caoddzd_oAjpfzb_cAcEEha_1nR_oa0 12 -32768 32767 FORMAT "%5.0" DEPOSIT ABSOLUTE /end AXIS_PTS
/begin AXIS_PTS AXX_KF_TA_IKSOLL "AXX_KF_TA_IKSOLL" 0x8071A4CC Nkw_atm _REC_A1AXS_1_MBSE_S2 65535 caoddzd_oAjpfzb_cAcEEha_1nR_oa0 4 -32768 32767 DEPOSIT ABSOLUTE /end AXIS_PTS
/begin AXIS_PTS AXX_KF_TA_VKSOLL "AXX_KF_TA_VKSOLL" 0x8071A4C4 Nkw_atm _REC_A1AXS_1_MBSE_S2 65535 caoddzd_oAjpfzb_cAcEEha_1nR_oa0 4 -32768 32767 DEPOSIT ABSOLUTE /end AXIS_PTS
/begin AXIS_PTS AXX_KF_TD_FETTDELAY_TABG "AXX_KF_TD_FETTDELAY_TABG" 0x8074E50E Tw_r1 _REC_A1AXS_1_MBSE_S2 6553.5 BMW_q0p1_degC 6 -3276.8 3276.7 FORMAT "%6.1" DEPOSIT ABSOLUTE /end AXIS_PTS
/begin AXIS_PTS AXX_KF_ZWMIN_KSOT "AXX_KF_ZWMIN_KSOT" 0x80737B46 Nkw _REC_A1AXS_1_MBSE_S2 65535 caoddzd_oAjpfzb_cAcEEha_1nR_oa0 8 -32768 32767 FORMAT "%5.0" DEPOSIT ABSOLUTE /end AXIS_PTS
/begin AXIS_PTS AXX_KF_ZWMIN_WSOT "AXX_KF_ZWMIN_WSOT" 0x80737B36 Nkw _REC_A1AXS_1_MBSE_S2 65535 caoddzd_oAjpfzb_cAcEEha_1nR_oa0 8 -32768 32767 FORMAT "%5.0" DEPOSIT ABSOLUTE /end AXIS_PTS
/begin AXIS_PTS AXX_KL_FK_TUMG_OPF "AXX_KL_FK_TUMG_OPF" 0x8074B3A2 Tumg_wm _REC_A1AXS_1_MBSE_S2 6553.5 BMW_q0p1_degC 10 -3276.8 3276.7 DEPOSIT ABSOLUTE /end AXIS_PTS
/begin AXIS_PTS AXX_KL_FLD_KKS "AXX_KL_FLD_KKS" 0x8074B4F8 F_pld_wm_f _REC_A1AXS_1_MBSE_U2 7.9998779296875 acriqBc_tfkBqod_ocgjxzc_nR_8oa0 6 0 7.9998779296875 DEPOSIT ABSOLUTE /end AXIS_PTS
/begin AXIS_PTS AXX_KL_LA_SBL "AXX_KL_LA_SBL" 0x8074E568 Nkw _REC_A1AXS_1_MBSE_S2 65535 caoddzd_oAjpfzb_cAcEEha_1nR_oa0 6 -32768 32767 FORMAT "%5.0" DEPOSIT ABSOLUTE /end AXIS_PTS
/begin AXIS_PTS AXX_KL_NEL_I "AXX_KL_NEL_I" 0x8074B34A Dtmot_tkwsoll_elue _REC_A1AXS_1_MBSE_S2 655.35 DchEpAd_DBCFgoa_Ckhahgc_q__aoa0 4 -327.68 327.67 DEPOSIT ABSOLUTE /end AXIS_PTS
/begin AXIS_PTS AXX_KL_NEL_KLIMA_MX "AXX_KL_NEL_KLIMA_MX" 0x8074AE9C Tumg_wm _REC_A1AXS_1_MBSE_S2 6553.5 BMW_q0p1_degC 4 -3276.8 3276.7 DEPOSIT ABSOLUTE /end AXIS_PTS
/begin AXIS_PTS AXX_KL_NEL_SPL "AXX_KL_NEL_SPL" 0x8074B442 V_wm _REC_A1AXS_1_MBSE_U2 6553.5 BMW_q0p1_kilometer_per_hour 4 0 6553.5 DEPOSIT ABSOLUTE /end AXIS_PTS
/begin AXIS_PTS AXX_KL_NEL_TABG_TUMG "AXX_KL_NEL_TABG_TUMG" 0x8074B39A Tumg_wm _REC_A1AXS_1_MBSE_S2 6553.5 BMW_q0p1_degC 4 -3276.8 3276.7 DEPOSIT ABSOLUTE /end AXIS_PTS
/begin AXIS_PTS AXX_KL_NEL_TANS_KLOPF "AXX_KL_NEL_TANS_KLOPF" 0x8074B392 Dtans_tumg_wm _REC_A1AXS_1_MBSE_S2 6553.5 BMW_q0p1_degC 4 -3276.8 3276.7 FORMAT "%6.1" DEPOSIT ABSOLUTE /end AXIS_PTS
/begin AXIS_PTS AXX_KL_NEL_TDME "AXX_KL_NEL_TDME" 0x8074B342 Tdme_wm _REC_A1AXS_1_MBSE_S2 655.35 DchEpAd_DBCFgoa_Ckhahgc_q__aoa0 4 -327.68 327.67 FORMAT "%6.2" DEPOSIT ABSOLUTE /end AXIS_PTS
/begin AXIS_PTS AXX_KL_NEL_TEGS "AXX_KL_NEL_TEGS" 0x8074B476 Tegs_wm _REC_A1AXS_1_MBSE_S2 65535 BufnDdb_jpjgsgc_jmDugsa_qCRoa0o 4 -32768 32767 FORMAT "%6.0" DEPOSIT ABSOLUTE /end AXIS_PTS
/begin AXIS_PTS AXX_KL_NEL_TKA "AXX_KL_NEL_TKA" 0x8074B336 Tka_wm _REC_A1AXS_1_MBSE_S2 655.35 DchEpAd_DBCFgoa_Ckhahgc_q__aoa0 6 -327.68 327.67 FORMAT "%6.2" DEPOSIT ABSOLUTE /end AXIS_PTS
/begin AXIS_PTS AXX_KL_NEL_TMOT "AXX_KL_NEL_TMOT" 0x8074B31E Dtmot_tkwsoll_f _REC_A1AXS_1_MBSE_S2 655.35 DchEpAd_DBCFgoa_Ckhahgc_q__aoa0 12 -327.68 327.67 FORMAT "%6.2" DEPOSIT ABSOLUTE /end AXIS_PTS
/begin AXIS_PTS AXX_KL_NEL_V_MX "AXX_KL_NEL_V_MX" 0x8074B43A V_wm _REC_A1AXS_1_MBSE_U2 6553.5 BMW_q0p1_kilometer_per_hour 4 0 6553.5 FORMAT "%6.1" DEPOSIT ABSOLUTE /end AXIS_PTS
/begin AXIS_PTS AXX_KL_NEL_VSKR_TUMG "AXX_KL_NEL_VSKR_TUMG" 0x8074B38A Tumg_wm _REC_A1AXS_1_MBSE_S2 6553.5 BMW_q0p1_degC 4 -3276.8 3276.7 DEPOSIT ABSOLUTE /end AXIS_PTS
/begin AXIS_PTS AXX_KL_NEWP_KLIMA_MX "AXX_KL_NEWP_KLIMA_MX" 0x8074AE94 Tumg_wm _REC_A1AXS_1_MBSE_S2 6553.5 BMW_q0p1_degC 4 -3276.8 3276.7 DEPOSIT ABSOLUTE /end AXIS_PTS
/begin AXIS_PTS AXX_KL_NKW_SOUND_MNMX "AXX_KL_NKW_SOUND_MNMX" 0x807585C8 Gangi _REC_A1AXS_1_MBSE_U1 255 raChrxc_kBtBrmb_FmDuEFa_n__aa0o 8 0 255 FORMAT "%3.0" DEPOSIT ABSOLUTE /end AXIS_PTS
/begin AXIS_PTS AXX_KL_PSPVDK_SOLMAXGD "Nkw" 0x8071F24E NO_INPUT_QUANTITY _REC_A1AXS_1_MBSE_S2 32767 caoddzd_oAjpfzb_cAcEEha_1nR_oa0 6 0 32767 FORMAT "%5.0" DEPOSIT ABSOLUTE /end AXIS_PTS
/begin AXIS_PTS AXX_KL_RFTNLMX "Nkw" 0x8071F790 NO_INPUT_QUANTITY _REC_A1AXS_1_MBSE_S2 32767 caoddzd_oAjpfzb_cAcEEha_1nR_oa0 10 0 32767 FORMAT "%5.0" DEPOSIT ABSOLUTE /end AXIS_PTS
/begin AXIS_PTS AXX_KL_T_IKAT_SOUND_MX "AXX_KL_T_IKAT_SOUND_MX" 0x807585C4 Anz_b_sound _REC_A1AXS_1_MBSE_U1 255 raChrxc_kBtBrmb_FmDuEFa_n__aa0o 4 0 255 FORMAT "%5.0" DEPOSIT ABSOLUTE /end AXIS_PTS
/begin AXIS_PTS AXX_KL_TD_SOUND_MX "AXX_KL_TD_SOUND_MX" 0x8072DD9C V_fzg_plaus _REC_A1AXS_1_MBSE_S2 1310.7 jgbhAma_smpAegb_hlEBAmd_k__0oa0 4 -655.36 655.34 FORMAT "%6.2" DEPOSIT ABSOLUTE /end AXIS_PTS
/begin AXIS_PTS AXX_KL_TD_SOUND_MX_FREI "AXX_KL_TD_SOUND_MX_FREI" 0x8072DD94 V_fzg_plaus _REC_A1AXS_1_MBSE_S2 1310.7 jgbhAma_smpAegb_hlEBAmd_k__0oa0 4 -655.36 655.34 FORMAT "%6.2" DEPOSIT ABSOLUTE /end AXIS_PTS
/begin AXIS_PTS AXX_KL_TD_SOUND_MX_SPORT "AXX_KL_TD_SOUND_MX_SPORT" 0x8072DD8C V_fzg_plaus _REC_A1AXS_1_MBSE_S2 1310.7 jgbhAma_smpAegb_hlEBAmd_k__0oa0 4 -655.36 655.34 FORMAT "%6.2" DEPOSIT ABSOLUTE /end AXIS_PTS
/begin AXIS_PTS AXX_KL_TKW_HI "Kuehlmittel-Solltemperatur in der Betriebsart High in Abhaengigkeit der Umgebungstemperatur" 0x80736CBA Tumg_wm _REC_A1AXS_1_MBSE_S2 6553.5 BMW_q0p1_degC 4 -3276.8 3276.7 DEPOSIT ABSOLUTE /end AXIS_PTS
/begin AXIS_PTS AXX_KL_TKW_NO "AXX_KL_TKW_NO" 0x80736CB2 Tumg_wm _REC_A1AXS_1_MBSE_S2 6553.5 BMW_q0p1_degC 4 -3276.8 3276.7 DEPOSIT ABSOLUTE /end AXIS_PTS
/begin AXIS_PTS AXY_KF_BSLGF "AXY_KF_BSLGF" 0x8071A378 Rf_atm _REC_A1AXS_1_MBSE_S2 655.35 CgkBooc_wkiDfEd_Czglhgc_fR_1a0o 4 -327.68 327.67 DEPOSIT ABSOLUTE /end AXIS_PTS
/begin AXIS_PTS AXY_KF_DLAMBSVST_TABG "AXY_KF_DLAMBSVST_TABG" 0x8071A63C Rf_atm _REC_A1AXS_1_MBSE_S2 655.35 CgkBooc_wkiDfEd_Czglhgc_fR_1a0o 8 -327.68 327.67 DEPOSIT ABSOLUTE /end AXIS_PTS
/begin AXIS_PTS AXY_KF_DPLDS_PRED "Drf_s2spred" 0x80746AAC Drf_s2spred _REC_A1AXS_1_MBSE_U2 655.35 CgkBooc_wkiDfEd_Czglhgc_fR_1a0o 6 0 655.35 DEPOSIT ABSOLUTE /end AXIS_PTS
/begin AXIS_PTS AXY_KF_DPLDSOLL_SPORT "F_psspu" 0x80723896 NO_INPUT_QUANTITY _REC_A1AXS_1_MBSE_U2 7.9998779296875 acriqBc_tfkBqod_ocgjxzc_nR_8oa0 6 0 7.9998779296875 FORMAT "%7.5" DEPOSIT ABSOLUTE /end AXIS_PTS
/begin AXIS_PTS AXY_KF_DZWMIN_NORMAL_SOT "AXY_KF_DZWMIN_NORMAL_SOT" 0x80737B2E V _REC_A1AXS_1_MBSE_U2 65535 AFeDmkb_cAbjmcc_kAkskhd_k__0oa0 4 0 65535 FORMAT "%5.0" DEPOSIT ABSOLUTE /end AXIS_PTS
/begin AXIS_PTS AXY_KF_DZWMIN_SPORT_SOT "AXY_KF_DZWMIN_SPORT_SOT" 0x80737B16 V _REC_A1AXS_1_MBSE_U2 65535 AFeDmkb_cAbjmcc_kAkskhd_k__0oa0 4 0 65535 FORMAT "%5.0" DEPOSIT ABSOLUTE /end AXIS_PTS
/begin AXIS_PTS AXY_KF_FRKKORRF_1 "AXY_KF_FRKKORRF_1" 0x80714FB0 Rf _REC_A1AXS_1_MBSE_S2 655.35 CgkBooc_wkiDfEd_Czglhgc_fR_1a0o 16 -327.68 327.67 FORMAT "%7.2" DEPOSIT ABSOLUTE /end AXIS_PTS
/begin AXIS_PTS AXY_KF_KLIMA_KKS "AXY_KF_KLIMA_KKS" 0x8074AEA4 V_wm _REC_A1AXS_1_MBSE_U2 6553.5 BMW_q0p1_kilometer_per_hour 6 0 6553.5 DEPOSIT ABSOLUTE /end AXIS_PTS
/begin AXIS_PTS AXY_KF_KOEFF_B_LA "AXY_KF_KOEFF_B_LA" 0x807374C2 NO_INPUT_QUANTITY _REC_A1AXS_1_MBSE_S2 655.35 CgkBooc_wkiDfEd_Czglhgc_fR_1a0o 6 -327.68 327.67 FORMAT "%9.2" DEPOSIT ABSOLUTE /end AXIS_PTS
/begin AXIS_PTS AXY_KF_LA_BEZ "AXY_KF_LA_BEZ" 0x807374B2 NO_INPUT_QUANTITY _REC_A1AXS_1_MBSE_S2 655.35 CgkBooc_wkiDfEd_Czglhgc_fR_1a0o 8 -327.68 327.67 FORMAT "%9.2" DEPOSIT ABSOLUTE /end AXIS_PTS
/begin AXIS_PTS AXY_KF_LA_EZA "AXY_KF_LA_EZA" 0x8071EF06 Rf _REC_A1AXS_1_MBSE_S2 655.35 CgkBooc_wkiDfEd_Czglhgc_fR_1a0o 6 -327.68 327.67 FORMAT "%7.2" DEPOSIT ABSOLUTE /end AXIS_PTS
/begin AXIS_PTS AXY_KF_LAMIN_H "AXY_KF_LAMIN_H" 0x8071F00A Rf _REC_A1AXS_1_MBSE_S2 655.35 CgkBooc_wkiDfEd_Czglhgc_fR_1a0o 6 -327.68 327.67 FORMAT "%7.2" DEPOSIT ABSOLUTE /end AXIS_PTS
/begin AXIS_PTS AXY_KF_MD_RES_NST_KEY "AXY_KF_MD_RES_NST_KEY" 0x80731620 Tmot _REC_A1AXS_1_MBSE_S2 655.35 DchEpAd_DBCFgoa_Ckhahgc_q__aoa0 4 -327.68 327.67 FORMAT "%7.2" DEPOSIT ABSOLUTE /end AXIS_PTS
/begin AXIS_PTS AXY_KF_N_GASSTOSS_UND_ANFAHR "KF_NMAX_ANFAHR_MODE_0" 0x80728A8C NO_INPUT_QUANTITY _REC_A1AXS_1_MBSE_S2 1599.9755859375 vfyBdwd_ftexgja_BcFdiDd_fR_1a0o 4 -800 799.9755859375 FORMAT "%7.2" DEPOSIT ABSOLUTE /end AXIS_PTS
/begin AXIS_PTS AXY_KF_NEL_OPF_V "AXY_KF_NEL_OPF_V" 0x8074B426 V_wm _REC_A1AXS_1_MBSE_U2 6553.5 BMW_q0p1_kilometer_per_hour 10 0 6553.5 DEPOSIT ABSOLUTE /end AXIS_PTS
/begin AXIS_PTS AXY_KF_NEL_TABG "AXY_KF_NEL_TABG" 0x8074B41E V_wm _REC_A1AXS_1_MBSE_U2 6553.5 BMW_q0p1_kilometer_per_hour 4 0 6553.5 FORMAT "%6.1" DEPOSIT ABSOLUTE /end AXIS_PTS
/begin AXIS_PTS AXY_KF_NEL_TANS "AXY_KF_NEL_TANS" 0x8074B382 Tumg_wm _REC_A1AXS_1_MBSE_S2 6553.5 BMW_q0p1_degC 4 -3276.8 3276.7 FORMAT "%6.1" DEPOSIT ABSOLUTE /end AXIS_PTS
/begin AXIS_PTS AXY_KF_NEL_TGET "AXY_KF_NEL_TGET" 0x8074B40E V_wm _REC_A1AXS_1_MBSE_U2 6553.5 BMW_q0p1_kilometer_per_hour 8 0 6553.5 DEPOSIT ABSOLUTE /end AXIS_PTS
/begin AXIS_PTS AXY_KF_NEL_TMOT_TKA "AXY_KF_NEL_TMOT_TKA" 0x8074B2E6 Dtkwsoll_tka_f _REC_A1AXS_1_MBSE_S2 655.35 DchEpAd_DBCFgoa_Ckhahgc_q__aoa0 8 -327.68 327.67 FORMAT "%6.2" DEPOSIT ABSOLUTE /end AXIS_PTS
/begin AXIS_PTS AXY_KF_NEL_VSKR "AXY_KF_NEL_VSKR" 0x8074B406 V_wm _REC_A1AXS_1_MBSE_U2 6553.5 BMW_q0p1_kilometer_per_hour 4 0 6553.5 FORMAT "%6.1" DEPOSIT ABSOLUTE /end AXIS_PTS
/begin AXIS_PTS AXY_KF_NEWP_LLK_TANS "AXY_KF_NEWP_LLK_TANS" 0x8074BC1E Tumg_wm _REC_A1AXS_1_MBSE_S2 6553.5 BMW_q0p1_degC 6 -3276.8 3276.7 DEPOSIT ABSOLUTE /end AXIS_PTS
/begin AXIS_PTS AXY_KF_NMAX_ANFAHR_MODE_0 "KF_NMAX_ANFAHR_MODE_0" 0x80728F3C NO_INPUT_QUANTITY _REC_A1AXS_1_MBSE_S2 1599.9755859375 vfyBdwd_ftexgja_BcFdiDd_fR_1a0o 4 -800 799.9755859375 FORMAT "%7.2" DEPOSIT ABSOLUTE /end AXIS_PTS
/begin AXIS_PTS AXY_KF_NMAX_ANFAHR_MODE_1 "KF_NMAX_ANFAHR_MODE_1" 0x80728F34 NO_INPUT_QUANTITY _REC_A1AXS_1_MBSE_S2 1599.9755859375 vfyBdwd_ftexgja_BcFdiDd_fR_1a0o 4 -800 799.9755859375 FORMAT "%7.2" DEPOSIT ABSOLUTE /end AXIS_PTS
/begin AXIS_PTS AXY_KF_NMAX_ANFAHR_MODE_2 "KF_NMAX_ANFAHR_MODE_2" 0x80728F2C NO_INPUT_QUANTITY _REC_A1AXS_1_MBSE_S2 1599.9755859375 vfyBdwd_ftexgja_BcFdiDd_fR_1a0o 4 -800 799.9755859375 FORMAT "%7.2" DEPOSIT ABSOLUTE /end AXIS_PTS
/begin AXIS_PTS AXY_KF_PHA_H_E1 "AXY_KF_PHA_H_E1" 0x80719356 NO_INPUT_QUANTITY _REC_A1AXS_1_MBSE_S2 3199.951171875 zyyxBpb_rEsnvtc_gktukCa_fR_5a0o 8 -1600 1599.951171875 DEPOSIT ABSOLUTE /end AXIS_PTS
/begin AXIS_PTS AXY_KF_PRAIL_H "AXY_KF_PRAIL_H" 0x80725EB8 BMWrailco_rat_VabHom_sw _REC_A1AXS_1_MBSE_S2 3199.951171875 zyyxBpb_rEsnvtc_gktukCa_fR_5a0o 8 -1600 1599.951171875 FORMAT "%8.3" DEPOSIT ABSOLUTE /end AXIS_PTS
/begin AXIS_PTS AXY_KF_PRAIL_H_K "AXY_KF_PRAIL_H_K" 0x80725E78 BMWrailco_rat_VabHom_sw _REC_A1AXS_1_MBSE_S2 3199.951171875 zyyxBpb_rEsnvtc_gktukCa_fR_5a0o 8 -1600 1599.951171875 FORMAT "%8.3" DEPOSIT ABSOLUTE /end AXIS_PTS
/begin AXIS_PTS AXY_KF_PRAIL_HDPWARM "Achse" 0x80725EA8 BMWrailco_rat_VabHom_sw _REC_A1AXS_1_MBSE_S2 3199.951171875 zyyxBpb_rEsnvtc_gktukCa_fR_5a0o 8 -1600 1599.951171875 FORMAT "%8.3" DEPOSIT ABSOLUTE /end AXIS_PTS
/begin AXIS_PTS AXY_KF_PRAIL_HGD "Achse" 0x80725E98 BMWrailco_rat_VabHom_sw _REC_A1AXS_1_MBSE_S2 3199.951171875 zyyxBpb_rEsnvtc_gktukCa_fR_5a0o 8 -1600 1599.951171875 FORMAT "%8.3" DEPOSIT ABSOLUTE /end AXIS_PTS
/begin AXIS_PTS AXY_KF_PRAIL_HGD_K "Achse" 0x80725E88 BMWrailco_rat_VabHom_sw _REC_A1AXS_1_MBSE_S2 3199.951171875 zyyxBpb_rEsnvtc_gktukCa_fR_5a0o 8 -1600 1599.951171875 FORMAT "%8.3" DEPOSIT ABSOLUTE /end AXIS_PTS
/begin AXIS_PTS AXY_KF_ST_RKBAS_GD "AXY_KF_ST_RKBAS_GD" 0x8074F9F4 BMWinj_t_Eng_sw _REC_A1AXS_1_MBSE_S2 655.35 DchEpAd_DBCFgoa_Ckhahgc_q__aoa0 10 -327.68 327.67 FORMAT "%7.2" DEPOSIT ABSOLUTE /end AXIS_PTS
/begin AXIS_PTS AXY_KF_ST_RKBAS_VVT "AXY_KF_ST_RKBAS_VVT" 0x8074F2E2 BMWinj_t_Eng_sw _REC_A1AXS_1_MBSE_S2 655.35 DchEpAd_DBCFgoa_Ckhahgc_q__aoa0 12 -327.68 327.67 FORMAT "%7.2" DEPOSIT ABSOLUTE /end AXIS_PTS
/begin AXIS_PTS AXY_KF_TA_IKSOLL "AXY_KF_TA_IKSOLL" 0x8071A4BC Rf_atm _REC_A1AXS_1_MBSE_S2 655.35 CgkBooc_wkiDfEd_Czglhgc_fR_1a0o 4 -327.68 327.67 DEPOSIT ABSOLUTE /end AXIS_PTS
/begin AXIS_PTS AXY_KF_TA_VKSOLL "AXY_KF_TA_VKSOLL" 0x8071A4B4 Rf_atm _REC_A1AXS_1_MBSE_S2 655.35 CgkBooc_wkiDfEd_Czglhgc_fR_1a0o 4 -327.68 327.67 DEPOSIT ABSOLUTE /end AXIS_PTS
/begin AXIS_PTS AXY_KF_TD_FETTDELAY_TABG "AXY_KF_TD_FETTDELAY_TABG" 0x8074E560 Nkw _REC_A1AXS_1_MBSE_S2 6554 caoddzd_oAjpfzb_cAcEEha_1nR_oa0 4 -3277 3277 FORMAT "%5.0" DEPOSIT ABSOLUTE /end AXIS_PTS
/begin AXIS_PTS AXY_KF_ZWMIN_KSOT "AXY_KF_ZWMIN_KSOT" 0x80737B06 NO_INPUT_QUANTITY _REC_A1AXS_1_MBSE_S2 655.35 CgkBooc_wkiDfEd_Czglhgc_fR_1a0o 8 -327.68 327.67 FORMAT "%9.4" DEPOSIT ABSOLUTE /end AXIS_PTS
/begin AXIS_PTS AXY_KF_ZWMIN_WSOT "AXY_KF_ZWMIN_WSOT" 0x80737AF6 NO_INPUT_QUANTITY _REC_A1AXS_1_MBSE_S2 655.35 CgkBooc_wkiDfEd_Czglhgc_fR_1a0o 8 -327.68 327.67 FORMAT "%9.4" DEPOSIT ABSOLUTE /end AXIS_PTS
/begin AXIS_PTS BMWausy_p_DifCat_Ax "Mass flow through catalyst for pressure loss across catalyst" 0x80711CA0 NO_INPUT_QUANTITY _REC_A1AXS_1_MBSE_U2 2047.96875 CByjozc_eCmpBAb_pljBAmd_k__0oa0 8 0 2047.96875 FORMAT "%8.3" DEPOSIT ABSOLUTE /end AXIS_PTS
/begin AXIS_PTS BMWchas_p_RailInjMpl_Ax "Catalyst heating after start, rail pressure injection multiple X-axis" 0x8073CA0A Nkw _REC_A1AXS_1_MBSE_S2 65535 caoddzd_oAjpfzb_cAcEEha_1nR_oa0 6 -32768 32767 FORMAT "%5.0" DEPOSIT ABSOLUTE /end AXIS_PTS
/begin AXIS_PTS BMWchas_p_RailInjMpl_Ay "Catalyst heating after start, rail pressure injection multiple Y-axis" 0x8073C9FE BMWrailco_rat_VabHom_sw _REC_A1AXS_1_MBSE_S2 3199.951171875 zyyxBpb_rEsnvtc_gktukCa_fR_5a0o 6 -1600 1599.951171875 FORMAT "%8.3" DEPOSIT ABSOLUTE /end AXIS_PTS
/begin AXIS_PTS BMWchas_p_RailInjSng_Ax "Catalyst heating after start, rail pressure injection single X-axis" 0x8073C9EE Nkw _REC_A1AXS_1_MBSE_S2 65535 caoddzd_oAjpfzb_cAcEEha_1nR_oa0 8 -32768 32767 FORMAT "%5.0" DEPOSIT ABSOLUTE /end AXIS_PTS
/begin AXIS_PTS BMWchas_p_RailInjSng_Ay "Catalyst heating after start, rail pressure injection single Y-axis" 0x8073C9DE BMWrailco_rat_VabHom_sw _REC_A1AXS_1_MBSE_S2 3199.951171875 zyyxBpb_rEsnvtc_gktukCa_fR_5a0o 8 -1600 1599.951171875 FORMAT "%8.3" DEPOSIT ABSOLUTE /end AXIS_PTS
/begin AXIS_PTS BMWchas_st_OpmBasCatCold_Ax "axis for BMWchas_st_OpmBasCatCold_T" 0x8073CE18 BMWchst_t_Eng_sw _REC_A1AXS_1_MBSE_S2 655.35 DchEpAd_DBCFgoa_Ckhahgc_q__aoa0 8 -327.68 327.67 FORMAT "%6.2" DEPOSIT ABSOLUTE /end AXIS_PTS
/begin AXIS_PTS BMWchas_st_OpmBasLiOff_Ax "axis for BMWchas_st_OpmBasLiOff_T" 0x8073CE08 BMWchst_t_Eng_sw _REC_A1AXS_1_MBSE_S2 655.35 DchEpAd_DBCFgoa_Ckhahgc_q__aoa0 8 -327.68 327.67 FORMAT "%6.2" DEPOSIT ABSOLUTE /end AXIS_PTS
/begin AXIS_PTS BMWchas_tq_ResExhFlpClsd_Ax "Catalyst heating after start, torque result exhaust flap closed X-axis" 0x8073C6FA Nkw _REC_A1AXS_1_MBSE_S2 65535 caoddzd_oAjpfzb_cAcEEha_1nR_oa0 8 -32768 32767 FORMAT "%5.0" DEPOSIT ABSOLUTE /end AXIS_PTS
/begin AXIS_PTS BMWext_lam_CptPronDfco_Ax "Exhaust temperature model, lambda component protection deceleration fuel cutoff X-axis" 0x8071A1F6 NO_INPUT_QUANTITY _REC_A1AXS_1_MBSE_S2 65535 caoddzd_oAjpfzb_cAcEEha_1nR_oa0 6 -32768 32767 FORMAT "%5.0" DEPOSIT ABSOLUTE /end AXIS_PTS
/begin AXIS_PTS BMWgpfheat_p_RailInjMpl_Ax "GPF heating, rail pressure injection multiple X-axis" 0x8071D22E Nkw _REC_A1AXS_1_MBSE_S2 65535 caoddzd_oAjpfzb_cAcEEha_1nR_oa0 6 -32768 32767 FORMAT "%5.0" DEPOSIT ABSOLUTE /end AXIS_PTS
/begin AXIS_PTS BMWgpfheat_p_RailInjMpl_Ay "GPF heating, rail pressure injection multiple Y-axis" 0x8071D222 BMWrailco_rat_VabHom_sw _REC_A1AXS_1_MBSE_S2 3199.951171875 zyyxBpb_rEsnvtc_gktukCa_fR_5a0o 6 -1600 1599.951171875 FORMAT "%8.3" DEPOSIT ABSOLUTE /end AXIS_PTS
/begin AXIS_PTS BMWgpfheat_p_RailInjSng_Ax "GPF heating, rail pressure injection single X-axis" 0x8071D216 Nkw _REC_A1AXS_1_MBSE_S2 65535 caoddzd_oAjpfzb_cAcEEha_1nR_oa0 6 -32768 32767 FORMAT "%5.0" DEPOSIT ABSOLUTE /end AXIS_PTS
/begin AXIS_PTS BMWgpfheat_p_RailInjSng_Ay "GPF heating, rail pressure injection single Y-axis" 0x8071D20A BMWrailco_rat_VabHom_sw _REC_A1AXS_1_MBSE_S2 3199.951171875 zyyxBpb_rEsnvtc_gktukCa_fR_5a0o 6 -1600 1599.951171875 FORMAT "%8.3" DEPOSIT ABSOLUTE /end AXIS_PTS
/begin AXIS_PTS BMWgpfheat_tq_ResExhFlpClsd_Ax "GPF heating, torque result exhaust flap closed X-axis" 0x8071D8CC Nkw _REC_A1AXS_1_MBSE_S2 65535 caoddzd_oAjpfzb_cAcEEha_1nR_oa0 8 -32768 32767 FORMAT "%5.0" DEPOSIT ABSOLUTE /end AXIS_PTS
/begin AXIS_PTS BMWinjmon_fac_HppEff_Ax "Injection map factor for high-pressure pump efficiency (X-axis)" 0x80716C4E Nkw_10ms _REC_A1AXS_1_MBSE_S2 65535 caoddzd_oAjpfzb_cAcEEha_1nR_oa0 8 -32768 32767 FORMAT "%5.0" DEPOSIT ABSOLUTE /end AXIS_PTS
/begin AXIS_PTS BMWinjmon_fac_HppEff_Ay "Injection map factor for high-pressure pump efficiency (Y-axis)" 0x80716C46 BMWrail_p_RpsActVal _REC_A1AXS_1_MBSE_U2 131.07 bukAcFc_hypjrAa_CBhougc_MCRooa0 4 0 131.07 DEPOSIT ABSOLUTE /end AXIS_PTS
/begin AXIS_PTS BMWlpa_n_EfpEngStrtAmb_Ax "Electric fuel pump speed setpoint for start ambient X-axis" 0x8071C600 Tumg _REC_A1AXS_1_MBSE_S2 6553.5 BMW_q0p1_degC 4 -3276.8 3276.7 FORMAT "%6.1" DEPOSIT ABSOLUTE /end AXIS_PTS
/begin AXIS_PTS BMWlpa_n_EfpEngStrtAmb_Ay "Electric fuel pump speed setpoint for start ambient Y-axis" 0x8071C5F8 Pumg _REC_A1AXS_1_MBSE_U2 8191.875 BMW_p_sw_q0p125_hPa 4 0 8191.875 FORMAT "%8.3" DEPOSIT ABSOLUTE /end AXIS_PTS
/begin AXIS_PTS BMWlpa_n_EfpEngStrtPRail_Ax "Electric fuel pump speed setpoint for start rail pressure X-axis" 0x8071C5F4 BMWlpi_p_HiPAbs _REC_A1AXS_1_MBSE_U2 131.07 bukAcFc_hypjrAa_CBhougc_MCRooa0 2 0 131.07 DEPOSIT ABSOLUTE /end AXIS_PTS
/begin AXIS_PTS BMWlpa_n_EfpModSafe_Ax "Electric fuel pump speed setpoint safe mode X-axis" 0x8071C610 BMWlpi_t_Fu_sw _REC_A1AXS_1_MBSE_S2 655.35 DchEpAd_DBCFgoa_Ckhahgc_q__aoa0 4 -327.68 327.67 FORMAT "%5.2" DEPOSIT ABSOLUTE /end AXIS_PTS
/begin AXIS_PTS BMWlpa_n_EfpModSafe_Ay "Electric fuel pump speed setpoint safe mode Y-axis" 0x8071C608 BMWlpi_volf_Fu_sw _REC_A1AXS_1_MBSE_S2 655.35 zBcBzad_vmoivka_mFzjCgc_lCRooa0 4 -327.68 327.67 FORMAT "%5.2" DEPOSIT ABSOLUTE /end AXIS_PTS
/begin AXIS_PTS BMWlpa_volf_FuMaxBoosCtlr_Ax "LoPAsst Kraftstoffvolumenstrom bei Boost Nachfuehrung (X-Achse)" 0x8074103C BMWlpsc_p_DeSp_sw _REC_A1AXS_1_MBSE_S2 65.535 rgduxyd_mlihaBb_gsCghzb_bCRa0a0 6 -32.768 32.767 FORMAT "%5.3" DEPOSIT ABSOLUTE /end AXIS_PTS
/begin AXIS_PTS BMWlpsc_p_HppMax_Ax "Achse" 0x807412FA BMWlpi_volf_Fu_sw _REC_A1AXS_1_MBSE_S2 655.35 zBcBzad_vmoivka_mFzjCgc_lCRooa0 4 -327.68 327.67 FORMAT "%5.2" DEPOSIT ABSOLUTE /end AXIS_PTS
/begin AXIS_PTS BMWlpsc_volf_FuEjrPmp_Ax "Achse" 0x8071CD12 BMWlpsc_p_EfpSpCtld_uw _REC_A1AXS_1_MBSE_U2 65.535 rgduxyd_mlihaBb_gsCghzb_bCRa0a0 8 0 65.535 FORMAT "%5.3" DEPOSIT ABSOLUTE /end AXIS_PTS
/begin AXIS_PTS BMWlpsc_volf_FuEjrPmp_Ay "Achse" 0x8075522C BMWlpsc_st_TankCod_ub _REC_A1AXS_1_MBSE_U1 255 raChrxc_kBtBrmb_FmDuEFa_n__aa0o 4 0 255 FORMAT "%3.0" DEPOSIT ABSOLUTE /end AXIS_PTS
/begin AXIS_PTS BMWlpsd_p_RailDifMax_Ax "Achse" 0x8071CE30 BMWlpi_p_HiPAbsSp _REC_A1AXS_1_MBSE_U2 131.07 bukAcFc_hypjrAa_CBhougc_MCRooa0 4 0 131.07 DEPOSIT ABSOLUTE /end AXIS_PTS
/begin AXIS_PTS BMWosc_n_Gb1Max_Ax "Maximale zuverlassige Motordrehzahl für Getriebeschutz" 0x8075DE87 Gangi _REC_A1AXS_1_MBSE_U1 255 raChrxc_kBtBrmb_FmDuEFa_n__aa0o 10 0 255 FORMAT "%3.0" DEPOSIT ABSOLUTE /end AXIS_PTS
/begin AXIS_PTS BMWshl_n_SpdMaxAt_Ax "X-axis BMWshl_n_SpdMaxAt" 0x807647A6 Gangi _REC_A1AXS_1_MBSE_U1 255 raChrxc_kBtBrmb_FmDuEFa_n__aa0o 8 0 255 FORMAT "%3.0" DEPOSIT ABSOLUTE /end AXIS_PTS
/begin AXIS_PTS BMWshl_n_SpdMaxMt_Ax "X-axis BMWshl_n_SpdMaxMt" 0x807647A0 Gangi _REC_A1AXS_1_MBSE_U1 255 raChrxc_kBtBrmb_FmDuEFa_n__aa0o 6 0 255 FORMAT "%3.0" DEPOSIT ABSOLUTE /end AXIS_PTS
/begin AXIS_PTS BMWtchctr_fac_pwr_CompLimPctl_Ax "AXX_KL_F_PTURBVST" 0x80747CEC BMWtchsp_mf_CmprNorm_uw _REC_A1AXS_1_MBSE_U2 2047.96875 CByjozc_eCmpBAb_pljBAmd_k__0oa0 6 0 2047.96875 FORMAT "%10.3" DEPOSIT ABSOLUTE /end AXIS_PTS
/begin AXIS_PTS BMWtchctr_rat_p_ComprLimPctl_Ax "AXX_KL_FPLDSVLD_MN_DIS" 0x80747CD4 BMWtchsp_mf_CmprNorm_uw _REC_A1AXS_1_MBSE_U2 2047.96875 CByjozc_eCmpBAb_pljBAmd_k__0oa0 12 0 2047.96875 FORMAT "%10.3" DEPOSIT ABSOLUTE /end AXIS_PTS
/begin AXIS_PTS BMWtchctr_t_ExGasMdl_Ax "AXX_KF_TABGATL" 0x80747B84 Nkw _REC_A1AXS_1_MBSE_S2 65535 caoddzd_oAjpfzb_cAcEEha_1nR_oa0 6 -32768 32767 FORMAT "%5.0" DEPOSIT ABSOLUTE /end AXIS_PTS
/begin AXIS_PTS BMWtchctr_t_ExGasMdl_Ay "AXY_KF_TABGATL" 0x80747B78 Rf _REC_A1AXS_1_MBSE_S2 655.35 CgkBooc_wkiDfEd_Czglhgc_fR_1a0o 6 -327.68 327.67 FORMAT "%7.2" DEPOSIT ABSOLUTE /end AXIS_PTS
/begin AXIS_PTS BMWtchctr_t_ExGasMdlScav_Ax "AXX_KF_TABGATL" 0x80747B9C Nkw _REC_A1AXS_1_MBSE_S2 65535 caoddzd_oAjpfzb_cAcEEha_1nR_oa0 6 -32768 32767 FORMAT "%5.0" DEPOSIT ABSOLUTE /end AXIS_PTS
/begin AXIS_PTS BMWtchctr_t_ExGasMdlScav_Ay "AXY_KF_TABGATL" 0x80747B90 Rf _REC_A1AXS_1_MBSE_S2 655.35 CgkBooc_wkiDfEd_Czglhgc_fR_1a0o 6 -327.68 327.67 FORMAT "%7.2" DEPOSIT ABSOLUTE /end AXIS_PTS
/begin AXIS_PTS BMWtchob_fac_tq_Delt_Ax "AXX_KL_FDMDMX_OB" 0x80727AD6 Tans _REC_A1AXS_1_MBSE_S2 6553.5 BMW_q0p1_degC 4 -3276.8 3276.7 FORMAT "%6.1" DEPOSIT ABSOLUTE /end AXIS_PTS
/begin AXIS_PTS BMWtchsp_fac_FilPRatCmpr_Ax "AXX_KL_FK_PLDSVLD" 0x80727FC0 BMWtchsp_mf_CmprNorm_uw _REC_A1AXS_1_MBSE_U2 2047.96875 CByjozc_eCmpBAb_pljBAmd_k__0oa0 4 0 2047.96875 FORMAT "%10.3" DEPOSIT ABSOLUTE /end AXIS_PTS
/begin AXIS_PTS BMWtchsp_fac_mf_FilCmprNorm_Ax "AXX_KL_FK_MSSOLATL" 0x80728002 NO_INPUT_QUANTITY _REC_A1AXS_1_MBSE_U2 2047.96875 CByjozc_eCmpBAb_pljBAmd_k__0oa0 4 0 2047.96875 FORMAT "%10.3" DEPOSIT ABSOLUTE /end AXIS_PTS
/begin AXIS_PTS BMWtchsp_rat_p_CmprMax_Ax "AXX_KF_FPLDMAX" 0x80727F64 BMWtchsp_mf_CmprNorm_uw _REC_A1AXS_1_MBSE_U2 2047.96875 CByjozc_eCmpBAb_pljBAmd_k__0oa0 8 0 2047.96875 FORMAT "%10.3" DEPOSIT ABSOLUTE /end AXIS_PTS
/begin AXIS_PTS BMWtchsp_rat_p_CmprMax_Ay "AXY_KF_FPLDMAX" 0x80727F58 BMWtchtbc_t_BefCmpr_sw _REC_A1AXS_1_MBSE_S2 6553.5 BMW_q0p1_degC 6 -3276.8 3276.7 FORMAT "%6.1" DEPOSIT ABSOLUTE /end AXIS_PTS
/begin AXIS_PTS BMWtchsp_rat_p_CmprMaxRace_Ax "AXX_KF_FPLDMAX" 0x80727F90 BMWtchsp_mf_CmprNorm_uw _REC_A1AXS_1_MBSE_U2 2047.96875 CByjozc_eCmpBAb_pljBAmd_k__0oa0 8 0 2047.96875 FORMAT "%10.3" DEPOSIT ABSOLUTE /end AXIS_PTS
/begin AXIS_PTS BMWtchsp_rat_p_CmprMaxRace_Ay "AXY_KF_FPLDMAX" 0x80727F84 BMWtchtbc_t_BefCmpr_sw _REC_A1AXS_1_MBSE_S2 6553.5 BMW_q0p1_degC 6 -3276.8 3276.7 FORMAT "%6.1" DEPOSIT ABSOLUTE /end AXIS_PTS
/begin AXIS_PTS BMWtchsp_rat_p_CmprMaxTMax_Ax "Achse" 0x80727F74 NO_INPUT_QUANTITY _REC_A1AXS_1_MBSE_U2 3.99993896484375 epDxoEa_vnwexaa_kAzmuka_q__14a0 8 0 3.99993896484375 FORMAT "%6.1" DEPOSIT ABSOLUTE /end AXIS_PTS
/begin AXIS_PTS BMWtchsp_rat_p_CmprPmp_Ax "AXX_KL_FPLDPUMP" 0x80727F48 BMWtchsp_mf_CmprNorm_uw _REC_A1AXS_1_MBSE_U2 2047.96875 CByjozc_eCmpBAb_pljBAmd_k__0oa0 8 0 2047.96875 FORMAT "%10.3" DEPOSIT ABSOLUTE /end AXIS_PTS
/begin AXIS_PTS BMWtqe_n_EngLhModEngDynSp_Ax "Torque Engine(Moment Verbrennungsmotor) Number of revolutions(Drehzahl) engine(Verbrennungsmotor) limit high(Obergrenze) mode(Modus) engine(Verbrennungsmotor) dynamic(dynamisch) setpoint(Sollwert) axis x direction(X-Achse)" 0x80760BA7 BMW_mod_EngDynSp _REC_A1AXS_1_MBSE_U1 255 raChrxc_kBtBrmb_FmDuEFa_n__aa0o 8 0 255 DEPOSIT ABSOLUTE /end AXIS_PTS
/begin AXIS_PTS BMWtqe_n_NMaxEngTqLimd_Ax "Torque Engine(Moment Verbrennungsmotor) Number of revolutions(Drehzahl) Speed in rpm( Drezahl ) maximum(Maximum, Max) engine(Verbrennungsmotor) torque(Drehmoment) limited(begrenzt) axis x direction(X-Achse)" 0x80760BB0 BMWtqe_fac_EngTqLimd _REC_A1AXS_1_MBSE_U1 0.99609375 BMW_Powertrain_DxECompuMethods_Def_ub_b1_nounit 5 0 0.99609375 DEPOSIT ABSOLUTE /end AXIS_PTS
/begin AXIS_PTS BMWtqe_st_SptDet4NoiseAcvn_Ax "Torque Engine(Moment Verbrennungsmotor) status, state(Status, Zustand, Bitleiste) sport(Sport) detection(Erkennung) four(vier, 4) noise(Geräusche) activation(Aktivierung) axis x direction(X-Achse)" 0x80758619 Status_usecase_antr _REC_A1AXS_1_MBSE_U1 11 raChrxc_kBtBrmb_FmDuEFa_n__aa0o 12 0 11 FORMAT "%6.0" DEPOSIT ABSOLUTE /end AXIS_PTS
/begin AXIS_PTS BMWtqe_st_SptDet4NoiseAcvn_Ay "Torque Engine(Moment Verbrennungsmotor) status, state(Status, Zustand, Bitleiste) sport(Sport) detection(Erkennung) four(vier, 4) noise(Geräusche) activation(Aktivierung) axis y direction(Y-Achse)" 0x80758615 St_dsc_can _REC_A1AXS_1_MBSE_U1 11 raChrxc_kBtBrmb_FmDuEFa_n__aa0o 4 0 11 FORMAT "%3.0" DEPOSIT ABSOLUTE /end AXIS_PTS
/begin AXIS_PTS GXX_KF_LABAS "Group X-axis for KF_LABASxxx and KF_LA_SK" 0x8074E53C Nkw _REC_A1AXS_1_MBSE_S2 65535 caoddzd_oAjpfzb_cAcEEha_1nR_oa0 18 -32768 32767 FORMAT "%5.0" DEPOSIT ABSOLUTE /end AXIS_PTS
/begin AXIS_PTS GXX_KF_PHA_H_B1_BAS "GXX_KF_PHA_H_B1_BAS" 0x80717766 Nkw _REC_A1AXS_1_MBSE_S2 65535 caoddzd_oAjpfzb_cAcEEha_1nR_oa0 10 -32768 32767 FORMAT "%5.0" DEPOSIT ABSOLUTE /end AXIS_PTS
/begin AXIS_PTS GXY_KF_LABAS "Group Y-axis for KF_LABASxxx and KF_LA_SK" 0x8074E51A Rf _REC_A1AXS_1_MBSE_S2 655.35 CgkBooc_wkiDfEd_Czglhgc_fR_1a0o 17 -327.68 327.67 FORMAT "%7.2" DEPOSIT ABSOLUTE /end AXIS_PTS
/begin AXIS_PTS GXY_KF_PHA_H_B1_BAS "GXY_KF_PHA_H_B1_BAS input Rk_soll_h_xlb" 0x8071773E NO_INPUT_QUANTITY _REC_A1AXS_1_MBSE_S2 3199.951171875 zyyxBpb_rEsnvtc_gktukCa_fR_5a0o 12 -1600 1599.951171875 FORMAT "%8.3" DEPOSIT ABSOLUTE /end AXIS_PTS
/begin AXIS_PTS SNM08HDUW "Breakpoint distribution for engine speed" 0x807ABB3C NO_INPUT_QUANTITY Axis_Xu16 16383.75 nmot_sw_q0p25 8 0 16383.75 FORMAT "%8.2" DEPOSIT ABSOLUTE /end AXIS_PTS
/begin AXIS_PTS SPD06HDSW "Breakpoint distribution for rail pressure control deviation" 0x8079DAB6 FuPHi_pHpRglnDeLoc Axis_Xs16 131.07 RBPtCel_p_0p002_1 6 -65.536 65.534 FORMAT "%8.5" DEPOSIT ABSOLUTE /end AXIS_PTS
/begin CHARACTERISTIC AKR_dmHFMThdMin_C "Minimum threshold for HFM value to close exhaust flap" VALUE 0x8078E042 KwUw 6553.5 asfzqDd_xfCuqha_hliBAmd_k__0oa0 0 6553.5 FORMAT "%8.3" /end CHARACTERISTIC
/begin CHARACTERISTIC AKR_stSpt_C "Sport mode status" VALUE 0x8078E538 FklWUb 255 DEZ 0 255 FORMAT "%5.1" /end CHARACTERISTIC
/begin CHARACTERISTIC BMWchas_tq_ResExhFlpClsdHys_C "Hysterese für das schließen der Abgasklappe " VALUE 0x8073B33E CurG_Ws16 6553.5 BMW_dm_sw_q0p1_Nm -3276.8 3276.7 FORMAT "%6.1" /end CHARACTERISTIC
/begin CHARACTERISTIC BMWchas_v_IdlGearAcvMin_C "Threshold vehicle velocity for setting gear engaged for manual transmission vehicles" VALUE 0x8073B33A CurG_Ws16 1310.7 jgbhAma_smpAegb_hlEBAmd_k__0oa0 -655.36 655.34 FORMAT "%6.2" /end CHARACTERISTIC
/begin CHARACTERISTIC BMWchas_v_MaxExhFlpClsd_C "Maximum speed up to which the exhaust flap should remain closed" VALUE 0x8073B338 CurG_Ws16 1310.7 jgbhAma_smpAegb_hlEBAmd_k__0oa0 -655.36 655.34 FORMAT "%6.2" /end CHARACTERISTIC
/begin CHARACTERISTIC BMWchst_t_CatMax_C "threshold cat temperatur for canceling catalyst heating" VALUE 0x8071201E CurG_Ws16 6553.5 BMW_q0p1_degC -3276.8 3276.7 /end CHARACTERISTIC
/begin CHARACTERISTIC BMWgpfdiag_m_ThdAshSnsr_C "Threshold for setting PWarnAsche regarding learned ash mass" VALUE 0x80741362 CurG_Ws16 511.9921875 bqonsub_DgsgbFa_Czglhgc_gR_1a0o -256 255.9921875 /end CHARACTERISTIC
/begin CHARACTERISTIC BMWgpfheat_p_RailTstrPcg_C "GPF heating, rail pressure setpoint for preconditioning" VALUE 0x8071D172 KwUw 39.9993896484375 cxdjuna_xpuCged_ocEpdua_MCRa2a0 0 39.9993896484375 /end CHARACTERISTIC
/begin CHARACTERISTIC BMWgpfheat_tq_ResExhFlpClsdHys_C "Hysterese für das schließen der Abgasklappe " VALUE 0x8071D27A CurG_Ws16 6553.5 BMW_dm_sw_q0p1_Nm -3276.8 3276.7 FORMAT "%6.1" /end CHARACTERISTIC
/begin CHARACTERISTIC BMWgpfp_swi_PclFil_C "Manual switch to activate GPF functionality in Gpf_Cluster. NOTE: The switch is only evaluated in the INI function. Changes to the switch must be flashed and the ECU must enter sleep mode." VALUE 0x807553B8 FklWUb 1 fgjpsvb_fDqjECa_acgrbDd_n_dae__ 0 1 /end CHARACTERISTIC
/begin CHARACTERISTIC BMWlpa_fac_n_PwrMgrFild_C "Filter constant for electric fuel pump speed setpoint for fEPM" VALUE 0x80751BC8 KwUw 0.999984741210938 FzbmlAa_gCtylrb_ckCqxAc_nR_6oa0 0 0.999984741210938 FORMAT "%6.4" /end CHARACTERISTIC
/begin CHARACTERISTIC BMWlpa_n_EfpModMax_C "Electric fuel pump speed setpoint max mode" VALUE 0x8071C502 KwUw 65535 caoddzd_oAjpfzb_cAcEEha_1nR_oa0 0 65535 FORMAT "%5.0" /end CHARACTERISTIC
/begin CHARACTERISTIC BMWlpa_volf_FuBoosRstOfs_C "LoPAsst Kraftstoffvolumenstrom fuer Boost Reset Offset" VALUE 0x8074101C CurG_Ws16 655.35 zBcBzad_vmoivka_mFzjCgc_lCRooa0 -327.68 327.67 /end CHARACTERISTIC
/begin CHARACTERISTIC BMWlpa_volf_FuFpcOvrT_C "LoPAsst filling limitation due to electric fuel pump over-temperature maximum volume flow" VALUE 0x80741018 CurG_Ws16 655.35 zBcBzad_vmoivka_mFzjCgc_lCRooa0 -327.68 327.67 /end CHARACTERISTIC
/begin CHARACTERISTIC BMWosd_pwr_MaxSptDispkW_C "Sportanzeigen Bereichsende Leistung - Rohwert in kW" VALUE 0x8070CD26 KwUw 65535 raChrxc_kBtBrmb_FmDuEFa_n__aa0o 0 65535 /end CHARACTERISTIC
/begin CHARACTERISTIC BMWosd_tq_MaxSptDispNm_C "Sportanzeigen Bereichsende Drehmoment - Rohwert in Nm" VALUE 0x8070CD24 KwUw 65535 lFwocba_tlxgpab_wmDuExd_NCRoa0o 0 65535 /end CHARACTERISTIC
/begin CHARACTERISTIC BMWshl_n_ThdSpdDispSegAlOn_C "RPM threshold at which shift lights always flash" VALUE 0x80751138 CurG_Ws16 10000 caoddzd_oAjpfzb_cAcEEha_1nR_oa0 0 10000 /end CHARACTERISTIC
/begin CHARACTERISTIC BMWtchbas_cw_Noise_C "Configuration for wastegate opening for acoustic reasons" VALUE 0x807562A1 FklWUb 255 raChrxc_kBtBrmb_FmDuEFa_n__aa0o 0 255 FORMAT "%5.0" /end CHARACTERISTIC
/begin CHARACTERISTIC BMWtchbpi_p_MaxTcSptDisp_C "Anzeigebereich Ladedruck" VALUE 0x80764BB6 FklWUb 12.75 qDyjaAb_mviibsd_eCcdamc_bCRooa0 0 12.75 /end CHARACTERISTIC
/begin CHARACTERISTIC BMWtchdiag_n_EngMin_C "Lower RPM threshold for leakage detection" VALUE 0x8072773C CurG_Ws16 65535 caoddzd_oAjpfzb_cAcEEha_1nR_oa0 -32768 32767 FORMAT "%5.0" /end CHARACTERISTIC
/begin CHARACTERISTIC BMWtchob_p_DifEnd_C "Control deviation for overboost end" VALUE 0x807278FE CurG_Ws16 8191.875 BMW_p_sw_q0p125_hPa -4096 4095.875 FORMAT "%10.3" /end CHARACTERISTIC
/begin CHARACTERISTIC BMWtchob_p_DifGraTrigMin_C "Control deviation gradient for triggering overboost" VALUE 0x80727AEA CurG_Ws16 8191.875 BMW_p_sw_q0p125_hPa -4096 4095.875 FORMAT "%10.3" /end CHARACTERISTIC
/begin CHARACTERISTIC BMWtchsp_p_OfsMax_C "Offset on Pld_soll_max. This is subtracted from Pld_soll_max. If actual pressure Pvdkds rises above this threshold, Rf_max_pldmax calculation is activated (load is high enough for Fups and Pirg to be used for Rfmax calculation)" VALUE 0x80727DAC KwUw 8191.875 BMW_p_sw_q0p125_hPa 0 8191.875 FORMAT "%10.3" /end CHARACTERISTIC
/begin CHARACTERISTIC BMWtchsp_p_ReqMax_C "Maximum target boost pressure due to boost pressure sensor diagnostics" VALUE 0x80727DA6 KwUw 8191.875 BMW_p_sw_q0p125_hPa 0 8191.875 FORMAT "%10.3" /end CHARACTERISTIC
/begin CHARACTERISTIC BMWtqe_n_LamStrdMax_C "Max permitted lambda in stratified operation" VALUE 0x807302F2 CurG_Ws16 65535 raChrxc_kBtBrmb_FmDuEFa_n__aa0o -32768 32767 FORMAT "%6.0" /end CHARACTERISTIC
/begin CHARACTERISTIC BMWtqe_st_ProhCylOffGc_C "manual request to prohibit EZA during gear change (request to EGS) (0 = kein Verbot, 1 = Verbot)" VALUE 0x8075801A FklWUb 255 raChrxc_kBtBrmb_FmDuEFa_n__aa0o 0 255 FORMAT "%3.0" /end CHARACTERISTIC
/begin CHARACTERISTIC BMWtqe_swi_NoiseWiDiDfco_C "Switch, um die Funktionalitaet eines Schubblubberns trotz Verbot-SA zu aktivieren" VALUE 0x80758584 FklWUb 1 fgjpsvb_fDqjECa_acgrbDd_n_dae__ 0 1 /end CHARACTERISTIC
/begin CHARACTERISTIC CW_ATMOD "" VALUE 0x80754F6F FklWUb 1 B_TRUE 0 1 FORMAT "%13.11" /end CHARACTERISTIC
/begin CHARACTERISTIC CW_SOUND "CW_SOUND" VALUE 0x807585AE FklWUb 255 raChrxc_kBtBrmb_FmDuEFa_n__aa0o 0 255 FORMAT "%7.0" /end CHARACTERISTIC
/begin CHARACTERISTIC CWAKR "Codeword for exhaust flap control" VALUE 0x8078E57D FklWUb 255 DEZ 0 255 FORMAT "%5.1" /end CHARACTERISTIC
/begin CHARACTERISTIC CWSTEGSPROGAKR "Codeword for exhaust flap control via stegsprog" VALUE 0x8078E581 FklWUb 255 DEZ 0 255 FORMAT "%5.1" /end CHARACTERISTIC
/begin CHARACTERISTIC CWVMAXCOD "Codeword VMAX coding active" VALUE 0x807AB905 FklWUb 255 DEZ 0 255 FORMAT "%5.1" /end CHARACTERISTIC
/begin CHARACTERISTIC Exh_swtSensCfgPPFlt_C "Switch for configuration/adjustment of the pressure sensor" VALUE 0x807B1058 FklWUb 255 BMW_ba_poel__ 0 255 FORMAT "%5.1" /end CHARACTERISTIC
/begin CHARACTERISTIC K_BS_MN "Lambda minimum value for component protection" VALUE 0x8071A18C KwUw 15.999755859375 BumqDkc_mryszAa_EcglxAc_nR_4oa0 0 15.999755859375 /end CHARACTERISTIC
/begin CHARACTERISTIC K_EDA_MD_ANZ_BS_SCAL_CODE0 "Base scaling per range in the display" VALUE 0x80753A5F FklWUb 255 raChrxc_kBtBrmb_FmDuEFa_n__aa0o 0 255 /end CHARACTERISTIC
/begin CHARACTERISTIC K_EDA_MD_ANZ_BS_SCAL_CODE1 "Base scaling per range in the display" VALUE 0x80753A5E FklWUb 255 raChrxc_kBtBrmb_FmDuEFa_n__aa0o 0 255 /end CHARACTERISTIC
/begin CHARACTERISTIC K_EDA_MD_ANZ_BS_SCAL_CODE2 "Base scaling per range in the display" VALUE 0x80753A5D FklWUb 255 raChrxc_kBtBrmb_FmDuEFa_n__aa0o 0 255 /end CHARACTERISTIC
/begin CHARACTERISTIC K_EDA_MD_ANZ_BS_SCAL_CODE3 "Base scaling per range in the display" VALUE 0x80753A5C FklWUb 255 raChrxc_kBtBrmb_FmDuEFa_n__aa0o 0 255 /end CHARACTERISTIC
/begin CHARACTERISTIC K_EDA_MD_ANZ_BS_SCAL_CODE4 "Base scaling per range in the display" VALUE 0x80753A5B FklWUb 255 raChrxc_kBtBrmb_FmDuEFa_n__aa0o 0 255 /end CHARACTERISTIC
/begin CHARACTERISTIC K_EDA_P_ANZ_SPORT_BS_SCAL_CODE0 "Base scaling per range in the display" VALUE 0x80753A5A FklWUb 255 raChrxc_kBtBrmb_FmDuEFa_n__aa0o 0 255 /end CHARACTERISTIC
/begin CHARACTERISTIC K_EDA_P_ANZ_SPORT_BS_SCAL_CODE1 "Base scaling per range in the display" VALUE 0x80753A59 FklWUb 255 raChrxc_kBtBrmb_FmDuEFa_n__aa0o 0 255 /end CHARACTERISTIC
/begin CHARACTERISTIC K_EDA_P_ANZ_SPORT_BS_SCAL_CODE2 "Base scaling per range in the display" VALUE 0x80753A58 FklWUb 255 raChrxc_kBtBrmb_FmDuEFa_n__aa0o 0 255 /end CHARACTERISTIC
/begin CHARACTERISTIC K_EDA_P_ANZ_SPORT_BS_SCAL_CODE3 "Base scaling per range in the display" VALUE 0x80753A57 FklWUb 255 raChrxc_kBtBrmb_FmDuEFa_n__aa0o 0 255 /end CHARACTERISTIC
/begin CHARACTERISTIC K_F_SOT_RUECKBLICK_RS "Offset for overrun burble factor during downshift" VALUE 0x8075399A FklWUb 0.99609375 BMW_Powertrain_DxECompuMethods_Def_ub_b1_nounit 0 0.99609375 FORMAT "%6.4" /end CHARACTERISTIC
/begin CHARACTERISTIC K_F_SOT_RUECKBLICK_STAND "Factor for overrun burble at standstill" VALUE 0x80753999 FklWUb 0.99609375 BMW_Powertrain_DxECompuMethods_Def_ub_b1_nounit 0 0.99609375 FORMAT "%6.4" /end CHARACTERISTIC
/begin CHARACTERISTIC K_FK_NEL_VSKR "Filterung der E-Luefteranforderung über Kraftstoffverbrauch" VALUE 0x80760E7A FklWUb 0.99609375 BMW_Powertrain_DxECompuMethods_Def_ub_b1_nounit 0 0.99609375 FORMAT "%6.4" /end CHARACTERISTIC
/begin CHARACTERISTIC K_FRFMXBS_MN "Limitation factor for filling intervention at component protection rich running limit" VALUE 0x8071A214 KwUw 1.99996948242188 Bhvfwhc_bigEubd_BBEupBd_nR_3oa0 0 1.99996948242188 FORMAT "%14.5" /end CHARACTERISTIC
/begin CHARACTERISTIC K_LA_FETTDELAY "Lambda threshold above which an enrichment request from KF_LABAS_XXX is suppressed" VALUE 0x8074DDD4 KwUw 15.999755859375 BumqDkc_mryszAa_EcglxAc_nR_4oa0 0 15.999755859375 FORMAT "%9.4" /end CHARACTERISTIC
/begin CHARACTERISTIC K_MAX_PSSOLBER "Maximum Ps_soll_offs (for calculation of Ps_soll_sm_nl)" VALUE 0x8071F5A8 CurG_Ws16 8191.875 BMW_p_sw_q0p125_hPa -4096 4095.875 FORMAT "%8.3" /end CHARACTERISTIC
/begin CHARACTERISTIC K_MSVANST_DIFFPRAIL "Constant monitoring of high-pressure pump actuation minimum rail pressure undershoot" VALUE 0x80716BB0 KwUw 39.9993896484375 cxdjuna_xpuCged_ocEpdua_MCRa2a0 0 39.9993896484375 FORMAT "%6.2" /end CHARACTERISTIC
/begin CHARACTERISTIC K_N_GB1_IN_MAX_OSC "Max speed for GB1 (gearbox stage 1) protection" VALUE 0x80739EF6 CurG_Ws16 65535 caoddzd_oAjpfzb_cAcEEha_1nR_oa0 -32768 32767 FORMAT "%5.0" /end CHARACTERISTIC
/begin CHARACTERISTIC K_NADONNMX "Upper engine speed limit for releasing N.N. adaptation, throttle or lift (B_mradon)" VALUE 0x80712C8E CurG_Ws16 32767 caoddzd_oAjpfzb_cAcEEha_1nR_oa0 0 32767 FORMAT "%5.0" /end CHARACTERISTIC
/begin CHARACTERISTIC K_NKW_MAX "Max crankshaft speed" VALUE 0x807299FC CurG_Ws16 32767 caoddzd_oAjpfzb_cAcEEha_1nR_oa0 0 32767 FORMAT "%5.0" /end CHARACTERISTIC
/begin CHARACTERISTIC K_NMX_VM_ABS "Max applicable engine speed (N_vm_max)" VALUE 0x80731802 CurG_Ws16 65535 caoddzd_oAjpfzb_cAcEEha_1nR_oa0 -32768 32767 FORMAT "%5.0" /end CHARACTERISTIC
/begin CHARACTERISTIC K_NMX_VM_BA_GD "Maximum speed in throttled operating mode (GD)" VALUE 0x8074AB6A CurG_Ws16 65535 caoddzd_oAjpfzb_cAcEEha_1nR_oa0 -32768 32767 FORMAT "%5.0" /end CHARACTERISTIC
/begin CHARACTERISTIC K_NMX_VM_BA_VVT "Maximum speed in VVT operating mode" VALUE 0x8074AB68 CurG_Ws16 65535 caoddzd_oAjpfzb_cAcEEha_1nR_oa0 -32768 32767 FORMAT "%5.0" /end CHARACTERISTIC
/begin CHARACTERISTIC K_NMX_VM_FETRAWE "Maximum speed in FETRAWE mode" VALUE 0x807317FE CurG_Ws16 65535 caoddzd_oAjpfzb_cAcEEha_1nR_oa0 -32768 32767 FORMAT "%5.0" /end CHARACTERISTIC
/begin CHARACTERISTIC K_NMX_VM_OG_COMFORT "Upper RPM limit in COMFORT mode (Status_usecase_antr)" VALUE 0x8074AB66 CurG_Ws16 65535 caoddzd_oAjpfzb_cAcEEha_1nR_oa0 -32768 32767 FORMAT "%5.0" /end CHARACTERISTIC
/begin CHARACTERISTIC K_NMX_VM_OG_ECO "Upper RPM limit in ECO mode (Status_usecase_antr)" VALUE 0x8074AB64 CurG_Ws16 65535 caoddzd_oAjpfzb_cAcEEha_1nR_oa0 -32768 32767 FORMAT "%5.0" /end CHARACTERISTIC
/begin CHARACTERISTIC K_NMX_VM_OG_RENNSTART "Upper RPM limit in LAUNCH CONTROL mode (Status_usecase_antr)" VALUE 0x8074AB62 CurG_Ws16 65535 caoddzd_oAjpfzb_cAcEEha_1nR_oa0 -32768 32767 FORMAT "%5.0" /end CHARACTERISTIC
/begin CHARACTERISTIC K_NMX_VM_OG_SPORT "Upper RPM limit in SPORT mode (Status_usecase_antr)" VALUE 0x8074AB60 CurG_Ws16 65535 caoddzd_oAjpfzb_cAcEEha_1nR_oa0 -32768 32767 FORMAT "%5.0" /end CHARACTERISTIC
/begin CHARACTERISTIC K_NMX_VM_OG_SPORTPLUS "Upper RPM limit in SPORT PLUS mode (Status_usecase_antr)" VALUE 0x8074AB5E CurG_Ws16 65535 caoddzd_oAjpfzb_cAcEEha_1nR_oa0 -32768 32767 FORMAT "%5.0" /end CHARACTERISTIC
/begin CHARACTERISTIC K_PAK_MX "Maximum exhaust manifold pressure" VALUE 0x80711AC0 KwUw 8191.875 BMW_p_sw_q0p125_hPa 0 8191.875 FORMAT "%7.1" /end CHARACTERISTIC
/begin CHARACTERISTIC K_PAM_MODE_FUELLUNGSEG_NKW_HYS "Hysteresis for RPM thresholds for downshift of Pam_fuellungsseg_mode (2->1 or 1->0)" VALUE 0x807137F0 CurG_Ws16 65535 caoddzd_oAjpfzb_cAcEEha_1nR_oa0 -32768 32767 FORMAT "%5.0" /end CHARACTERISTIC
/begin CHARACTERISTIC K_PAM_MODE_FUELLUNGSEG_NKW1 "RPM threshold for switching Pam_fuellungseg_mode from 0 to 1" VALUE 0x807137F4 CurG_Ws16 32767 caoddzd_oAjpfzb_cAcEEha_1nR_oa0 0 32767 FORMAT "%5.0" /end CHARACTERISTIC
/begin CHARACTERISTIC K_PAM_MODE_FUELLUNGSEG_NKW2 "RPM threshold for switching Pam_fuellungseg_mode from 1 to 2" VALUE 0x807137F2 CurG_Ws16 32767 caoddzd_oAjpfzb_cAcEEha_1nR_oa0 0 32767 FORMAT "%5.0" /end CHARACTERISTIC
/begin CHARACTERISTIC K_PRAIL_ST_MAX "Maximum rail pressure setpoint for engine start" VALUE 0x80746D0E KwUw 39.9761962890625 cxdjuna_xpuCged_ocEpdua_MCRa2a0 0 39.9761962890625 FORMAT "%9.4" /end CHARACTERISTIC
/begin CHARACTERISTIC K_QS_ANF_KLIMA_MX "Maximum considered heat flow request from IHKA" VALUE 0x80760C5D FklWUb 99.609375 BMW_q0p3906_PERC 0 99.609375 /end CHARACTERISTIC
/begin CHARACTERISTIC K_T_FETTDELAY_SPERR "Time during which a renewed enrichment suppression is blocked" VALUE 0x807630D7 FklWUb 255 hcpywvc_dcqzDlc_FmDugua_s__aa0o 0 255 FORMAT "%5.2" /end CHARACTERISTIC
/begin CHARACTERISTIC K_T_NK_SOUND_MX "K_T_NK_SOUND_MX" VALUE 0x8072DCEA CurG_Ws16 6553.5 BMW_q0p1_degC -3276.8 3276.7 /end CHARACTERISTIC
/begin CHARACTERISTIC K_T_SOUND_MN "K_T_SOUND_MN" VALUE 0x8072DCE8 CurG_Ws16 655.35 DchEpAd_DBCFgoa_Ckhahgc_q__aoa0 -327.68 327.67 /end CHARACTERISTIC
/begin CHARACTERISTIC K_T_VL_SOUND_MX "K_T_VL_SOUND_MX" VALUE 0x8072DCE6 CurG_Ws16 6553.5 BMW_q0p1_degC -3276.8 3276.7 /end CHARACTERISTIC
/begin CHARACTERISTIC K_TDOFF_HEIZ_OPF "OPF Heizung Zeitverzögerung für E-Lüfteranforderung" VALUE 0x8074B19C KwUw 6553.5 BMW_q0p1__ 0 6553.5 /end CHARACTERISTIC
/begin CHARACTERISTIC K_TDON_HEIZ_OPF "OPF Heizung Zeitverzögerung für E-Lüfteranforderung" VALUE 0x8074B19A KwUw 6553.5 BMW_q0p1__ 0 6553.5 /end CHARACTERISTIC
/begin CHARACTERISTIC K_TKW_MX "Coolant target temperature in MAX operating mode" VALUE 0x80736C90 CurG_Ws16 655.35 DchEpAd_DBCFgoa_Ckhahgc_q__aoa0 -327.68 327.67 /end CHARACTERISTIC
/begin CHARACTERISTIC K_TKW_WA "Coolant target temperature in warm-up operating mode" VALUE 0x80736C8C CurG_Ws16 655.35 DchEpAd_DBCFgoa_Ckhahgc_q__aoa0 -327.68 327.67 /end CHARACTERISTIC
/begin CHARACTERISTIC K_V_SOT_MN "Min. vehicle speed for overrun burble" VALUE 0x8070C950 CurG_Ws16 1310.7 Asyaixa_wdvtenb_FCefaCb_n__aa0o -655.36 655.34 FORMAT "%7.1" /end CHARACTERISTIC
/begin CHARACTERISTIC K_V_SOUND_MN "K_V_SOUND_MN" VALUE 0x8072DCE4 KwUw 1310.7 jgbhAma_smpAegb_hlEBAmd_k__0oa0 0 1310.7 /end CHARACTERISTIC
/begin CHARACTERISTIC K_V_SOUND_MX "K_V_SOUND_MX" VALUE 0x8072DCE2 KwUw 1310.7 jgbhAma_smpAegb_hlEBAmd_k__0oa0 0 1310.7 /end CHARACTERISTIC
/begin CHARACTERISTIC NMAX "RPM limiter" VALUE 0x807A427A KwUw 16383.75 nmot_sw_q0p25 0 16383.75 FORMAT "%8.2" /end CHARACTERISTIC
/begin CHARACTERISTIC NMAXKR "RPM limit at safety retard of knock control" VALUE 0x807A427E KwUw 16383.75 nmot_sw_q0p25 0 16383.75 FORMAT "%8.2" /end CHARACTERISTIC
/begin CHARACTERISTIC NMAXSWT "RPM limit via SWT" VALUE 0x807A4282 KwUw 16383.75 nmot_sw_q0p25 0 16383.75 FORMAT "%8.2" /end CHARACTERISTIC
/begin CHARACTERISTIC NMXHDR "RPM limit at high-pressure rail controller fault" VALUE 0x807A1748 CurG_Ws16 16383.5 n_sw_q0p5 0 16383.5 FORMAT "%8.2" /end CHARACTERISTIC
/begin CHARACTERISTIC NWARNORINI "Tachometer orange zone start RPM" VALUE 0x8078EE6E KwUw 16383.75 nmot_sw_q0p25 0 16383.75 FORMAT "%8.2" /end CHARACTERISTIC
/begin CHARACTERISTIC PFlt_stActv_C "Activation of particle filter functionality" VALUE 0x807A629C FklWUb 255 BMW_ba_poel__ 0 255 FORMAT "%5.1" /end CHARACTERISTIC
/begin CHARACTERISTIC PFlt_stPfilTyp_C "Bit-coded type of the particle filter" VALUE 0x807A629D FklWUb 255 BMW_ba_poel__ 0 255 FORMAT "%5.1" /end CHARACTERISTIC
/begin CHARACTERISTIC PVDMX "Upper pressure threshold for range check" VALUE 0x80795286 KwUw 5119.922 p_uw_q0p078 0 5119.922 FORMAT "%8.3" /end CHARACTERISTIC
/begin CHARACTERISTIC S_AUSWAHL_FETTDELAY "Switch for changing the lambda setpoint during enrichment suppression. Either lambda=1 or max selection between La_main and K_LA_FETTDELAY is output." VALUE 0x807630D6 FklWUb 1 raChrxc_kBtBrmb_FmDuEFa_n__aa0o 0 1 FORMAT "%3.0" /end CHARACTERISTIC
/begin CHARACTERISTIC S_PRAIL_GL_LA1 "Schalter zur Aktivierung des Sollraildrucks aus Grundkennfeld im Betriebsmodus CILCN " VALUE 0x80755F9C FklWUb 255 raChrxc_kBtBrmb_FmDuEFa_n__aa0o 0 255 FORMAT "%3.0" /end CHARACTERISTIC
/begin CHARACTERISTIC TMOTAKR "Temperature threshold for engine temperature dependent exhaust flap control" VALUE 0x8078E588 FklWUb 191.3 temp_ub_q0p75_o48 -48 143.3 FORMAT "%5.1" /end CHARACTERISTIC
/begin CHARACTERISTIC TVSTAKR "Delay time for exhaust flap actuation after start" VALUE 0x8078E58A KwUw 655.35 t10msxs_ub_b2p55 0 655.35 FORMAT "%8.4" /end CHARACTERISTIC
/begin CHARACTERISTIC VMAXOVC "Vmax limitation value, variant-coded" VALUE 0x807AB980 KwUw 511.9922 vfzg_sw_q0p00781 0 511.9922 FORMAT "%8.4" /end CHARACTERISTIC
/begin CHARACTERISTIC VMINAKR "Minimum vehicle speed for pulse output" VALUE 0x8078E58C FklWUb 318.8 vfzg_ub_q1p25 0 318.8 FORMAT "%5.1" /end CHARACTERISTIC
/begin CHARACTERISTIC BMWext_lam_MinCptPronInit_Ca "Minimal Lambda Bauteilschutz in Init; Vektorelement 0 = VorATL, 1=VorKat, 2=InKat" VAL_BLK 0x8071A04E KwUw 15.999755859375 BumqDkc_mryszAa_EcglxAc_nR_4oa0 0 15.999755859375 NUMBER 3 MATRIX_DIM 3 1 1 /end CHARACTERISTIC
/begin CHARACTERISTIC BMWausy_p_DifCat_T "Exhaust system pressure loss across the catalyst depending on mass flow" CURVE 0x80711C40 _REC_A1CUR_1_MBSE_U2_S1 8191.875 BMW_p_sw_q0p125_hPa 0 8191.875 FORMAT "%8.3"
 /begin AXIS_DESCR COM_AXIS NO_INPUT_QUANTITY CByjozc_eCmpBAb_pljBAmd_k__0oa0 8 0 2047.96875 AXIS_PTS_REF BMWausy_p_DifCat_Ax FORMAT "%8.3" MONOTONY STRICT_INCREASE DEPOSIT ABSOLUTE /end AXIS_DESCR
/end CHARACTERISTIC
/begin CHARACTERISTIC BMWchas_st_OpmBasCatCold_T "Basic catalyst heating mode wish while catalyst is cold" CURVE 0x8075E153 _REC_A1CUR_1_MBSE_U1_S1 3 wDvwtyd_Bhgozed_DCekdfb_nsttFSS 0 3
 /begin AXIS_DESCR COM_AXIS BMWchst_t_Eng_sw DchEpAd_DBCFgoa_Ckhahgc_q__aoa0 8 -327.68 327.67 AXIS_PTS_REF BMWchas_st_OpmBasCatCold_Ax FORMAT "%6.2" MONOTONY MON_INCREASE DEPOSIT ABSOLUTE /end AXIS_DESCR
/end CHARACTERISTIC
/begin CHARACTERISTIC BMWchas_st_OpmBasLiOff_T "Basic catalyst heating mode wish after catalyst light-off has been reached" CURVE 0x8075E14B _REC_A1CUR_1_MBSE_U1_S1 3 wDvwtyd_Bhgozed_DCekdfb_nsttFSS 0 3
 /begin AXIS_DESCR COM_AXIS BMWchst_t_Eng_sw DchEpAd_DBCFgoa_Ckhahgc_q__aoa0 8 -327.68 327.67 AXIS_PTS_REF BMWchas_st_OpmBasLiOff_Ax FORMAT "%6.2" MONOTONY MON_INCREASE DEPOSIT ABSOLUTE /end AXIS_DESCR
/end CHARACTERISTIC
/begin CHARACTERISTIC BMWchas_tq_ResExhFlpClsd_T "Torque reserve above which the exhaust flap should be closed for acoustic reasons" CURVE 0x8073C69E _REC_A1CUR_1_MBSE_S2_S1 6553.5 BMW_dm_sw_q0p1_Nm -3276.8 3276.7 FORMAT "%6.1"
 /begin AXIS_DESCR COM_AXIS Nkw caoddzd_oAjpfzb_cAcEEha_1nR_oa0 8 -32768 32767 AXIS_PTS_REF BMWchas_tq_ResExhFlpClsd_Ax FORMAT "%5.0" MONOTONY STRICT_INCREASE DEPOSIT ABSOLUTE /end AXIS_DESCR
/end CHARACTERISTIC
/begin CHARACTERISTIC BMWext_lam_CptPronDfco_T "Lambda feedforward value after cylinder deactivation in component protection" CURVE 0x8071A1DE _REC_A1CUR_1_MBSE_U2_S1 15.999755859375 BumqDkc_mryszAa_EcglxAc_nR_4oa0 0 15.999755859375 FORMAT "%9.4"
 /begin AXIS_DESCR COM_AXIS NO_INPUT_QUANTITY caoddzd_oAjpfzb_cAcEEha_1nR_oa0 6 -32768 32767 AXIS_PTS_REF BMWext_lam_CptPronDfco_Ax FORMAT "%5.0" MONOTONY STRICT_INCREASE DEPOSIT ABSOLUTE /end AXIS_DESCR
/end CHARACTERISTIC
/begin CHARACTERISTIC BMWgpfheat_tq_ResExhFlpClsd_T "Torque reserve above which the exhaust flap should be closed for acoustic reasons" CURVE 0x8071D80C _REC_A1CUR_1_MBSE_S2_S1 6553.5 BMW_dm_sw_q0p1_Nm -3276.8 3276.7 FORMAT "%6.1"
 /begin AXIS_DESCR COM_AXIS Nkw caoddzd_oAjpfzb_cAcEEha_1nR_oa0 8 -32768 32767 AXIS_PTS_REF BMWgpfheat_tq_ResExhFlpClsd_Ax FORMAT "%5.0" MONOTONY STRICT_INCREASE DEPOSIT ABSOLUTE /end AXIS_DESCR
/end CHARACTERISTIC
/begin CHARACTERISTIC BMWlpa_n_EfpEngStrtPRail_T "Electric fuel pump speed setpoint for start rail pressure" CURVE 0x8071C5CC _REC_A1CUR_1_MBSE_U2_S1 65535 caoddzd_oAjpfzb_cAcEEha_1nR_oa0 0 65535 FORMAT "%5.0"
 /begin AXIS_DESCR COM_AXIS BMWlpi_p_HiPAbs bukAcFc_hypjrAa_CBhougc_MCRooa0 2 0 131.07 AXIS_PTS_REF BMWlpa_n_EfpEngStrtPRail_Ax MONOTONY STRICT_INCREASE DEPOSIT ABSOLUTE /end AXIS_DESCR
/end CHARACTERISTIC
/begin CHARACTERISTIC BMWlpa_volf_FuMaxBoosCtlr_T "LoPAsst Kraftstoffvolumenstrom bei Boost Nachfuehrung (Kennlinie)" CURVE 0x80741028 _REC_A1CUR_1_MBSE_S2_S1 655.35 zBcBzad_vmoivka_mFzjCgc_lCRooa0 -327.68 327.67
 /begin AXIS_DESCR COM_AXIS BMWlpsc_p_DeSp_sw rgduxyd_mlihaBb_gsCghzb_bCRa0a0 6 -32.768 32.767 AXIS_PTS_REF BMWlpa_volf_FuMaxBoosCtlr_Ax FORMAT "%5.3" MONOTONY STRICT_INCREASE DEPOSIT ABSOLUTE /end AXIS_DESCR
/end CHARACTERISTIC
/begin CHARACTERISTIC BMWlpsc_p_HppMax_T "Curve maximum pressure before high-pressure pump depending on flow rate" CURVE 0x807412EA _REC_A1CUR_1_MBSE_U2_S1 65.535 rgduxyd_mlihaBb_gsCghzb_bCRa0a0 0 65.535 FORMAT "%5.3"
 /begin AXIS_DESCR COM_AXIS BMWlpi_volf_Fu_sw zBcBzad_vmoivka_mFzjCgc_lCRooa0 4 -327.68 327.67 AXIS_PTS_REF BMWlpsc_p_HppMax_Ax FORMAT "%5.2" MONOTONY STRICT_INCREASE DEPOSIT ABSOLUTE /end AXIS_DESCR
/end CHARACTERISTIC
/begin CHARACTERISTIC BMWlpsd_p_RailDifMax_T "Rail pressure deviation threshold" CURVE 0x8071CE28 _REC_A1CUR_1_MBSE_U2_S1 131.07 bukAcFc_hypjrAa_CBhougc_MCRooa0 0 131.07
 /begin AXIS_DESCR COM_AXIS BMWlpi_p_HiPAbsSp bukAcFc_hypjrAa_CBhougc_MCRooa0 4 0 131.07 AXIS_PTS_REF BMWlpsd_p_RailDifMax_Ax MONOTONY STRICT_INCREASE DEPOSIT ABSOLUTE /end AXIS_DESCR
/end CHARACTERISTIC
/begin CHARACTERISTIC BMWosc_n_Gb1Max_MT "Maximale zuverlassige Motordrehzahl für Getriebeschutz im Handschalter" CURVE 0x80739F16 _REC_A1CUR_1_MBSE_S2_S1 65535 caoddzd_oAjpfzb_cAcEEha_1nR_oa0 -32768 32767 FORMAT "%5.0"
 /begin AXIS_DESCR COM_AXIS Gangi raChrxc_kBtBrmb_FmDuEFa_n__aa0o 10 0 255 AXIS_PTS_REF BMWosc_n_Gb1Max_Ax FORMAT "%3.0" MONOTONY STRICT_INCREASE DEPOSIT ABSOLUTE /end AXIS_DESCR
/end CHARACTERISTIC
/begin CHARACTERISTIC BMWosc_n_Gb1Max_T "Maximale zuverlassige Motordrehzahl für Getriebeschutz" CURVE 0x80739F02 _REC_A1CUR_1_MBSE_S2_S1 65535 caoddzd_oAjpfzb_cAcEEha_1nR_oa0 -32768 32767 FORMAT "%5.0"
 /begin AXIS_DESCR COM_AXIS Gangi raChrxc_kBtBrmb_FmDuEFa_n__aa0o 10 0 255 AXIS_PTS_REF BMWosc_n_Gb1Max_Ax FORMAT "%3.0" MONOTONY STRICT_INCREASE DEPOSIT ABSOLUTE /end AXIS_DESCR
/end CHARACTERISTIC
/begin CHARACTERISTIC BMWshl_n_SpdMaxAt_T "Gear-dependent maximum RPM for automatic transmission shift light" CURVE 0x8075110C _REC_A1CUR_1_MBSE_S2_S1 65535 caoddzd_oAjpfzb_cAcEEha_1nR_oa0 -32768 32767
 /begin AXIS_DESCR COM_AXIS Gangi raChrxc_kBtBrmb_FmDuEFa_n__aa0o 8 0 255 AXIS_PTS_REF BMWshl_n_SpdMaxAt_Ax FORMAT "%3.0" MONOTONY STRICT_INCREASE DEPOSIT ABSOLUTE /end AXIS_DESCR
/end CHARACTERISTIC
/begin CHARACTERISTIC BMWshl_n_SpdMaxMt_T "Gear-dependent maximum RPM for manual transmission shift light" CURVE 0x80751100 _REC_A1CUR_1_MBSE_S2_S1 65535 caoddzd_oAjpfzb_cAcEEha_1nR_oa0 -32768 32767
 /begin AXIS_DESCR COM_AXIS Gangi raChrxc_kBtBrmb_FmDuEFa_n__aa0o 6 0 255 AXIS_PTS_REF BMWshl_n_SpdMaxMt_Ax FORMAT "%3.0" MONOTONY STRICT_INCREASE DEPOSIT ABSOLUTE /end AXIS_DESCR
/end CHARACTERISTIC
/begin CHARACTERISTIC BMWtchctr_fac_pwr_CompLimPctl_T "Feedforward factor up to which the controller can raise compressor power above feedforward using P and D components" CURVE 0x80747CC8 _REC_A1CUR_1_MBSE_U2_S1 1.99996948242188 Bhvfwhc_bigEubd_BBEupBd_nR_3oa0 0 1.99996948242188 FORMAT "%11.4"
 /begin AXIS_DESCR COM_AXIS BMWtchsp_mf_CmprNorm_uw CByjozc_eCmpBAb_pljBAmd_k__0oa0 6 0 2047.96875 AXIS_PTS_REF BMWtchctr_fac_pwr_CompLimPctl_Ax FORMAT "%10.3" MONOTONY STRICT_INCREASE DEPOSIT ABSOLUTE /end AXIS_DESCR
/end CHARACTERISTIC
/begin CHARACTERISTIC BMWtchctr_rat_p_ComprLimPctl_T "Minimum limit of target charge factor for aborting boost pressure control with decreasing target pressure" CURVE 0x80747CB0 _REC_A1CUR_1_MBSE_U2_S1 7.9998779296875 acriqBc_tfkBqod_ocgjxzc_nR_8oa0 0 7.9998779296875 FORMAT "%10.3"
 /begin AXIS_DESCR COM_AXIS BMWtchsp_mf_CmprNorm_uw CByjozc_eCmpBAb_pljBAmd_k__0oa0 12 0 2047.96875 AXIS_PTS_REF BMWtchctr_rat_p_ComprLimPctl_Ax FORMAT "%10.3" MONOTONY STRICT_INCREASE DEPOSIT ABSOLUTE /end AXIS_DESCR
/end CHARACTERISTIC
/begin CHARACTERISTIC BMWtchob_fac_tq_Delt_T "Reduction factor for overboost torque via intake air temperature" CURVE 0x80727A68 _REC_A1CUR_1_MBSE_U2_S1 0.999984741210938 FzbmlAa_gCtylrb_ckCqxAc_nR_6oa0 0 0.999984741210938 FORMAT "%6.4"
 /begin AXIS_DESCR COM_AXIS Tans BMW_q0p1_degC 4 -3276.8 3276.7 AXIS_PTS_REF BMWtchob_fac_tq_Delt_Ax FORMAT "%6.1" MONOTONY STRICT_INCREASE DEPOSIT ABSOLUTE /end AXIS_DESCR
/end CHARACTERISTIC
/begin CHARACTERISTIC BMWtchsp_fac_FilPRatCmpr_T "Filter constant for target pressure ratio" CURVE 0x80727F10 _REC_A1CUR_1_MBSE_U2_S1 0.999984741210938 FzbmlAa_gCtylrb_ckCqxAc_nR_6oa0 0 0.999984741210938 FORMAT "%14.5"
 /begin AXIS_DESCR COM_AXIS BMWtchsp_mf_CmprNorm_uw CByjozc_eCmpBAb_pljBAmd_k__0oa0 4 0 2047.96875 AXIS_PTS_REF BMWtchsp_fac_FilPRatCmpr_Ax FORMAT "%10.3" MONOTONY STRICT_INCREASE DEPOSIT ABSOLUTE /end AXIS_DESCR
/end CHARACTERISTIC
/begin CHARACTERISTIC BMWtchsp_fac_mf_FilCmprNorm_T "Filter constant for corrected target mass flow" CURVE 0x80727FEA _REC_A1CUR_1_MBSE_U2_S1 0.999984741210938 FzbmlAa_gCtylrb_ckCqxAc_nR_6oa0 0 0.999984741210938 FORMAT "%14.5"
 /begin AXIS_DESCR COM_AXIS NO_INPUT_QUANTITY CByjozc_eCmpBAb_pljBAmd_k__0oa0 4 0 2047.96875 AXIS_PTS_REF BMWtchsp_fac_mf_FilCmprNorm_Ax FORMAT "%10.3" MONOTONY STRICT_INCREASE DEPOSIT ABSOLUTE /end AXIS_DESCR
/end CHARACTERISTIC
/begin CHARACTERISTIC BMWtchsp_rat_p_CmprMaxTMax_T "Maximaler Aufladegrad zur Einhaltung der maximalen Verdichteraustrittstemperatur. Physikalische Umrechnung: Ausgang = Eingang ^ (k / (k-1))" CURVE 0x80727EE0 _REC_A1CUR_1_MBSE_U2_S1 3.99993896484375 ilxsavd_hkzmBfc_lAzCpAb_nR_1oa0 0 3.99993896484375
 /begin AXIS_DESCR COM_AXIS NO_INPUT_QUANTITY epDxoEa_vnwexaa_kAzmuka_q__14a0 8 0 3.99993896484375 AXIS_PTS_REF BMWtchsp_rat_p_CmprMaxTMax_Ax FORMAT "%6.1" MONOTONY STRICT_INCREASE DEPOSIT ABSOLUTE /end AXIS_DESCR
/end CHARACTERISTIC
/begin CHARACTERISTIC BMWtchsp_rat_p_CmprPmp_T "KL_FPLDPUMP" CURVE 0x80727ED0 _REC_A1CUR_1_MBSE_U2_S1 3.99993896484375 ilxsavd_hkzmBfc_lAzCpAb_nR_1oa0 0 3.99993896484375
 /begin AXIS_DESCR COM_AXIS BMWtchsp_mf_CmprNorm_uw CByjozc_eCmpBAb_pljBAmd_k__0oa0 8 0 2047.96875 AXIS_PTS_REF BMWtchsp_rat_p_CmprPmp_Ax FORMAT "%10.3" MONOTONY STRICT_INCREASE DEPOSIT ABSOLUTE /end AXIS_DESCR
/end CHARACTERISTIC
/begin CHARACTERISTIC BMWtqe_b_Clu4NoiseDeac_T "Torque engine clutch noise deactivation curve" CURVE 0x80758609 _REC_A1CUR_1_MBSE_U1_S1 1 fgjpsvb_fDqjECa_acgrbDd_n_dae__ 0 1
 /begin AXIS_DESCR COM_AXIS Status_usecase_antr raChrxc_kBtBrmb_FmDuEFa_n__aa0o 12 0 11 AXIS_PTS_REF BMWtqe_st_SptDet4NoiseAcvn_Ax FORMAT "%6.0" MONOTONY STRICT_INCREASE DEPOSIT ABSOLUTE /end AXIS_DESCR
/end CHARACTERISTIC
/begin CHARACTERISTIC BMWtqe_n_EngLhModEngDynSp_T "Obere Nmax-Grenze in Abhaengigkeit von BMW_mod_EngDynSp" CURVE 0x8074AB70 _REC_A1CUR_1_MBSE_S2_S1 65535 caoddzd_oAjpfzb_cAcEEha_1nR_oa0 -32768 32767 FORMAT "%5.0"
 /begin AXIS_DESCR COM_AXIS BMW_mod_EngDynSp raChrxc_kBtBrmb_FmDuEFa_n__aa0o 8 0 255 AXIS_PTS_REF BMWtqe_n_EngLhModEngDynSp_Ax MONOTONY STRICT_INCREASE DEPOSIT ABSOLUTE /end AXIS_DESCR
/end CHARACTERISTIC
/begin CHARACTERISTIC BMWtqe_n_NMaxEngTqLimdAt_T "Begrenzung vom N_vm_max in Abhaengigkeit vom Momentenbegrenzung fuer ein Automatikgetriebe" CURVE 0x8074AB96 _REC_A1CUR_1_MBSE_S2_S1 65535 caoddzd_oAjpfzb_cAcEEha_1nR_oa0 -32768 32767 FORMAT "%6.0"
 /begin AXIS_DESCR COM_AXIS BMWtqe_fac_EngTqLimd BMW_Powertrain_DxECompuMethods_Def_ub_b1_nounit 5 0 0.99609375 AXIS_PTS_REF BMWtqe_n_NMaxEngTqLimd_Ax MONOTONY STRICT_INCREASE DEPOSIT ABSOLUTE /end AXIS_DESCR
/end CHARACTERISTIC
/begin CHARACTERISTIC BMWtqe_n_NMaxEngTqLimdDct_T "Begrenzung vom N_vm_max in Abhaengigkeit vom Momentenbegrenzung fuer ein DKG" CURVE 0x8074AB8C _REC_A1CUR_1_MBSE_S2_S1 65535 caoddzd_oAjpfzb_cAcEEha_1nR_oa0 -32768 32767 FORMAT "%6.0"
 /begin AXIS_DESCR COM_AXIS BMWtqe_fac_EngTqLimd BMW_Powertrain_DxECompuMethods_Def_ub_b1_nounit 5 0 0.99609375 AXIS_PTS_REF BMWtqe_n_NMaxEngTqLimd_Ax MONOTONY STRICT_INCREASE DEPOSIT ABSOLUTE /end AXIS_DESCR
/end CHARACTERISTIC
/begin CHARACTERISTIC BMWtqe_n_NMaxEngTqLimdMt_T "Begrenzung vom N_vm_max in Abhaengigkeit vom Momentenbegrenzung fuer ein Handschaltergetriebe" CURVE 0x8074AB82 _REC_A1CUR_1_MBSE_S2_S1 65535 caoddzd_oAjpfzb_cAcEEha_1nR_oa0 -32768 32767 FORMAT "%6.0"
 /begin AXIS_DESCR COM_AXIS BMWtqe_fac_EngTqLimd BMW_Powertrain_DxECompuMethods_Def_ub_b1_nounit 5 0 0.99609375 AXIS_PTS_REF BMWtqe_n_NMaxEngTqLimd_Ax MONOTONY STRICT_INCREASE DEPOSIT ABSOLUTE /end AXIS_DESCR
/end CHARACTERISTIC
/begin CHARACTERISTIC EngPrt_nMax_CUR "Maximum permissible engine speed (steady-state)" CURVE 0x807A4256 RB_Curve_S8_U16_Static 16383.75 nmot_sw_q0p25 0 16383.75 FORMAT "%8.2"
 /begin AXIS_DESCR STD_AXIS EngPrt_NMAXSgangsis_mp DEZ 11 -128 127 FORMAT "%5.1" DEPOSIT ABSOLUTE /end AXIS_DESCR
/end CHARACTERISTIC
/begin CHARACTERISTIC FuPHi_FlmMaxpl_T "Kennlinie maximale relative Kraftstoffmasse für Plausibilisierung des Hochdrucksystems" CURVE 0x80794EFC RB_Curve_S16_U16_Static 3071.953 rel_q0p046875 0 3071.953 FORMAT "%8.3"
 /begin AXIS_DESCR STD_AXIS Epm_nEng EngN 4 -16384 16383.5 FORMAT "%8.2" DEPOSIT ABSOLUTE /end AXIS_DESCR
/end CHARACTERISTIC
/begin CHARACTERISTIC FWIHDR "Weighting factor PI controller parameter high-pressure rail; I-component" CURVE 0x8079DA7E Cur_Xu8Wu8 1.992188 fak_ub_b2 0 1.992188 FORMAT "%8.6"
 /begin AXIS_DESCR STD_AXIS FupHi_nEngLResHDR nmot_q40 8 0 10200 FORMAT "%5.0" DEPOSIT ABSOLUTE /end AXIS_DESCR
/end CHARACTERISTIC
/begin CHARACTERISTIC KL_FK_TUMG_OPF "Faktor zur Anpassung der OPF-Regeneration-Lüfteranforderung in Abhaengigkeit des Umgebungstemperatur" CURVE 0x80760E8C _REC_A1CUR_1_MBSE_U1_S1 5.1 Asyaixa_wdvtenb_FCefaCb_n__aa0o 0 5.1
 /begin AXIS_DESCR COM_AXIS Tumg_wm BMW_q0p1_degC 10 -3276.8 3276.7 AXIS_PTS_REF AXX_KL_FK_TUMG_OPF MONOTONY STRICT_INCREASE DEPOSIT ABSOLUTE /end AXIS_DESCR
/end CHARACTERISTIC
/begin CHARACTERISTIC KL_FLD_KKS "Request for switching the intake manifold flap depending on the filtered average throttle pressure" CURVE 0x80761114 _REC_A1CUR_1_MBSE_U1_S1 10 raChrxc_kBtBrmb_FmDuEFa_n__aa0o 0 10
 /begin AXIS_DESCR COM_AXIS F_pld_wm_f acriqBc_tfkBqod_ocgjxzc_nR_8oa0 6 0 7.9998779296875 AXIS_PTS_REF AXX_KL_FLD_KKS MONOTONY STRICT_INCREASE DEPOSIT ABSOLUTE /end AXIS_DESCR
/end CHARACTERISTIC
/begin CHARACTERISTIC KL_LA_SBL "Curve lambda setpoint for overrun burble" CURVE 0x8074DDD6 _REC_A1CUR_1_MBSE_U2_S1 15.999755859375 BumqDkc_mryszAa_EcglxAc_nR_4oa0 0 15.999755859375 FORMAT "%9.4"
 /begin AXIS_DESCR COM_AXIS Nkw caoddzd_oAjpfzb_cAcEEha_1nR_oa0 6 -32768 32767 AXIS_PTS_REF AXX_KL_LA_SBL FORMAT "%5.0" MONOTONY STRICT_INCREASE DEPOSIT ABSOLUTE /end AXIS_DESCR
/end CHARACTERISTIC
/begin CHARACTERISTIC KL_NEL_I "Weighting factor for accumulated coolant difference" CURVE 0x8074B1A2 _REC_A1CUR_1_MBSE_S2_S1 655.35 lCylrsa_tioqzad_Csrxmdd_f__o0a0 -327.68 327.67 FORMAT "%6.2"
 /begin AXIS_DESCR COM_AXIS Dtmot_tkwsoll_elue DchEpAd_DBCFgoa_Ckhahgc_q__aoa0 4 -327.68 327.67 AXIS_PTS_REF AXX_KL_NEL_I MONOTONY STRICT_INCREASE DEPOSIT ABSOLUTE /end AXIS_DESCR
/end CHARACTERISTIC
/begin CHARACTERISTIC KL_NEL_KLIMA_MX "Maximum electric fan speed request from air conditioning depending on ambient temperature" CURVE 0x80760CA6 _REC_A1CUR_1_MBSE_U1_S1 99.609375 BMW_q0p3906_PERC 0 99.609375
 /begin AXIS_DESCR COM_AXIS Tumg_wm BMW_q0p1_degC 4 -3276.8 3276.7 AXIS_PTS_REF AXX_KL_NEL_KLIMA_MX MONOTONY STRICT_INCREASE DEPOSIT ABSOLUTE /end AXIS_DESCR
/end CHARACTERISTIC
/begin CHARACTERISTIC KL_NEL_SPL "Electric fan speed request to support engine compartment purging" CURVE 0x80760ED0 _REC_A1CUR_1_MBSE_U1_S1 99.609375 BMW_q0p3906_PERC 0 99.609375
 /begin AXIS_DESCR COM_AXIS V_wm BMW_q0p1_kilometer_per_hour 4 0 6553.5 AXIS_PTS_REF AXX_KL_NEL_SPL MONOTONY STRICT_INCREASE DEPOSIT ABSOLUTE /end AXIS_DESCR
/end CHARACTERISTIC
/begin CHARACTERISTIC KL_NEL_TABG_TUMG "Factor for adjusting electric fan speed based on exhaust gas temperature" CURVE 0x80760E9A _REC_A1CUR_1_MBSE_U1_S1 0.99609375 BMW_Powertrain_DxECompuMethods_Def_ub_b1_nounit 0 0.99609375 FORMAT "%6.4"
 /begin AXIS_DESCR COM_AXIS Tumg_wm BMW_q0p1_degC 4 -3276.8 3276.7 AXIS_PTS_REF AXX_KL_NEL_TABG_TUMG MONOTONY STRICT_INCREASE DEPOSIT ABSOLUTE /end AXIS_DESCR
/end CHARACTERISTIC
/begin CHARACTERISTIC KL_NEL_TANS_KLOPF "Electric fan speed request due to intake air temperature from knock detection" CURVE 0x80760ECC _REC_A1CUR_1_MBSE_U1_S1 99.609375 BMW_q0p3906_PERC 0 99.609375
 /begin AXIS_DESCR COM_AXIS Dtans_tumg_wm BMW_q0p1_degC 4 -3276.8 3276.7 AXIS_PTS_REF AXX_KL_NEL_TANS_KLOPF FORMAT "%6.1" MONOTONY STRICT_INCREASE DEPOSIT ABSOLUTE /end AXIS_DESCR
/end CHARACTERISTIC
/begin CHARACTERISTIC KL_NEL_TDME "Electric fan speed request due to DME temperature" CURVE 0x80760EC8 _REC_A1CUR_1_MBSE_U1_S1 99.609375 BMW_q0p3906_PERC 0 99.609375
 /begin AXIS_DESCR COM_AXIS Tdme_wm DchEpAd_DBCFgoa_Ckhahgc_q__aoa0 4 -327.68 327.67 AXIS_PTS_REF AXX_KL_NEL_TDME FORMAT "%6.2" MONOTONY STRICT_INCREASE DEPOSIT ABSOLUTE /end AXIS_DESCR
/end CHARACTERISTIC
/begin CHARACTERISTIC KL_NEL_TEGS "Electric fan speed request due to EGS temperature" CURVE 0x80760EC4 _REC_A1CUR_1_MBSE_U1_S1 99.609375 BMW_q0p3906_PERC 0 99.609375
 /begin AXIS_DESCR COM_AXIS Tegs_wm BufnDdb_jpjgsgc_jmDugsa_qCRoa0o 4 -32768 32767 AXIS_PTS_REF AXX_KL_NEL_TEGS FORMAT "%6.0" MONOTONY STRICT_INCREASE DEPOSIT ABSOLUTE /end AXIS_DESCR
/end CHARACTERISTIC
/begin CHARACTERISTIC KL_NEL_TKA "Electric fan speed request depending on coolant radiator outlet temperature" CURVE 0x80760EBE _REC_A1CUR_1_MBSE_U1_S1 99.609375 BMW_q0p3906_PERC 0 99.609375
 /begin AXIS_DESCR COM_AXIS Tka_wm DchEpAd_DBCFgoa_Ckhahgc_q__aoa0 6 -327.68 327.67 AXIS_PTS_REF AXX_KL_NEL_TKA FORMAT "%6.2" MONOTONY STRICT_INCREASE DEPOSIT ABSOLUTE /end AXIS_DESCR
/end CHARACTERISTIC
/begin CHARACTERISTIC KL_NEL_TMOT "Electric fan speed request due to engine temperature" CURVE 0x80760EB2 _REC_A1CUR_1_MBSE_U1_S1 99.609375 BMW_q0p3906_PERC 0 99.609375
 /begin AXIS_DESCR COM_AXIS Dtmot_tkwsoll_f DchEpAd_DBCFgoa_Ckhahgc_q__aoa0 12 -327.68 327.67 AXIS_PTS_REF AXX_KL_NEL_TMOT FORMAT "%6.2" MONOTONY STRICT_INCREASE DEPOSIT ABSOLUTE /end AXIS_DESCR
/end CHARACTERISTIC
/begin CHARACTERISTIC KL_NEL_V_MX "Maximum electric fan speed request from integrated coolant difference depending on vehicle speed" CURVE 0x80760E9E _REC_A1CUR_1_MBSE_U1_S1 99.609375 BMW_q0p3906_PERC 0 99.609375
 /begin AXIS_DESCR COM_AXIS V_wm BMW_q0p1_kilometer_per_hour 4 0 6553.5 AXIS_PTS_REF AXX_KL_NEL_V_MX FORMAT "%6.1" MONOTONY STRICT_INCREASE DEPOSIT ABSOLUTE /end AXIS_DESCR
/end CHARACTERISTIC
/begin CHARACTERISTIC KL_NEL_VSKR_TUMG "Faktor zur Anpassung der E-Luefterdrehzahl über Kraftstoffverbrauch" CURVE 0x80760E96 _REC_A1CUR_1_MBSE_U1_S1 0.99609375 BMW_Powertrain_DxECompuMethods_Def_ub_b1_nounit 0 0.99609375 FORMAT "%6.4"
 /begin AXIS_DESCR COM_AXIS Tumg_wm BMW_q0p1_degC 4 -3276.8 3276.7 AXIS_PTS_REF AXX_KL_NEL_VSKR_TUMG MONOTONY STRICT_INCREASE DEPOSIT ABSOLUTE /end AXIS_DESCR
/end CHARACTERISTIC
/begin CHARACTERISTIC KL_NEWP_KLIMA_MX "Maximum permissible EWP speed request from air conditioning depending on ambient temperature" CURVE 0x80760CAA _REC_A1CUR_1_MBSE_U1_S1 100 nnxvdDd_vDnjvqd_FmDuEEa_f__aa0o 0 100
 /begin AXIS_DESCR COM_AXIS Tumg_wm BMW_q0p1_degC 4 -3276.8 3276.7 AXIS_PTS_REF AXX_KL_NEWP_KLIMA_MX MONOTONY STRICT_INCREASE DEPOSIT ABSOLUTE /end AXIS_DESCR
/end CHARACTERISTIC
/begin CHARACTERISTIC KL_NKW_SOUND_MN "Min. RPM threshold for activation of BMWtqe_b_NoisePre_bo depending on gear" CURVE 0x8072DD0A _REC_A1CUR_1_MBSE_S2_S1 65535 caoddzd_oAjpfzb_cAcEEha_1nR_oa0 -32768 32767
 /begin AXIS_DESCR COM_AXIS Gangi raChrxc_kBtBrmb_FmDuEFa_n__aa0o 8 0 255 AXIS_PTS_REF AXX_KL_NKW_SOUND_MNMX FORMAT "%3.0" MONOTONY STRICT_INCREASE DEPOSIT ABSOLUTE /end AXIS_DESCR
/end CHARACTERISTIC
/begin CHARACTERISTIC KL_NKW_SOUND_MX "Max. RPM threshold for activation of BMWtqe_b_NoisePre_bo depending on gear" CURVE 0x8072DCFA _REC_A1CUR_1_MBSE_S2_S1 65535 caoddzd_oAjpfzb_cAcEEha_1nR_oa0 -32768 32767
 /begin AXIS_DESCR COM_AXIS Gangi raChrxc_kBtBrmb_FmDuEFa_n__aa0o 8 0 255 AXIS_PTS_REF AXX_KL_NKW_SOUND_MNMX FORMAT "%3.0" MONOTONY STRICT_INCREASE DEPOSIT ABSOLUTE /end AXIS_DESCR
/end CHARACTERISTIC
/begin CHARACTERISTIC KL_PSPVDK_SOLMAXGD "Maximum target pressure ratio across throttle; speed-dependent with intercooler behind throttle" CURVE 0x8071F242 _REC_A1CUR_1_MBSE_U2_S1 3.99993896484375 ilxsavd_hkzmBfc_lAzCpAb_nR_1oa0 0 3.99993896484375 FORMAT "%7.4"
 /begin AXIS_DESCR COM_AXIS NO_INPUT_QUANTITY caoddzd_oAjpfzb_cAcEEha_1nR_oa0 6 0 32767 AXIS_PTS_REF AXX_KL_PSPVDK_SOLMAXGD FORMAT "%5.0" MONOTONY STRICT_INCREASE DEPOSIT ABSOLUTE /end AXIS_DESCR
/end CHARACTERISTIC
/begin CHARACTERISTIC KL_RFTNLMX "Maximum nonlinear Drf for calculation of Ps_soll_sm_nl" CURVE 0x8071F6F6 _REC_A1CUR_1_MBSE_S2_S1 327.67 CgkBooc_wkiDfEd_Czglhgc_fR_1a0o 0 327.67 FORMAT "%7.2"
 /begin AXIS_DESCR COM_AXIS NO_INPUT_QUANTITY caoddzd_oAjpfzb_cAcEEha_1nR_oa0 10 0 32767 AXIS_PTS_REF AXX_KL_RFTNLMX FORMAT "%5.0" MONOTONY MON_INCREASE DEPOSIT ABSOLUTE /end AXIS_DESCR
/end CHARACTERISTIC
/begin CHARACTERISTIC KL_T_IKAT_SOUND_MX "Temperaturschwelle Kat fürSchubblubberfreigabe " CURVE 0x8072DCF2 _REC_A1CUR_1_MBSE_S2_S1 6553.5 BMW_q0p1_degC -3276.8 3276.7
 /begin AXIS_DESCR COM_AXIS Anz_b_sound raChrxc_kBtBrmb_FmDuEFa_n__aa0o 4 0 255 AXIS_PTS_REF AXX_KL_T_IKAT_SOUND_MX FORMAT "%5.0" MONOTONY STRICT_INCREASE DEPOSIT ABSOLUTE /end AXIS_DESCR
/end CHARACTERISTIC
/begin CHARACTERISTIC KL_TD_SOUND_MX "KL_TD_SOUND_MX" CURVE 0x8072DD84 _REC_A1CUR_1_MBSE_U2_S1 655.35 camcxxd_bxlpdsa_Cshlhgc_sR_1a0o 0 655.35
 /begin AXIS_DESCR COM_AXIS V_fzg_plaus jgbhAma_smpAegb_hlEBAmd_k__0oa0 4 -655.36 655.34 AXIS_PTS_REF AXX_KL_TD_SOUND_MX FORMAT "%6.2" MONOTONY STRICT_INCREASE DEPOSIT ABSOLUTE /end AXIS_DESCR
/end CHARACTERISTIC
/begin CHARACTERISTIC KL_TD_SOUND_MX_FREI "Sound duration freely configurable" CURVE 0x8072DD7C _REC_A1CUR_1_MBSE_U2_S1 655.35 camcxxd_bxlpdsa_Cshlhgc_sR_1a0o 0 655.35
 /begin AXIS_DESCR COM_AXIS V_fzg_plaus jgbhAma_smpAegb_hlEBAmd_k__0oa0 4 -655.36 655.34 AXIS_PTS_REF AXX_KL_TD_SOUND_MX_FREI FORMAT "%6.2" MONOTONY STRICT_INCREASE DEPOSIT ABSOLUTE /end AXIS_DESCR
/end CHARACTERISTIC
/begin CHARACTERISTIC KL_TD_SOUND_MX_SPORT "KL_TD_SOUND_MX_SPORT" CURVE 0x8072DD74 _REC_A1CUR_1_MBSE_U2_S1 655.35 camcxxd_bxlpdsa_Cshlhgc_sR_1a0o 0 655.35
 /begin AXIS_DESCR COM_AXIS V_fzg_plaus jgbhAma_smpAegb_hlEBAmd_k__0oa0 4 -655.36 655.34 AXIS_PTS_REF AXX_KL_TD_SOUND_MX_SPORT FORMAT "%6.2" MONOTONY STRICT_INCREASE DEPOSIT ABSOLUTE /end AXIS_DESCR
/end CHARACTERISTIC
/begin CHARACTERISTIC KL_TKW_HI "Coolant target temperature in high operating mode depending on ambient temperature" CURVE 0x80736CA2 _REC_A1CUR_1_MBSE_S2_S1 655.35 DchEpAd_DBCFgoa_Ckhahgc_q__aoa0 -327.68 327.67
 /begin AXIS_DESCR COM_AXIS Tumg_wm BMW_q0p1_degC 4 -3276.8 3276.7 AXIS_PTS_REF AXX_KL_TKW_HI MONOTONY STRICT_INCREASE DEPOSIT ABSOLUTE /end AXIS_DESCR
/end CHARACTERISTIC
/begin CHARACTERISTIC KL_TKW_NO "Coolant target temperature in normal operating mode depending on ambient temperature" CURVE 0x80736C9A _REC_A1CUR_1_MBSE_S2_S1 655.35 DchEpAd_DBCFgoa_Ckhahgc_q__aoa0 -327.68 327.67
 /begin AXIS_DESCR COM_AXIS Tumg_wm BMW_q0p1_degC 4 -3276.8 3276.7 AXIS_PTS_REF AXX_KL_TKW_NO MONOTONY STRICT_INCREASE DEPOSIT ABSOLUTE /end AXIS_DESCR
/end CHARACTERISTIC
/begin CHARACTERISTIC KLFVSTOTF "Offset correction of MSV feedforward depending on fuel temperature" CURVE 0x807ABB1F Cur_Xu8Wu8 1.992188 fak_ub_b2 0 1.992188 FORMAT "%8.6"
 /begin AXIS_DESCR STD_AXIS tfuelsq_msg temp_ub_q0p75_o48 3 -48 143.3 FORMAT "%5.1" DEPOSIT ABSOLUTE /end AXIS_DESCR
/end CHARACTERISTIC
/begin CHARACTERISTIC KLIHDR "I-component of the rail pressure controller" CURVE 0x8079DA94 KwUw 7.999878 fak_sw_b4 0 7.999878 FORMAT "%8.6"
 /begin AXIS_DESCR COM_AXIS FuPHi_pHpRglnDeLoc RBPtCel_p_0p002_1 6 -65.536 65.534 AXIS_PTS_REF SPD06HDSW FORMAT "%8.5" DEPOSIT ABSOLUTE /end AXIS_DESCR
/end CHARACTERISTIC
/begin CHARACTERISTIC KLPHDR "P-component of the rail pressure controller" CURVE 0x8079DAA0 KwUw 7.999878 fak_sw_b4 0 7.999878 FORMAT "%8.6"
 /begin AXIS_DESCR COM_AXIS FuPHi_pHpRglnDeLoc RBPtCel_p_0p002_1 6 -65.536 65.534 AXIS_PTS_REF SPD06HDSW FORMAT "%8.5" DEPOSIT ABSOLUTE /end AXIS_DESCR
/end CHARACTERISTIC
/begin CHARACTERISTIC KLPHDRTF "Factor for P-component of high-pressure rail controller as function of temperature" CURVE 0x8079DAAC Cur_Xu8Wu8 1.992188 fak_ub_b2 0 1.992188 FORMAT "%8.6"
 /begin AXIS_DESCR STD_AXIS tfuelsq_msg temp_ub_q0p75_o48 4 -48 143.3 FORMAT "%5.1" DEPOSIT ABSOLUTE /end AXIS_DESCR
/end CHARACTERISTIC
/begin CHARACTERISTIC KLVSTMSVG "Gain factor for MSV feedforward" CURVE 0x807ABB26 KwUw 3.999939 fak_q6p1035Em5 0 3.999939 FORMAT "%8.6"
 /begin AXIS_DESCR COM_AXIS NO_INPUT_QUANTITY nmot_sw_q0p25 8 0 16383.75 AXIS_PTS_REF SNM08HDUW FORMAT "%8.2" DEPOSIT ABSOLUTE /end AXIS_DESCR
/end CHARACTERISTIC
/begin CHARACTERISTIC NMAXTMM "RPM limiter at high engine temperature" CURVE 0x807A4284 KlAUbSstUbWUw_Static 16383.75 nmot_sw_q0p25 0 16383.75 FORMAT "%8.2"
 /begin AXIS_DESCR STD_AXIS EngPrt_t1_mp temp_ub_q0p75_o48 4 -48 143.3 FORMAT "%5.1" DEPOSIT ABSOLUTE /end AXIS_DESCR
/end CHARACTERISTIC
/begin CHARACTERISTIC NMAXTO "RPM limiter at high oil temperature" CURVE 0x807A4292 Cur_Xu16Wu16 16383.75 nmot_sw_q0p25 0 16383.75 FORMAT "%8.2"
 /begin AXIS_DESCR STD_AXIS EngPrt_t2_mp temp_q0p0234_o273 4 -273.15 1262.827 FORMAT "%8.3" DEPOSIT ABSOLUTE /end AXIS_DESCR
/end CHARACTERISTIC
/begin CHARACTERISTIC VSEKPMXN "Curve target fuel volume flow at full load depending on engine speed" CURVE 0x80791053 Cur_Xu8Wu8 255 RBPtCel_vol_1p0_1 0 255 FORMAT "%5.1"
 /begin AXIS_DESCR STD_AXIS NO_INPUT_QUANTITY nmot_q40 5 0 10200 FORMAT "%5.0" DEPOSIT ABSOLUTE /end AXIS_DESCR
/end CHARACTERISTIC
/begin CHARACTERISTIC AKRGRCC "Map for exhaust flap control depending on current gear and engine speed, with closed convertible top" MAP 0x8078CE22 Map_Xs16Ys16Ws16 400 rel_q0p39 -200 200 FORMAT "%8.4"
 /begin AXIS_DESCR STD_AXIS gangakr DEZ 10 0 127 FORMAT "%8.4" DEPOSIT ABSOLUTE /end AXIS_DESCR
 /begin AXIS_DESCR STD_AXIS Epm_nEngLRes nmot_q40 12 0 10200 FORMAT "%8.2" DEPOSIT ABSOLUTE /end AXIS_DESCR
/end CHARACTERISTIC
/begin CHARACTERISTIC AKRGRCC_VAR1 "Map for exhaust flap control depending on current gear and engine speed, with closed convertible top and sport button active" MAP 0x8078D7FA Map_Xs16Ys16Ws16 400 rel_q0p39 -200 200 FORMAT "%8.4"
 /begin AXIS_DESCR STD_AXIS gangakr DEZ 6 0 127 FORMAT "%8.4" DEPOSIT ABSOLUTE /end AXIS_DESCR
 /begin AXIS_DESCR STD_AXIS Epm_nEngLRes nmot_q40 8 0 10200 FORMAT "%8.2" DEPOSIT ABSOLUTE /end AXIS_DESCR
/end CHARACTERISTIC
/begin CHARACTERISTIC AKRGRCC_VAR2 "Map for exhaust flap control depending on current gear and engine speed, with closed convertible top and sport button active" MAP 0x8078D87A Map_Xs16Ys16Ws16 400 rel_q0p39 -200 200 FORMAT "%8.4"
 /begin AXIS_DESCR STD_AXIS gangakr DEZ 6 0 127 FORMAT "%8.4" DEPOSIT ABSOLUTE /end AXIS_DESCR
 /begin AXIS_DESCR STD_AXIS Epm_nEngLRes nmot_q40 8 0 10200 FORMAT "%8.2" DEPOSIT ABSOLUTE /end AXIS_DESCR
/end CHARACTERISTIC
/begin CHARACTERISTIC AKRGRCC_VAR3 "Map for exhaust flap control depending on current gear and engine speed, with closed convertible top and sport button active" MAP 0x8078D8FA Map_Xs16Ys16Ws16 400 rel_q0p39 -200 200 FORMAT "%8.4"
 /begin AXIS_DESCR STD_AXIS gangakr DEZ 6 0 127 FORMAT "%8.4" DEPOSIT ABSOLUTE /end AXIS_DESCR
 /begin AXIS_DESCR STD_AXIS Epm_nEngLRes nmot_q40 8 0 10200 FORMAT "%8.2" DEPOSIT ABSOLUTE /end AXIS_DESCR
/end CHARACTERISTIC
/begin CHARACTERISTIC AKRGRCCAT "Map for exhaust flap control depending on current gear and engine speed (DCT or AT gearbox), with closed convertible top" MAP 0x8078CF42 Map_Xs16Ys16Ws16 400 rel_q0p39 -200 200 FORMAT "%8.4"
 /begin AXIS_DESCR STD_AXIS gangakr DEZ 10 0 127 FORMAT "%8.4" DEPOSIT ABSOLUTE /end AXIS_DESCR
 /begin AXIS_DESCR STD_AXIS Epm_nEngLRes nmot_q40 12 0 10200 FORMAT "%8.2" DEPOSIT ABSOLUTE /end AXIS_DESCR
/end CHARACTERISTIC
/begin CHARACTERISTIC AKRGRCCAT_VAR1 "Map for exhaust flap control depending on current gear and engine speed (DCT or AT gearbox), with closed convertible top" MAP 0x8078D36E Map_Xs16Ys16Ws16 400 rel_q0p39 -200 200 FORMAT "%8.4"
 /begin AXIS_DESCR STD_AXIS gangakr DEZ 8 0 127 FORMAT "%8.4" DEPOSIT ABSOLUTE /end AXIS_DESCR
 /begin AXIS_DESCR STD_AXIS Epm_nEngLRes nmot_q40 8 0 10200 FORMAT "%8.2" DEPOSIT ABSOLUTE /end AXIS_DESCR
/end CHARACTERISTIC
/begin CHARACTERISTIC AKRGRCCAT_VAR2 "Map for exhaust flap control depending on current gear and engine speed (DCT or AT gearbox), with closed convertible top" MAP 0x8078D412 Map_Xs16Ys16Ws16 400 rel_q0p39 -200 200 FORMAT "%8.4"
 /begin AXIS_DESCR STD_AXIS gangakr DEZ 8 0 127 FORMAT "%8.4" DEPOSIT ABSOLUTE /end AXIS_DESCR
 /begin AXIS_DESCR STD_AXIS Epm_nEngLRes nmot_q40 8 0 10200 FORMAT "%8.2" DEPOSIT ABSOLUTE /end AXIS_DESCR
/end CHARACTERISTIC
/begin CHARACTERISTIC AKRGRCCAT_VAR3 "Map for exhaust flap control depending on current gear and engine speed (DCT or AT gearbox), with closed convertible top" MAP 0x8078D4B6 Map_Xs16Ys16Ws16 400 rel_q0p39 -200 200 FORMAT "%8.4"
 /begin AXIS_DESCR STD_AXIS gangakr DEZ 8 0 127 FORMAT "%8.4" DEPOSIT ABSOLUTE /end AXIS_DESCR
 /begin AXIS_DESCR STD_AXIS Epm_nEngLRes nmot_q40 8 0 10200 FORMAT "%8.2" DEPOSIT ABSOLUTE /end AXIS_DESCR
/end CHARACTERISTIC
/begin CHARACTERISTIC AKRGRCCATM "Map for exhaust flap control depending on current gear and engine speed (DCT or AT gearbox), with closed convertible top and sport button active" MAP 0x8078D062 Map_Xs16Ys16Ws16 400 rel_q0p39 -200 200 FORMAT "%8.4"
 /begin AXIS_DESCR STD_AXIS gangakr DEZ 10 0 127 FORMAT "%8.4" DEPOSIT ABSOLUTE /end AXIS_DESCR
 /begin AXIS_DESCR STD_AXIS Epm_nEngLRes nmot_q40 12 0 10200 FORMAT "%8.2" DEPOSIT ABSOLUTE /end AXIS_DESCR
/end CHARACTERISTIC
/begin CHARACTERISTIC AKRGRCCATM_VAR1 "Map for exhaust flap control depending on current gear and engine speed (DCT or AT gearbox), with closed convertible top and sport button active" MAP 0x8078D182 Map_Xs16Ys16Ws16 400 rel_q0p39 -200 200 FORMAT "%8.4"
 /begin AXIS_DESCR STD_AXIS gangakr DEZ 8 0 127 FORMAT "%8.4" DEPOSIT ABSOLUTE /end AXIS_DESCR
 /begin AXIS_DESCR STD_AXIS Epm_nEngLRes nmot_q40 8 0 10200 FORMAT "%8.2" DEPOSIT ABSOLUTE /end AXIS_DESCR
/end CHARACTERISTIC
/begin CHARACTERISTIC AKRGRCCATM_VAR2 "Map for exhaust flap control depending on current gear and engine speed (DCT or AT gearbox), with closed convertible top and sport button active" MAP 0x8078D226 Map_Xs16Ys16Ws16 400 rel_q0p39 -200 200 FORMAT "%8.4"
 /begin AXIS_DESCR STD_AXIS gangakr DEZ 8 0 127 FORMAT "%8.4" DEPOSIT ABSOLUTE /end AXIS_DESCR
 /begin AXIS_DESCR STD_AXIS Epm_nEngLRes nmot_q40 8 0 10200 FORMAT "%8.2" DEPOSIT ABSOLUTE /end AXIS_DESCR
/end CHARACTERISTIC
/begin CHARACTERISTIC AKRGRCCATM_VAR3 "Map for exhaust flap control depending on current gear and engine speed (DCT or AT gearbox), with closed convertible top and sport button active" MAP 0x8078D2CA Map_Xs16Ys16Ws16 400 rel_q0p39 -200 200 FORMAT "%8.4"
 /begin AXIS_DESCR STD_AXIS gangakr DEZ 8 0 127 FORMAT "%8.4" DEPOSIT ABSOLUTE /end AXIS_DESCR
 /begin AXIS_DESCR STD_AXIS Epm_nEngLRes nmot_q40 8 0 10200 FORMAT "%8.2" DEPOSIT ABSOLUTE /end AXIS_DESCR
/end CHARACTERISTIC
/begin CHARACTERISTIC AKRGRCCM "Map for exhaust flap control depending on current gear and engine speed, with closed convertible top and sport button active" MAP 0x8078D55A Map_Xs16Ys16Ws16 400 rel_q0p39 -200 200 FORMAT "%8.4"
 /begin AXIS_DESCR STD_AXIS gangakr DEZ 10 0 127 FORMAT "%8.4" DEPOSIT ABSOLUTE /end AXIS_DESCR
 /begin AXIS_DESCR STD_AXIS Epm_nEngLRes nmot_q40 12 0 10200 FORMAT "%8.2" DEPOSIT ABSOLUTE /end AXIS_DESCR
/end CHARACTERISTIC
/begin CHARACTERISTIC AKRGRCCM_VAR1 "Map for exhaust flap control depending on current gear and engine speed, with closed convertible top and sport button active" MAP 0x8078D67A Map_Xs16Ys16Ws16 400 rel_q0p39 -200 200 FORMAT "%8.4"
 /begin AXIS_DESCR STD_AXIS gangakr DEZ 6 0 127 FORMAT "%8.4" DEPOSIT ABSOLUTE /end AXIS_DESCR
 /begin AXIS_DESCR STD_AXIS Epm_nEngLRes nmot_q40 8 0 10200 FORMAT "%8.2" DEPOSIT ABSOLUTE /end AXIS_DESCR
/end CHARACTERISTIC
/begin CHARACTERISTIC AKRGRCCM_VAR2 "Map for exhaust flap control depending on current gear and engine speed, with closed convertible top and sport button active" MAP 0x8078D6FA Map_Xs16Ys16Ws16 400 rel_q0p39 -200 200 FORMAT "%8.4"
 /begin AXIS_DESCR STD_AXIS gangakr DEZ 6 0 127 FORMAT "%8.4" DEPOSIT ABSOLUTE /end AXIS_DESCR
 /begin AXIS_DESCR STD_AXIS Epm_nEngLRes nmot_q40 8 0 10200 FORMAT "%8.2" DEPOSIT ABSOLUTE /end AXIS_DESCR
/end CHARACTERISTIC
/begin CHARACTERISTIC AKRGRCCM_VAR3 "Map for exhaust flap control depending on current gear and engine speed, with closed convertible top and sport button active" MAP 0x8078D77A Map_Xs16Ys16Ws16 400 rel_q0p39 -200 200 FORMAT "%8.4"
 /begin AXIS_DESCR STD_AXIS gangakr DEZ 6 0 127 FORMAT "%8.4" DEPOSIT ABSOLUTE /end AXIS_DESCR
 /begin AXIS_DESCR STD_AXIS Epm_nEngLRes nmot_q40 8 0 10200 FORMAT "%8.2" DEPOSIT ABSOLUTE /end AXIS_DESCR
/end CHARACTERISTIC
/begin CHARACTERISTIC AKRGRCO "Map for exhaust flap control depending on current gear and engine speed, with open convertible top" MAP 0x8078D97A Map_Xs16Ys16Ws16 400 rel_q0p39 -200 200 FORMAT "%8.4"
 /begin AXIS_DESCR STD_AXIS gangakr DEZ 10 0 127 FORMAT "%8.4" DEPOSIT ABSOLUTE /end AXIS_DESCR
 /begin AXIS_DESCR STD_AXIS Epm_nEngLRes nmot_q40 12 0 10200 FORMAT "%8.2" DEPOSIT ABSOLUTE /end AXIS_DESCR
/end CHARACTERISTIC
/begin CHARACTERISTIC AKRGRCO_VAR1 "Map for exhaust flap control depending on current gear and engine speed, with open convertible top" MAP 0x8078DFC2 Map_Xs16Ys16Ws16 400 rel_q0p39 -200 200 FORMAT "%8.4"
 /begin AXIS_DESCR STD_AXIS gangakr DEZ 6 0 127 FORMAT "%8.4" DEPOSIT ABSOLUTE /end AXIS_DESCR
 /begin AXIS_DESCR STD_AXIS Epm_nEngLRes nmot_q40 8 0 10200 FORMAT "%8.2" DEPOSIT ABSOLUTE /end AXIS_DESCR
/end CHARACTERISTIC
/begin CHARACTERISTIC AKRGRCOAT "Map for exhaust flap control depending on current gear and engine speed (DCT or AT gearbox), with open convertible top" MAP 0x8078DA9A Map_Xs16Ys16Ws16 400 rel_q0p39 -200 200 FORMAT "%8.4"
 /begin AXIS_DESCR STD_AXIS gangakr DEZ 10 0 127 FORMAT "%8.4" DEPOSIT ABSOLUTE /end AXIS_DESCR
 /begin AXIS_DESCR STD_AXIS Epm_nEngLRes nmot_q40 12 0 10200 FORMAT "%8.2" DEPOSIT ABSOLUTE /end AXIS_DESCR
/end CHARACTERISTIC
/begin CHARACTERISTIC AKRGRCOAT_VAR1 "Map for exhaust flap control depending on current gear and engine speed (DCT or AT gearbox), with open convertible top" MAP 0x8078DD7E Map_Xs16Ys16Ws16 400 rel_q0p39 -200 200 FORMAT "%8.4"
 /begin AXIS_DESCR STD_AXIS gangakr DEZ 8 0 127 FORMAT "%8.4" DEPOSIT ABSOLUTE /end AXIS_DESCR
 /begin AXIS_DESCR STD_AXIS Epm_nEngLRes nmot_q40 8 0 10200 FORMAT "%8.2" DEPOSIT ABSOLUTE /end AXIS_DESCR
/end CHARACTERISTIC
/begin CHARACTERISTIC AKRGRCOATM "Map for exhaust flap control depending on current gear and engine speed (DCT or AT gearbox), with open convertible top and sport button active" MAP 0x8078DBBA Map_Xs16Ys16Ws16 400 rel_q0p39 -200 200 FORMAT "%8.4"
 /begin AXIS_DESCR STD_AXIS gangakr DEZ 10 0 127 FORMAT "%8.4" DEPOSIT ABSOLUTE /end AXIS_DESCR
 /begin AXIS_DESCR STD_AXIS Epm_nEngLRes nmot_q40 12 0 10200 FORMAT "%8.2" DEPOSIT ABSOLUTE /end AXIS_DESCR
/end CHARACTERISTIC
/begin CHARACTERISTIC AKRGRCOATM_VAR1 "Map for exhaust flap control depending on current gear and engine speed (DCT or AT gearbox), with open convertible top and sport button active" MAP 0x8078DCDA Map_Xs16Ys16Ws16 400 rel_q0p39 -200 200 FORMAT "%8.4"
 /begin AXIS_DESCR STD_AXIS gangakr DEZ 8 0 127 FORMAT "%8.4" DEPOSIT ABSOLUTE /end AXIS_DESCR
 /begin AXIS_DESCR STD_AXIS Epm_nEngLRes nmot_q40 8 0 10200 FORMAT "%8.2" DEPOSIT ABSOLUTE /end AXIS_DESCR
/end CHARACTERISTIC
/begin CHARACTERISTIC AKRGRCOM "Map for exhaust flap control depending on current gear and engine speed, with open convertible top and sport button active" MAP 0x8078DE22 Map_Xs16Ys16Ws16 400 rel_q0p39 -200 200 FORMAT "%8.4"
 /begin AXIS_DESCR STD_AXIS gangakr DEZ 10 0 127 FORMAT "%8.4" DEPOSIT ABSOLUTE /end AXIS_DESCR
 /begin AXIS_DESCR STD_AXIS Epm_nEngLRes nmot_q40 12 0 10200 FORMAT "%8.2" DEPOSIT ABSOLUTE /end AXIS_DESCR
/end CHARACTERISTIC
/begin CHARACTERISTIC AKRGRCOM_VAR1 "Map for exhaust flap control depending on current gear and engine speed, with open convertible top and sport button active" MAP 0x8078DF42 Map_Xs16Ys16Ws16 400 rel_q0p39 -200 200 FORMAT "%8.4"
 /begin AXIS_DESCR STD_AXIS gangakr DEZ 6 0 127 FORMAT "%8.4" DEPOSIT ABSOLUTE /end AXIS_DESCR
 /begin AXIS_DESCR STD_AXIS Epm_nEngLRes nmot_q40 8 0 10200 FORMAT "%8.2" DEPOSIT ABSOLUTE /end AXIS_DESCR
/end CHARACTERISTIC
/begin CHARACTERISTIC BMWchas_p_RailInjMpl_M "Rail pressure setpoint for multiple injection" MAP 0x8073BE02 _REC_A1CUR_1_MBSE_U2_S1 39.9993896484375 cxdjuna_xpuCged_ocEpdua_MCRa2a0 0 39.9993896484375
 /begin AXIS_DESCR COM_AXIS Nkw caoddzd_oAjpfzb_cAcEEha_1nR_oa0 6 -32768 32767 AXIS_PTS_REF BMWchas_p_RailInjMpl_Ax FORMAT "%5.0" MONOTONY STRICT_INCREASE DEPOSIT ABSOLUTE /end AXIS_DESCR
 /begin AXIS_DESCR COM_AXIS BMWrailco_rat_VabHom_sw zyyxBpb_rEsnvtc_gktukCa_fR_5a0o 6 -1600 1599.951171875 AXIS_PTS_REF BMWchas_p_RailInjMpl_Ay FORMAT "%8.3" MONOTONY STRICT_INCREASE DEPOSIT ABSOLUTE /end AXIS_DESCR
/end CHARACTERISTIC
/begin CHARACTERISTIC BMWchas_p_RailInjSng_M "Rail pressure setpoint for single injection" MAP 0x8073BD82 _REC_A1CUR_1_MBSE_U2_S1 39.9993896484375 cxdjuna_xpuCged_ocEpdua_MCRa2a0 0 39.9993896484375
 /begin AXIS_DESCR COM_AXIS Nkw caoddzd_oAjpfzb_cAcEEha_1nR_oa0 8 -32768 32767 AXIS_PTS_REF BMWchas_p_RailInjSng_Ax FORMAT "%5.0" MONOTONY STRICT_INCREASE DEPOSIT ABSOLUTE /end AXIS_DESCR
 /begin AXIS_DESCR COM_AXIS BMWrailco_rat_VabHom_sw zyyxBpb_rEsnvtc_gktukCa_fR_5a0o 8 -1600 1599.951171875 AXIS_PTS_REF BMWchas_p_RailInjSng_Ay FORMAT "%8.3" MONOTONY STRICT_INCREASE DEPOSIT ABSOLUTE /end AXIS_DESCR
/end CHARACTERISTIC
/begin CHARACTERISTIC BMWgpfheat_p_RailInjMpl_M "GPF heating, rail pressure setpoint for multiple injection" MAP 0x8071D1C2 _REC_A1CUR_1_MBSE_U2_S1 39.9993896484375 cxdjuna_xpuCged_ocEpdua_MCRa2a0 0 39.9993896484375
 /begin AXIS_DESCR COM_AXIS Nkw caoddzd_oAjpfzb_cAcEEha_1nR_oa0 6 -32768 32767 AXIS_PTS_REF BMWgpfheat_p_RailInjMpl_Ax FORMAT "%5.0" MONOTONY STRICT_INCREASE DEPOSIT ABSOLUTE /end AXIS_DESCR
 /begin AXIS_DESCR COM_AXIS BMWrailco_rat_VabHom_sw zyyxBpb_rEsnvtc_gktukCa_fR_5a0o 6 -1600 1599.951171875 AXIS_PTS_REF BMWgpfheat_p_RailInjMpl_Ay FORMAT "%8.3" MONOTONY STRICT_INCREASE DEPOSIT ABSOLUTE /end AXIS_DESCR
/end CHARACTERISTIC
/begin CHARACTERISTIC BMWgpfheat_p_RailInjSng_M "GPF heating, rail pressure setpoint for single injection" MAP 0x8071D17A _REC_A1CUR_1_MBSE_U2_S1 39.9993896484375 cxdjuna_xpuCged_ocEpdua_MCRa2a0 0 39.9993896484375
 /begin AXIS_DESCR COM_AXIS Nkw caoddzd_oAjpfzb_cAcEEha_1nR_oa0 6 -32768 32767 AXIS_PTS_REF BMWgpfheat_p_RailInjSng_Ax FORMAT "%5.0" MONOTONY STRICT_INCREASE DEPOSIT ABSOLUTE /end AXIS_DESCR
 /begin AXIS_DESCR COM_AXIS BMWrailco_rat_VabHom_sw zyyxBpb_rEsnvtc_gktukCa_fR_5a0o 6 -1600 1599.951171875 AXIS_PTS_REF BMWgpfheat_p_RailInjSng_Ay FORMAT "%8.3" MONOTONY STRICT_INCREASE DEPOSIT ABSOLUTE /end AXIS_DESCR
/end CHARACTERISTIC
/begin CHARACTERISTIC BMWinjmon_fac_HppEff_M "Injection map factor for high-pressure pump efficiency" MAP 0x80716BD6 _REC_A1CUR_1_MBSE_U2_S1 1.99996948242188 Bhvfwhc_bigEubd_BBEupBd_nR_3oa0 0 1.99996948242188 FORMAT "%6.2"
 /begin AXIS_DESCR COM_AXIS Nkw_10ms caoddzd_oAjpfzb_cAcEEha_1nR_oa0 8 -32768 32767 AXIS_PTS_REF BMWinjmon_fac_HppEff_Ax FORMAT "%5.0" MONOTONY STRICT_INCREASE DEPOSIT ABSOLUTE /end AXIS_DESCR
 /begin AXIS_DESCR COM_AXIS BMWrail_p_RpsActVal bukAcFc_hypjrAa_CBhougc_MCRooa0 4 0 131.07 AXIS_PTS_REF BMWinjmon_fac_HppEff_Ay MONOTONY STRICT_INCREASE DEPOSIT ABSOLUTE /end AXIS_DESCR
/end CHARACTERISTIC
/begin CHARACTERISTIC BMWlpa_n_EfpEngStrtAmb_M "Electric fuel pump speed setpoint for start ambient" MAP 0x8071C5D4 _REC_A1CUR_1_MBSE_U2_S1 65535 caoddzd_oAjpfzb_cAcEEha_1nR_oa0 0 65535 FORMAT "%5.0"
 /begin AXIS_DESCR COM_AXIS Tumg BMW_q0p1_degC 4 -3276.8 3276.7 AXIS_PTS_REF BMWlpa_n_EfpEngStrtAmb_Ax FORMAT "%6.1" MONOTONY STRICT_INCREASE DEPOSIT ABSOLUTE /end AXIS_DESCR
 /begin AXIS_DESCR COM_AXIS Pumg BMW_p_sw_q0p125_hPa 4 0 8191.875 AXIS_PTS_REF BMWlpa_n_EfpEngStrtAmb_Ay FORMAT "%8.3" MONOTONY STRICT_INCREASE DEPOSIT ABSOLUTE /end AXIS_DESCR
/end CHARACTERISTIC
/begin CHARACTERISTIC BMWlpa_n_EfpModSafe_M "Electric fuel pump speed setpoint safe mode" MAP 0x8071C51C _REC_A1CUR_1_MBSE_U2_S1 65535 caoddzd_oAjpfzb_cAcEEha_1nR_oa0 0 65535 FORMAT "%5.0"
 /begin AXIS_DESCR COM_AXIS BMWlpi_t_Fu_sw DchEpAd_DBCFgoa_Ckhahgc_q__aoa0 4 -327.68 327.67 AXIS_PTS_REF BMWlpa_n_EfpModSafe_Ax FORMAT "%5.2" MONOTONY STRICT_INCREASE DEPOSIT ABSOLUTE /end AXIS_DESCR
 /begin AXIS_DESCR COM_AXIS BMWlpi_volf_Fu_sw zBcBzad_vmoivka_mFzjCgc_lCRooa0 4 -327.68 327.67 AXIS_PTS_REF BMWlpa_n_EfpModSafe_Ay FORMAT "%5.2" MONOTONY STRICT_INCREASE DEPOSIT ABSOLUTE /end AXIS_DESCR
/end CHARACTERISTIC
/begin CHARACTERISTIC BMWlpsc_volf_FuEjrPmp_M "Map volume flow" MAP 0x8071CA16 _REC_A1CUR_1_MBSE_S2_S1 655.35 zBcBzad_vmoivka_mFzjCgc_lCRooa0 -327.68 327.67 FORMAT "%5.2"
 /begin AXIS_DESCR COM_AXIS BMWlpsc_p_EfpSpCtld_uw rgduxyd_mlihaBb_gsCghzb_bCRa0a0 8 0 65.535 AXIS_PTS_REF BMWlpsc_volf_FuEjrPmp_Ax FORMAT "%5.3" MONOTONY STRICT_INCREASE DEPOSIT ABSOLUTE /end AXIS_DESCR
 /begin AXIS_DESCR COM_AXIS BMWlpsc_st_TankCod_ub raChrxc_kBtBrmb_FmDuEFa_n__aa0o 4 0 255 AXIS_PTS_REF BMWlpsc_volf_FuEjrPmp_Ay FORMAT "%3.0" MONOTONY STRICT_INCREASE DEPOSIT ABSOLUTE /end AXIS_DESCR
/end CHARACTERISTIC
/begin CHARACTERISTIC BMWtchctr_t_ExGasMdl_M "Exhaust gas temperature during dynamic load changes for physical turbocharger feedforward control" MAP 0x807477BC _REC_A1CUR_1_MBSE_S2_S1 6553.5 BMW_q0p1_degC -3276.8 3276.7 FORMAT "%7.1"
 /begin AXIS_DESCR COM_AXIS Nkw caoddzd_oAjpfzb_cAcEEha_1nR_oa0 6 -32768 32767 AXIS_PTS_REF BMWtchctr_t_ExGasMdl_Ax FORMAT "%5.0" MONOTONY STRICT_INCREASE DEPOSIT ABSOLUTE /end AXIS_DESCR
 /begin AXIS_DESCR COM_AXIS Rf CgkBooc_wkiDfEd_Czglhgc_fR_1a0o 6 -327.68 327.67 AXIS_PTS_REF BMWtchctr_t_ExGasMdl_Ay FORMAT "%7.2" MONOTONY STRICT_INCREASE DEPOSIT ABSOLUTE /end AXIS_DESCR
/end CHARACTERISTIC
/begin CHARACTERISTIC BMWtchctr_t_ExGasMdlScav_M "Exhaust gas temperature during dynamic load changes for physical turbocharger feedforward control" MAP 0x80747804 _REC_A1CUR_1_MBSE_S2_S1 6553.5 BMW_q0p1_degC -3276.8 3276.7 FORMAT "%7.1"
 /begin AXIS_DESCR COM_AXIS Nkw caoddzd_oAjpfzb_cAcEEha_1nR_oa0 6 -32768 32767 AXIS_PTS_REF BMWtchctr_t_ExGasMdlScav_Ax FORMAT "%5.0" MONOTONY STRICT_INCREASE DEPOSIT ABSOLUTE /end AXIS_DESCR
 /begin AXIS_DESCR COM_AXIS Rf CgkBooc_wkiDfEd_Czglhgc_fR_1a0o 6 -327.68 327.67 AXIS_PTS_REF BMWtchctr_t_ExGasMdlScav_Ay FORMAT "%7.2" MONOTONY STRICT_INCREASE DEPOSIT ABSOLUTE /end AXIS_DESCR
/end CHARACTERISTIC
/begin CHARACTERISTIC BMWtchsp_rat_p_CmprMax_M "Max allowed compressor pressure ratio (model-based)" MAP 0x80727DC4 _REC_A1CUR_1_MBSE_U2_S1 3.99993896484375 ilxsavd_hkzmBfc_lAzCpAb_nR_1oa0 0 3.99993896484375
 /begin AXIS_DESCR COM_AXIS BMWtchsp_mf_CmprNorm_uw CByjozc_eCmpBAb_pljBAmd_k__0oa0 8 0 2047.96875 AXIS_PTS_REF BMWtchsp_rat_p_CmprMax_Ax FORMAT "%10.3" MONOTONY STRICT_INCREASE DEPOSIT ABSOLUTE /end AXIS_DESCR
 /begin AXIS_DESCR COM_AXIS BMWtchtbc_t_BefCmpr_sw BMW_q0p1_degC 6 -3276.8 3276.7 AXIS_PTS_REF BMWtchsp_rat_p_CmprMax_Ay FORMAT "%6.1" MONOTONY STRICT_INCREASE DEPOSIT ABSOLUTE /end AXIS_DESCR
/end CHARACTERISTIC
/begin CHARACTERISTIC BMWtchsp_rat_p_CmprMaxRace_M "Max compressor pressure ratio (race mode)" MAP 0x80727E24 _REC_A1CUR_1_MBSE_U2_S1 3.99993896484375 ilxsavd_hkzmBfc_lAzCpAb_nR_1oa0 0 3.99993896484375
 /begin AXIS_DESCR COM_AXIS BMWtchsp_mf_CmprNorm_uw CByjozc_eCmpBAb_pljBAmd_k__0oa0 8 0 2047.96875 AXIS_PTS_REF BMWtchsp_rat_p_CmprMaxRace_Ax FORMAT "%10.3" MONOTONY STRICT_INCREASE DEPOSIT ABSOLUTE /end AXIS_DESCR
 /begin AXIS_DESCR COM_AXIS BMWtchtbc_t_BefCmpr_sw BMW_q0p1_degC 6 -3276.8 3276.7 AXIS_PTS_REF BMWtchsp_rat_p_CmprMaxRace_Ay FORMAT "%6.1" MONOTONY STRICT_INCREASE DEPOSIT ABSOLUTE /end AXIS_DESCR
/end CHARACTERISTIC
/begin CHARACTERISTIC BMWtqe_st_SptDet4NoiseAcvn_M "Torque Engine(Moment Verbrennungsmotor) status, state(Status, Zustand, Bitleiste) sport(Sport) detection(Erkennung) four(vier, 4) noise(Geräusche) activation(Aktivierung) map(Kennfeld)" MAP 0x807585D1 _REC_A1CUR_1_MBSE_U1_S1 255 raChrxc_kBtBrmb_FmDuEFa_n__aa0o 0 255 FORMAT "%3.0"
 /begin AXIS_DESCR COM_AXIS Status_usecase_antr raChrxc_kBtBrmb_FmDuEFa_n__aa0o 12 0 11 AXIS_PTS_REF BMWtqe_st_SptDet4NoiseAcvn_Ax FORMAT "%6.0" MONOTONY STRICT_INCREASE DEPOSIT ABSOLUTE /end AXIS_DESCR
 /begin AXIS_DESCR COM_AXIS St_dsc_can raChrxc_kBtBrmb_FmDuEFa_n__aa0o 4 0 11 AXIS_PTS_REF BMWtqe_st_SptDet4NoiseAcvn_Ay FORMAT "%3.0" MONOTONY STRICT_INCREASE DEPOSIT ABSOLUTE /end AXIS_DESCR
/end CHARACTERISTIC
/begin CHARACTERISTIC KF_BSLGF "Lambda rich running limit for component protection filling intervention" MAP 0x8071A23C _REC_A1CUR_1_MBSE_U2_S1 15.999755859375 BumqDkc_mryszAa_EcglxAc_nR_4oa0 0 15.999755859375
 /begin AXIS_DESCR COM_AXIS Nkw_atm caoddzd_oAjpfzb_cAcEEha_1nR_oa0 4 -32768 32767 AXIS_PTS_REF AXX_KF_BSLGF MONOTONY STRICT_INCREASE DEPOSIT ABSOLUTE /end AXIS_DESCR
 /begin AXIS_DESCR COM_AXIS Rf_atm CgkBooc_wkiDfEd_Czglhgc_fR_1a0o 4 -327.68 327.67 AXIS_PTS_REF AXY_KF_BSLGF MONOTONY STRICT_INCREASE DEPOSIT ABSOLUTE /end AXIS_DESCR
/end CHARACTERISTIC
/begin CHARACTERISTIC KF_DLAMBSVST_TABG "Delta lambda for feedforward control of component protection exhaust temperature branch" MAP 0x8071A560 _REC_A1CUR_1_MBSE_S2_S1 8 BumqDkc_mryszAa_EcglxAc_nR_4oa0 -8 0 FORMAT "%7.4"
 /begin AXIS_DESCR COM_AXIS Nkw_atm caoddzd_oAjpfzb_cAcEEha_1nR_oa0 8 -32768 32767 AXIS_PTS_REF AXX_KF_DLAMBSVST_TABG MONOTONY STRICT_INCREASE DEPOSIT ABSOLUTE /end AXIS_DESCR
 /begin AXIS_DESCR COM_AXIS Rf_atm CgkBooc_wkiDfEd_Czglhgc_fR_1a0o 8 -327.68 327.67 AXIS_PTS_REF AXY_KF_DLAMBSVST_TABG MONOTONY STRICT_INCREASE DEPOSIT ABSOLUTE /end AXIS_DESCR
/end CHARACTERISTIC
/begin CHARACTERISTIC KF_DPLDS_PRED "Offset target boost pressure as f(engine speed, dynamic Rf_soll damping)" MAP 0x8074699C _REC_A1CUR_1_MBSE_U2_S1 8191.875 rAdkuaa_wDllxja_BnDuEFa_n__aa0o 0 8191.875
 /begin AXIS_DESCR COM_AXIS Nkw caoddzd_oAjpfzb_cAcEEha_1nR_oa0 6 0 32767 AXIS_PTS_REF AXX_KF_DPLDS_PRED FORMAT "%5.0" MONOTONY MON_INCREASE DEPOSIT ABSOLUTE /end AXIS_DESCR
 /begin AXIS_DESCR COM_AXIS Drf_s2spred CgkBooc_wkiDfEd_Czglhgc_fR_1a0o 6 0 655.35 AXIS_PTS_REF AXY_KF_DPLDS_PRED MONOTONY MON_INCREASE DEPOSIT ABSOLUTE /end AXIS_DESCR
/end CHARACTERISTIC
/begin CHARACTERISTIC KF_DPLDSOLL_SPORT "Map boost pressure offset on target boost pressure (in sport mode)" MAP 0x8072382E _REC_A1CUR_1_MBSE_U2_S1 8191.875 BMW_p_sw_q0p125_hPa 0 8191.875 FORMAT "%8.3"
 /begin AXIS_DESCR COM_AXIS NO_INPUT_QUANTITY caoddzd_oAjpfzb_cAcEEha_1nR_oa0 6 0 32767 AXIS_PTS_REF AXX_KF_DPLDSOLL_SPORT FORMAT "%5.0" MONOTONY MON_INCREASE DEPOSIT ABSOLUTE /end AXIS_DESCR
 /begin AXIS_DESCR COM_AXIS NO_INPUT_QUANTITY acriqBc_tfkBqod_ocgjxzc_nR_8oa0 6 0 7.9998779296875 AXIS_PTS_REF AXY_KF_DPLDSOLL_SPORT FORMAT "%7.5" MONOTONY MON_INCREASE DEPOSIT ABSOLUTE /end AXIS_DESCR
/end CHARACTERISTIC
/begin CHARACTERISTIC KF_DZWMIN_NORMAL_SOT "Ignition angle intervention for sound tuning" MAP 0x8075D545 _REC_A1CUR_1_MBSE_S1_S1 127.5 aAwkuzc_BFpgCmb_tmDukma_q__aa0o -64 63.5
 /begin AXIS_DESCR COM_AXIS Nkw caoddzd_oAjpfzb_cAcEEha_1nR_oa0 6 -32768 32767 AXIS_PTS_REF AXX_KF_DZWMIN_NORMAL_SOT FORMAT "%5.0" MONOTONY STRICT_INCREASE DEPOSIT ABSOLUTE /end AXIS_DESCR
 /begin AXIS_DESCR COM_AXIS V AFeDmkb_cAbjmcc_kAkskhd_k__0oa0 4 0 65535 AXIS_PTS_REF AXY_KF_DZWMIN_NORMAL_SOT FORMAT "%5.0" MONOTONY STRICT_INCREASE DEPOSIT ABSOLUTE /end AXIS_DESCR
/end CHARACTERISTIC
/begin CHARACTERISTIC KF_DZWMIN_SPORT_SOT "Ignition angle intervention for sound tuning at B_sport" MAP 0x8075D4ED _REC_A1CUR_1_MBSE_S1_S1 127.5 aAwkuzc_BFpgCmb_tmDukma_q__aa0o -64 63.5
 /begin AXIS_DESCR COM_AXIS Nkw caoddzd_oAjpfzb_cAcEEha_1nR_oa0 6 -32768 32767 AXIS_PTS_REF AXX_KF_DZWMIN_SPORT_SOT FORMAT "%5.0" MONOTONY STRICT_INCREASE DEPOSIT ABSOLUTE /end AXIS_DESCR
 /begin AXIS_DESCR COM_AXIS V AFeDmkb_cAbjmcc_kAkskhd_k__0oa0 4 0 65535 AXIS_PTS_REF AXY_KF_DZWMIN_SPORT_SOT FORMAT "%5.0" MONOTONY STRICT_INCREASE DEPOSIT ABSOLUTE /end AXIS_DESCR
/end CHARACTERISTIC
/begin CHARACTERISTIC KF_FRKKORRF_1 "Map feedforward correction bank 1" MAP 0x80714DB0 _REC_A1CUR_1_MBSE_U2_S1 1.99996948242188 Bhvfwhc_bigEubd_BBEupBd_nR_3oa0 0 1.99996948242188 FORMAT "%14.5"
 /begin AXIS_DESCR COM_AXIS Nkw caoddzd_oAjpfzb_cAcEEha_1nR_oa0 16 -32768 32767 AXIS_PTS_REF AXX_KF_FRKKORRF_1 FORMAT "%5.0" MONOTONY STRICT_INCREASE DEPOSIT ABSOLUTE /end AXIS_DESCR
 /begin AXIS_DESCR COM_AXIS Rf CgkBooc_wkiDfEd_Czglhgc_fR_1a0o 16 -327.68 327.67 AXIS_PTS_REF AXY_KF_FRKKORRF_1 FORMAT "%7.2" MONOTONY STRICT_INCREASE DEPOSIT ABSOLUTE /end AXIS_DESCR
/end CHARACTERISTIC
/begin CHARACTERISTIC KF_KLIMA_KKS "Map for converting air flap position depending on climate fan request and vehicle speed" MAP 0x80760CAE _REC_A1CUR_1_MBSE_U1_S1 10 raChrxc_kBtBrmb_FmDuEFa_n__aa0o 0 10
 /begin AXIS_DESCR COM_AXIS Nelueft_klima_wm BMW_q0p3906_PERC 6 0 99.609375 AXIS_PTS_REF AXX_KF_KLIMA_KKS MONOTONY STRICT_INCREASE DEPOSIT ABSOLUTE /end AXIS_DESCR
 /begin AXIS_DESCR COM_AXIS V_wm BMW_q0p1_kilometer_per_hour 6 0 6553.5 AXIS_PTS_REF AXY_KF_KLIMA_KKS MONOTONY STRICT_INCREASE DEPOSIT ABSOLUTE /end AXIS_DESCR
/end CHARACTERISTIC
/begin CHARACTERISTIC KF_KOEFF_B_LA "Coefficient B for lambda correction of ignition angle knock limit" MAP 0x80737392 _REC_A1CUR_1_MBSE_U2_S1 15.999755859375 BumqDkc_mryszAa_EcglxAc_nR_4oa0 0 15.999755859375 FORMAT "%9.4"
 /begin AXIS_DESCR COM_AXIS Nkw caoddzd_oAjpfzb_cAcEEha_1nR_oa0 6 -32768 32767 AXIS_PTS_REF AXX_KF_KOEFF_B_LA FORMAT "%5.0" MONOTONY STRICT_INCREASE DEPOSIT ABSOLUTE /end AXIS_DESCR
 /begin AXIS_DESCR COM_AXIS NO_INPUT_QUANTITY CgkBooc_wkiDfEd_Czglhgc_fR_1a0o 6 -327.68 327.67 AXIS_PTS_REF AXY_KF_KOEFF_B_LA FORMAT "%9.2" MONOTONY STRICT_INCREASE DEPOSIT ABSOLUTE /end AXIS_DESCR
/end CHARACTERISTIC
/begin CHARACTERISTIC KF_LA_BEZ "Reference lambda for lambda correction of ignition angle knock limit" MAP 0x80737332 _REC_A1CUR_1_MBSE_U2_S1 15.999755859375 BumqDkc_mryszAa_EcglxAc_nR_4oa0 0 15.999755859375 FORMAT "%9.4"
 /begin AXIS_DESCR COM_AXIS Nkw caoddzd_oAjpfzb_cAcEEha_1nR_oa0 6 -32768 32767 AXIS_PTS_REF AXX_KF_LA_BEZ FORMAT "%5.0" MONOTONY STRICT_INCREASE DEPOSIT ABSOLUTE /end AXIS_DESCR
 /begin AXIS_DESCR COM_AXIS NO_INPUT_QUANTITY CgkBooc_wkiDfEd_Czglhgc_fR_1a0o 8 -327.68 327.67 AXIS_PTS_REF AXY_KF_LA_BEZ FORMAT "%9.2" MONOTONY MON_INCREASE DEPOSIT ABSOLUTE /end AXIS_DESCR
/end CHARACTERISTIC
/begin CHARACTERISTIC KF_LA_EZA "Lambda setpoint for single cylinder deactivation" MAP 0x8071ED48 _REC_A1CUR_1_MBSE_U2_S1 15.999755859375 BumqDkc_mryszAa_EcglxAc_nR_4oa0 0 15.999755859375 FORMAT "%9.4"
 /begin AXIS_DESCR COM_AXIS Nkw caoddzd_oAjpfzb_cAcEEha_1nR_oa0 6 -32768 32767 AXIS_PTS_REF AXX_KF_LA_EZA FORMAT "%5.0" MONOTONY STRICT_INCREASE DEPOSIT ABSOLUTE /end AXIS_DESCR
 /begin AXIS_DESCR COM_AXIS Rf CgkBooc_wkiDfEd_Czglhgc_fR_1a0o 6 -327.68 327.67 AXIS_PTS_REF AXY_KF_LA_EZA FORMAT "%7.2" MONOTONY STRICT_INCREASE DEPOSIT ABSOLUTE /end AXIS_DESCR
/end CHARACTERISTIC
/begin CHARACTERISTIC KF_LA_SK "Base lambda in homogeneous mode during super-knock" MAP 0x8074DDE2 _REC_A1CUR_1_MBSE_U2_S1 15.999755859375 BumqDkc_mryszAa_EcglxAc_nR_4oa0 0 15.999755859375 FORMAT "%9.4"
 /begin AXIS_DESCR COM_AXIS Nkw caoddzd_oAjpfzb_cAcEEha_1nR_oa0 18 -32768 32767 AXIS_PTS_REF GXX_KF_LABAS FORMAT "%5.0" MONOTONY STRICT_INCREASE DEPOSIT ABSOLUTE /end AXIS_DESCR
 /begin AXIS_DESCR COM_AXIS Rf CgkBooc_wkiDfEd_Czglhgc_fR_1a0o 17 -327.68 327.67 AXIS_PTS_REF GXY_KF_LABAS FORMAT "%7.2" MONOTONY STRICT_INCREASE DEPOSIT ABSOLUTE /end AXIS_DESCR
/end CHARACTERISTIC
/begin CHARACTERISTIC KF_LABAS_1 "Base lambda in homogeneous mode bank 1" MAP 0x8074E2AA _REC_A1CUR_1_MBSE_U2_S1 15.999755859375 BumqDkc_mryszAa_EcglxAc_nR_4oa0 0 15.999755859375 FORMAT "%9.4"
 /begin AXIS_DESCR COM_AXIS Nkw caoddzd_oAjpfzb_cAcEEha_1nR_oa0 18 -32768 32767 AXIS_PTS_REF GXX_KF_LABAS FORMAT "%5.0" MONOTONY STRICT_INCREASE DEPOSIT ABSOLUTE /end AXIS_DESCR
 /begin AXIS_DESCR COM_AXIS Rf CgkBooc_wkiDfEd_Czglhgc_fR_1a0o 17 -327.68 327.67 AXIS_PTS_REF GXY_KF_LABAS FORMAT "%7.2" MONOTONY STRICT_INCREASE DEPOSIT ABSOLUTE /end AXIS_DESCR
/end CHARACTERISTIC
/begin CHARACTERISTIC KF_LABAS_2 "Base lambda in homogeneous mode bank 2" MAP 0x8074E046 _REC_A1CUR_1_MBSE_U2_S1 15.999755859375 BumqDkc_mryszAa_EcglxAc_nR_4oa0 0 15.999755859375 FORMAT "%9.4"
 /begin AXIS_DESCR COM_AXIS Nkw caoddzd_oAjpfzb_cAcEEha_1nR_oa0 18 -32768 32767 AXIS_PTS_REF GXX_KF_LABAS FORMAT "%5.0" MONOTONY STRICT_INCREASE DEPOSIT ABSOLUTE /end AXIS_DESCR
 /begin AXIS_DESCR COM_AXIS Rf CgkBooc_wkiDfEd_Czglhgc_fR_1a0o 17 -327.68 327.67 AXIS_PTS_REF GXY_KF_LABAS FORMAT "%7.2" MONOTONY STRICT_INCREASE DEPOSIT ABSOLUTE /end AXIS_DESCR
/end CHARACTERISTIC
/begin CHARACTERISTIC KF_LAMIN_H "Lambda combustion limit rich" MAP 0x8071EFC2 _REC_A1CUR_1_MBSE_U2_S1 15.999755859375 BumqDkc_mryszAa_EcglxAc_nR_4oa0 0 15.999755859375 FORMAT "%9.4"
 /begin AXIS_DESCR COM_AXIS Nkw caoddzd_oAjpfzb_cAcEEha_1nR_oa0 6 -32768 32767 AXIS_PTS_REF AXX_KF_LAMIN_H FORMAT "%5.0" MONOTONY STRICT_INCREASE DEPOSIT ABSOLUTE /end AXIS_DESCR
 /begin AXIS_DESCR COM_AXIS Rf CgkBooc_wkiDfEd_Czglhgc_fR_1a0o 6 -327.68 327.67 AXIS_PTS_REF AXY_KF_LAMIN_H FORMAT "%7.2" MONOTONY STRICT_INCREASE DEPOSIT ABSOLUTE /end AXIS_DESCR
/end CHARACTERISTIC
/begin CHARACTERISTIC KF_MD_RES_NST_KEY "Torque reserve during post-start" MAP 0x80731514 _REC_A1CUR_1_MBSE_S2_S1 6553.5 BMW_dm_sw_q0p1_Nm -3276.8 3276.7 FORMAT "%6.1"
 /begin AXIS_DESCR COM_AXIS Tn_start_10 camcxxd_bxlpdsa_Cshlhgc_sR_1a0o 4 0 655.35 AXIS_PTS_REF AXX_KF_MD_RES_NST_KEY FORMAT "%7.2" MONOTONY STRICT_INCREASE DEPOSIT ABSOLUTE /end AXIS_DESCR
 /begin AXIS_DESCR COM_AXIS Tmot DchEpAd_DBCFgoa_Ckhahgc_q__aoa0 4 -327.68 327.67 AXIS_PTS_REF AXY_KF_MD_RES_NST_KEY FORMAT "%7.2" MONOTONY STRICT_INCREASE DEPOSIT ABSOLUTE /end AXIS_DESCR
/end CHARACTERISTIC
/begin CHARACTERISTIC KF_N_GASSTOSS_ANFAHR_KUPP "Max. zulaessige Anfahrdrehzahl (normal Mode) bei getretener Kupplung" MAP 0x80728A4C _REC_A1CUR_1_MBSE_S2_S1 65535 caoddzd_oAjpfzb_cAcEEha_1nR_oa0 -32768 32767 FORMAT "%5.0"
 /begin AXIS_DESCR COM_AXIS NO_INPUT_QUANTITY jgbhAma_smpAegb_hlEBAmd_k__0oa0 6 -655.36 655.34 AXIS_PTS_REF AXX_KF_N_GASSTOSS_UND_ANFAHR FORMAT "%7.2" MONOTONY STRICT_INCREASE DEPOSIT ABSOLUTE /end AXIS_DESCR
 /begin AXIS_DESCR COM_AXIS NO_INPUT_QUANTITY vfyBdwd_ftexgja_BcFdiDd_fR_1a0o 4 -800 799.9755859375 AXIS_PTS_REF AXY_KF_N_GASSTOSS_UND_ANFAHR FORMAT "%7.2" MONOTONY STRICT_INCREASE DEPOSIT ABSOLUTE /end AXIS_DESCR
/end CHARACTERISTIC
/begin CHARACTERISTIC KF_N_GASSTOSS_UND_ANFAHR "Max. permissible launch RPM (normal mode)" MAP 0x80728A1C _REC_A1CUR_1_MBSE_S2_S1 65535 caoddzd_oAjpfzb_cAcEEha_1nR_oa0 -32768 32767 FORMAT "%5.0"
 /begin AXIS_DESCR COM_AXIS NO_INPUT_QUANTITY jgbhAma_smpAegb_hlEBAmd_k__0oa0 6 -655.36 655.34 AXIS_PTS_REF AXX_KF_N_GASSTOSS_UND_ANFAHR FORMAT "%7.2" MONOTONY STRICT_INCREASE DEPOSIT ABSOLUTE /end AXIS_DESCR
 /begin AXIS_DESCR COM_AXIS NO_INPUT_QUANTITY vfyBdwd_ftexgja_BcFdiDd_fR_1a0o 4 -800 799.9755859375 AXIS_PTS_REF AXY_KF_N_GASSTOSS_UND_ANFAHR FORMAT "%7.2" MONOTONY STRICT_INCREASE DEPOSIT ABSOLUTE /end AXIS_DESCR
/end CHARACTERISTIC
/begin CHARACTERISTIC KF_NEL_OPF_V "E-Luefterdrehzahlanforderung durch OPF-Temperatur über Fahrgeschwindigkeit" MAP 0x80760FAC _REC_A1CUR_1_MBSE_U1_S1 99.609375 BMW_q0p3906_PERC 0 99.609375
 /begin AXIS_DESCR COM_AXIS T_opf_in_wm BMW_q0p1_degC 10 -3276.8 3276.7 AXIS_PTS_REF AXX_KF_NEL_OPF_V MONOTONY STRICT_INCREASE DEPOSIT ABSOLUTE /end AXIS_DESCR
 /begin AXIS_DESCR COM_AXIS V_wm BMW_q0p1_kilometer_per_hour 10 0 6553.5 AXIS_PTS_REF AXY_KF_NEL_OPF_V MONOTONY STRICT_INCREASE DEPOSIT ABSOLUTE /end AXIS_DESCR
/end CHARACTERISTIC
/begin CHARACTERISTIC KF_NEL_TABG "Electric fan speed request due to exhaust gas temperature" MAP 0x80760F9C _REC_A1CUR_1_MBSE_U1_S1 99.609375 BMW_q0p3906_PERC 0 99.609375
 /begin AXIS_DESCR COM_AXIS Tabg_wm BMW_q0p1_degC 4 -3276.8 3276.7 AXIS_PTS_REF AXX_KF_NEL_TABG FORMAT "%6.1" MONOTONY STRICT_INCREASE DEPOSIT ABSOLUTE /end AXIS_DESCR
 /begin AXIS_DESCR COM_AXIS V_wm BMW_q0p1_kilometer_per_hour 4 0 6553.5 AXIS_PTS_REF AXY_KF_NEL_TABG FORMAT "%6.1" MONOTONY STRICT_INCREASE DEPOSIT ABSOLUTE /end AXIS_DESCR
/end CHARACTERISTIC
/begin CHARACTERISTIC KF_NEL_TANS "Electric fan speed request due to intake air temperature" MAP 0x80760F8C _REC_A1CUR_1_MBSE_U1_S1 99.609375 BMW_q0p3906_PERC 0 99.609375
 /begin AXIS_DESCR COM_AXIS Dtans_tumg_wm BMW_q0p1_degC 4 -3276.8 3276.7 AXIS_PTS_REF AXX_KF_NEL_TANS FORMAT "%6.1" MONOTONY STRICT_INCREASE DEPOSIT ABSOLUTE /end AXIS_DESCR
 /begin AXIS_DESCR COM_AXIS Tumg_wm BMW_q0p1_degC 4 -3276.8 3276.7 AXIS_PTS_REF AXY_KF_NEL_TANS FORMAT "%6.1" MONOTONY STRICT_INCREASE DEPOSIT ABSOLUTE /end AXIS_DESCR
/end CHARACTERISTIC
/begin CHARACTERISTIC KF_NEL_TGET "E-Luefterdrehzahlanforderung durch die Getriebeoeltemperatur und Geschwindigkeit" MAP 0x80760F4C _REC_A1CUR_1_MBSE_U1_S1 99.609375 BMW_q0p3906_PERC 0 99.609375
 /begin AXIS_DESCR COM_AXIS Tget_wm DchEpAd_DBCFgoa_Ckhahgc_q__aoa0 8 -327.68 327.67 AXIS_PTS_REF AXX_KF_NEL_TGET FORMAT "%6.2" MONOTONY STRICT_INCREASE DEPOSIT ABSOLUTE /end AXIS_DESCR
 /begin AXIS_DESCR COM_AXIS V_wm BMW_q0p1_kilometer_per_hour 8 0 6553.5 AXIS_PTS_REF AXY_KF_NEL_TGET MONOTONY STRICT_INCREASE DEPOSIT ABSOLUTE /end AXIS_DESCR
/end CHARACTERISTIC
/begin CHARACTERISTIC KF_NEL_TMOT_TKA "E-Luefterdrehzahlanforderung durch Delta Tkwsoll zu Tmot über Tka" MAP 0x80760EEC _REC_A1CUR_1_MBSE_U1_S1 99.609375 BMW_q0p3906_PERC 0 99.609375
 /begin AXIS_DESCR COM_AXIS Dtmot_tkwsoll_f DchEpAd_DBCFgoa_Ckhahgc_q__aoa0 12 -327.68 327.67 AXIS_PTS_REF AXX_KF_NEL_TMOT_TKA FORMAT "%6.2" MONOTONY STRICT_INCREASE DEPOSIT ABSOLUTE /end AXIS_DESCR
 /begin AXIS_DESCR COM_AXIS Dtkwsoll_tka_f DchEpAd_DBCFgoa_Ckhahgc_q__aoa0 8 -327.68 327.67 AXIS_PTS_REF AXY_KF_NEL_TMOT_TKA FORMAT "%6.2" MONOTONY STRICT_INCREASE DEPOSIT ABSOLUTE /end AXIS_DESCR
/end CHARACTERISTIC
/begin CHARACTERISTIC KF_NEL_VSKR "E-Luefterdrehzahlanforderung über Kraftstoffverbrauch" MAP 0x80760ED4 _REC_A1CUR_1_MBSE_U1_S1 99.609375 BMW_q0p3906_PERC 0 99.609375
 /begin AXIS_DESCR COM_AXIS Vskr_mw_wm fpBesqd_hAxmiba_AAwtged_u__0oa0 6 0 65535 AXIS_PTS_REF AXX_KF_NEL_VSKR MONOTONY STRICT_INCREASE DEPOSIT ABSOLUTE /end AXIS_DESCR
 /begin AXIS_DESCR COM_AXIS V_wm BMW_q0p1_kilometer_per_hour 4 0 6553.5 AXIS_PTS_REF AXY_KF_NEL_VSKR FORMAT "%6.1" MONOTONY STRICT_INCREASE DEPOSIT ABSOLUTE /end AXIS_DESCR
/end CHARACTERISTIC
/begin CHARACTERISTIC KF_NEWP_LLK_TANS "Anforderung der EW_LLK in Abhaengigkeit der Ansauglufttemperatur und Differenz zwischen Ansauglufttemperatur und Umgebungstemperatur" MAP 0x8076142B _REC_A1CUR_1_MBSE_U1_S1 100 nnxvdDd_vDnjvqd_FmDuEEa_f__aa0o 0 100
 /begin AXIS_DESCR COM_AXIS Dtans_tumg_wm BMW_q0p1_degC 6 -3276.8 3276.7 AXIS_PTS_REF AXX_KF_NEWP_LLK_TANS MONOTONY STRICT_INCREASE DEPOSIT ABSOLUTE /end AXIS_DESCR
 /begin AXIS_DESCR COM_AXIS Tumg_wm BMW_q0p1_degC 6 -3276.8 3276.7 AXIS_PTS_REF AXY_KF_NEWP_LLK_TANS MONOTONY STRICT_INCREASE DEPOSIT ABSOLUTE /end AXIS_DESCR
/end CHARACTERISTIC
/begin CHARACTERISTIC KF_NMAX_ANFAHR_MODE_0 "Max. permissible launch RPM (normal mode)" MAP 0x80728E30 _REC_A1CUR_1_MBSE_S2_S1 65535 caoddzd_oAjpfzb_cAcEEha_1nR_oa0 -32768 32767 FORMAT "%5.0"
 /begin AXIS_DESCR COM_AXIS NO_INPUT_QUANTITY jgbhAma_smpAegb_hlEBAmd_k__0oa0 6 -655.36 655.34 AXIS_PTS_REF AXX_KF_NMAX_ANFAHR_MODE_0 FORMAT "%7.2" MONOTONY STRICT_INCREASE DEPOSIT ABSOLUTE /end AXIS_DESCR
 /begin AXIS_DESCR COM_AXIS NO_INPUT_QUANTITY vfyBdwd_ftexgja_BcFdiDd_fR_1a0o 4 -800 799.9755859375 AXIS_PTS_REF AXY_KF_NMAX_ANFAHR_MODE_0 FORMAT "%7.2" MONOTONY STRICT_INCREASE DEPOSIT ABSOLUTE /end AXIS_DESCR
/end CHARACTERISTIC
/begin CHARACTERISTIC KF_NMAX_ANFAHR_MODE_1 "Max. permissible launch RPM (A_max mode / DTC)" MAP 0x80728E00 _REC_A1CUR_1_MBSE_S2_S1 65535 caoddzd_oAjpfzb_cAcEEha_1nR_oa0 -32768 32767 FORMAT "%5.0"
 /begin AXIS_DESCR COM_AXIS NO_INPUT_QUANTITY jgbhAma_smpAegb_hlEBAmd_k__0oa0 6 -655.36 655.34 AXIS_PTS_REF AXX_KF_NMAX_ANFAHR_MODE_1 FORMAT "%7.2" MONOTONY STRICT_INCREASE DEPOSIT ABSOLUTE /end AXIS_DESCR
 /begin AXIS_DESCR COM_AXIS NO_INPUT_QUANTITY vfyBdwd_ftexgja_BcFdiDd_fR_1a0o 4 -800 799.9755859375 AXIS_PTS_REF AXY_KF_NMAX_ANFAHR_MODE_1 FORMAT "%7.2" MONOTONY STRICT_INCREASE DEPOSIT ABSOLUTE /end AXIS_DESCR
/end CHARACTERISTIC
/begin CHARACTERISTIC KF_NMAX_ANFAHR_MODE_2 "Max. permissible launch RPM (smoky burnout mode / DSC off)" MAP 0x80728DD0 _REC_A1CUR_1_MBSE_S2_S1 65535 caoddzd_oAjpfzb_cAcEEha_1nR_oa0 -32768 32767 FORMAT "%5.0"
 /begin AXIS_DESCR COM_AXIS NO_INPUT_QUANTITY jgbhAma_smpAegb_hlEBAmd_k__0oa0 6 -655.36 655.34 AXIS_PTS_REF AXX_KF_NMAX_ANFAHR_MODE_2 FORMAT "%7.2" MONOTONY STRICT_INCREASE DEPOSIT ABSOLUTE /end AXIS_DESCR
 /begin AXIS_DESCR COM_AXIS NO_INPUT_QUANTITY vfyBdwd_ftexgja_BcFdiDd_fR_1a0o 4 -800 799.9755859375 AXIS_PTS_REF AXY_KF_NMAX_ANFAHR_MODE_2 FORMAT "%7.2" MONOTONY STRICT_INCREASE DEPOSIT ABSOLUTE /end AXIS_DESCR
/end CHARACTERISTIC
/begin CHARACTERISTIC KF_PHA_H_B1_SK_PRE "Map start angle injection event 1 preventive super-knock" MAP 0x807171FE _REC_A1CUR_1_MBSE_S2_S1 1535.9765625 aEmoCzd_erpwvfb_msfkhgc_qR_1a0o -768 767.9765625
 /begin AXIS_DESCR COM_AXIS Nkw caoddzd_oAjpfzb_cAcEEha_1nR_oa0 10 -32768 32767 AXIS_PTS_REF GXX_KF_PHA_H_B1_BAS FORMAT "%5.0" MONOTONY STRICT_INCREASE DEPOSIT ABSOLUTE /end AXIS_DESCR
 /begin AXIS_DESCR COM_AXIS NO_INPUT_QUANTITY zyyxBpb_rEsnvtc_gktukCa_fR_5a0o 12 -1600 1599.951171875 AXIS_PTS_REF GXY_KF_PHA_H_B1_BAS FORMAT "%8.3" MONOTONY STRICT_INCREASE DEPOSIT ABSOLUTE /end AXIS_DESCR
/end CHARACTERISTIC
/begin CHARACTERISTIC KF_PHA_H_B1_W "Map start angle injection event 1 warm" MAP 0x8071708E _REC_A1CUR_1_MBSE_S2_S1 1535.9765625 aEmoCzd_erpwvfb_msfkhgc_qR_1a0o -768 767.9765625
 /begin AXIS_DESCR COM_AXIS Nkw caoddzd_oAjpfzb_cAcEEha_1nR_oa0 10 -32768 32767 AXIS_PTS_REF GXX_KF_PHA_H_B1_BAS FORMAT "%5.0" MONOTONY STRICT_INCREASE DEPOSIT ABSOLUTE /end AXIS_DESCR
 /begin AXIS_DESCR COM_AXIS NO_INPUT_QUANTITY zyyxBpb_rEsnvtc_gktukCa_fR_5a0o 12 -1600 1599.951171875 AXIS_PTS_REF GXY_KF_PHA_H_B1_BAS FORMAT "%8.3" MONOTONY STRICT_INCREASE DEPOSIT ABSOLUTE /end AXIS_DESCR
/end CHARACTERISTIC
/begin CHARACTERISTIC KF_PHA_H_E1 "KF_PHA_H_E1" MAP 0x807189F6 _REC_A1CUR_1_MBSE_S2_S1 1535.9765625 ridxkCa_Dxvxtdc_CChkhgc_nR_1a0o -768 767.9765625
 /begin AXIS_DESCR COM_AXIS Nkw caoddzd_oAjpfzb_cAcEEha_1nR_oa0 8 -32768 32767 AXIS_PTS_REF AXX_KF_PHA_H_E1 FORMAT "%5.0" MONOTONY STRICT_INCREASE DEPOSIT ABSOLUTE /end AXIS_DESCR
 /begin AXIS_DESCR COM_AXIS NO_INPUT_QUANTITY zyyxBpb_rEsnvtc_gktukCa_fR_5a0o 8 -1600 1599.951171875 AXIS_PTS_REF AXY_KF_PHA_H_E1 MONOTONY STRICT_INCREASE DEPOSIT ABSOLUTE /end AXIS_DESCR
/end CHARACTERISTIC
/begin CHARACTERISTIC KF_PRAIL_H "Map rail pressure homogeneous -- with active VVT" MAP 0x80725DD0 _REC_A1CUR_1_MBSE_U2_S1 39.9993896484375 cxdjuna_xpuCged_ocEpdua_MCRa2a0 0 39.9993896484375 FORMAT "%9.4"
 /begin AXIS_DESCR COM_AXIS Nkw caoddzd_oAjpfzb_cAcEEha_1nR_oa0 8 -32768 32767 AXIS_PTS_REF AXX_KF_PRAIL_H FORMAT "%5.0" MONOTONY STRICT_INCREASE DEPOSIT ABSOLUTE /end AXIS_DESCR
 /begin AXIS_DESCR COM_AXIS BMWrailco_rat_VabHom_sw zyyxBpb_rEsnvtc_gktukCa_fR_5a0o 8 -1600 1599.951171875 AXIS_PTS_REF AXY_KF_PRAIL_H FORMAT "%8.3" MONOTONY STRICT_INCREASE DEPOSIT ABSOLUTE /end AXIS_DESCR
/end CHARACTERISTIC
/begin CHARACTERISTIC KF_PRAIL_H_K "Map rail pressure homogeneous cold -- with active VVT" MAP 0x80725B50 _REC_A1CUR_1_MBSE_U2_S1 39.9993896484375 cxdjuna_xpuCged_ocEpdua_MCRa2a0 0 39.9993896484375 FORMAT "%9.4"
 /begin AXIS_DESCR COM_AXIS Nkw caoddzd_oAjpfzb_cAcEEha_1nR_oa0 8 -32768 32767 AXIS_PTS_REF AXX_KF_PRAIL_H_K FORMAT "%5.0" MONOTONY STRICT_INCREASE DEPOSIT ABSOLUTE /end AXIS_DESCR
 /begin AXIS_DESCR COM_AXIS BMWrailco_rat_VabHom_sw zyyxBpb_rEsnvtc_gktukCa_fR_5a0o 8 -1600 1599.951171875 AXIS_PTS_REF AXY_KF_PRAIL_H_K FORMAT "%8.3" MONOTONY STRICT_INCREASE DEPOSIT ABSOLUTE /end AXIS_DESCR
/end CHARACTERISTIC
/begin CHARACTERISTIC KF_PRAIL_HDPWARM "Map rail pressure for protection against warm high-pressure pump" MAP 0x80725D50 _REC_A1CUR_1_MBSE_U2_S1 39.9993896484375 cxdjuna_xpuCged_ocEpdua_MCRa2a0 0 39.9993896484375 FORMAT "%9.4"
 /begin AXIS_DESCR COM_AXIS Nkw caoddzd_oAjpfzb_cAcEEha_1nR_oa0 8 -32768 32767 AXIS_PTS_REF AXX_KF_PRAIL_HDPWARM FORMAT "%5.0" MONOTONY STRICT_INCREASE DEPOSIT ABSOLUTE /end AXIS_DESCR
 /begin AXIS_DESCR COM_AXIS BMWrailco_rat_VabHom_sw zyyxBpb_rEsnvtc_gktukCa_fR_5a0o 8 -1600 1599.951171875 AXIS_PTS_REF AXY_KF_PRAIL_HDPWARM FORMAT "%8.3" MONOTONY STRICT_INCREASE DEPOSIT ABSOLUTE /end AXIS_DESCR
/end CHARACTERISTIC
/begin CHARACTERISTIC KF_PRAIL_HDPWARM_KH "Kennfeld RAILDRUCK bei Schutz vor warmen HDP während KH" MAP 0x80725CD0 _REC_A1CUR_1_MBSE_U2_S1 39.9993896484375 cxdjuna_xpuCged_ocEpdua_MCRa2a0 0 39.9993896484375 FORMAT "%9.4"
 /begin AXIS_DESCR COM_AXIS Nkw caoddzd_oAjpfzb_cAcEEha_1nR_oa0 8 -32768 32767 AXIS_PTS_REF AXX_KF_PRAIL_HDPWARM FORMAT "%5.0" MONOTONY STRICT_INCREASE DEPOSIT ABSOLUTE /end AXIS_DESCR
 /begin AXIS_DESCR COM_AXIS BMWrailco_rat_VabHom_sw zyyxBpb_rEsnvtc_gktukCa_fR_5a0o 8 -1600 1599.951171875 AXIS_PTS_REF AXY_KF_PRAIL_HDPWARM FORMAT "%8.3" MONOTONY STRICT_INCREASE DEPOSIT ABSOLUTE /end AXIS_DESCR
/end CHARACTERISTIC
/begin CHARACTERISTIC KF_PRAIL_HGD "Map rail pressure homogeneous -- with inactive VVT (throttled)" MAP 0x80725C50 _REC_A1CUR_1_MBSE_U2_S1 39.9993896484375 cxdjuna_xpuCged_ocEpdua_MCRa2a0 0 39.9993896484375 FORMAT "%9.4"
 /begin AXIS_DESCR COM_AXIS Nkw caoddzd_oAjpfzb_cAcEEha_1nR_oa0 8 -32768 32767 AXIS_PTS_REF AXX_KF_PRAIL_HGD FORMAT "%5.0" MONOTONY STRICT_INCREASE DEPOSIT ABSOLUTE /end AXIS_DESCR
 /begin AXIS_DESCR COM_AXIS BMWrailco_rat_VabHom_sw zyyxBpb_rEsnvtc_gktukCa_fR_5a0o 8 -1600 1599.951171875 AXIS_PTS_REF AXY_KF_PRAIL_HGD FORMAT "%8.3" MONOTONY STRICT_INCREASE DEPOSIT ABSOLUTE /end AXIS_DESCR
/end CHARACTERISTIC
/begin CHARACTERISTIC KF_PRAIL_HGD_K "Map rail pressure homogeneous cold -- with inactive VVT (throttled)" MAP 0x80725BD0 _REC_A1CUR_1_MBSE_U2_S1 39.9993896484375 cxdjuna_xpuCged_ocEpdua_MCRa2a0 0 39.9993896484375 FORMAT "%9.4"
 /begin AXIS_DESCR COM_AXIS Nkw caoddzd_oAjpfzb_cAcEEha_1nR_oa0 8 -32768 32767 AXIS_PTS_REF AXX_KF_PRAIL_HGD_K FORMAT "%5.0" MONOTONY STRICT_INCREASE DEPOSIT ABSOLUTE /end AXIS_DESCR
 /begin AXIS_DESCR COM_AXIS BMWrailco_rat_VabHom_sw zyyxBpb_rEsnvtc_gktukCa_fR_5a0o 8 -1600 1599.951171875 AXIS_PTS_REF AXY_KF_PRAIL_HGD_K FORMAT "%8.3" MONOTONY STRICT_INCREASE DEPOSIT ABSOLUTE /end AXIS_DESCR
/end CHARACTERISTIC
/begin CHARACTERISTIC KF_ST_RKBAS_GD "Map base Rk quantity throttled operation" MAP 0x8074F8FC _REC_A1CUR_1_MBSE_S2_S1 3199.951171875 zyyxBpb_rEsnvtc_gktukCa_fR_5a0o -1600 1599.951171875
 /begin AXIS_DESCR COM_AXIS Nkw caoddzd_oAjpfzb_cAcEEha_1nR_oa0 10 -32768 32767 AXIS_PTS_REF AXX_KF_ST_RKBAS_GD FORMAT "%5.0" MONOTONY STRICT_INCREASE DEPOSIT ABSOLUTE /end AXIS_DESCR
 /begin AXIS_DESCR COM_AXIS BMWinj_t_Eng_sw DchEpAd_DBCFgoa_Ckhahgc_q__aoa0 10 -327.68 327.67 AXIS_PTS_REF AXY_KF_ST_RKBAS_GD FORMAT "%7.2" MONOTONY STRICT_INCREASE DEPOSIT ABSOLUTE /end AXIS_DESCR
/end CHARACTERISTIC
/begin CHARACTERISTIC KF_ST_RKBAS_VVT "Map base Rk quantity VVT operation" MAP 0x8074F1C2 _REC_A1CUR_1_MBSE_S2_S1 3199.951171875 zyyxBpb_rEsnvtc_gktukCa_fR_5a0o -1600 1599.951171875
 /begin AXIS_DESCR COM_AXIS Nkw caoddzd_oAjpfzb_cAcEEha_1nR_oa0 12 -32768 32767 AXIS_PTS_REF AXX_KF_ST_RKBAS_VVT FORMAT "%5.0" MONOTONY STRICT_INCREASE DEPOSIT ABSOLUTE /end AXIS_DESCR
 /begin AXIS_DESCR COM_AXIS BMWinj_t_Eng_sw DchEpAd_DBCFgoa_Ckhahgc_q__aoa0 12 -327.68 327.67 AXIS_PTS_REF AXY_KF_ST_RKBAS_VVT FORMAT "%7.2" MONOTONY STRICT_INCREASE DEPOSIT ABSOLUTE /end AXIS_DESCR
/end CHARACTERISTIC
/begin CHARACTERISTIC KF_TA_IKSOLL "Target temperature for exhaust gas temperature in catalyst" MAP 0x8071A3C4 _REC_A1CUR_1_MBSE_S2_S1 6553.5 BMW_q0p1_degC -3276.8 3276.7 FORMAT "%6.1"
 /begin AXIS_DESCR COM_AXIS Nkw_atm caoddzd_oAjpfzb_cAcEEha_1nR_oa0 4 -32768 32767 AXIS_PTS_REF AXX_KF_TA_IKSOLL MONOTONY STRICT_INCREASE DEPOSIT ABSOLUTE /end AXIS_DESCR
 /begin AXIS_DESCR COM_AXIS Rf_atm CgkBooc_wkiDfEd_Czglhgc_fR_1a0o 4 -327.68 327.67 AXIS_PTS_REF AXY_KF_TA_IKSOLL MONOTONY STRICT_INCREASE DEPOSIT ABSOLUTE /end AXIS_DESCR
/end CHARACTERISTIC
/begin CHARACTERISTIC KF_TA_VKSOLL "Target temperature for exhaust gas temperature mixing section" MAP 0x8071A3A4 _REC_A1CUR_1_MBSE_S2_S1 6553.5 BMW_q0p1_degC -3276.8 3276.7 FORMAT "%6.1"
 /begin AXIS_DESCR COM_AXIS Nkw_atm caoddzd_oAjpfzb_cAcEEha_1nR_oa0 4 -32768 32767 AXIS_PTS_REF AXX_KF_TA_VKSOLL MONOTONY STRICT_INCREASE DEPOSIT ABSOLUTE /end AXIS_DESCR
 /begin AXIS_DESCR COM_AXIS Rf_atm CgkBooc_wkiDfEd_Czglhgc_fR_1a0o 4 -327.68 327.67 AXIS_PTS_REF AXY_KF_TA_VKSOLL MONOTONY STRICT_INCREASE DEPOSIT ABSOLUTE /end AXIS_DESCR
/end CHARACTERISTIC
/begin CHARACTERISTIC KF_TD_FETTDELAY_TABG "Duration of enrichment suppression from KF_LABAS_XXX. This time depends on pipe wall temperature Tw_r1." MAP 0x807630D8 _REC_A1CUR_1_MBSE_U1_S1 51 BMW_q0p2_s 0 51
 /begin AXIS_DESCR COM_AXIS Tw_r1 BMW_q0p1_degC 6 -3276.8 3276.7 AXIS_PTS_REF AXX_KF_TD_FETTDELAY_TABG FORMAT "%6.1" MONOTONY STRICT_INCREASE DEPOSIT ABSOLUTE /end AXIS_DESCR
 /begin AXIS_DESCR COM_AXIS Nkw caoddzd_oAjpfzb_cAcEEha_1nR_oa0 4 -3277 3277 AXIS_PTS_REF AXY_KF_TD_FETTDELAY_TABG FORMAT "%5.0" MONOTONY STRICT_INCREASE DEPOSIT ABSOLUTE /end AXIS_DESCR
/end CHARACTERISTIC
/begin CHARACTERISTIC KF_ZWMIN_KSOT "Minimum ignition angle for sound tuning cold" MAP 0x8075D4AD _REC_A1CUR_1_MBSE_S1_S1 127.5 aAwkuzc_BFpgCmb_tmDukma_q__aa0o -64 63.5
 /begin AXIS_DESCR COM_AXIS Nkw caoddzd_oAjpfzb_cAcEEha_1nR_oa0 8 -32768 32767 AXIS_PTS_REF AXX_KF_ZWMIN_KSOT FORMAT "%5.0" MONOTONY STRICT_INCREASE DEPOSIT ABSOLUTE /end AXIS_DESCR
 /begin AXIS_DESCR COM_AXIS NO_INPUT_QUANTITY CgkBooc_wkiDfEd_Czglhgc_fR_1a0o 8 -327.68 327.67 AXIS_PTS_REF AXY_KF_ZWMIN_KSOT FORMAT "%9.4" MONOTONY STRICT_INCREASE DEPOSIT ABSOLUTE /end AXIS_DESCR
/end CHARACTERISTIC
/begin CHARACTERISTIC KF_ZWMIN_WSOT "Minimum ignition angle for sound tuning warm" MAP 0x8075D46D _REC_A1CUR_1_MBSE_S1_S1 127.5 aAwkuzc_BFpgCmb_tmDukma_q__aa0o -64 63.5
 /begin AXIS_DESCR COM_AXIS Nkw caoddzd_oAjpfzb_cAcEEha_1nR_oa0 8 -32768 32767 AXIS_PTS_REF AXX_KF_ZWMIN_WSOT FORMAT "%5.0" MONOTONY STRICT_INCREASE DEPOSIT ABSOLUTE /end AXIS_DESCR
 /begin AXIS_DESCR COM_AXIS NO_INPUT_QUANTITY CgkBooc_wkiDfEd_Czglhgc_fR_1a0o 8 -327.68 327.67 AXIS_PTS_REF AXY_KF_ZWMIN_WSOT FORMAT "%9.4" MONOTONY STRICT_INCREASE DEPOSIT ABSOLUTE /end AXIS_DESCR
/end CHARACTERISTIC
/begin FUNCTION Antilag ""
 /begin SUB_FUNCTION Antilag_Codewords Antilag_PIDs Antilag_Rolling Antilag_Safety Antilag_Standing /end SUB_FUNCTION
/end FUNCTION
/begin FUNCTION Antilag_Codewords "" /end FUNCTION
/begin FUNCTION Antilag_PIDs "" /end FUNCTION
/begin FUNCTION Antilag_Rolling "" /end FUNCTION
/begin FUNCTION Antilag_Safety "" /end FUNCTION
/begin FUNCTION Antilag_Standing "" /end FUNCTION
/begin FUNCTION Boost "Intake/exhaust pressure targets/limits"
 /begin DEF_CHARACTERISTIC K_PAK_MX BMWlpa_n_EfpEngStrtAmb_M KL_PSPVDK_SOLMAXGD K_MAX_PSSOLBER KL_RFTNLMX KF_DPLDSOLL_SPORT BMWtchdiag_n_EngMin_C BMWtchob_p_DifEnd_C BMWtchob_fac_tq_Delt_T BMWtchob_p_DifGraTrigMin_C BMWtchsp_p_ReqMax_C BMWtchsp_p_OfsMax_C BMWtchsp_rat_p_CmprMax_M BMWtchsp_rat_p_CmprMaxRace_M BMWtchsp_rat_p_CmprPmp_T BMWtchsp_rat_p_CmprMaxTMax_T BMWtchsp_fac_FilPRatCmpr_T BMWtchsp_fac_mf_FilCmprNorm_T KF_DPLDS_PRED BMWtchctr_rat_p_ComprLimPctl_T BMWtchctr_fac_pwr_CompLimPctl_T KF_NEWP_LLK_TANS PVDMX /end DEF_CHARACTERISTIC
/end FUNCTION
/begin FUNCTION BoostByGear "" /begin SUB_FUNCTION BoostByGear_Codewords /end SUB_FUNCTION /end FUNCTION
/begin FUNCTION BoostByGear_Codewords "" /end FUNCTION
/begin FUNCTION Burbles ""
 /begin SUB_FUNCTION Burbles_Codewords Burbles_Slot0 Burbles_Slot1 Burbles_Slot2 Burbles_Slot3 Burbles_Slot4 Burbles_Slot5 /end SUB_FUNCTION
/end FUNCTION
/begin FUNCTION Burbles_Codewords "" /end FUNCTION
/begin FUNCTION Burbles_Slot0 "" /end FUNCTION
/begin FUNCTION Burbles_Slot1 "" /end FUNCTION
/begin FUNCTION Burbles_Slot2 "" /end FUNCTION
/begin FUNCTION Burbles_Slot3 "" /end FUNCTION
/begin FUNCTION Burbles_Slot4 "" /end FUNCTION
/begin FUNCTION Burbles_Slot5 "" /end FUNCTION
/begin FUNCTION Cooling "Engine cooling"
 /begin DEF_CHARACTERISTIC K_TKW_WA K_TKW_MX KL_TKW_NO KL_TKW_HI K_TDON_HEIZ_OPF K_TDOFF_HEIZ_OPF KL_NEL_I K_QS_ANF_KLIMA_MX KL_NEL_KLIMA_MX KL_NEWP_KLIMA_MX KF_KLIMA_KKS K_FK_NEL_VSKR KL_FK_TUMG_OPF KL_NEL_VSKR_TUMG KL_NEL_TABG_TUMG KL_NEL_V_MX KL_NEL_TMOT KL_NEL_TKA KL_NEL_TEGS KL_NEL_TDME KL_NEL_TANS_KLOPF KL_NEL_SPL KF_NEL_VSKR KF_NEL_TMOT_TKA KF_NEL_TGET KF_NEL_TANS KF_NEL_TABG KF_NEL_OPF_V KL_FLD_KKS /end DEF_CHARACTERISTIC
/end FUNCTION
/begin FUNCTION CustomCode ""
 /begin SUB_FUNCTION Antilag BoostByGear Burbles CustomCodeMenu ExhaustFlap FlexFuel MaxCooling RadiatorFlap SwitchableMaps TcuTorqueLimiter Valet /end SUB_FUNCTION
/end FUNCTION
/begin FUNCTION CustomCodeMenu "" /begin SUB_FUNCTION CustomCodeMenu_Codewords CustomCodeMenu_CanBusIds /end SUB_FUNCTION /end FUNCTION
/begin FUNCTION CustomCodeMenu_CanBusIds "" /end FUNCTION
/begin FUNCTION CustomCodeMenu_Codewords "" /end FUNCTION
/begin FUNCTION DisplayCalibration "Sport gauge scales for power and torque"
 /begin DEF_CHARACTERISTIC BMWosd_tq_MaxSptDispNm_C BMWosd_pwr_MaxSptDispkW_C BMWshl_n_SpdMaxMt_T BMWshl_n_SpdMaxAt_T BMWshl_n_ThdSpdDispSegAlOn_C K_EDA_P_ANZ_SPORT_BS_SCAL_CODE3 K_EDA_P_ANZ_SPORT_BS_SCAL_CODE2 K_EDA_P_ANZ_SPORT_BS_SCAL_CODE1 K_EDA_P_ANZ_SPORT_BS_SCAL_CODE0 K_EDA_MD_ANZ_BS_SCAL_CODE4 K_EDA_MD_ANZ_BS_SCAL_CODE3 K_EDA_MD_ANZ_BS_SCAL_CODE2 K_EDA_MD_ANZ_BS_SCAL_CODE1 K_EDA_MD_ANZ_BS_SCAL_CODE0 BMWtchbpi_p_MaxTcSptDisp_C NWARNORINI /end DEF_CHARACTERISTIC
/end FUNCTION
/begin FUNCTION EngineSpeed "Engine Speed"
 /begin DEF_CHARACTERISTIC K_NADONNMX K_PAM_MODE_FUELLUNGSEG_NKW_HYS K_PAM_MODE_FUELLUNGSEG_NKW2 K_PAM_MODE_FUELLUNGSEG_NKW1 KF_N_GASSTOSS_UND_ANFAHR KF_N_GASSTOSS_ANFAHR_KUPP KF_NMAX_ANFAHR_MODE_2 KF_NMAX_ANFAHR_MODE_1 KF_NMAX_ANFAHR_MODE_0 K_NKW_MAX K_NMX_VM_FETRAWE K_NMX_VM_ABS K_N_GB1_IN_MAX_OSC BMWosc_n_Gb1Max_T BMWosc_n_Gb1Max_MT K_NMX_VM_OG_SPORTPLUS K_NMX_VM_OG_SPORT K_NMX_VM_OG_RENNSTART K_NMX_VM_OG_ECO K_NMX_VM_OG_COMFORT K_NMX_VM_BA_VVT K_NMX_VM_BA_GD BMWtqe_n_EngLhModEngDynSp_T BMWtqe_n_NMaxEngTqLimdMt_T BMWtqe_n_NMaxEngTqLimdDct_T BMWtqe_n_NMaxEngTqLimdAt_T EngPrt_nMax_CUR NMAX NMAXKR NMAXSWT NMAXTMM NMAXTO /end DEF_CHARACTERISTIC
/end FUNCTION
/begin FUNCTION Exhaust "Exhaust flap, burbles and noise"
 /begin DEF_CHARACTERISTIC K_V_SOT_MN BMWausy_p_DifCat_T BMWchst_t_CatMax_C BMWgpfheat_p_RailTstrPcg_C BMWgpfheat_p_RailInjSng_M BMWgpfheat_p_RailInjMpl_M BMWgpfheat_tq_ResExhFlpClsdHys_C BMWgpfheat_tq_ResExhFlpClsd_T KF_LA_EZA K_V_SOUND_MX K_V_SOUND_MN K_T_VL_SOUND_MX K_T_SOUND_MN K_T_NK_SOUND_MX KL_T_IKAT_SOUND_MX KL_NKW_SOUND_MX KL_NKW_SOUND_MN KL_TD_SOUND_MX_SPORT KL_TD_SOUND_MX_FREI KL_TD_SOUND_MX KF_MD_RES_NST_KEY BMWchas_v_MaxExhFlpClsd_C BMWchas_v_IdlGearAcvMin_C BMWchas_tq_ResExhFlpClsdHys_C BMWchas_tq_ResExhFlpClsd_T BMWgpfdiag_m_ThdAshSnsr_C K_F_SOT_RUECKBLICK_STAND K_F_SOT_RUECKBLICK_RS BMWgpfp_swi_PclFil_C BMWtchbas_cw_Noise_C BMWtqe_st_ProhCylOffGc_C BMWtqe_swi_NoiseWiDiDfco_C CW_SOUND BMWtqe_st_SptDet4NoiseAcvn_M BMWtqe_b_Clu4NoiseDeac_T KF_ZWMIN_WSOT KF_ZWMIN_KSOT KF_DZWMIN_SPORT_SOT KF_DZWMIN_NORMAL_SOT BMWchas_st_OpmBasLiOff_T BMWchas_st_OpmBasCatCold_T AKRGRCC AKRGRCCAT AKRGRCCATM AKRGRCCATM_VAR1 AKRGRCCATM_VAR2 AKRGRCCATM_VAR3 AKRGRCCAT_VAR1 AKRGRCCAT_VAR2 AKRGRCCAT_VAR3 AKRGRCCM AKRGRCCM_VAR1 AKRGRCCM_VAR2 AKRGRCCM_VAR3 AKRGRCC_VAR1 AKRGRCC_VAR2 AKRGRCC_VAR3 AKRGRCO AKRGRCOAT AKRGRCOATM AKRGRCOATM_VAR1 AKRGRCOAT_VAR1 AKRGRCOM AKRGRCOM_VAR1 AKRGRCO_VAR1 AKR_dmHFMThdMin_C AKR_stSpt_C CWAKR CWSTEGSPROGAKR TMOTAKR TVSTAKR VMINAKR PFlt_stActv_C PFlt_stPfilTyp_C CWVMAXCOD VMAXOVC Exh_swtSensCfgPPFlt_C /end DEF_CHARACTERISTIC
/end FUNCTION
/begin FUNCTION ExhaustFlap "" /begin SUB_FUNCTION ExhaustFlap_Codewords /end SUB_FUNCTION /end FUNCTION
/begin FUNCTION ExhaustFlap_Codewords "" /end FUNCTION
/begin FUNCTION ExhaustGasTemperature "Target EGT"
 /begin DEF_CHARACTERISTIC KF_TA_VKSOLL KF_TA_IKSOLL BMWtchctr_t_ExGasMdl_M BMWtchctr_t_ExGasMdlScav_M /end DEF_CHARACTERISTIC
/end FUNCTION
/begin FUNCTION FlexFuel ""
 /begin SUB_FUNCTION FlexFuel_General_Codewords FlexFuel_Map_Codewords FlexFuel_Slot0 FlexFuel_Slot1 FlexFuel_Slot2 FlexFuel_Slot3 FlexFuel_Slot4 /end SUB_FUNCTION
/end FUNCTION
/begin FUNCTION FlexFuel_General_Codewords "" /end FUNCTION
/begin FUNCTION FlexFuel_Map_Codewords "" /end FUNCTION
/begin FUNCTION FlexFuel_Slot0 "Used for all slots if CW_UseMultipleFlexFuelSlots is disabled"
 /begin SUB_FUNCTION FlexFuel_Slot0_Codewords FlexFuel_Slot0_Blenders FlexFuel_Slot0_SensorlessValues /end SUB_FUNCTION
/end FUNCTION
/begin FUNCTION FlexFuel_Slot0_Blenders "" /end FUNCTION
/begin FUNCTION FlexFuel_Slot0_Codewords "" /end FUNCTION
/begin FUNCTION FlexFuel_Slot0_SensorlessValues "E% without sensor (ECA)" /end FUNCTION
/begin FUNCTION FlexFuel_Slot1 "Only used if CW_UseMultipleFlexFuelSlots is enabled"
 /begin SUB_FUNCTION FlexFuel_Slot1_Codewords FlexFuel_Slot1_Blenders FlexFuel_Slot1_SensorlessValues /end SUB_FUNCTION
/end FUNCTION
/begin FUNCTION FlexFuel_Slot1_Blenders "" /end FUNCTION
/begin FUNCTION FlexFuel_Slot1_Codewords "" /end FUNCTION
/begin FUNCTION FlexFuel_Slot1_SensorlessValues "E% without sensor (ECA)" /end FUNCTION
/begin FUNCTION FlexFuel_Slot2 "Only used if CW_UseMultipleFlexFuelSlots is enabled"
 /begin SUB_FUNCTION FlexFuel_Slot2_Codewords FlexFuel_Slot2_Blenders FlexFuel_Slot2_SensorlessValues /end SUB_FUNCTION
/end FUNCTION
/begin FUNCTION FlexFuel_Slot2_Blenders "" /end FUNCTION
/begin FUNCTION FlexFuel_Slot2_Codewords "" /end FUNCTION
/begin FUNCTION FlexFuel_Slot2_SensorlessValues "E% without sensor (ECA)" /end FUNCTION
/begin FUNCTION FlexFuel_Slot3 "Only used if CW_UseMultipleFlexFuelSlots is enabled"
 /begin SUB_FUNCTION FlexFuel_Slot3_Codewords FlexFuel_Slot3_Blenders FlexFuel_Slot3_SensorlessValues /end SUB_FUNCTION
/end FUNCTION
/begin FUNCTION FlexFuel_Slot3_Blenders "" /end FUNCTION
/begin FUNCTION FlexFuel_Slot3_Codewords "" /end FUNCTION
/begin FUNCTION FlexFuel_Slot3_SensorlessValues "E% without sensor (ECA)" /end FUNCTION
/begin FUNCTION FlexFuel_Slot4 "Only used if CW_UseMultipleFlexFuelSlots is enabled"
 /begin SUB_FUNCTION FlexFuel_Slot4_Codewords FlexFuel_Slot4_Blenders FlexFuel_Slot4_SensorlessValues /end SUB_FUNCTION
/end FUNCTION
/begin FUNCTION FlexFuel_Slot4_Blenders "" /end FUNCTION
/begin FUNCTION FlexFuel_Slot4_Codewords "" /end FUNCTION
/begin FUNCTION FlexFuel_Slot4_SensorlessValues "E% without sensor (ECA)" /end FUNCTION
/begin FUNCTION FuelCorrection "Lambda modifiers" /begin DEF_CHARACTERISTIC KF_FRKKORRF_1 KF_PHA_H_B1_W KF_PHA_H_E1 /end DEF_CHARACTERISTIC /end FUNCTION
/begin FUNCTION FuelLimits "Lambda limits" /begin DEF_CHARACTERISTIC K_BS_MN K_FRFMXBS_MN KF_BSLGF KL_LA_SBL /end DEF_CHARACTERISTIC /end FUNCTION
/begin FUNCTION FuelTargets "Lambda targets"
 /begin DEF_CHARACTERISTIC KF_LABAS_1 K_MSVANST_DIFFPRAIL BMWinjmon_fac_HppEff_M KF_PHA_H_B1_SK_PRE BMWext_lam_MinCptPronInit_Ca BMWext_lam_CptPronDfco_T KF_DLAMBSVST_TABG BMWlpa_n_EfpModMax_C BMWlpa_n_EfpModSafe_M BMWlpa_n_EfpEngStrtPRail_T BMWlpsc_volf_FuEjrPmp_M BMWlpsd_p_RailDifMax_T KF_LAMIN_H KF_PRAIL_H_K KF_PRAIL_HGD_K KF_PRAIL_HGD KF_PRAIL_HDPWARM_KH KF_PRAIL_HDPWARM KF_PRAIL_H BMWtqe_n_LamStrdMax_C KF_LA_BEZ KF_KOEFF_B_LA BMWchas_p_RailInjSng_M BMWchas_p_RailInjMpl_M BMWlpa_volf_FuFpcOvrT_C BMWlpa_volf_FuBoosRstOfs_C BMWlpa_volf_FuMaxBoosCtlr_T BMWlpsc_p_HppMax_T K_PRAIL_ST_MAX K_LA_FETTDELAY KF_LA_SK KF_LABAS_2 KF_ST_RKBAS_VVT KF_ST_RKBAS_GD BMWlpa_fac_n_PwrMgrFild_C CW_ATMOD S_PRAIL_GL_LA1 S_AUSWAHL_FETTDELAY K_T_FETTDELAY_SPERR KF_TD_FETTDELAY_TABG VSEKPMXN FuPHi_FlmMaxpl_T FWIHDR KLIHDR KLPHDR KLPHDRTF NMXHDR KLFVSTOTF KLVSTMSVG /end DEF_CHARACTERISTIC
/end FUNCTION
/begin FUNCTION GenericCharacteristics "OEM Maps"
 /begin SUB_FUNCTION FuelTargets OilPressure Exhaust TorqueLimiters DisplayCalibration LoadControl Boost EngineSpeed FuelCorrection Limits FuelLimits ExhaustGasTemperature LowPressureFuelPump Vanos WastegateControl ThrottleControl Cooling Ignition Knock MAFSensor TorqueMonitoring /end SUB_FUNCTION
/end FUNCTION
/begin COMPU_METHOD aAwkuzc_BFpgCmb_tmDukma_q__aa0o "aAwkuzc_BFpgCmb_tmDukma_q__aa0o" RAT_FUNC "%6.3" "°" COEFFS 0 2 0 0 0 1 /end COMPU_METHOD
/begin COMPU_METHOD acriqBc_tfkBqod_ocgjxzc_nR_8oa0 "acriqBc_tfkBqod_ocgjxzc_nR_8oa0" RAT_FUNC "%6.3" "-" COEFFS 0 8192 0 0 0 1 /end COMPU_METHOD
/begin COMPU_METHOD aEmoCzd_erpwvfb_msfkhgc_qR_1a0o "aEmoCzd_erpwvfb_msfkhgc_qR_1a0o" RAT_FUNC "%6.3" "°" COEFFS 0 128 0 0 0 3 /end COMPU_METHOD
/begin COMPU_METHOD AFeDmkb_cAbjmcc_kAkskhd_k__0oa0 "AFeDmkb_cAbjmcc_kAkskhd_k__0oa0" RAT_FUNC "%6.3" "km/h" COEFFS 0 1 0 0 0 1 /end COMPU_METHOD
/begin COMPU_METHOD asfzqDd_xfCuqha_hliBAmd_k__0oa0 "asfzqDd_xfCuqha_hliBAmd_k__0oa0" RAT_FUNC "%6.3" "kg/h" COEFFS 0 10 0 0 0 1 /end COMPU_METHOD
/begin COMPU_METHOD Asyaixa_wdvtenb_FCefaCb_n__aa0o "Asyaixa_wdvtenb_FCefaCb_n__aa0o" RAT_FUNC "%6.3" "-" COEFFS 0 50 0 0 0 1 /end COMPU_METHOD
/begin COMPU_METHOD B_TRUE "" TAB_VERB "%6.3" "" COMPU_TAB_REF ACCMPR_CODAVL_SY_Compu /end COMPU_METHOD
/begin COMPU_METHOD Bhvfwhc_bigEubd_BBEupBd_nR_3oa0 "Bhvfwhc_bigEubd_BBEupBd_nR_3oa0" RAT_FUNC "%6.3" "-" COEFFS 0 32768 0 0 0 1 /end COMPU_METHOD
/begin COMPU_METHOD BMW_ba_poel__ "" RAT_FUNC "%6.2" "-" COEFFS 0 1 0 0 0 1 /end COMPU_METHOD
/begin COMPU_METHOD BMW_dm_sw_q0p1_Nm "" RAT_FUNC "%6.3" "Nm" COEFFS 0 10 0 0 0 1 /end COMPU_METHOD
/begin COMPU_METHOD BMW_p_sw_q0p125_hPa "" RAT_FUNC "%6.3" "hPa" COEFFS 0 8 0 0 0 1 /end COMPU_METHOD
/begin COMPU_METHOD BMW_Powertrain_DxECompuMethods_Def_ub_b1_nounit "Def_ub_b1" RAT_FUNC "%6.3" "-" COEFFS 0 256 0 0 0 1 /end COMPU_METHOD
/begin COMPU_METHOD BMW_q0p1__ "" RAT_FUNC "%6.3" "-" COEFFS 0 10 0 0 0 1 /end COMPU_METHOD
/begin COMPU_METHOD BMW_q0p1_degC "" RAT_FUNC "%6.3" "°C" COEFFS 0 10 0 0 0 1 /end COMPU_METHOD
/begin COMPU_METHOD BMW_q0p1_kilometer_per_hour "" RAT_FUNC "%6.3" "km/h" COEFFS 0 10 0 0 0 1 /end COMPU_METHOD
/begin COMPU_METHOD BMW_q0p2_s "" RAT_FUNC "%6.3" "s" COEFFS 0 5 0 0 0 1 /end COMPU_METHOD
/begin COMPU_METHOD BMW_q0p3906_PERC "" RAT_FUNC "%6.3" "%" COEFFS 0 64 0 0 0 25 /end COMPU_METHOD
/begin COMPU_METHOD bqonsub_DgsgbFa_Czglhgc_gR_1a0o "bqonsub_DgsgbFa_Czglhgc_gR_1a0o" RAT_FUNC "%6.3" "g" COEFFS 0 128 0 0 0 1 /end COMPU_METHOD
/begin COMPU_METHOD BufnDdb_jpjgsgc_jmDugsa_qCRoa0o "Def_q1" RAT_FUNC "%6.3" "°C" COEFFS 0 1 0 0 0 1 /end COMPU_METHOD
/begin COMPU_METHOD bukAcFc_hypjrAa_CBhougc_MCRooa0 "bukAcFc_hypjrAa_CBhougc_MCRooa0" RAT_FUNC "%6.3" "MPa" COEFFS 0 500 0 0 0 1 /end COMPU_METHOD
/begin COMPU_METHOD BumqDkc_mryszAa_EcglxAc_nR_4oa0 "BumqDkc_mryszAa_EcglxAc_nR_4oa0" RAT_FUNC "%6.3" "-" COEFFS 0 4096 0 0 0 1 /end COMPU_METHOD
/begin COMPU_METHOD camcxxd_bxlpdsa_Cshlhgc_sR_1a0o "Def_q0p01" RAT_FUNC "%6.3" "s" COEFFS 0 100 0 0 0 1 /end COMPU_METHOD
/begin COMPU_METHOD caoddzd_oAjpfzb_cAcEEha_1nR_oa0 "Def_q1" RAT_FUNC "%6.3" "1/min" COEFFS 0 1 0 0 0 1 /end COMPU_METHOD
/begin COMPU_METHOD CByjozc_eCmpBAb_pljBAmd_k__0oa0 "CByjozc_eCmpBAb_pljBAmd_k__0oa0" RAT_FUNC "%6.3" "kg/h" COEFFS 0 32 0 0 0 1 /end COMPU_METHOD
/begin COMPU_METHOD CgkBooc_wkiDfEd_Czglhgc_fR_1a0o "Def_q0p01" RAT_FUNC "%6.3" "%" COEFFS 0 100 0 0 0 1 /end COMPU_METHOD
/begin COMPU_METHOD cxdjuna_xpuCged_ocEpdua_MCRa2a0 "cxdjuna_xpuCged_ocEpdua_MCRa2a0" RAT_FUNC "%6.3" "MPa" COEFFS 0 8192 0 0 0 5 /end COMPU_METHOD
/begin COMPU_METHOD DchEpAd_DBCFgoa_Ckhahgc_q__aoa0 "DchEpAd_DBCFgoa_Ckhahgc_q__aoa0" RAT_FUNC "%6.3" "°C" COEFFS 0 100 0 0 0 1 /end COMPU_METHOD
/begin COMPU_METHOD DEZ "" RAT_FUNC "%6.2" "" COEFFS 0 1 0 0 0 1 /end COMPU_METHOD
/begin COMPU_METHOD EngN "" RAT_FUNC "%6.3" "rpm" COEFFS 0 2 0 0 0 1 /end COMPU_METHOD
/begin COMPU_METHOD epDxoEa_vnwexaa_kAzmuka_q__14a0 "epDxoEa_vnwexaa_kAzmuka_q__14a0" RAT_FUNC "%6.3" "°C" COEFFS 0 16384 0 0 0 1 /end COMPU_METHOD
/begin COMPU_METHOD fak_q6p1035Em5 "" RAT_FUNC "%7.6" "-" COEFFS 0 65536 0 0 0 4 /end COMPU_METHOD
/begin COMPU_METHOD fak_sw_b4 "" RAT_FUNC "%6.5" "-" COEFFS 0 65536 0 0 0 8 /end COMPU_METHOD
/begin COMPU_METHOD fak_ub_b2 "" RAT_FUNC "%8.5" "-" COEFFS 0 256 0 0 0 2 /end COMPU_METHOD
/begin COMPU_METHOD fgjpsvb_fDqjECa_acgrbDd_n_dae__ "Def_bool" TAB_VERB "%6.3" "-" COMPU_TAB_REF Cmxqxpb_zopwEwb_acgrjwd___dae__ /end COMPU_METHOD
/begin COMPU_METHOD fpBesqd_hAxmiba_AAwtged_u__0oa0 "fpBesqd_hAxmiba_AAwtged_u__0oa0" RAT_FUNC "%6.3" "ul/s" COEFFS 0 1 0 0 0 1 /end COMPU_METHOD
/begin COMPU_METHOD FzbmlAa_gCtylrb_ckCqxAc_nR_6oa0 "FzbmlAa_gCtylrb_ckCqxAc_nR_6oa0" RAT_FUNC "%6.3" "-" COEFFS 0 65536 0 0 0 1 /end COMPU_METHOD
/begin COMPU_METHOD hcpywvc_dcqzDlc_FmDugua_s__aa0o "Def_q1" RAT_FUNC "%6.3" "s" COEFFS 0 1 0 0 0 1 /end COMPU_METHOD
/begin COMPU_METHOD ilxsavd_hkzmBfc_lAzCpAb_nR_1oa0 "ilxsavd_hkzmBfc_lAzCpAb_nR_1oa0" RAT_FUNC "%6.3" "-" COEFFS 0 16384 0 0 0 1 /end COMPU_METHOD
/begin COMPU_METHOD jgbhAma_smpAegb_hlEBAmd_k__0oa0 "jgbhAma_smpAegb_hlEBAmd_k__0oa0" RAT_FUNC "%6.3" "km/h" COEFFS 0 50 0 0 0 1 /end COMPU_METHOD
/begin COMPU_METHOD lCylrsa_tioqzad_Csrxmdd_f__o0a0 "lCylrsa_tioqzad_Csrxmdd_f__o0a0" RAT_FUNC "%6.3" "%/Ks" COEFFS 0 100 0 0 0 1 /end COMPU_METHOD
/begin COMPU_METHOD lFwocba_tlxgpab_wmDuExd_NCRoa0o "lFwocba_tlxgpab_wmDuExd_NCRoa0o" RAT_FUNC "%6.3" "Nm" COEFFS 0 1 0 0 0 1 /end COMPU_METHOD
/begin COMPU_METHOD n_sw_q0p5 "" RAT_FUNC "%6.3" "1/min" COEFFS 0 2 0 0 0 1 /end COMPU_METHOD
/begin COMPU_METHOD nmot_q40 "" RAT_FUNC "%6.1" "1/min" COEFFS 0 1 0 0 0 40 /end COMPU_METHOD
/begin COMPU_METHOD nmot_sw_q0p25 "" RAT_FUNC "%6.3" "1/min" COEFFS 0 1 0 0 0 0.25 /end COMPU_METHOD
/begin COMPU_METHOD nnxvdDd_vDnjvqd_FmDuEEa_f__aa0o "Def_q1" RAT_FUNC "%6.3" "%" COEFFS 0 1 0 0 0 1 /end COMPU_METHOD
/begin COMPU_METHOD p_uw_q0p078 "" RAT_FUNC "%6.4" "hPa" COEFFS 0 256 0 0 0 20 /end COMPU_METHOD
/begin COMPU_METHOD qDyjaAb_mviibsd_eCcdamc_bCRooa0 "qDyjaAb_mviibsd_eCcdamc_bCRooa0" RAT_FUNC "%6.3" "bar" COEFFS 0 20 0 0 0 1 /end COMPU_METHOD
/begin COMPU_METHOD raChrxc_kBtBrmb_FmDuEFa_n__aa0o "Def_q1" RAT_FUNC "%6.3" "-" COEFFS 0 1 0 0 0 1 /end COMPU_METHOD
/begin COMPU_METHOD rAdkuaa_wDllxja_BnDuEFa_n__aa0o "rAdkuaa_wDllxja_BnDuEFa_n__aa0o" RAT_FUNC "%6.3" "-" COEFFS 0 8 0 0 0 1 /end COMPU_METHOD
/begin COMPU_METHOD RBPtCel_p_0p002_1 "" RAT_FUNC "%6.4" "MPa" COEFFS 0 1000 0 0 0 2 /end COMPU_METHOD
/begin COMPU_METHOD RBPtCel_vol_1p0_1 "" RAT_FUNC "%6.2" "l" COEFFS 0 1 0 0 0 1 /end COMPU_METHOD
/begin COMPU_METHOD rel_q0p046875 "" RAT_FUNC "%6.4" "%" COEFFS 0 65536 0 0 0 3072 /end COMPU_METHOD
/begin COMPU_METHOD rel_q0p39 "" RAT_FUNC "%6.3" "%" COEFFS 0 256 0 0 0 100 /end COMPU_METHOD
/begin COMPU_METHOD rgduxyd_mlihaBb_gsCghzb_bCRa0a0 "rgduxyd_mlihaBb_gsCghzb_bCRa0a0" RAT_FUNC "%6.3" "bar" COEFFS 0 1000 0 0 0 1 /end COMPU_METHOD
/begin COMPU_METHOD ridxkCa_Dxvxtdc_CChkhgc_nR_1a0o "ridxkCa_Dxvxtdc_CChkhgc_nR_1a0o" RAT_FUNC "%6.3" "-" COEFFS 0 128 0 0 0 3 /end COMPU_METHOD
/begin COMPU_METHOD t10msxs_ub_b2p55 "" RAT_FUNC "%6.4" "s" COEFFS 0 1 0 0 0 0.01 /end COMPU_METHOD
/begin COMPU_METHOD temp_q0p0234_o273 "" RAT_FUNC "%6.1" "Grad C" COEFFS 0 1 273.15 0 0 0.0234375 /end COMPU_METHOD
/begin COMPU_METHOD temp_ub_q0p75_o48 "" RAT_FUNC "%6.2" "Grad C" COEFFS 0 1 48 0 0 0.75 /end COMPU_METHOD
/begin COMPU_METHOD vfyBdwd_ftexgja_BcFdiDd_fR_1a0o "Def_q0p0244" RAT_FUNC "%6.3" "%" COEFFS 0 1024 0 0 0 25 /end COMPU_METHOD
/begin COMPU_METHOD vfzg_sw_q0p00781 "" RAT_FUNC "%6.4" "km/h" COEFFS 0 1 0 0 0 0.0078125 /end COMPU_METHOD
/begin COMPU_METHOD vfzg_ub_q1p25 "" RAT_FUNC "%6.2" "km/h" COEFFS 0 1 0 0 0 1.25 /end COMPU_METHOD
/begin COMPU_METHOD wDvwtyd_Bhgozed_DCekdfb_nsttFSS "wDvwtyd_Bhgozed_DCekdfb_nsttFSS" TAB_VERB "%6.3" "-" COMPU_TAB_REF wDvwtyd_Bhgozed_DCekdfb_nsttFSS /end COMPU_METHOD
/begin COMPU_METHOD zBcBzad_vmoivka_mFzjCgc_lCRooa0 "zBcBzad_vmoivka_mFzjCgc_lCRooa0" RAT_FUNC "%6.3" "l/h" COEFFS 0 100 0 0 0 1 /end COMPU_METHOD
/begin COMPU_METHOD zyyxBpb_rEsnvtc_gktukCa_fR_5a0o "zyyxBpb_rEsnvtc_gktukCa_fR_5a0o" RAT_FUNC "%6.3" "%" COEFFS 0 512 0 0 0 25 /end COMPU_METHOD
/begin COMPU_VTAB ACCMPR_CODAVL_SY_Compu "" TAB_VERB 2 0 "FALSE" 1 "TRUE" /end COMPU_VTAB
/begin COMPU_VTAB Cmxqxpb_zopwEwb_acgrjwd___dae__ "Cmxqxpb_zopwEwb_acgrjwd___dae__" TAB_VERB 2 0 "false" 1 "true" DEFAULT_VALUE "Zustand nicht definiert" /end COMPU_VTAB
/begin COMPU_VTAB wDvwtyd_Bhgozed_DCekdfb_nsttFSS "wDvwtyd_Bhgozed_DCekdfb_nsttFSS" TAB_VERB 4 0 "CH_OFF" 1 "CH_1ES" 2 "CH_2ES" 3 "CH_3ES" DEFAULT_VALUE "Zustand nicht definiert" /end COMPU_VTAB
/begin RECORD_LAYOUT _REC_A1AXS_1_MBSE_S2 ALIGNMENT_BYTE 1 ALIGNMENT_WORD 2 ALIGNMENT_LONG 4 ALIGNMENT_FLOAT32_IEEE 4 ALIGNMENT_FLOAT64_IEEE 4 AXIS_PTS_X 1 SWORD INDEX_INCR DIRECT /end RECORD_LAYOUT
/begin RECORD_LAYOUT _REC_A1AXS_1_MBSE_U1 ALIGNMENT_BYTE 1 ALIGNMENT_WORD 2 ALIGNMENT_LONG 4 ALIGNMENT_FLOAT32_IEEE 4 ALIGNMENT_FLOAT64_IEEE 4 AXIS_PTS_X 1 UBYTE INDEX_INCR DIRECT /end RECORD_LAYOUT
/begin RECORD_LAYOUT _REC_A1AXS_1_MBSE_U2 ALIGNMENT_BYTE 1 ALIGNMENT_WORD 2 ALIGNMENT_LONG 4 ALIGNMENT_FLOAT32_IEEE 4 ALIGNMENT_FLOAT64_IEEE 4 AXIS_PTS_X 1 UWORD INDEX_INCR DIRECT /end RECORD_LAYOUT
/begin RECORD_LAYOUT _REC_A1CUR_1_MBSE_S1_S1 ALIGNMENT_BYTE 1 ALIGNMENT_WORD 2 ALIGNMENT_LONG 4 ALIGNMENT_FLOAT32_IEEE 4 ALIGNMENT_FLOAT64_IEEE 4 FNC_VALUES 1 SBYTE ROW_DIR DIRECT /end RECORD_LAYOUT
/begin RECORD_LAYOUT _REC_A1CUR_1_MBSE_S2_S1 ALIGNMENT_BYTE 1 ALIGNMENT_WORD 2 ALIGNMENT_LONG 4 ALIGNMENT_FLOAT32_IEEE 4 ALIGNMENT_FLOAT64_IEEE 4 FNC_VALUES 1 SWORD ROW_DIR DIRECT /end RECORD_LAYOUT
/begin RECORD_LAYOUT _REC_A1CUR_1_MBSE_U1_S1 ALIGNMENT_BYTE 1 ALIGNMENT_WORD 2 ALIGNMENT_LONG 4 ALIGNMENT_FLOAT32_IEEE 4 ALIGNMENT_FLOAT64_IEEE 4 FNC_VALUES 1 UBYTE ROW_DIR DIRECT /end RECORD_LAYOUT
/begin RECORD_LAYOUT _REC_A1CUR_1_MBSE_U2_S1 ALIGNMENT_BYTE 1 ALIGNMENT_WORD 2 ALIGNMENT_LONG 4 ALIGNMENT_FLOAT32_IEEE 4 ALIGNMENT_FLOAT64_IEEE 4 FNC_VALUES 1 UWORD ROW_DIR DIRECT /end RECORD_LAYOUT
/begin RECORD_LAYOUT Axis_Xs16 ALIGNMENT_BYTE 1 ALIGNMENT_WORD 2 ALIGNMENT_LONG 4 ALIGNMENT_FLOAT32_IEEE 4 ALIGNMENT_FLOAT64_IEEE 4 NO_AXIS_PTS_X 1 SWORD AXIS_PTS_X 2 SWORD INDEX_INCR DIRECT /end RECORD_LAYOUT
/begin RECORD_LAYOUT Axis_Xu16 ALIGNMENT_BYTE 1 ALIGNMENT_WORD 2 ALIGNMENT_LONG 4 ALIGNMENT_FLOAT32_IEEE 4 ALIGNMENT_FLOAT64_IEEE 4 NO_AXIS_PTS_X 1 UWORD AXIS_PTS_X 2 UWORD INDEX_INCR DIRECT /end RECORD_LAYOUT
/begin RECORD_LAYOUT Cur_Xu16Wu16 ALIGNMENT_BYTE 1 ALIGNMENT_WORD 2 ALIGNMENT_LONG 4 ALIGNMENT_FLOAT32_IEEE 4 ALIGNMENT_FLOAT64_IEEE 4 NO_AXIS_PTS_X 1 UWORD AXIS_PTS_X 2 UWORD INDEX_INCR DIRECT FNC_VALUES 3 UWORD COLUMN_DIR DIRECT /end RECORD_LAYOUT
/begin RECORD_LAYOUT Cur_Xu8Wu8 ALIGNMENT_BYTE 1 ALIGNMENT_WORD 2 ALIGNMENT_LONG 4 ALIGNMENT_FLOAT32_IEEE 4 ALIGNMENT_FLOAT64_IEEE 4 NO_AXIS_PTS_X 1 UBYTE AXIS_PTS_X 2 UBYTE INDEX_INCR DIRECT FNC_VALUES 3 UBYTE COLUMN_DIR DIRECT /end RECORD_LAYOUT
/begin RECORD_LAYOUT CurG_Ws16 ALIGNMENT_BYTE 1 ALIGNMENT_WORD 2 ALIGNMENT_LONG 4 ALIGNMENT_FLOAT32_IEEE 4 ALIGNMENT_FLOAT64_IEEE 4 FNC_VALUES 1 SWORD COLUMN_DIR DIRECT /end RECORD_LAYOUT
/begin RECORD_LAYOUT FklWUb ALIGNMENT_BYTE 1 ALIGNMENT_WORD 2 ALIGNMENT_LONG 4 ALIGNMENT_FLOAT32_IEEE 4 ALIGNMENT_FLOAT64_IEEE 4 FNC_VALUES 1 UBYTE COLUMN_DIR DIRECT /end RECORD_LAYOUT
/begin RECORD_LAYOUT KlAUbSstUbWUw_Static ALIGNMENT_BYTE 1 ALIGNMENT_WORD 2 ALIGNMENT_LONG 4 ALIGNMENT_FLOAT32_IEEE 4 ALIGNMENT_FLOAT64_IEEE 4 NO_AXIS_PTS_X 1 UBYTE AXIS_PTS_X 2 UBYTE INDEX_INCR DIRECT FNC_VALUES 3 UWORD COLUMN_DIR DIRECT STATIC_RECORD_LAYOUT /end RECORD_LAYOUT
/begin RECORD_LAYOUT KwUw ALIGNMENT_BYTE 1 ALIGNMENT_WORD 2 ALIGNMENT_LONG 4 ALIGNMENT_FLOAT32_IEEE 4 ALIGNMENT_FLOAT64_IEEE 4 FNC_VALUES 1 UWORD COLUMN_DIR DIRECT /end RECORD_LAYOUT
/begin RECORD_LAYOUT Map_Xs16Ys16Ws16 ALIGNMENT_BYTE 1 ALIGNMENT_WORD 2 ALIGNMENT_LONG 4 ALIGNMENT_FLOAT32_IEEE 4 ALIGNMENT_FLOAT64_IEEE 4 NO_AXIS_PTS_X 1 SWORD NO_AXIS_PTS_Y 2 SWORD AXIS_PTS_X 3 SWORD INDEX_INCR DIRECT AXIS_PTS_Y 4 SWORD INDEX_INCR DIRECT FNC_VALUES 5 SWORD COLUMN_DIR DIRECT /end RECORD_LAYOUT
/begin RECORD_LAYOUT RB_Curve_S16_U16_Static ALIGNMENT_BYTE 1 ALIGNMENT_WORD 2 ALIGNMENT_LONG 4 ALIGNMENT_FLOAT32_IEEE 4 ALIGNMENT_FLOAT64_IEEE 4 NO_AXIS_PTS_X 1 SWORD AXIS_PTS_X 2 SWORD INDEX_INCR DIRECT FNC_VALUES 3 UWORD COLUMN_DIR DIRECT STATIC_RECORD_LAYOUT /end RECORD_LAYOUT
/begin RECORD_LAYOUT RB_Curve_S8_U16_Static ALIGNMENT_BYTE 1 ALIGNMENT_WORD 2 ALIGNMENT_LONG 4 ALIGNMENT_FLOAT32_IEEE 4 ALIGNMENT_FLOAT64_IEEE 4 NO_AXIS_PTS_X 1 SBYTE AXIS_PTS_X 2 SBYTE INDEX_INCR DIRECT FNC_VALUES 3 UWORD COLUMN_DIR DIRECT STATIC_RECORD_LAYOUT /end RECORD_LAYOUT
/end MODULE
/end PROJECT
