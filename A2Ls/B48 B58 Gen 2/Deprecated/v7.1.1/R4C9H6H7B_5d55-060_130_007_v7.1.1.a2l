/*
The MG Flasher Team
8/1/2024
Created with optimization mode
*/ ASAP2_VERSION 1 60
/begin PROJECT MG1CS201_BX8TUE_R4C2H6H7B "MG1CS201"
/begin HEADER "" VERSION "R4C2H6H7B" PROJECT_NO MG1CS201_BX8TUE_R4C2H6H7B /end HEADER
/begin MODULE DIM ""
/begin MOD_PAR "MG1CS201" VERSION "R4C2H6H7B" CUSTOMER_NO "11" USER "APPLICATOR" ECU "MG1CS201" CPU_TYPE "IFX" EPK "56/1/MG1CS201/11/MG1CS201_BX8TUE_R4C2H6H7B//R4C2H6H7B///" ADDR_EPK 0x8075BC75
 /begin MEMORY_SEGMENT Pst80000000 "" RESERVED FLASH INTERN 0x80000000 0x20 -1 -1 -1 -1 -1 /end MEMORY_SEGMENT
 /begin MEMORY_SEGMENT Pst80000020 "" RESERVED FLASH INTERN 0x80000020 0xBFE0 -1 -1 -1 -1 -1 /end MEMORY_SEGMENT
 /begin MEMORY_SEGMENT Pst80010000 "" RESERVED FLASH INTERN 0x80010000 0x8000 -1 -1 -1 -1 -1 /end MEMORY_SEGMENT
 /begin MEMORY_SEGMENT Pst80080000 "" CODE FLASH INTERN 0x80080000 0x67F7E0 -1 -1 -1 -1 -1
  /begin IF_DATA ETK_XETK
   /begin ETK_XETK_ACCESS SERIAL_INTERFACE /end ETK_XETK_ACCESS
  /end IF_DATA
  /begin IF_DATA XCPplus 0x0102
   /begin SEGMENT 0x0 0x1 0x0 0x0 0x0 /begin CHECKSUM XCP_CRC_32 /end CHECKSUM
    /begin PAGE 0x0 ECU_ACCESS_WITH_XCP_ONLY XCP_READ_ACCESS_WITH_ECU_ONLY XCP_WRITE_ACCESS_NOT_ALLOWED /end PAGE
   /end SEGMENT
  /end IF_DATA
 /end MEMORY_SEGMENT
 /begin MEMORY_SEGMENT Pst806FF7E0 "" RESERVED FLASH INTERN 0x806FF7E0 0x520 -1 -1 -1 -1 -1 /end MEMORY_SEGMENT
 /begin MEMORY_SEGMENT Pst807FF7E0 "" RESERVED FLASH INTERN 0x807FF7E0 0x520 -1 -1 -1 -1 -1
  /begin IF_DATA ETK_XETK WRITE_AT_DATA_UPDATE USE_FILE ETK_XETK_REF 1 2 3 4 /end IF_DATA
 /end MEMORY_SEGMENT
 /begin MEMORY_SEGMENT Pst80028000 "" CODE FLASH INTERN 0x80028000 0x37D00 -1 -1 -1 -1 -1
  /begin IF_DATA ETK_XETK
   /begin ETK_XETK_ACCESS SERIAL_INTERFACE /end ETK_XETK_ACCESS
  /end IF_DATA
  /begin IF_DATA XCPplus 0x0102
   /begin SEGMENT 0x2 0x1 0x0 0x0 0x0 /begin CHECKSUM XCP_CRC_32 /end CHECKSUM
    /begin PAGE 0x0 ECU_ACCESS_WITH_XCP_ONLY XCP_READ_ACCESS_WITH_ECU_ONLY XCP_WRITE_ACCESS_NOT_ALLOWED /end PAGE
   /end SEGMENT
  /end IF_DATA
 /end MEMORY_SEGMENT
 /begin MEMORY_SEGMENT Pst80018100 "" RESERVED FLASH INTERN 0x80018100 0x3F00 -1 -1 -1 -1 -1 /end MEMORY_SEGMENT
 /begin MEMORY_SEGMENT Pst80060100 "" RESERVED FLASH INTERN 0x80060100 0x1FF00 -1 -1 -1 -1 -1 /end MEMORY_SEGMENT
 /begin MEMORY_SEGMENT Pst80018000 "" RESERVED FLASH INTERN 0x80018000 0x100 -1 -1 -1 -1 -1 /end MEMORY_SEGMENT
 /begin MEMORY_SEGMENT Pst80060000 "" RESERVED FLASH INTERN 0x80060000 0x100 -1 -1 -1 -1 -1 /end MEMORY_SEGMENT
 /begin MEMORY_SEGMENT Pst80020000 "" RESERVED FLASH INTERN 0x80020000 0x300 -1 -1 -1 -1 -1 /end MEMORY_SEGMENT
 /begin MEMORY_SEGMENT Pst8005FD00 "" RESERVED FLASH INTERN 0x8005FD00 0x300 -1 -1 -1 -1 -1 /end MEMORY_SEGMENT
 /begin MEMORY_SEGMENT Pst806FFD00 "" RESERVED FLASH INTERN 0x806FFD00 0x300 -1 -1 -1 -1 -1 /end MEMORY_SEGMENT
 /begin MEMORY_SEGMENT Pst807FFD08 "" RESERVED FLASH INTERN 0x807FFD08 0x104 -1 -1 -1 -1 -1 /end MEMORY_SEGMENT
 /begin MEMORY_SEGMENT Pst807FFFDC "" RESERVED FLASH INTERN 0x807FFFDC 0x24 -1 -1 -1 -1 -1 /end MEMORY_SEGMENT
 /begin MEMORY_SEGMENT Dst80700000 "" DATA FLASH INTERN 0x80700000 0xFF7E0 -1 -1 -1 -1 -1
  /begin IF_DATA ETK_XETK
   /begin ETK_XETK_ACCESS SERIAL_INTERFACE /end ETK_XETK_ACCESS
  /end IF_DATA
  /begin IF_DATA XCPplus 0x0102
   /begin SEGMENT 0x1 0x2 0x0 0x0 0x0 /begin CHECKSUM XCP_CRC_32 /end CHECKSUM
    /begin PAGE 0x0 ECU_ACCESS_DONT_CARE XCP_READ_ACCESS_DONT_CARE XCP_WRITE_ACCESS_NOT_ALLOWED /end PAGE
    /begin PAGE 0x1 ECU_ACCESS_DONT_CARE XCP_READ_ACCESS_DONT_CARE XCP_WRITE_ACCESS_WITH_ECU_ONLY /end PAGE
   /end SEGMENT
  /end IF_DATA
 /end MEMORY_SEGMENT
 /begin MEMORY_SEGMENT Dst807FFD00 "" DATA FLASH INTERN 0x807FFD00 0x8 -1 -1 -1 -1 -1
  /begin IF_DATA ETK_XETK
   /begin ETK_XETK_ACCESS SERIAL_INTERFACE /end ETK_XETK_ACCESS
  /end IF_DATA
  /begin IF_DATA XCPplus 0x0102
   /begin SEGMENT 0x3 0x2 0x0 0x0 0x0 /begin CHECKSUM XCP_CRC_32 /end CHECKSUM
    /begin PAGE 0x0 ECU_ACCESS_DONT_CARE XCP_READ_ACCESS_DONT_CARE XCP_WRITE_ACCESS_NOT_ALLOWED /end PAGE
    /begin PAGE 0x1 ECU_ACCESS_DONT_CARE XCP_READ_ACCESS_DONT_CARE XCP_WRITE_ACCESS_WITH_ECU_ONLY /end PAGE
   /end SEGMENT
  /end IF_DATA
 /end MEMORY_SEGMENT
 /begin MEMORY_SEGMENT Dst807FFE0C "" DATA FLASH INTERN 0x807FFE0C 0x1D0 -1 -1 -1 -1 -1
  /begin IF_DATA ETK_XETK
   /begin ETK_XETK_ACCESS SERIAL_INTERFACE /end ETK_XETK_ACCESS
  /end IF_DATA
  /begin IF_DATA XCPplus 0x0102
   /begin SEGMENT 0x4 0x2 0x0 0x0 0x0 /begin CHECKSUM XCP_CRC_32 /end CHECKSUM
    /begin PAGE 0x0 ECU_ACCESS_DONT_CARE XCP_READ_ACCESS_DONT_CARE XCP_WRITE_ACCESS_NOT_ALLOWED /end PAGE
    /begin PAGE 0x1 ECU_ACCESS_DONT_CARE XCP_READ_ACCESS_DONT_CARE XCP_WRITE_ACCESS_WITH_ECU_ONLY /end PAGE
   /end SEGMENT
  /end IF_DATA
 /end MEMORY_SEGMENT
 /begin MEMORY_SEGMENT RamAFE70000 "" VARIABLES RAM INTERN 0xAFE70000 0x8000 -1 -1 -1 -1 -1
  /begin IF_DATA ETK_XETK
   /begin ETK_XETK_ACCESS SERIAL_INTERFACE /end ETK_XETK_ACCESS
  /end IF_DATA
  /begin IF_DATA XCPplus 0x0102
   /begin SEGMENT 0x5 0x0 0x0 0x0 0x0 /end SEGMENT
  /end IF_DATA
 /end MEMORY_SEGMENT
 /begin MEMORY_SEGMENT RamB0000000 "" VARIABLES RAM INTERN 0xB0000000 0x8000 -1 -1 -1 -1 -1
  /begin IF_DATA ETK_XETK
   /begin ETK_XETK_ACCESS SERIAL_INTERFACE /end ETK_XETK_ACCESS
  /end IF_DATA
  /begin IF_DATA XCPplus 0x0102
   /begin SEGMENT 0x6 0x0 0x0 0x0 0x0 /end SEGMENT
  /end IF_DATA
 /end MEMORY_SEGMENT
 /begin MEMORY_SEGMENT Ram70100000 "" VARIABLES RAM INTERN 0x70100000 0x8000 -1 -1 -1 -1 -1
  /begin IF_DATA ETK_XETK
   /begin ETK_XETK_ACCESS SERIAL_INTERFACE /end ETK_XETK_ACCESS
  /end IF_DATA
  /begin IF_DATA XCPplus 0x0102
   /begin SEGMENT 0x7 0x0 0x0 0x0 0x0 /end SEGMENT
  /end IF_DATA
 /end MEMORY_SEGMENT
 /begin MEMORY_SEGMENT Ram60100000 "" VARIABLES RAM INTERN 0x60100000 0x8000 -1 -1 -1 -1 -1
  /begin IF_DATA ETK_XETK
   /begin ETK_XETK_ACCESS SERIAL_INTERFACE /end ETK_XETK_ACCESS
  /end IF_DATA
  /begin IF_DATA XCPplus 0x0102
   /begin SEGMENT 0x8 0x0 0x0 0x0 0x0 /end SEGMENT
  /end IF_DATA
 /end MEMORY_SEGMENT
 /begin MEMORY_SEGMENT Ram50100000 "" VARIABLES RAM INTERN 0x50100000 0x8000 -1 -1 -1 -1 -1
  /begin IF_DATA ETK_XETK
   /begin ETK_XETK_ACCESS SERIAL_INTERFACE /end ETK_XETK_ACCESS
  /end IF_DATA
  /begin IF_DATA XCPplus 0x0102
   /begin SEGMENT 0x9 0x0 0x0 0x0 0x0 /end SEGMENT
  /end IF_DATA
 /end MEMORY_SEGMENT
 /begin MEMORY_SEGMENT Ram70000000 "" VARIABLES RAM INTERN 0x70000000 0x1E000 -1 -1 -1 -1 -1
  /begin IF_DATA ETK_XETK
   /begin ETK_XETK_ACCESS SERIAL_INTERFACE /end ETK_XETK_ACCESS
  /end IF_DATA
  /begin IF_DATA XCPplus 0x0102
   /begin SEGMENT 0xA 0x0 0x0 0x0 0x0 /end SEGMENT
  /end IF_DATA
 /end MEMORY_SEGMENT
 /begin MEMORY_SEGMENT Ram60000000 "" VARIABLES RAM INTERN 0x60000000 0x3C000 -1 -1 -1 -1 -1
  /begin IF_DATA ETK_XETK
   /begin ETK_XETK_ACCESS SERIAL_INTERFACE /end ETK_XETK_ACCESS
  /end IF_DATA
  /begin IF_DATA XCPplus 0x0102
   /begin SEGMENT 0xB 0x0 0x0 0x0 0x0 /end SEGMENT
  /end IF_DATA
 /end MEMORY_SEGMENT
 /begin MEMORY_SEGMENT Ram50000000 "" VARIABLES RAM INTERN 0x50000000 0x3C000 -1 -1 -1 -1 -1
  /begin IF_DATA ETK_XETK
   /begin ETK_XETK_ACCESS SERIAL_INTERFACE /end ETK_XETK_ACCESS
  /end IF_DATA
  /begin IF_DATA XCPplus 0x0102
   /begin SEGMENT 0xC 0x0 0x0 0x0 0x0 /end SEGMENT
  /end IF_DATA
 /end MEMORY_SEGMENT
 /begin MEMORY_SEGMENT RamBF1F0E70 "" VARIABLES RAM INTERN 0xBF1F0E70 0xF190 -1 -1 -1 -1 -1
  /begin IF_DATA ETK_XETK
   /begin ETK_XETK_ACCESS SERIAL_INTERFACE /end ETK_XETK_ACCESS
  /end IF_DATA
  /begin IF_DATA XCPplus 0x0102
   /begin SEGMENT 0xD 0x0 0x0 0x0 0x0 /end SEGMENT
  /end IF_DATA
 /end MEMORY_SEGMENT
 /begin MEMORY_SEGMENT RamBF1E0000 "" CALIBRATION_VARIABLES RAM INTERN 0xBF1E0000 0x10E70 -1 -1 -1 -1 -1
  /begin IF_DATA ETK_XETK
   /begin ETK_XETK_ACCESS SERIAL_INTERFACE /end ETK_XETK_ACCESS
  /end IF_DATA
  /begin IF_DATA XCPplus 0x0102
   /begin SEGMENT 0xE 0x0 0x0 0x0 0x0 /end SEGMENT
  /end IF_DATA
 /end MEMORY_SEGMENT
/end MOD_PAR
/begin MOD_COMMON "" BYTE_ORDER MSB_LAST DEPOSIT ABSOLUTE ALIGNMENT_BYTE 1 ALIGNMENT_WORD 2 ALIGNMENT_LONG 4 ALIGNMENT_FLOAT32_IEEE 4 ALIGNMENT_FLOAT64_IEEE 4 /end MOD_COMMON
/begin AXIS_PTS Antilag_BMWtchctr_p_DifCrtnPp_Ax___MGF_CC_PF "AXX_KF_PDIFF_ATLR_P" 0x8072159E BMWtchbas_p_Dif_sw _REC_A1AXS_1_MBSE_S2 8191.875 BMW_p_sw_q0p125_hPa 12 -4096 4095.875 FORMAT "%10.3" DEPOSIT ABSOLUTE /end AXIS_PTS
/begin AXIS_PTS Antilag_BMWtchctr_p_DifCrtnPp_Ay___MGF_CC_PF "AXY_KF_PDIFF_ATLR_P" 0x807C0002 BMWtchsp_mf_Ex_uw _REC_A1AXS_1_MBSE_U2 2047.96875 CByjozc_eCmpBAb_pljBAmd_k__0oa0 6 0 2047.96875 FORMAT "%10.3" DEPOSIT ABSOLUTE /end AXIS_PTS
/begin AXIS_PTS Antilag_BMWtchctr_p_DifCrtnPpDyn_Ax___MGF_CC_PF "AXX_KF_PDIFF_ATLR_P" 0x807215C2 BMWtchbas_p_Dif_sw _REC_A1AXS_1_MBSE_S2 8191.875 BMW_p_sw_q0p125_hPa 12 -4096 4095.875 FORMAT "%10.3" DEPOSIT ABSOLUTE /end AXIS_PTS
/begin AXIS_PTS Antilag_BMWtchctr_p_DifCrtnPpDyn_Ay___MGF_CC_PF "AXY_KF_PDIFF_ATLR_P" 0x807C009E BMWtchsp_mf_Ex_uw _REC_A1AXS_1_MBSE_U2 2047.96875 CByjozc_eCmpBAb_pljBAmd_k__0oa0 6 0 2047.96875 FORMAT "%10.3" DEPOSIT ABSOLUTE /end AXIS_PTS
/begin AXIS_PTS Antilag_BMWtchctr_pwr_Pctl_Ax___MGF_CC_PF "AXX_KF_ATL_PVERD" 0x807C02C2 BMWtchsp_rat_p_CmprLim_uw _REC_A1AXS_1_MBSE_U2 7.9998779296875 acriqBc_tfkBqod_ocgjxzc_nR_8oa0 20 0 7.9998779296875 FORMAT "%11.4" DEPOSIT ABSOLUTE /end AXIS_PTS
/begin AXIS_PTS Antilag_BMWtchctr_pwr_Pctl_Ay___MGF_CC_PF "AXY_KF_ATL_PVERD" 0x807C02EA BMWtchsp_mf_CmprNorm_uw _REC_A1AXS_1_MBSE_U2 2047.96875 CByjozc_eCmpBAb_pljBAmd_k__0oa0 16 0 2047.96875 FORMAT "%10.3" DEPOSIT ABSOLUTE /end AXIS_PTS
/begin AXIS_PTS Antilag_BMWtqe_gra_NMaxEngLimd_Ax___MGF_CC_PF "Torque Engine(Moment Verbrennungsmotor) gradient(Steigung) Speed in rpm( Drezahl ) maximum(Maximum, Max) engine(Verbrennungsmotor) limited(begrenzt) axis x direction(X-Achse)" 0x80752EEF BMWtqe_idx_SpdMaxLimr_ub _REC_A1AXS_1_MBSE_U1 255 raChrxc_kBtBrmb_FmDuEFa_n__aa0o 10 0 255 FORMAT "%3.0" DEPOSIT ABSOLUTE /end AXIS_PTS
/begin AXIS_PTS Antilag_IgnRoll_X_Axis___MGF_CC_PF "Ignition setpoint: Engine speed [Nkw] vs Boost actual [Ps]. (CCv7.1.1)" 0x807C08E8 Nkw ___MGF_CC_Antilag_Ign_Roll_xAxis 0 caoddzd_oAjpfzb_cAcEEha_1nR_oa0 10 -32768 32767 EXTENDED_LIMITS 0 0 /end AXIS_PTS
/begin AXIS_PTS Antilag_IgnRoll_Y_Axis___MGF_CC_PF "Ignition setpoint: Engine speed [Nkw] vs Boost actual [Ps]. (CCv7.1.1)" 0x807C09C8 Ps ___MGF_CC_Antilag_Ign_Roll_xAxis 0 BMW_p_sw_q0p125_hPa 10 -32768 32767 EXTENDED_LIMITS 0 0 /end AXIS_PTS
/begin AXIS_PTS Antilag_IgnStand_X_Axis___MGF_CC_PF "Ignition setpoint: Engine speed [Nkw] vs Boost actual [Ps]. (CCv7.1.1)" 0x807C08FC Nkw ___MGF_CC_Antilag_Ign_Roll_xAxis 0 caoddzd_oAjpfzb_cAcEEha_1nR_oa0 10 -32768 32767 EXTENDED_LIMITS 0 0 /end AXIS_PTS
/begin AXIS_PTS Antilag_IgnStand_Y_Axis___MGF_CC_PF "Ignition setpoint: Engine speed [Nkw] vs Boost actual [Ps]. (CCv7.1.1)" 0x807C09DC Ps ___MGF_CC_Antilag_Ign_Roll_xAxis 0 BMW_p_sw_q0p125_hPa 10 -32768 32767 EXTENDED_LIMITS 0 0 /end AXIS_PTS
/begin AXIS_PTS Antilag_LambdaRoll_X_Axis___MGF_CC_PF "Fueling setpoint: Engine speed [Nkw] vs Exhaust Gas Temperature [EGT] before turbine [Tabg_vl_xab]. (CCv7.1.1)" 0x807C0910 Nkw ___MGF_CC_Antilag_Ign_Roll_xAxis 0 caoddzd_oAjpfzb_cAcEEha_1nR_oa0 10 -32768 32767 EXTENDED_LIMITS 0 0 /end AXIS_PTS
/begin AXIS_PTS Antilag_LambdaRoll_Y_Axis___MGF_CC_PF "Fueling setpoint: Engine speed [Nkw] vs Exhaust Gas Temperature [EGT] before turbine [Tabg_vl_xab]. (CCv7.1.1)" 0x807C09F0 Tabg_vl_xab ___MGF_CC_Antilag_Ign_Roll_xAxis 0 BMW_q0p1_degC 10 -32768 32767 EXTENDED_LIMITS 0 0 /end AXIS_PTS
/begin AXIS_PTS Antilag_LambdaStand_X_Axis___MGF_CC_PF "Fueling setpoint: Engine speed [Nkw] vs Exhaust Gas Temperature [EGT] before turbine [Tabg_vl_xab]. (CCv7.1.1)" 0x807C0924 Nkw ___MGF_CC_Antilag_Ign_Roll_xAxis 0 caoddzd_oAjpfzb_cAcEEha_1nR_oa0 10 -32768 32767 EXTENDED_LIMITS 0 0 /end AXIS_PTS
/begin AXIS_PTS Antilag_LambdaStand_Y_Axis___MGF_CC_PF "Fueling setpoint: Engine speed [Nkw] vs Exhaust Gas Temperature [EGT] before turbine [Tabg_vl_xab]. (CCv7.1.1)" 0x807C0A04 Tabg_vl_xab ___MGF_CC_Antilag_Ign_Roll_xAxis 0 BMW_q0p1_degC 10 -32768 32767 EXTENDED_LIMITS 0 0 /end AXIS_PTS
/begin AXIS_PTS AXX_KF_FDZWT_PF1 "AXX_KF_FDZWT_PF1" 0x80730302 Tmot _REC_A1AXS_1_MBSE_S2 655.35 DchEpAd_DBCFgoa_Ckhahgc_q__aoa0 6 -327.68 327.67 FORMAT "%7.2" DEPOSIT ABSOLUTE /end AXIS_PTS
/begin AXIS_PTS AXX_KF_FDZWT_PF2 "AXX_KF_FDZWT_PF2" 0x807302F6 Tmot _REC_A1AXS_1_MBSE_S2 655.35 DchEpAd_DBCFgoa_Ckhahgc_q__aoa0 6 -327.68 327.67 FORMAT "%7.2" DEPOSIT ABSOLUTE /end AXIS_PTS
/begin AXIS_PTS AXX_KF_FRKKORRF_1 "AXX_KF_FRKKORRF_1" 0x8071132C Nkw _REC_A1AXS_1_MBSE_S2 65535 caoddzd_oAjpfzb_cAcEEha_1nR_oa0 16 -32768 32767 FORMAT "%5.0" DEPOSIT ABSOLUTE /end AXIS_PTS
/begin AXIS_PTS AXX_KF_MDIOP_1_TQE "Filling / Filling Rf" 0x80726C48 NO_INPUT_QUANTITY _REC_A1AXS_1_MBSE_S2 655.35 CgkBooc_wkiDfEd_Czglhgc_fR_1a0o 18 -327.68 327.67 FORMAT "%6.2" DEPOSIT ABSOLUTE /end AXIS_PTS
/begin AXIS_PTS AXX_KF_MDIOP_1_TQE___MGF_CC_PF_Slot0 "Filling / Filling Rf (Slot 0, OEM Address)" 0x80726C48 NO_INPUT_QUANTITY _REC_A1AXS_1_MBSE_S2 655.35 CgkBooc_wkiDfEd_Czglhgc_fR_1a0o 18 -327.68 327.67 FORMAT "%6.2" DEPOSIT ABSOLUTE /end AXIS_PTS
/begin AXIS_PTS AXX_KF_MDIOP_1_TQE___MGF_CC_PF_Slot1 "Filling / Filling Rf (Slot 1, CCv7.1.1, Pump Fuel)" 0x807C0938 NO_INPUT_QUANTITY _REC_A1AXS_1_MBSE_S2 655.35 CgkBooc_wkiDfEd_Czglhgc_fR_1a0o 18 -327.68 327.67 FORMAT "%6.2" DEPOSIT ABSOLUTE /end AXIS_PTS
/begin AXIS_PTS AXX_KF_MDIOP_1_TQE___MGF_CC_PF_Slot2 "Filling / Filling Rf (Slot 2, CCv7.1.1, Pump Fuel)" 0x807C095C NO_INPUT_QUANTITY _REC_A1AXS_1_MBSE_S2 655.35 CgkBooc_wkiDfEd_Czglhgc_fR_1a0o 18 -327.68 327.67 FORMAT "%6.2" DEPOSIT ABSOLUTE /end AXIS_PTS
/begin AXIS_PTS AXX_KF_MDIOP_1_TQE___MGF_CC_PF_Slot3 "Filling / Filling Rf (Slot 3, CCv7.1.1, Pump Fuel)" 0x807C0980 NO_INPUT_QUANTITY _REC_A1AXS_1_MBSE_S2 655.35 CgkBooc_wkiDfEd_Czglhgc_fR_1a0o 18 -327.68 327.67 FORMAT "%6.2" DEPOSIT ABSOLUTE /end AXIS_PTS
/begin AXIS_PTS AXX_KF_MDIOP_1_TQE___MGF_CC_PF_Slot4 "Filling / Filling Rf (Slot 4, CCv7.1.1, Pump Fuel)" 0x807C09A4 NO_INPUT_QUANTITY _REC_A1AXS_1_MBSE_S2 655.35 CgkBooc_wkiDfEd_Czglhgc_fR_1a0o 18 -327.68 327.67 FORMAT "%6.2" DEPOSIT ABSOLUTE /end AXIS_PTS
/begin AXIS_PTS AXX_KF_ZW_PF1 "AXX_KF_ZW_PF1" 0x80730144 Nkw _REC_A1AXS_1_MBSE_S2 65535 caoddzd_oAjpfzb_cAcEEha_1nR_oa0 20 -32768 32767 FORMAT "%5.0" DEPOSIT ABSOLUTE /end AXIS_PTS
/begin AXIS_PTS AXX_KF_ZW_PF2 "AXX_KF_ZW_PF2" 0x8073011C Nkw _REC_A1AXS_1_MBSE_S2 65535 caoddzd_oAjpfzb_cAcEEha_1nR_oa0 20 -32768 32767 FORMAT "%5.0" DEPOSIT ABSOLUTE /end AXIS_PTS
/begin AXIS_PTS AXX_KF_ZW_S_PF1 "AXX_KF_ZW_S_PF1" 0x807300F4 Nkw _REC_A1AXS_1_MBSE_S2 65535 caoddzd_oAjpfzb_cAcEEha_1nR_oa0 20 -32768 32767 FORMAT "%5.0" DEPOSIT ABSOLUTE /end AXIS_PTS
/begin AXIS_PTS AXX_KF_ZW_S_PF2 "AXX_KF_ZW_S_PF2" 0x807300CC Nkw _REC_A1AXS_1_MBSE_S2 65535 caoddzd_oAjpfzb_cAcEEha_1nR_oa0 20 -32768 32767 FORMAT "%5.0" DEPOSIT ABSOLUTE /end AXIS_PTS
/begin AXIS_PTS AXX_KF_ZW_VP_PF1 "AXX_KF_ZW_VP_PF1" 0x80747A88 Nkw _REC_A1AXS_1_MBSE_S2 65535 caoddzd_oAjpfzb_cAcEEha_1nR_oa0 20 -32768 32767 FORMAT "%5.0" DEPOSIT ABSOLUTE /end AXIS_PTS
/begin AXIS_PTS AXX_KF_ZW_VP_PF2 "AXX_KF_ZW_VP_PF2" 0x80747A60 Nkw _REC_A1AXS_1_MBSE_S2 65535 caoddzd_oAjpfzb_cAcEEha_1nR_oa0 20 -32768 32767 FORMAT "%5.0" DEPOSIT ABSOLUTE /end AXIS_PTS
/begin AXIS_PTS AXX_KF_ZWMIN_KSOT "AXX_KF_ZWMIN_KSOT" 0x80730C56 Nkw _REC_A1AXS_1_MBSE_S2 65535 caoddzd_oAjpfzb_cAcEEha_1nR_oa0 8 -32768 32767 FORMAT "%5.0" DEPOSIT ABSOLUTE /end AXIS_PTS
/begin AXIS_PTS AXX_KF_ZWMIN_WSOT "AXX_KF_ZWMIN_WSOT" 0x80730C46 Nkw _REC_A1AXS_1_MBSE_S2 65535 caoddzd_oAjpfzb_cAcEEha_1nR_oa0 8 -32768 32767 FORMAT "%5.0" DEPOSIT ABSOLUTE /end AXIS_PTS
/begin AXIS_PTS AXX_KL_RF_MAX "Nkw" 0x8071B8DC NO_INPUT_QUANTITY _REC_A1AXS_1_MBSE_S2 65535 caoddzd_oAjpfzb_cAcEEha_1nR_oa0 12 -32768 32767 FORMAT "%5.0" DEPOSIT ABSOLUTE /end AXIS_PTS
/begin AXIS_PTS AXX_KL_RF_MAX_UESP "Nkw" 0x8071B8C4 NO_INPUT_QUANTITY _REC_A1AXS_1_MBSE_S2 65535 caoddzd_oAjpfzb_cAcEEha_1nR_oa0 12 -32768 32767 FORMAT "%5.0" DEPOSIT ABSOLUTE /end AXIS_PTS
/begin AXIS_PTS AXY_KF_FDZWT_PF1 "AXY_KF_FDZWT_PF1" 0x807302EA Tans _REC_A1AXS_1_MBSE_S2 6553.5 BMW_q0p1_degC 6 -3276.8 3276.7 FORMAT "%6.1" DEPOSIT ABSOLUTE /end AXIS_PTS
/begin AXIS_PTS AXY_KF_FDZWT_PF2 "AXY_KF_FDZWT_PF2" 0x807302DE Tans _REC_A1AXS_1_MBSE_S2 6553.5 BMW_q0p1_degC 6 -3276.8 3276.7 FORMAT "%6.1" DEPOSIT ABSOLUTE /end AXIS_PTS
/begin AXIS_PTS AXY_KF_FRKKORRF_1 "AXY_KF_FRKKORRF_1" 0x807112F4 Rf _REC_A1AXS_1_MBSE_S2 655.35 CgkBooc_wkiDfEd_Czglhgc_fR_1a0o 16 -327.68 327.67 FORMAT "%7.2" DEPOSIT ABSOLUTE /end AXIS_PTS
/begin AXIS_PTS AXY_KF_MDIOP_1_TQE "Speed / rpm commercial vehicle" 0x80726C20 NO_INPUT_QUANTITY _REC_A1AXS_1_MBSE_S2 65535 caoddzd_oAjpfzb_cAcEEha_1nR_oa0 20 -32768 32767 FORMAT "%5.0" DEPOSIT ABSOLUTE /end AXIS_PTS
/begin AXIS_PTS AXY_KF_MDIOP_1_TQE___MGF_CC "Speed / rpm commercial vehicle (CCv7.1.1)" 0x80726C20 NO_INPUT_QUANTITY _REC_A1AXS_1_MBSE_S2 65535 caoddzd_oAjpfzb_cAcEEha_1nR_oa0 20 -32768 32767 FORMAT "%5.0" DEPOSIT ABSOLUTE /end AXIS_PTS
/begin AXIS_PTS AXY_KF_ZW_PF1 "AXY_KF_ZW_PF1" 0x8073007C NO_INPUT_QUANTITY _REC_A1AXS_1_MBSE_S2 655.35 CgkBooc_wkiDfEd_Czglhgc_fR_1a0o 20 -327.68 327.67 FORMAT "%9.2" DEPOSIT ABSOLUTE /end AXIS_PTS
/begin AXIS_PTS AXY_KF_ZW_PF2 "AXY_KF_ZW_PF2" 0x80730054 NO_INPUT_QUANTITY _REC_A1AXS_1_MBSE_S2 655.35 CgkBooc_wkiDfEd_Czglhgc_fR_1a0o 20 -327.68 327.67 FORMAT "%9.2" DEPOSIT ABSOLUTE /end AXIS_PTS
/begin AXIS_PTS AXY_KF_ZW_S_PF1 "AXY_KF_ZW_S_PF1" 0x8073002C NO_INPUT_QUANTITY _REC_A1AXS_1_MBSE_S2 655.35 CgkBooc_wkiDfEd_Czglhgc_fR_1a0o 20 -327.68 327.67 FORMAT "%9.2" DEPOSIT ABSOLUTE /end AXIS_PTS
/begin AXIS_PTS AXY_KF_ZW_S_PF2 "AXY_KF_ZW_S_PF2" 0x80730004 NO_INPUT_QUANTITY _REC_A1AXS_1_MBSE_S2 655.35 CgkBooc_wkiDfEd_Czglhgc_fR_1a0o 20 -327.68 327.67 FORMAT "%9.2" DEPOSIT ABSOLUTE /end AXIS_PTS
/begin AXIS_PTS AXY_KF_ZW_VP_PF1 "AXY_KF_ZW_VP_PF1" 0x80747A40 Rf_zwv _REC_A1AXS_1_MBSE_S2 655.35 CgkBooc_wkiDfEd_Czglhgc_fR_1a0o 16 -327.68 327.67 FORMAT "%9.2" DEPOSIT ABSOLUTE /end AXIS_PTS
/begin AXIS_PTS AXY_KF_ZW_VP_PF2 "AXY_KF_ZW_VP_PF2" 0x80747A20 Rf_zwv _REC_A1AXS_1_MBSE_S2 655.35 CgkBooc_wkiDfEd_Czglhgc_fR_1a0o 16 -327.68 327.67 FORMAT "%9.2" DEPOSIT ABSOLUTE /end AXIS_PTS
/begin AXIS_PTS AXY_KF_ZWMIN_KSOT "AXY_KF_ZWMIN_KSOT" 0x80730C16 NO_INPUT_QUANTITY _REC_A1AXS_1_MBSE_S2 655.35 CgkBooc_wkiDfEd_Czglhgc_fR_1a0o 8 -327.68 327.67 FORMAT "%9.4" DEPOSIT ABSOLUTE /end AXIS_PTS
/begin AXIS_PTS AXY_KF_ZWMIN_WSOT "AXY_KF_ZWMIN_WSOT" 0x80730C06 NO_INPUT_QUANTITY _REC_A1AXS_1_MBSE_S2 655.35 CgkBooc_wkiDfEd_Czglhgc_fR_1a0o 8 -327.68 327.67 FORMAT "%9.4" DEPOSIT ABSOLUTE /end AXIS_PTS
/begin AXIS_PTS BMWtchctr_p_DifCrtnPp_Ax "AXX_KF_PDIFF_ATLR_P" 0x8072159E BMWtchbas_p_Dif_sw _REC_A1AXS_1_MBSE_S2 8191.875 BMW_p_sw_q0p125_hPa 12 -4096 4095.875 FORMAT "%10.3" DEPOSIT ABSOLUTE /end AXIS_PTS
/begin AXIS_PTS BMWtchctr_p_DifCrtnPp_Ay___MGF_CC_PF_Slot0 "AXY_KF_PDIFF_ATLR_P (Slot 0, OEM Address)" 0x80721592 BMWtchsp_mf_Ex_uw _REC_A1AXS_1_MBSE_U2 2047.96875 CByjozc_eCmpBAb_pljBAmd_k__0oa0 6 0 2047.96875 FORMAT "%10.3" DEPOSIT ABSOLUTE /end AXIS_PTS
/begin AXIS_PTS BMWtchctr_p_DifCrtnPp_Ay___MGF_CC_PF_Slot1 "AXY_KF_PDIFF_ATLR_P (Slot 1, CCv7.1.1, Pump Fuel)" 0x807C0A18 BMWtchsp_mf_Ex_uw _REC_A1AXS_1_MBSE_U2 2047.96875 CByjozc_eCmpBAb_pljBAmd_k__0oa0 6 0 2047.96875 FORMAT "%10.3" DEPOSIT ABSOLUTE /end AXIS_PTS
/begin AXIS_PTS BMWtchctr_p_DifCrtnPp_Ay___MGF_CC_PF_Slot2 "AXY_KF_PDIFF_ATLR_P (Slot 2, CCv7.1.1, Pump Fuel)" 0x807C0A24 BMWtchsp_mf_Ex_uw _REC_A1AXS_1_MBSE_U2 2047.96875 CByjozc_eCmpBAb_pljBAmd_k__0oa0 6 0 2047.96875 FORMAT "%10.3" DEPOSIT ABSOLUTE /end AXIS_PTS
/begin AXIS_PTS BMWtchctr_p_DifCrtnPp_Ay___MGF_CC_PF_Slot3 "AXY_KF_PDIFF_ATLR_P (Slot 3, CCv7.1.1, Pump Fuel)" 0x807C0A30 BMWtchsp_mf_Ex_uw _REC_A1AXS_1_MBSE_U2 2047.96875 CByjozc_eCmpBAb_pljBAmd_k__0oa0 6 0 2047.96875 FORMAT "%10.3" DEPOSIT ABSOLUTE /end AXIS_PTS
/begin AXIS_PTS BMWtchctr_p_DifCrtnPp_Ay___MGF_CC_PF_Slot4 "AXY_KF_PDIFF_ATLR_P (Slot 4, CCv7.1.1, Pump Fuel)" 0x807C0A3C BMWtchsp_mf_Ex_uw _REC_A1AXS_1_MBSE_U2 2047.96875 CByjozc_eCmpBAb_pljBAmd_k__0oa0 6 0 2047.96875 FORMAT "%10.3" DEPOSIT ABSOLUTE /end AXIS_PTS
/begin AXIS_PTS BMWtchctr_pct_WgBasc_Ax "AXX_KF_WGPOS_VST" 0x80740918 NO_INPUT_QUANTITY _REC_A1AXS_1_MBSE_U2 3.99993896484375 ilxsavd_hkzmBfc_lAzCpAb_nR_1oa0 12 0 3.99993896484375 FORMAT "%14.5" DEPOSIT ABSOLUTE /end AXIS_PTS
/begin AXIS_PTS BMWtchctr_pct_WgBasc_Ay "AXY_KF_WGPOS_VST" 0x80740900 NO_INPUT_QUANTITY _REC_A1AXS_1_MBSE_U2 2047.96875 CByjozc_eCmpBAb_pljBAmd_k__0oa0 12 0 2047.96875 FORMAT "%10.3" DEPOSIT ABSOLUTE /end AXIS_PTS
/begin AXIS_PTS BMWtchctr_pwr_Dp_Ax "AXX_KF_PATLR_D" 0x80721546 BMWtchbas_p_Dif_sw _REC_A1AXS_1_MBSE_S2 8191.875 BMW_p_sw_q0p125_hPa 14 -4096 4095.875 FORMAT "%10.3" DEPOSIT ABSOLUTE /end AXIS_PTS
/begin AXIS_PTS BMWtchctr_pwr_Dp_Ay "AXY_KF_PATLR_D" 0x8072152A BMWtchbas_p_DifGra_sw _REC_A1AXS_1_MBSE_S2 8191.875 BMW_p_sw_q0p125_hPa 14 -4096 4095.875 FORMAT "%10.3" DEPOSIT ABSOLUTE /end AXIS_PTS
/begin AXIS_PTS BMWtchctr_pwr_Pctl_Ax___MGF_CC_PF_Slot0 "AXX_KF_ATL_PVERD (Slot 0, OEM Address)" 0x80721502 BMWtchsp_rat_p_CmprLim_uw _REC_A1AXS_1_MBSE_U2 7.9998779296875 acriqBc_tfkBqod_ocgjxzc_nR_8oa0 20 0 7.9998779296875 FORMAT "%11.4" DEPOSIT ABSOLUTE /end AXIS_PTS
/begin AXIS_PTS BMWtchctr_pwr_Pctl_Ax___MGF_CC_PF_Slot1 "AXX_KF_ATL_PVERD (Slot 1, CCv7.1.1, Pump Fuel)" 0x807C1728 BMWtchsp_rat_p_CmprLim_uw _REC_A1AXS_1_MBSE_U2 7.9998779296875 acriqBc_tfkBqod_ocgjxzc_nR_8oa0 20 0 7.9998779296875 FORMAT "%11.4" DEPOSIT ABSOLUTE /end AXIS_PTS
/begin AXIS_PTS BMWtchctr_pwr_Pctl_Ax___MGF_CC_PF_Slot2 "AXX_KF_ATL_PVERD (Slot 2, CCv7.1.1, Pump Fuel)" 0x807C1750 BMWtchsp_rat_p_CmprLim_uw _REC_A1AXS_1_MBSE_U2 7.9998779296875 acriqBc_tfkBqod_ocgjxzc_nR_8oa0 20 0 7.9998779296875 FORMAT "%11.4" DEPOSIT ABSOLUTE /end AXIS_PTS
/begin AXIS_PTS BMWtchctr_pwr_Pctl_Ax___MGF_CC_PF_Slot3 "AXX_KF_ATL_PVERD (Slot 3, CCv7.1.1, Pump Fuel)" 0x807C1778 BMWtchsp_rat_p_CmprLim_uw _REC_A1AXS_1_MBSE_U2 7.9998779296875 acriqBc_tfkBqod_ocgjxzc_nR_8oa0 20 0 7.9998779296875 FORMAT "%11.4" DEPOSIT ABSOLUTE /end AXIS_PTS
/begin AXIS_PTS BMWtchctr_pwr_Pctl_Ax___MGF_CC_PF_Slot4 "AXX_KF_ATL_PVERD (Slot 4, CCv7.1.1, Pump Fuel)" 0x807C17A0 BMWtchsp_rat_p_CmprLim_uw _REC_A1AXS_1_MBSE_U2 7.9998779296875 acriqBc_tfkBqod_ocgjxzc_nR_8oa0 20 0 7.9998779296875 FORMAT "%11.4" DEPOSIT ABSOLUTE /end AXIS_PTS
/begin AXIS_PTS BMWtchctr_pwr_Pctl_Ay___MGF_CC_PF_Slot0 "AXY_KF_ATL_PVERD (Slot 0, OEM Address)" 0x807214E2 BMWtchsp_mf_CmprNorm_uw _REC_A1AXS_1_MBSE_U2 2047.96875 CByjozc_eCmpBAb_pljBAmd_k__0oa0 16 0 2047.96875 FORMAT "%10.3" DEPOSIT ABSOLUTE /end AXIS_PTS
/begin AXIS_PTS BMWtchctr_pwr_Pctl_Ay___MGF_CC_PF_Slot1 "AXY_KF_ATL_PVERD (Slot 1, CCv7.1.1, Pump Fuel)" 0x807C17C8 BMWtchsp_mf_CmprNorm_uw _REC_A1AXS_1_MBSE_U2 2047.96875 CByjozc_eCmpBAb_pljBAmd_k__0oa0 16 0 2047.96875 FORMAT "%10.3" DEPOSIT ABSOLUTE /end AXIS_PTS
/begin AXIS_PTS BMWtchctr_pwr_Pctl_Ay___MGF_CC_PF_Slot2 "AXY_KF_ATL_PVERD (Slot 2, CCv7.1.1, Pump Fuel)" 0x807C17E8 BMWtchsp_mf_CmprNorm_uw _REC_A1AXS_1_MBSE_U2 2047.96875 CByjozc_eCmpBAb_pljBAmd_k__0oa0 16 0 2047.96875 FORMAT "%10.3" DEPOSIT ABSOLUTE /end AXIS_PTS
/begin AXIS_PTS BMWtchctr_pwr_Pctl_Ay___MGF_CC_PF_Slot3 "AXY_KF_ATL_PVERD (Slot 3, CCv7.1.1, Pump Fuel)" 0x807C1808 BMWtchsp_mf_CmprNorm_uw _REC_A1AXS_1_MBSE_U2 2047.96875 CByjozc_eCmpBAb_pljBAmd_k__0oa0 16 0 2047.96875 FORMAT "%10.3" DEPOSIT ABSOLUTE /end AXIS_PTS
/begin AXIS_PTS BMWtchctr_pwr_Pctl_Ay___MGF_CC_PF_Slot4 "AXY_KF_ATL_PVERD (Slot 4, CCv7.1.1, Pump Fuel)" 0x807C1828 BMWtchsp_mf_CmprNorm_uw _REC_A1AXS_1_MBSE_U2 2047.96875 CByjozc_eCmpBAb_pljBAmd_k__0oa0 16 0 2047.96875 FORMAT "%10.3" DEPOSIT ABSOLUTE /end AXIS_PTS
/begin AXIS_PTS BMWtchsp_rat_p_CmprMax_Ax "AXX_KF_FPLDMAX" 0x80721D42 BMWtchsp_mf_CmprNorm_uw _REC_A1AXS_1_MBSE_U2 2047.96875 CByjozc_eCmpBAb_pljBAmd_k__0oa0 8 0 2047.96875 FORMAT "%10.3" DEPOSIT ABSOLUTE /end AXIS_PTS
/begin AXIS_PTS BMWtchsp_rat_p_CmprMax_Ay "AXY_KF_FPLDMAX" 0x80721D36 BMWtchtbc_t_BefCmpr_sw _REC_A1AXS_1_MBSE_S2 6553.5 BMW_q0p1_degC 6 -3276.8 3276.7 FORMAT "%6.1" DEPOSIT ABSOLUTE /end AXIS_PTS
/begin AXIS_PTS BMWtchsp_rat_p_CmprPmp_Ax "AXX_KL_FPLDPUMP" 0x80721D26 BMWtchsp_mf_CmprNorm_uw _REC_A1AXS_1_MBSE_U2 2047.96875 CByjozc_eCmpBAb_pljBAmd_k__0oa0 8 0 2047.96875 FORMAT "%10.3" DEPOSIT ABSOLUTE /end AXIS_PTS
/begin AXIS_PTS BMWtqe_tqc_FlApplStg_Ax "Torque Engine torque crank shaft fulload application Stage axis x direction" 0x8072A090 Nkw_ref _REC_A1AXS_1_MBSE_S2 65535 caoddzd_oAjpfzb_cAcEEha_1nR_oa0 18 -32768 32767 DEPOSIT ABSOLUTE /end AXIS_PTS
/begin AXIS_PTS GXX_KF_LABAS "X axis groups for KF_LABASxxx and KF_LA_SK" 0x80746E6A Nkw _REC_A1AXS_1_MBSE_S2 65535 caoddzd_oAjpfzb_cAcEEha_1nR_oa0 18 -32768 32767 FORMAT "%5.0" DEPOSIT ABSOLUTE /end AXIS_PTS
/begin AXIS_PTS GXY_KF_LABAS "Groups Y axis for KF_LABASxxx and KF_LA_SK" 0x80746E48 Rf _REC_A1AXS_1_MBSE_S2 655.35 CgkBooc_wkiDfEd_Czglhgc_fR_1a0o 17 -327.68 327.67 FORMAT "%7.2" DEPOSIT ABSOLUTE /end AXIS_PTS
/begin CHARACTERISTIC Antilag_ActivationDelay___MGF_CC_PF "Activation delay (CCv7.1.1)" VALUE 0x807C0000 KwUw 655.35 camcxxd_bxlpdsa_Cshlhgc_sR_1a0o 0 655.35 /end CHARACTERISTIC
/begin CHARACTERISTIC Antilag_Antilag_CW___MGF_CC "Antilag Codeword: Set 1 (true) to enable function and 0 (false) to disable function (CCv7.1.1)" VALUE 0x807C4A3F FklWUb 1 B_TRUE 0 1 FORMAT "%13.11" /end CHARACTERISTIC
/begin CHARACTERISTIC Antilag_CoolantTempMax___MGF_CC_PF "Maximum coolant temperature (CCv7.1.1)" VALUE 0x807C058A KwUw 255 DchEpAd_DBCFgoa_Ckhahgc_q__aoa0 0 255 FORMAT "%7.0" PHYS_UNIT "-" /end CHARACTERISTIC
/begin CHARACTERISTIC Antilag_CoolantTempMin___MGF_CC_PF "Minimum coolant temperature (CCv7.1.1)" VALUE 0x807C058C KwUw 255 DchEpAd_DBCFgoa_Ckhahgc_q__aoa0 0 255 FORMAT "%7.0" PHYS_UNIT "-" /end CHARACTERISTIC
/begin CHARACTERISTIC Antilag_CutMethod___MGF_CC_PF "Method used to hold engine speed: 0 = fuel cut (bit of stuttering but safe), 1 = ignition cut (flame mode, very aggressive), 3 = factory rpm limiter (default, smoothest and safest) (CCv7.1.1)" VALUE 0x807C4A3C FklWUb 255 ___MGF_CC_EngineSpeedCutMethodCompuMethod 0 255 FORMAT "%7.0" /end CHARACTERISTIC
/begin CHARACTERISTIC Antilag_EgtTempMax___MGF_CC_PF "Maximum exhaust gas temperature [EGT] (CCv7.1.1)" VALUE 0x807C058E KwUw 255 BMW_q0p1_degC 0 255 FORMAT "%7.0" PHYS_UNIT "-" /end CHARACTERISTIC
/begin CHARACTERISTIC Antilag_IatTempMax___MGF_CC_PF "Maximum intake air temperature [IAT] (CCv7.1.1)" VALUE 0x807C4A3D FklWUb 255 ___MGF_CC_TemperatureCelsius_x3_d4_s48 0 255 FORMAT "%7.0" PHYS_UNIT "-" /end CHARACTERISTIC
/begin CHARACTERISTIC Antilag_MaxDuration___MGF_CC_PF "Maximum usage duration (CCv7.1.1)" VALUE 0x807C08B0 KwUw 655.35 camcxxd_bxlpdsa_Cshlhgc_sR_1a0o 0 655.35 /end CHARACTERISTIC
/begin CHARACTERISTIC Antilag_OverBoostThreshold___MGF_CC_PF "Maximum over boost (CCv7.1.1)" VALUE 0x807C08B2 KwUw 255 BMW_p_sw_q0p125_hPa 0 255 FORMAT "%7.0" PHYS_UNIT "-" /end CHARACTERISTIC
/begin CHARACTERISTIC Antilag_Pedal___MGF_CC_PF "Pedal threshold for activation (CCv7.1.1)" VALUE 0x807C4A3E FklWUb 255 ___MGF_CC_Pedal_x100_d256 0 255 FORMAT "%7.0" PHYS_UNIT "-" /end CHARACTERISTIC
/begin CHARACTERISTIC Antilag_RollingSpeedThreshold___MGF_CC_PF "Speed threshold to detect rolling (CCv7.1.1)" VALUE 0x807C08B4 KwUw 255 ___MGF_CC_Speedkmh_d64 0 255 FORMAT "%7.0" PHYS_UNIT "-" /end CHARACTERISTIC
/begin CHARACTERISTIC Antilag_RollRpmMax___MGF_CC_PF "RPM maximum engagement (CCv7.1.1)" VALUE 0x807C08B6 KwUw 32767.5 EngN -16384 16383.5 FORMAT "%8.2" /end CHARACTERISTIC
/begin CHARACTERISTIC Antilag_RollRpmMin___MGF_CC_PF "RPM minimum engagement (CCv7.1.1)" VALUE 0x807C08B8 KwUw 32767.5 EngN -16384 16383.5 FORMAT "%8.2" /end CHARACTERISTIC
/begin CHARACTERISTIC Antilag_RpmDelayUntilCutRoll___MGF_CC_PF "RPM delay until cut (CCv7.1.1)" VALUE 0x807C08BA KwUw 32767.5 EngN -16384 16383.5 FORMAT "%8.2" /end CHARACTERISTIC
/begin CHARACTERISTIC Antilag_RpmDelayUntilCutStand___MGF_CC_PF "RPM delay until cut (CCv7.1.1)" VALUE 0x807C08BC KwUw 32767.5 EngN -16384 16383.5 FORMAT "%8.2" /end CHARACTERISTIC
/begin CHARACTERISTIC Antilag_RpmSetpoint___MGF_CC_PF "RPM setpoint (CCv7.1.1)" VALUE 0x807C08BE CurG_Ws16 32767.5 EngN -16384 16383.5 FORMAT "%8.2" /end CHARACTERISTIC
/begin CHARACTERISTIC Antilag_TargetBoostRoll___MGF_CC_PF "Boost pressure setpoint (CCv7.1.1)" VALUE 0x807C08E4 KwUw 255 BMW_p_sw_q0p125_hPa 0 255 FORMAT "%7.0" PHYS_UNIT "-" /end CHARACTERISTIC
/begin CHARACTERISTIC Antilag_TargetBoostStand___MGF_CC_PF "Boost pressure setpoint (CCv7.1.1)" VALUE 0x807C08E6 KwUw 255 BMW_p_sw_q0p125_hPa 0 255 FORMAT "%7.0" PHYS_UNIT "-" /end CHARACTERISTIC
/begin CHARACTERISTIC Antilag_TargetNumberOfCylindersToSuppress___MGF_CC_PF "Target number of cylinders to suppress during antilag (CCv7.1.1)" VALUE 0x807C2491 FklWUb 8 raChrxc_kBtBrmb_FmDuEFa_n__aa0o 0 8 FORMAT "%3.0" /end CHARACTERISTIC
/begin CHARACTERISTIC BMWtchsp_p_ReqMax_C___MGF_CC_PF_Slot0 "Maximum target boost pressure due to boost pressure sensor diagnosis (Slot 0, OEM Address)" VALUE 0x80721C36 KwUw 8191.875 BMW_p_sw_q0p125_hPa 0 8191.875 FORMAT "%10.3" /end CHARACTERISTIC
/begin CHARACTERISTIC BMWtchsp_p_ReqMax_C___MGF_CC_PF_Slot1 "Maximum target boost pressure due to boost pressure sensor diagnosis (Slot 1, CCv7.1.1, Pump Fuel)" VALUE 0x807C2248 KwUw 8191.875 BMW_p_sw_q0p125_hPa 0 8191.875 FORMAT "%10.3" /end CHARACTERISTIC
/begin CHARACTERISTIC BMWtchsp_p_ReqMax_C___MGF_CC_PF_Slot2 "Maximum target boost pressure due to boost pressure sensor diagnosis (Slot 2, CCv7.1.1, Pump Fuel)" VALUE 0x807C224A KwUw 8191.875 BMW_p_sw_q0p125_hPa 0 8191.875 FORMAT "%10.3" /end CHARACTERISTIC
/begin CHARACTERISTIC BMWtchsp_p_ReqMax_C___MGF_CC_PF_Slot3 "Maximum target boost pressure due to boost pressure sensor diagnosis (Slot 3, CCv7.1.1, Pump Fuel)" VALUE 0x807C224C KwUw 8191.875 BMW_p_sw_q0p125_hPa 0 8191.875 FORMAT "%10.3" /end CHARACTERISTIC
/begin CHARACTERISTIC BMWtchsp_p_ReqMax_C___MGF_CC_PF_Slot4 "Maximum target boost pressure due to boost pressure sensor diagnosis (Slot 4, CCv7.1.1, Pump Fuel)" VALUE 0x807C224E KwUw 8191.875 BMW_p_sw_q0p125_hPa 0 8191.875 FORMAT "%10.3" /end CHARACTERISTIC
/begin CHARACTERISTIC Burbles_Burbles_CW___MGF_CC "Burbles Codeword: Set 1 (true) to enable function and 0 (false) to disable function (CCv7.1.1)" VALUE 0x807C4A40 FklWUb 1 B_TRUE 0 1 FORMAT "%13.11" /end CHARACTERISTIC
/begin CHARACTERISTIC CcmEnterMenuDelay___MGF_CC_PF "Delay to enter Custom Code Menu, CCM (CCv7.1.1)" VALUE 0x807C2410 KwUw 655.35 camcxxd_bxlpdsa_Cshlhgc_sR_1a0o 0 655.35 /end CHARACTERISTIC
/begin CHARACTERISTIC CcmTimeout___MGF_CC_PF "Timeout until automatic exit of Custom Code Menu, CCM (CCv7.1.1)" VALUE 0x807C2412 KwUw 655.35 camcxxd_bxlpdsa_Cshlhgc_sR_1a0o 0 655.35 /end CHARACTERISTIC
/begin CHARACTERISTIC CustomCodeMenu_CustomCodeMenu_CW___MGF_CC "CustomCodeMenu Codeword: Set 1 (true) to enable function and 0 (false) to disable function (CCv7.1.1)" VALUE 0x807C2466 FklWUb 1 B_TRUE 0 1 FORMAT "%13.11" /end CHARACTERISTIC
/begin CHARACTERISTIC CustomCodeMenu_CustomCodeMenu_CW_CruiseControlConfig___MGF_CC "CustomCodeMenu Cruise Control Config Codeword: Set 1 (true) if using RockerCombo and 0 (false) if using UniRocker (CCv7.1.1)" VALUE 0x807C2467 FklWUb 1 B_TRUE 0 1 FORMAT "%13.11" /end CHARACTERISTIC
/begin CHARACTERISTIC CustomCodeMenu_CustomCodeMenu_CW_UseAllCruiseControlCanBusData___MGF_CC "CustomCodeMenu Use All Cruise Control Can Bus Data Codeword: Set 1 (true) to use all cruise control CAN bus data and 0 (false) to use only Rocker data (CCv7.1.1)" VALUE 0x807C246D FklWUb 1 B_TRUE 0 1 FORMAT "%13.11" /end CHARACTERISTIC
/begin CHARACTERISTIC ExhaustFlap_ExhaustFlap_CW___MGF_CC "ExhaustFlap Codeword: Set 1 (true) to enable function and 0 (false) to disable function (CCv7.1.1)" VALUE 0x807C2468 FklWUb 1 B_TRUE 0 1 FORMAT "%13.11" /end CHARACTERISTIC
/begin CHARACTERISTIC ExhaustFlapClosedMaxLoad___MGF_CC_PF "Maximum load before overriding user selection and opening exhaust flaps (CCv7.1.1)" VALUE 0x807C2414 CurG_Ws16 255 CgkBooc_wkiDfEd_Czglhgc_fR_1a0o 0 255 FORMAT "%7.0" PHYS_UNIT "-" /end CHARACTERISTIC
/begin CHARACTERISTIC FlexFuel_FlexFuel_CW___MGF_CC "FlexFuel Codeword: Set 1 (true) to enable function and 0 (false) to disable function (CCv7.1.1)" VALUE 0x807C2469 FklWUb 1 B_TRUE 0 1 FORMAT "%13.11" /end CHARACTERISTIC
/begin CHARACTERISTIC FlexFuel_FlexFuel_CW_Blending___MGF_CC "FlexFuel Blending Codeword: Set 1 (true) to enable function and 0 (false) to disable function (CCv7.1.1)" VALUE 0x807C246A FklWUb 1 B_TRUE 0 1 FORMAT "%13.11" /end CHARACTERISTIC
/begin CHARACTERISTIC FlexFuel_FlexFuel_CW_SensorEthanol___MGF_CC "FlexFuel SensorEthanol Codeword: Set 1 (true) if flex fuel sensor is installed on PT-CAN2 and 0 (false) if not installed (CCv7.1.1)" VALUE 0x807C246C FklWUb 1 B_TRUE 0 1 FORMAT "%13.11" /end CHARACTERISTIC
/begin CHARACTERISTIC FlexFuelEthanolDisplayActivationDelay___MGF_CC_PF "Delay to display flex fuel ethanol content on the dash (CCv7.1.1)" VALUE 0x807C2416 KwUw 655.35 camcxxd_bxlpdsa_Cshlhgc_sR_1a0o 0 655.35 /end CHARACTERISTIC
/begin CHARACTERISTIC MaxCooling_MaxCooling_CW___MGF_CC "MaxCooling Codeword: Set 1 (true) to enable function and 0 (false) to disable function (CCv7.1.1)" VALUE 0x807C4A42 FklWUb 1 B_TRUE 0 1 FORMAT "%13.11" /end CHARACTERISTIC
/begin CHARACTERISTIC RadiatorFlap_RadiatorFlap_CW___MGF_CC "RadiatorFlap Codeword: Set 1 (true) to enable function and 0 (false) to disable function (CCv7.1.1)" VALUE 0x807C2490 FklWUb 1 B_TRUE 0 1 FORMAT "%13.11" /end CHARACTERISTIC
/begin CHARACTERISTIC SwitchableMaps_SwitchableMaps_CW_Ethanol___MGF_CC "SwitchableMaps Ethanol Codeword: Set 1 (true) to enable function and 0 (false) to disable function (CCv7.1.1)" VALUE 0x807C4A41 FklWUb 1 B_TRUE 0 1 FORMAT "%13.11" /end CHARACTERISTIC
/begin CHARACTERISTIC SwitchableMaps_SwitchableMaps_CW_Octane___MGF_CC "SwitchableMaps Octane Codeword: Set 1 (true) to enable function and 0 (false) to disable function (CCv7.1.1)" VALUE 0x807C4A43 FklWUb 1 B_TRUE 0 1 FORMAT "%13.11" /end CHARACTERISTIC
/begin CHARACTERISTIC TargetPumpSpeed___MGF_CC "Target pump speed when Max Cooling OTF is enabled (CCv7.1.1)" VALUE 0x807C49A8 KwUw 100 ___MGF_CC_Temperature_2 0 100 PHYS_UNIT "%" /end CHARACTERISTIC
/begin CHARACTERISTIC TargetTemperature___MGF_CC "Target temperature when Max Cooling OTF is enabled (CCv7.1.1)" VALUE 0x807C49AA CurG_Ws16 655.35 DchEpAd_DBCFgoa_Ckhahgc_q__aoa0 -327.68 327.67 /end CHARACTERISTIC
/begin CHARACTERISTIC TcuTorqueLimiter_TcuTorqueLimiter_CW___MGF_CC "TcuTorqueLimiter Codeword: Set 1 (true) to enable function and 0 (false) to disable function (CCv7.1.1)" VALUE 0x807FF7D4 FklWUb 1 B_TRUE 0 1 FORMAT "%13.11" /end CHARACTERISTIC
/begin CHARACTERISTIC UniRockerEnterDetectionDelay___MGF_CC_PF "Delay for 'enter' button detection with UniRocker button configuration in Custom Code Menu, CCM (CCv7.1.1)" VALUE 0x807C2418 KwUw 655.35 camcxxd_bxlpdsa_Cshlhgc_sR_1a0o 0 655.35 /end CHARACTERISTIC
/begin CHARACTERISTIC Valet_Valet_CW___MGF_CC "Valet Codeword: Set 1 (true) to enable function and 0 (false) to disable function (CCv7.1.1)" VALUE 0x807C246E FklWUb 1 B_TRUE 0 1 FORMAT "%13.11" /end CHARACTERISTIC
/begin CHARACTERISTIC ValetMaxPedal___MGF_CC_PF "Maximum allowable pedal which uses valet torque level 1, above which uses the more restrictive valet torque level 2 (CCv7.1.1)" VALUE 0x807C246F FklWUb 255 ___MGF_CC_Pedal_x100_d256 0 255 FORMAT "%7.0" PHYS_UNIT "-" /end CHARACTERISTIC
/begin CHARACTERISTIC ValetMaxRpm___MGF_CC_PF "Maximum permissable engine speed, RPM (CCv7.1.1)" VALUE 0x807C241A KwUw 32767.5 ___MGF_CC_EngineSpeed_d4 -16384 16383.5 FORMAT "%8.2" /end CHARACTERISTIC
/begin CHARACTERISTIC ValetMaxSpeed___MGF_CC_PF "Maximum allowable vehicle speed which uses valet torque level 1, above which uses the more restrictive valet torque level 2 (CCv7.1.1)" VALUE 0x807C241C KwUw 255 ___MGF_CC_Speedkmh_d64 0 255 FORMAT "%7.0" PHYS_UNIT "-" /end CHARACTERISTIC
/begin CHARACTERISTIC Antilag_BMWtqe_gra_NMaxEngLimdDwn_T___MGF_CC_PF "Lower gradient limit for the max. permitted speed VM (1/min/10ms) (X-Axis does not switch, CCv7.1.1)" CURVE 0x807C2470 _REC_A1CUR_1_MBSE_U2_S1 65535 raChrxc_kBtBrmb_FmDuEFa_n__aa0o 0 65535 FORMAT "%5.0" MATRIX_DIM 10 1 1
 /begin AXIS_DESCR COM_AXIS BMWtqe_idx_SpdMaxLimr_ub raChrxc_kBtBrmb_FmDuEFa_n__aa0o 10 0 255 AXIS_PTS_REF Antilag_BMWtqe_gra_NMaxEngLimd_Ax___MGF_CC_PF FORMAT "%3.0" MONOTONY STRICT_INCREASE DEPOSIT ABSOLUTE /end AXIS_DESCR
/end CHARACTERISTIC
/begin CHARACTERISTIC Antilag_SafetyTorqueCap___MGF_CC_PF "Target torque during antilag safety shutdown (CCv7.1.1)" CURVE 0x807C08C0 _REC_A1CUR_1_MBSE_S2_S1 6553.5 BMW_dm_sw_q0p1_Nm -3276.8 3276.7 FORMAT "%6.1" MATRIX_DIM 18 1 1
 /begin AXIS_DESCR COM_AXIS Nkw_ref caoddzd_oAjpfzb_cAcEEha_1nR_oa0 18 -32768 32767 AXIS_PTS_REF BMWtqe_tqc_FlApplStg_Ax MONOTONY STRICT_INCREASE DEPOSIT ABSOLUTE /end AXIS_DESCR
/end CHARACTERISTIC
/begin CHARACTERISTIC BMWtchsp_rat_p_CmprPmp_T___MGF_CC_PF_Slot0 "KL_FPLDPUMP (Slot 0, OEM Address)" CURVE 0x80721CE2 _REC_A1CUR_1_MBSE_U2_S1 3.99993896484375 ilxsavd_hkzmBfc_lAzCpAb_nR_1oa0 0 3.99993896484375
 /begin AXIS_DESCR COM_AXIS BMWtchsp_mf_CmprNorm_uw CByjozc_eCmpBAb_pljBAmd_k__0oa0 8 0 2047.96875 AXIS_PTS_REF BMWtchsp_rat_p_CmprPmp_Ax FORMAT "%10.3" MONOTONY STRICT_INCREASE DEPOSIT ABSOLUTE /end AXIS_DESCR
/end CHARACTERISTIC
/begin CHARACTERISTIC BMWtchsp_rat_p_CmprPmp_T___MGF_CC_PF_Slot1 "KL_FPLDPUMP (Slot 1, CCv7.1.1, Pump Fuel)" CURVE 0x807C23D0 _REC_A1CUR_1_MBSE_U2_S1 3.99993896484375 ilxsavd_hkzmBfc_lAzCpAb_nR_1oa0 0 3.99993896484375
 /begin AXIS_DESCR COM_AXIS BMWtchsp_mf_CmprNorm_uw CByjozc_eCmpBAb_pljBAmd_k__0oa0 8 0 2047.96875 AXIS_PTS_REF BMWtchsp_rat_p_CmprPmp_Ax FORMAT "%10.3" MONOTONY STRICT_INCREASE DEPOSIT ABSOLUTE /end AXIS_DESCR
/end CHARACTERISTIC
/begin CHARACTERISTIC BMWtchsp_rat_p_CmprPmp_T___MGF_CC_PF_Slot2 "KL_FPLDPUMP (Slot 2, CCv7.1.1, Pump Fuel)" CURVE 0x807C23E0 _REC_A1CUR_1_MBSE_U2_S1 3.99993896484375 ilxsavd_hkzmBfc_lAzCpAb_nR_1oa0 0 3.99993896484375
 /begin AXIS_DESCR COM_AXIS BMWtchsp_mf_CmprNorm_uw CByjozc_eCmpBAb_pljBAmd_k__0oa0 8 0 2047.96875 AXIS_PTS_REF BMWtchsp_rat_p_CmprPmp_Ax FORMAT "%10.3" MONOTONY STRICT_INCREASE DEPOSIT ABSOLUTE /end AXIS_DESCR
/end CHARACTERISTIC
/begin CHARACTERISTIC BMWtchsp_rat_p_CmprPmp_T___MGF_CC_PF_Slot3 "KL_FPLDPUMP (Slot 3, CCv7.1.1, Pump Fuel)" CURVE 0x807C23F0 _REC_A1CUR_1_MBSE_U2_S1 3.99993896484375 ilxsavd_hkzmBfc_lAzCpAb_nR_1oa0 0 3.99993896484375
 /begin AXIS_DESCR COM_AXIS BMWtchsp_mf_CmprNorm_uw CByjozc_eCmpBAb_pljBAmd_k__0oa0 8 0 2047.96875 AXIS_PTS_REF BMWtchsp_rat_p_CmprPmp_Ax FORMAT "%10.3" MONOTONY STRICT_INCREASE DEPOSIT ABSOLUTE /end AXIS_DESCR
/end CHARACTERISTIC
/begin CHARACTERISTIC BMWtchsp_rat_p_CmprPmp_T___MGF_CC_PF_Slot4 "KL_FPLDPUMP (Slot 4, CCv7.1.1, Pump Fuel)" CURVE 0x807C2400 _REC_A1CUR_1_MBSE_U2_S1 3.99993896484375 ilxsavd_hkzmBfc_lAzCpAb_nR_1oa0 0 3.99993896484375
 /begin AXIS_DESCR COM_AXIS BMWtchsp_mf_CmprNorm_uw CByjozc_eCmpBAb_pljBAmd_k__0oa0 8 0 2047.96875 AXIS_PTS_REF BMWtchsp_rat_p_CmprPmp_Ax FORMAT "%10.3" MONOTONY STRICT_INCREASE DEPOSIT ABSOLUTE /end AXIS_DESCR
/end CHARACTERISTIC
/begin CHARACTERISTIC BMWtqe_tqc_FlApplStgNorm_T___MGF_CC_PF_Slot0 "Torque Engine torque crank shaft fulload application Stage normal curve, table (Slot 0, OEM Address)" CURVE 0x8072A06C _REC_A1CUR_1_MBSE_S2_S1 6553.5 BMW_dm_sw_q0p1_Nm -3276.8 3276.7 FORMAT "%6.1"
 /begin AXIS_DESCR COM_AXIS Nkw_ref caoddzd_oAjpfzb_cAcEEha_1nR_oa0 18 -32768 32767 AXIS_PTS_REF BMWtqe_tqc_FlApplStg_Ax MONOTONY STRICT_INCREASE DEPOSIT ABSOLUTE /end AXIS_DESCR
/end CHARACTERISTIC
/begin CHARACTERISTIC BMWtqe_tqc_FlApplStgNorm_T___MGF_CC_PF_Slot1 "Torque Engine torque crank shaft fulload application Stage normal curve, table (Slot 1, CCv7.1.1, Pump Fuel)" CURVE 0x807C49AC _REC_A1CUR_1_MBSE_S2_S1 6553.5 BMW_dm_sw_q0p1_Nm -3276.8 3276.7 FORMAT "%6.1"
 /begin AXIS_DESCR COM_AXIS Nkw_ref caoddzd_oAjpfzb_cAcEEha_1nR_oa0 18 -32768 32767 AXIS_PTS_REF BMWtqe_tqc_FlApplStg_Ax MONOTONY STRICT_INCREASE DEPOSIT ABSOLUTE /end AXIS_DESCR
/end CHARACTERISTIC
/begin CHARACTERISTIC BMWtqe_tqc_FlApplStgNorm_T___MGF_CC_PF_Slot2 "Torque Engine torque crank shaft fulload application Stage normal curve, table (Slot 2, CCv7.1.1, Pump Fuel)" CURVE 0x807C49D0 _REC_A1CUR_1_MBSE_S2_S1 6553.5 BMW_dm_sw_q0p1_Nm -3276.8 3276.7 FORMAT "%6.1"
 /begin AXIS_DESCR COM_AXIS Nkw_ref caoddzd_oAjpfzb_cAcEEha_1nR_oa0 18 -32768 32767 AXIS_PTS_REF BMWtqe_tqc_FlApplStg_Ax MONOTONY STRICT_INCREASE DEPOSIT ABSOLUTE /end AXIS_DESCR
/end CHARACTERISTIC
/begin CHARACTERISTIC BMWtqe_tqc_FlApplStgNorm_T___MGF_CC_PF_Slot3 "Torque Engine torque crank shaft fulload application Stage normal curve, table (Slot 3, CCv7.1.1, Pump Fuel)" CURVE 0x807C49F4 _REC_A1CUR_1_MBSE_S2_S1 6553.5 BMW_dm_sw_q0p1_Nm -3276.8 3276.7 FORMAT "%6.1"
 /begin AXIS_DESCR COM_AXIS Nkw_ref caoddzd_oAjpfzb_cAcEEha_1nR_oa0 18 -32768 32767 AXIS_PTS_REF BMWtqe_tqc_FlApplStg_Ax MONOTONY STRICT_INCREASE DEPOSIT ABSOLUTE /end AXIS_DESCR
/end CHARACTERISTIC
/begin CHARACTERISTIC BMWtqe_tqc_FlApplStgNorm_T___MGF_CC_PF_Slot4 "Torque Engine torque crank shaft fulload application Stage normal curve, table (Slot 4, CCv7.1.1, Pump Fuel)" CURVE 0x807C4A18 _REC_A1CUR_1_MBSE_S2_S1 6553.5 BMW_dm_sw_q0p1_Nm -3276.8 3276.7 FORMAT "%6.1"
 /begin AXIS_DESCR COM_AXIS Nkw_ref caoddzd_oAjpfzb_cAcEEha_1nR_oa0 18 -32768 32767 AXIS_PTS_REF BMWtqe_tqc_FlApplStg_Ax MONOTONY STRICT_INCREASE DEPOSIT ABSOLUTE /end AXIS_DESCR
/end CHARACTERISTIC
/begin CHARACTERISTIC KL_RF_MAX___MGF_CC_PF_Slot0 "Characteristic maximum permissible filling over speed (Slot 0, OEM Address)" CURVE 0x8071B4BC _REC_A1CUR_1_MBSE_S2_S1 655.35 CgkBooc_wkiDfEd_Czglhgc_fR_1a0o -327.68 327.67 FORMAT "%7.2"
 /begin AXIS_DESCR COM_AXIS NO_INPUT_QUANTITY caoddzd_oAjpfzb_cAcEEha_1nR_oa0 12 -32768 32767 AXIS_PTS_REF AXX_KL_RF_MAX FORMAT "%5.0" MONOTONY MON_INCREASE DEPOSIT ABSOLUTE /end AXIS_DESCR
/end CHARACTERISTIC
/begin CHARACTERISTIC KL_RF_MAX___MGF_CC_PF_Slot1 "Characteristic maximum permissible filling over speed (Slot 1, CCv7.1.1, Pump Fuel)" CURVE 0x807C48E8 _REC_A1CUR_1_MBSE_S2_S1 655.35 CgkBooc_wkiDfEd_Czglhgc_fR_1a0o -327.68 327.67 FORMAT "%7.2"
 /begin AXIS_DESCR COM_AXIS NO_INPUT_QUANTITY caoddzd_oAjpfzb_cAcEEha_1nR_oa0 12 -32768 32767 AXIS_PTS_REF AXX_KL_RF_MAX FORMAT "%5.0" MONOTONY MON_INCREASE DEPOSIT ABSOLUTE /end AXIS_DESCR
/end CHARACTERISTIC
/begin CHARACTERISTIC KL_RF_MAX___MGF_CC_PF_Slot2 "Characteristic maximum permissible filling over speed (Slot 2, CCv7.1.1, Pump Fuel)" CURVE 0x807C4900 _REC_A1CUR_1_MBSE_S2_S1 655.35 CgkBooc_wkiDfEd_Czglhgc_fR_1a0o -327.68 327.67 FORMAT "%7.2"
 /begin AXIS_DESCR COM_AXIS NO_INPUT_QUANTITY caoddzd_oAjpfzb_cAcEEha_1nR_oa0 12 -32768 32767 AXIS_PTS_REF AXX_KL_RF_MAX FORMAT "%5.0" MONOTONY MON_INCREASE DEPOSIT ABSOLUTE /end AXIS_DESCR
/end CHARACTERISTIC
/begin CHARACTERISTIC KL_RF_MAX___MGF_CC_PF_Slot3 "Characteristic maximum permissible filling over speed (Slot 3, CCv7.1.1, Pump Fuel)" CURVE 0x807C4918 _REC_A1CUR_1_MBSE_S2_S1 655.35 CgkBooc_wkiDfEd_Czglhgc_fR_1a0o -327.68 327.67 FORMAT "%7.2"
 /begin AXIS_DESCR COM_AXIS NO_INPUT_QUANTITY caoddzd_oAjpfzb_cAcEEha_1nR_oa0 12 -32768 32767 AXIS_PTS_REF AXX_KL_RF_MAX FORMAT "%5.0" MONOTONY MON_INCREASE DEPOSIT ABSOLUTE /end AXIS_DESCR
/end CHARACTERISTIC
/begin CHARACTERISTIC KL_RF_MAX___MGF_CC_PF_Slot4 "Characteristic maximum permissible filling over speed (Slot 4, CCv7.1.1, Pump Fuel)" CURVE 0x807C4930 _REC_A1CUR_1_MBSE_S2_S1 655.35 CgkBooc_wkiDfEd_Czglhgc_fR_1a0o -327.68 327.67 FORMAT "%7.2"
 /begin AXIS_DESCR COM_AXIS NO_INPUT_QUANTITY caoddzd_oAjpfzb_cAcEEha_1nR_oa0 12 -32768 32767 AXIS_PTS_REF AXX_KL_RF_MAX FORMAT "%5.0" MONOTONY MON_INCREASE DEPOSIT ABSOLUTE /end AXIS_DESCR
/end CHARACTERISTIC
/begin CHARACTERISTIC KL_RF_MAX_UESP___MGF_CC_PF_Slot0 "Characteristic of the maximum permissible filling over the speed when flushing (Slot 0, OEM Address)" CURVE 0x8071B4A4 _REC_A1CUR_1_MBSE_S2_S1 655.35 CgkBooc_wkiDfEd_Czglhgc_fR_1a0o -327.68 327.67 FORMAT "%7.2"
 /begin AXIS_DESCR COM_AXIS NO_INPUT_QUANTITY caoddzd_oAjpfzb_cAcEEha_1nR_oa0 12 -32768 32767 AXIS_PTS_REF AXX_KL_RF_MAX_UESP FORMAT "%5.0" MONOTONY MON_INCREASE DEPOSIT ABSOLUTE /end AXIS_DESCR
/end CHARACTERISTIC
/begin CHARACTERISTIC KL_RF_MAX_UESP___MGF_CC_PF_Slot1 "Characteristic of the maximum permissible filling over the speed when flushing (Slot 1, CCv7.1.1, Pump Fuel)" CURVE 0x807C4948 _REC_A1CUR_1_MBSE_S2_S1 655.35 CgkBooc_wkiDfEd_Czglhgc_fR_1a0o -327.68 327.67 FORMAT "%7.2"
 /begin AXIS_DESCR COM_AXIS NO_INPUT_QUANTITY caoddzd_oAjpfzb_cAcEEha_1nR_oa0 12 -32768 32767 AXIS_PTS_REF AXX_KL_RF_MAX_UESP FORMAT "%5.0" MONOTONY MON_INCREASE DEPOSIT ABSOLUTE /end AXIS_DESCR
/end CHARACTERISTIC
/begin CHARACTERISTIC KL_RF_MAX_UESP___MGF_CC_PF_Slot2 "Characteristic of the maximum permissible filling over the speed when flushing (Slot 2, CCv7.1.1, Pump Fuel)" CURVE 0x807C4960 _REC_A1CUR_1_MBSE_S2_S1 655.35 CgkBooc_wkiDfEd_Czglhgc_fR_1a0o -327.68 327.67 FORMAT "%7.2"
 /begin AXIS_DESCR COM_AXIS NO_INPUT_QUANTITY caoddzd_oAjpfzb_cAcEEha_1nR_oa0 12 -32768 32767 AXIS_PTS_REF AXX_KL_RF_MAX_UESP FORMAT "%5.0" MONOTONY MON_INCREASE DEPOSIT ABSOLUTE /end AXIS_DESCR
/end CHARACTERISTIC
/begin CHARACTERISTIC KL_RF_MAX_UESP___MGF_CC_PF_Slot3 "Characteristic of the maximum permissible filling over the speed when flushing (Slot 3, CCv7.1.1, Pump Fuel)" CURVE 0x807C4978 _REC_A1CUR_1_MBSE_S2_S1 655.35 CgkBooc_wkiDfEd_Czglhgc_fR_1a0o -327.68 327.67 FORMAT "%7.2"
 /begin AXIS_DESCR COM_AXIS NO_INPUT_QUANTITY caoddzd_oAjpfzb_cAcEEha_1nR_oa0 12 -32768 32767 AXIS_PTS_REF AXX_KL_RF_MAX_UESP FORMAT "%5.0" MONOTONY MON_INCREASE DEPOSIT ABSOLUTE /end AXIS_DESCR
/end CHARACTERISTIC
/begin CHARACTERISTIC KL_RF_MAX_UESP___MGF_CC_PF_Slot4 "Characteristic of the maximum permissible filling over the speed when flushing (Slot 4, CCv7.1.1, Pump Fuel)" CURVE 0x807C4990 _REC_A1CUR_1_MBSE_S2_S1 655.35 CgkBooc_wkiDfEd_Czglhgc_fR_1a0o -327.68 327.67 FORMAT "%7.2"
 /begin AXIS_DESCR COM_AXIS NO_INPUT_QUANTITY caoddzd_oAjpfzb_cAcEEha_1nR_oa0 12 -32768 32767 AXIS_PTS_REF AXX_KL_RF_MAX_UESP FORMAT "%5.0" MONOTONY MON_INCREASE DEPOSIT ABSOLUTE /end AXIS_DESCR
/end CHARACTERISTIC
/begin CHARACTERISTIC ValetTorqueMap___MGF_CC_PF_Slot1 "Target torque during valet in level [1] (CCv7.1.1, Pump Fuel)" CURVE 0x807C241E _REC_A1CUR_1_MBSE_S2_S1 6553.5 BMW_dm_sw_q0p1_Nm -3276.8 3276.7 FORMAT "%6.1" MATRIX_DIM 18 1 1
 /begin AXIS_DESCR COM_AXIS Nkw_ref caoddzd_oAjpfzb_cAcEEha_1nR_oa0 18 -32768 32767 AXIS_PTS_REF BMWtqe_tqc_FlApplStg_Ax MONOTONY STRICT_INCREASE DEPOSIT ABSOLUTE /end AXIS_DESCR
/end CHARACTERISTIC
/begin CHARACTERISTIC ValetTorqueMap___MGF_CC_PF_Slot2 "Target torque during valet in level [2] (CCv7.1.1, Pump Fuel)" CURVE 0x807C2442 _REC_A1CUR_1_MBSE_S2_S1 6553.5 BMW_dm_sw_q0p1_Nm -3276.8 3276.7 FORMAT "%6.1" MATRIX_DIM 18 1 1
 /begin AXIS_DESCR COM_AXIS Nkw_ref caoddzd_oAjpfzb_cAcEEha_1nR_oa0 18 -32768 32767 AXIS_PTS_REF BMWtqe_tqc_FlApplStg_Ax MONOTONY STRICT_INCREASE DEPOSIT ABSOLUTE /end AXIS_DESCR
/end CHARACTERISTIC
/begin CHARACTERISTIC Antilag_BMWtchctr_p_DifCrtnPp_M___MGF_CC_PF "Correction of pressure difference f. P-part of the performance-based boost pressure controller (X-Axis does not switch, CCv7.1.1)" MAP 0x807C000E _REC_A1CUR_1_MBSE_S2_S1 8191.875 BMW_p_sw_q0p125_hPa -4096 4095.875 FORMAT "%10.3"
 /begin AXIS_DESCR COM_AXIS BMWtchbas_p_Dif_sw BMW_p_sw_q0p125_hPa 12 -4096 4095.875 AXIS_PTS_REF Antilag_BMWtchctr_p_DifCrtnPp_Ax___MGF_CC_PF FORMAT "%10.3" MONOTONY MON_INCREASE DEPOSIT ABSOLUTE /end AXIS_DESCR
 /begin AXIS_DESCR COM_AXIS BMWtchsp_mf_Ex_uw CByjozc_eCmpBAb_pljBAmd_k__0oa0 6 0 2047.96875 AXIS_PTS_REF Antilag_BMWtchctr_p_DifCrtnPp_Ay___MGF_CC_PF FORMAT "%10.3" MONOTONY STRICT_INCREASE DEPOSIT ABSOLUTE /end AXIS_DESCR
/end CHARACTERISTIC
/begin CHARACTERISTIC Antilag_BMWtchctr_p_DifCrtnPpDyn_M___MGF_CC_PF "Correction of pressure difference f. P-part of the performance-based boost pressure controller (X-Axis does not switch, CCv7.1.1)" MAP 0x807C00AA _REC_A1CUR_1_MBSE_S2_S1 8191.875 BMW_p_sw_q0p125_hPa -4096 4095.875 FORMAT "%10.3"
 /begin AXIS_DESCR COM_AXIS BMWtchbas_p_Dif_sw BMW_p_sw_q0p125_hPa 12 -4096 4095.875 AXIS_PTS_REF Antilag_BMWtchctr_p_DifCrtnPpDyn_Ax___MGF_CC_PF FORMAT "%10.3" MONOTONY MON_INCREASE DEPOSIT ABSOLUTE /end AXIS_DESCR
 /begin AXIS_DESCR COM_AXIS BMWtchsp_mf_Ex_uw CByjozc_eCmpBAb_pljBAmd_k__0oa0 6 0 2047.96875 AXIS_PTS_REF Antilag_BMWtchctr_p_DifCrtnPpDyn_Ay___MGF_CC_PF FORMAT "%10.3" MONOTONY STRICT_INCREASE DEPOSIT ABSOLUTE /end AXIS_DESCR
/end CHARACTERISTIC
/begin CHARACTERISTIC Antilag_BMWtchctr_pwr_Dp_M___MGF_CC_PF "D part of the performance-based boost pressure controller (X-Axis and Y-Axis do not switch, CCv7.1.1)" MAP 0x807C013A _REC_A1CUR_1_MBSE_S2_S1 127.998046875 jucyrzb_bpFgwfd_uqrfhgc_k__aoa0 -64 63.998046875 FORMAT "%10.3"
 /begin AXIS_DESCR COM_AXIS BMWtchbas_p_Dif_sw BMW_p_sw_q0p125_hPa 14 -4096 4095.875 AXIS_PTS_REF BMWtchctr_pwr_Dp_Ax FORMAT "%10.3" MONOTONY STRICT_INCREASE DEPOSIT ABSOLUTE /end AXIS_DESCR
 /begin AXIS_DESCR COM_AXIS BMWtchbas_p_DifGra_sw BMW_p_sw_q0p125_hPa 14 -4096 4095.875 AXIS_PTS_REF BMWtchctr_pwr_Dp_Ay FORMAT "%10.3" MONOTONY STRICT_INCREASE DEPOSIT ABSOLUTE /end AXIS_DESCR
/end CHARACTERISTIC
/begin CHARACTERISTIC Antilag_BMWtchctr_pwr_Pctl_M___MGF_CC_PF "Compressor map with required compressor / turbine performance (CCv7.1.1)" MAP 0x807C030A _REC_A1CUR_1_MBSE_U2_S1 127.998046875 jucyrzb_bpFgwfd_uqrfhgc_k__aoa0 0 127.998046875 FORMAT "%11.4"
 /begin AXIS_DESCR COM_AXIS BMWtchsp_rat_p_CmprLim_uw acriqBc_tfkBqod_ocgjxzc_nR_8oa0 20 0 7.9998779296875 AXIS_PTS_REF Antilag_BMWtchctr_pwr_Pctl_Ax___MGF_CC_PF FORMAT "%11.4" MONOTONY MON_INCREASE DEPOSIT ABSOLUTE /end AXIS_DESCR
 /begin AXIS_DESCR COM_AXIS BMWtchsp_mf_CmprNorm_uw CByjozc_eCmpBAb_pljBAmd_k__0oa0 16 0 2047.96875 AXIS_PTS_REF Antilag_BMWtchctr_pwr_Pctl_Ay___MGF_CC_PF FORMAT "%10.3" MONOTONY STRICT_INCREASE DEPOSIT ABSOLUTE /end AXIS_DESCR
/end CHARACTERISTIC
/begin CHARACTERISTIC Antilag_IgnRoll___MGF_CC_PF "Ignition setpoint: Engine speed [Nkw] vs Boost actual [Ps]. (CCv7.1.1)" MAP 0x807C0590 CurG_Ws16 0 ___MGF_CC_IgnitionTiming_d10 -32768 32767 MATRIX_DIM 10 10 1
 /begin AXIS_DESCR COM_AXIS Nkw caoddzd_oAjpfzb_cAcEEha_1nR_oa0 10 -32768 32767 AXIS_PTS_REF Antilag_IgnRoll_X_Axis___MGF_CC_PF EXTENDED_LIMITS 0 0 DEPOSIT ABSOLUTE /end AXIS_DESCR
 /begin AXIS_DESCR COM_AXIS Ps BMW_p_sw_q0p125_hPa 10 -32768 32767 AXIS_PTS_REF Antilag_IgnRoll_Y_Axis___MGF_CC_PF EXTENDED_LIMITS 0 0 DEPOSIT ABSOLUTE /end AXIS_DESCR
/end CHARACTERISTIC
/begin CHARACTERISTIC Antilag_IgnStand___MGF_CC_PF "Ignition setpoint: Engine speed [Nkw] vs Boost actual [Ps]. (CCv7.1.1)" MAP 0x807C0658 CurG_Ws16 0 ___MGF_CC_IgnitionTiming_d10 -32768 32767 MATRIX_DIM 10 10 1
 /begin AXIS_DESCR COM_AXIS Nkw caoddzd_oAjpfzb_cAcEEha_1nR_oa0 10 -32768 32767 AXIS_PTS_REF Antilag_IgnStand_X_Axis___MGF_CC_PF EXTENDED_LIMITS 0 0 DEPOSIT ABSOLUTE /end AXIS_DESCR
 /begin AXIS_DESCR COM_AXIS Ps BMW_p_sw_q0p125_hPa 10 -32768 32767 AXIS_PTS_REF Antilag_IgnStand_Y_Axis___MGF_CC_PF EXTENDED_LIMITS 0 0 DEPOSIT ABSOLUTE /end AXIS_DESCR
/end CHARACTERISTIC
/begin CHARACTERISTIC Antilag_LambdaRoll___MGF_CC_PF "Fueling setpoint: Engine speed [Nkw] vs Exhaust Gas Temperature [EGT] before turbine [Tabg_vl_xab]. (CCv7.1.1)" MAP 0x807C0720 KwUw 0 ___MGF_CC_Fueling_d10 -32768 32767 MATRIX_DIM 10 10 1
 /begin AXIS_DESCR COM_AXIS Nkw caoddzd_oAjpfzb_cAcEEha_1nR_oa0 10 -32768 32767 AXIS_PTS_REF Antilag_LambdaRoll_X_Axis___MGF_CC_PF EXTENDED_LIMITS 0 0 DEPOSIT ABSOLUTE /end AXIS_DESCR
 /begin AXIS_DESCR COM_AXIS Tabg_vl_xab BMW_q0p1_degC 10 -32768 32767 AXIS_PTS_REF Antilag_LambdaRoll_Y_Axis___MGF_CC_PF EXTENDED_LIMITS 0 0 DEPOSIT ABSOLUTE /end AXIS_DESCR
/end CHARACTERISTIC
/begin CHARACTERISTIC Antilag_LambdaStand___MGF_CC_PF "Fueling setpoint: Engine speed [Nkw] vs Exhaust Gas Temperature [EGT] before turbine [Tabg_vl_xab]. (CCv7.1.1)" MAP 0x807C07E8 KwUw 0 ___MGF_CC_Fueling_d10 -32768 32767 MATRIX_DIM 10 10 1
 /begin AXIS_DESCR COM_AXIS Nkw caoddzd_oAjpfzb_cAcEEha_1nR_oa0 10 -32768 32767 AXIS_PTS_REF Antilag_LambdaStand_X_Axis___MGF_CC_PF EXTENDED_LIMITS 0 0 DEPOSIT ABSOLUTE /end AXIS_DESCR
 /begin AXIS_DESCR COM_AXIS Tabg_vl_xab BMW_q0p1_degC 10 -32768 32767 AXIS_PTS_REF Antilag_LambdaStand_Y_Axis___MGF_CC_PF EXTENDED_LIMITS 0 0 DEPOSIT ABSOLUTE /end AXIS_DESCR
/end CHARACTERISTIC
/begin CHARACTERISTIC BMWtchctr_p_DifCrtnPp_M___MGF_CC_PF_Slot0 "Correction of pressure difference f. P-part of the performance-based boost pressure controller (X-Axis does not switch, Slot 0, OEM Address)" MAP 0x807212D2 _REC_A1CUR_1_MBSE_S2_S1 8191.875 BMW_p_sw_q0p125_hPa -4096 4095.875 FORMAT "%10.3"
 /begin AXIS_DESCR COM_AXIS BMWtchbas_p_Dif_sw BMW_p_sw_q0p125_hPa 12 -32768 32767 AXIS_PTS_REF BMWtchctr_p_DifCrtnPp_Ax EXTENDED_LIMITS 0 0 DEPOSIT ABSOLUTE /end AXIS_DESCR
 /begin AXIS_DESCR COM_AXIS BMWtchsp_mf_Ex_uw CByjozc_eCmpBAb_pljBAmd_k__0oa0 6 -32768 32767 AXIS_PTS_REF BMWtchctr_p_DifCrtnPp_Ay___MGF_CC_PF_Slot0 EXTENDED_LIMITS 0 0 DEPOSIT ABSOLUTE /end AXIS_DESCR
/end CHARACTERISTIC
/begin CHARACTERISTIC BMWtchctr_p_DifCrtnPp_M___MGF_CC_PF_Slot1 "Correction of pressure difference f. P-part of the performance-based boost pressure controller (X-Axis does not switch, Slot 1, CCv7.1.1, Pump Fuel)" MAP 0x807C0A48 _REC_A1CUR_1_MBSE_S2_S1 8191.875 BMW_p_sw_q0p125_hPa -4096 4095.875 FORMAT "%10.3"
 /begin AXIS_DESCR COM_AXIS BMWtchbas_p_Dif_sw BMW_p_sw_q0p125_hPa 12 -32768 32767 AXIS_PTS_REF BMWtchctr_p_DifCrtnPp_Ax EXTENDED_LIMITS 0 0 DEPOSIT ABSOLUTE /end AXIS_DESCR
 /begin AXIS_DESCR COM_AXIS BMWtchsp_mf_Ex_uw CByjozc_eCmpBAb_pljBAmd_k__0oa0 6 -32768 32767 AXIS_PTS_REF BMWtchctr_p_DifCrtnPp_Ay___MGF_CC_PF_Slot1 EXTENDED_LIMITS 0 0 DEPOSIT ABSOLUTE /end AXIS_DESCR
/end CHARACTERISTIC
/begin CHARACTERISTIC BMWtchctr_p_DifCrtnPp_M___MGF_CC_PF_Slot2 "Correction of pressure difference f. P-part of the performance-based boost pressure controller (X-Axis does not switch, Slot 2, CCv7.1.1, Pump Fuel)" MAP 0x807C0AD8 _REC_A1CUR_1_MBSE_S2_S1 8191.875 BMW_p_sw_q0p125_hPa -4096 4095.875 FORMAT "%10.3"
 /begin AXIS_DESCR COM_AXIS BMWtchbas_p_Dif_sw BMW_p_sw_q0p125_hPa 12 -32768 32767 AXIS_PTS_REF BMWtchctr_p_DifCrtnPp_Ax EXTENDED_LIMITS 0 0 DEPOSIT ABSOLUTE /end AXIS_DESCR
 /begin AXIS_DESCR COM_AXIS BMWtchsp_mf_Ex_uw CByjozc_eCmpBAb_pljBAmd_k__0oa0 6 -32768 32767 AXIS_PTS_REF BMWtchctr_p_DifCrtnPp_Ay___MGF_CC_PF_Slot2 EXTENDED_LIMITS 0 0 DEPOSIT ABSOLUTE /end AXIS_DESCR
/end CHARACTERISTIC
/begin CHARACTERISTIC BMWtchctr_p_DifCrtnPp_M___MGF_CC_PF_Slot3 "Correction of pressure difference f. P-part of the performance-based boost pressure controller (X-Axis does not switch, Slot 3, CCv7.1.1, Pump Fuel)" MAP 0x807C0B68 _REC_A1CUR_1_MBSE_S2_S1 8191.875 BMW_p_sw_q0p125_hPa -4096 4095.875 FORMAT "%10.3"
 /begin AXIS_DESCR COM_AXIS BMWtchbas_p_Dif_sw BMW_p_sw_q0p125_hPa 12 -32768 32767 AXIS_PTS_REF BMWtchctr_p_DifCrtnPp_Ax EXTENDED_LIMITS 0 0 DEPOSIT ABSOLUTE /end AXIS_DESCR
 /begin AXIS_DESCR COM_AXIS BMWtchsp_mf_Ex_uw CByjozc_eCmpBAb_pljBAmd_k__0oa0 6 -32768 32767 AXIS_PTS_REF BMWtchctr_p_DifCrtnPp_Ay___MGF_CC_PF_Slot3 EXTENDED_LIMITS 0 0 DEPOSIT ABSOLUTE /end AXIS_DESCR
/end CHARACTERISTIC
/begin CHARACTERISTIC BMWtchctr_p_DifCrtnPp_M___MGF_CC_PF_Slot4 "Correction of pressure difference f. P-part of the performance-based boost pressure controller (X-Axis does not switch, Slot 4, CCv7.1.1, Pump Fuel)" MAP 0x807C0BF8 _REC_A1CUR_1_MBSE_S2_S1 8191.875 BMW_p_sw_q0p125_hPa -4096 4095.875 FORMAT "%10.3"
 /begin AXIS_DESCR COM_AXIS BMWtchbas_p_Dif_sw BMW_p_sw_q0p125_hPa 12 -32768 32767 AXIS_PTS_REF BMWtchctr_p_DifCrtnPp_Ax EXTENDED_LIMITS 0 0 DEPOSIT ABSOLUTE /end AXIS_DESCR
 /begin AXIS_DESCR COM_AXIS BMWtchsp_mf_Ex_uw CByjozc_eCmpBAb_pljBAmd_k__0oa0 6 -32768 32767 AXIS_PTS_REF BMWtchctr_p_DifCrtnPp_Ay___MGF_CC_PF_Slot4 EXTENDED_LIMITS 0 0 DEPOSIT ABSOLUTE /end AXIS_DESCR
/end CHARACTERISTIC
/begin CHARACTERISTIC BMWtchctr_pct_WgBasc_M___MGF_CC_PF_Slot0 "Wastegate Position - for pilot control (Slot 0, OEM Address)" MAP 0x80740648 _REC_A1CUR_1_MBSE_U2_S1 99.9984741210938 wDDoctd_cCDyaFa_AvCkvFb_nR_6o0o 0 99.9984741210938 FORMAT "%10.3"
 /begin AXIS_DESCR COM_AXIS NO_INPUT_QUANTITY ilxsavd_hkzmBfc_lAzCpAb_nR_1oa0 12 0 3.99993896484375 AXIS_PTS_REF BMWtchctr_pct_WgBasc_Ax FORMAT "%14.5" MONOTONY STRICT_INCREASE DEPOSIT ABSOLUTE /end AXIS_DESCR
 /begin AXIS_DESCR COM_AXIS NO_INPUT_QUANTITY CByjozc_eCmpBAb_pljBAmd_k__0oa0 12 0 2047.96875 AXIS_PTS_REF BMWtchctr_pct_WgBasc_Ay FORMAT "%10.3" MONOTONY STRICT_INCREASE DEPOSIT ABSOLUTE /end AXIS_DESCR
/end CHARACTERISTIC
/begin CHARACTERISTIC BMWtchctr_pct_WgBasc_M___MGF_CC_PF_Slot1 "Wastegate Position - for pilot control (Slot 1, CCv7.1.1, Pump Fuel)" MAP 0x807C0C88 _REC_A1CUR_1_MBSE_U2_S1 99.9984741210938 wDDoctd_cCDyaFa_AvCkvFb_nR_6o0o 0 99.9984741210938 FORMAT "%10.3"
 /begin AXIS_DESCR COM_AXIS NO_INPUT_QUANTITY ilxsavd_hkzmBfc_lAzCpAb_nR_1oa0 12 0 3.99993896484375 AXIS_PTS_REF BMWtchctr_pct_WgBasc_Ax FORMAT "%14.5" MONOTONY STRICT_INCREASE DEPOSIT ABSOLUTE /end AXIS_DESCR
 /begin AXIS_DESCR COM_AXIS NO_INPUT_QUANTITY CByjozc_eCmpBAb_pljBAmd_k__0oa0 12 0 2047.96875 AXIS_PTS_REF BMWtchctr_pct_WgBasc_Ay FORMAT "%10.3" MONOTONY STRICT_INCREASE DEPOSIT ABSOLUTE /end AXIS_DESCR
/end CHARACTERISTIC
/begin CHARACTERISTIC BMWtchctr_pct_WgBasc_M___MGF_CC_PF_Slot2 "Wastegate Position - for pilot control (Slot 2, CCv7.1.1, Pump Fuel)" MAP 0x807C0DA8 _REC_A1CUR_1_MBSE_U2_S1 99.9984741210938 wDDoctd_cCDyaFa_AvCkvFb_nR_6o0o 0 99.9984741210938 FORMAT "%10.3"
 /begin AXIS_DESCR COM_AXIS NO_INPUT_QUANTITY ilxsavd_hkzmBfc_lAzCpAb_nR_1oa0 12 0 3.99993896484375 AXIS_PTS_REF BMWtchctr_pct_WgBasc_Ax FORMAT "%14.5" MONOTONY STRICT_INCREASE DEPOSIT ABSOLUTE /end AXIS_DESCR
 /begin AXIS_DESCR COM_AXIS NO_INPUT_QUANTITY CByjozc_eCmpBAb_pljBAmd_k__0oa0 12 0 2047.96875 AXIS_PTS_REF BMWtchctr_pct_WgBasc_Ay FORMAT "%10.3" MONOTONY STRICT_INCREASE DEPOSIT ABSOLUTE /end AXIS_DESCR
/end CHARACTERISTIC
/begin CHARACTERISTIC BMWtchctr_pct_WgBasc_M___MGF_CC_PF_Slot3 "Wastegate Position - for pilot control (Slot 3, CCv7.1.1, Pump Fuel)" MAP 0x807C0EC8 _REC_A1CUR_1_MBSE_U2_S1 99.9984741210938 wDDoctd_cCDyaFa_AvCkvFb_nR_6o0o 0 99.9984741210938 FORMAT "%10.3"
 /begin AXIS_DESCR COM_AXIS NO_INPUT_QUANTITY ilxsavd_hkzmBfc_lAzCpAb_nR_1oa0 12 0 3.99993896484375 AXIS_PTS_REF BMWtchctr_pct_WgBasc_Ax FORMAT "%14.5" MONOTONY STRICT_INCREASE DEPOSIT ABSOLUTE /end AXIS_DESCR
 /begin AXIS_DESCR COM_AXIS NO_INPUT_QUANTITY CByjozc_eCmpBAb_pljBAmd_k__0oa0 12 0 2047.96875 AXIS_PTS_REF BMWtchctr_pct_WgBasc_Ay FORMAT "%10.3" MONOTONY STRICT_INCREASE DEPOSIT ABSOLUTE /end AXIS_DESCR
/end CHARACTERISTIC
/begin CHARACTERISTIC BMWtchctr_pct_WgBasc_M___MGF_CC_PF_Slot4 "Wastegate Position - for pilot control (Slot 4, CCv7.1.1, Pump Fuel)" MAP 0x807C0FE8 _REC_A1CUR_1_MBSE_U2_S1 99.9984741210938 wDDoctd_cCDyaFa_AvCkvFb_nR_6o0o 0 99.9984741210938 FORMAT "%10.3"
 /begin AXIS_DESCR COM_AXIS NO_INPUT_QUANTITY ilxsavd_hkzmBfc_lAzCpAb_nR_1oa0 12 0 3.99993896484375 AXIS_PTS_REF BMWtchctr_pct_WgBasc_Ax FORMAT "%14.5" MONOTONY STRICT_INCREASE DEPOSIT ABSOLUTE /end AXIS_DESCR
 /begin AXIS_DESCR COM_AXIS NO_INPUT_QUANTITY CByjozc_eCmpBAb_pljBAmd_k__0oa0 12 0 2047.96875 AXIS_PTS_REF BMWtchctr_pct_WgBasc_Ay FORMAT "%10.3" MONOTONY STRICT_INCREASE DEPOSIT ABSOLUTE /end AXIS_DESCR
/end CHARACTERISTIC
/begin CHARACTERISTIC BMWtchctr_pwr_Dp_M___MGF_CC_PF_Slot0 "D part of the performance-based boost pressure controller (X-Axis and Y-Axis do not switch, Slot 0, OEM Address)" MAP 0x8072102A _REC_A1CUR_1_MBSE_S2_S1 127.998046875 jucyrzb_bpFgwfd_uqrfhgc_k__aoa0 -64 63.998046875 FORMAT "%10.3"
 /begin AXIS_DESCR COM_AXIS BMWtchbas_p_Dif_sw BMW_p_sw_q0p125_hPa 14 -4096 4095.875 AXIS_PTS_REF BMWtchctr_pwr_Dp_Ax FORMAT "%10.3" MONOTONY STRICT_INCREASE DEPOSIT ABSOLUTE /end AXIS_DESCR
 /begin AXIS_DESCR COM_AXIS BMWtchbas_p_DifGra_sw BMW_p_sw_q0p125_hPa 14 -4096 4095.875 AXIS_PTS_REF BMWtchctr_pwr_Dp_Ay FORMAT "%10.3" MONOTONY STRICT_INCREASE DEPOSIT ABSOLUTE /end AXIS_DESCR
/end CHARACTERISTIC
/begin CHARACTERISTIC BMWtchctr_pwr_Dp_M___MGF_CC_PF_Slot1 "D part of the performance-based boost pressure controller (X-Axis and Y-Axis do not switch, Slot 1, CCv7.1.1, Pump Fuel)" MAP 0x807C1108 _REC_A1CUR_1_MBSE_S2_S1 127.998046875 jucyrzb_bpFgwfd_uqrfhgc_k__aoa0 -64 63.998046875 FORMAT "%10.3"
 /begin AXIS_DESCR COM_AXIS BMWtchbas_p_Dif_sw BMW_p_sw_q0p125_hPa 14 -4096 4095.875 AXIS_PTS_REF BMWtchctr_pwr_Dp_Ax FORMAT "%10.3" MONOTONY STRICT_INCREASE DEPOSIT ABSOLUTE /end AXIS_DESCR
 /begin AXIS_DESCR COM_AXIS BMWtchbas_p_DifGra_sw BMW_p_sw_q0p125_hPa 14 -4096 4095.875 AXIS_PTS_REF BMWtchctr_pwr_Dp_Ay FORMAT "%10.3" MONOTONY STRICT_INCREASE DEPOSIT ABSOLUTE /end AXIS_DESCR
/end CHARACTERISTIC
/begin CHARACTERISTIC BMWtchctr_pwr_Dp_M___MGF_CC_PF_Slot2 "D part of the performance-based boost pressure controller (X-Axis and Y-Axis do not switch, Slot 2, CCv7.1.1, Pump Fuel)" MAP 0x807C1290 _REC_A1CUR_1_MBSE_S2_S1 127.998046875 jucyrzb_bpFgwfd_uqrfhgc_k__aoa0 -64 63.998046875 FORMAT "%10.3"
 /begin AXIS_DESCR COM_AXIS BMWtchbas_p_Dif_sw BMW_p_sw_q0p125_hPa 14 -4096 4095.875 AXIS_PTS_REF BMWtchctr_pwr_Dp_Ax FORMAT "%10.3" MONOTONY STRICT_INCREASE DEPOSIT ABSOLUTE /end AXIS_DESCR
 /begin AXIS_DESCR COM_AXIS BMWtchbas_p_DifGra_sw BMW_p_sw_q0p125_hPa 14 -4096 4095.875 AXIS_PTS_REF BMWtchctr_pwr_Dp_Ay FORMAT "%10.3" MONOTONY STRICT_INCREASE DEPOSIT ABSOLUTE /end AXIS_DESCR
/end CHARACTERISTIC
/begin CHARACTERISTIC BMWtchctr_pwr_Dp_M___MGF_CC_PF_Slot3 "D part of the performance-based boost pressure controller (X-Axis and Y-Axis do not switch, Slot 3, CCv7.1.1, Pump Fuel)" MAP 0x807C1418 _REC_A1CUR_1_MBSE_S2_S1 127.998046875 jucyrzb_bpFgwfd_uqrfhgc_k__aoa0 -64 63.998046875 FORMAT "%10.3"
 /begin AXIS_DESCR COM_AXIS BMWtchbas_p_Dif_sw BMW_p_sw_q0p125_hPa 14 -4096 4095.875 AXIS_PTS_REF BMWtchctr_pwr_Dp_Ax FORMAT "%10.3" MONOTONY STRICT_INCREASE DEPOSIT ABSOLUTE /end AXIS_DESCR
 /begin AXIS_DESCR COM_AXIS BMWtchbas_p_DifGra_sw BMW_p_sw_q0p125_hPa 14 -4096 4095.875 AXIS_PTS_REF BMWtchctr_pwr_Dp_Ay FORMAT "%10.3" MONOTONY STRICT_INCREASE DEPOSIT ABSOLUTE /end AXIS_DESCR
/end CHARACTERISTIC
/begin CHARACTERISTIC BMWtchctr_pwr_Dp_M___MGF_CC_PF_Slot4 "D part of the performance-based boost pressure controller (X-Axis and Y-Axis do not switch, Slot 4, CCv7.1.1, Pump Fuel)" MAP 0x807C15A0 _REC_A1CUR_1_MBSE_S2_S1 127.998046875 jucyrzb_bpFgwfd_uqrfhgc_k__aoa0 -64 63.998046875 FORMAT "%10.3"
 /begin AXIS_DESCR COM_AXIS BMWtchbas_p_Dif_sw BMW_p_sw_q0p125_hPa 14 -4096 4095.875 AXIS_PTS_REF BMWtchctr_pwr_Dp_Ax FORMAT "%10.3" MONOTONY STRICT_INCREASE DEPOSIT ABSOLUTE /end AXIS_DESCR
 /begin AXIS_DESCR COM_AXIS BMWtchbas_p_DifGra_sw BMW_p_sw_q0p125_hPa 14 -4096 4095.875 AXIS_PTS_REF BMWtchctr_pwr_Dp_Ay FORMAT "%10.3" MONOTONY STRICT_INCREASE DEPOSIT ABSOLUTE /end AXIS_DESCR
/end CHARACTERISTIC
/begin CHARACTERISTIC BMWtchctr_pwr_Pctl_M___MGF_CC_PF_Slot0 "Compressor map with required compressor / turbine performance (X-Axis does not switch, Slot 0, OEM Address)" MAP 0x80720DAA _REC_A1CUR_1_MBSE_U2_S1 127.998046875 jucyrzb_bpFgwfd_uqrfhgc_k__aoa0 0 127.998046875 FORMAT "%11.4"
 /begin AXIS_DESCR COM_AXIS BMWtchsp_rat_p_CmprLim_uw acriqBc_tfkBqod_ocgjxzc_nR_8oa0 20 -32768 32767 AXIS_PTS_REF BMWtchctr_pwr_Pctl_Ax___MGF_CC_PF_Slot0 EXTENDED_LIMITS 0 0 DEPOSIT ABSOLUTE /end AXIS_DESCR
 /begin AXIS_DESCR COM_AXIS BMWtchsp_mf_CmprNorm_uw CByjozc_eCmpBAb_pljBAmd_k__0oa0 16 -32768 32767 AXIS_PTS_REF BMWtchctr_pwr_Pctl_Ay___MGF_CC_PF_Slot0 EXTENDED_LIMITS 0 0 DEPOSIT ABSOLUTE /end AXIS_DESCR
/end CHARACTERISTIC
/begin CHARACTERISTIC BMWtchctr_pwr_Pctl_M___MGF_CC_PF_Slot1 "Compressor map with required compressor / turbine performance (X-Axis does not switch, Slot 1, CCv7.1.1, Pump Fuel)" MAP 0x807C1848 _REC_A1CUR_1_MBSE_U2_S1 127.998046875 jucyrzb_bpFgwfd_uqrfhgc_k__aoa0 0 127.998046875 FORMAT "%11.4"
 /begin AXIS_DESCR COM_AXIS BMWtchsp_rat_p_CmprLim_uw acriqBc_tfkBqod_ocgjxzc_nR_8oa0 20 -32768 32767 AXIS_PTS_REF BMWtchctr_pwr_Pctl_Ax___MGF_CC_PF_Slot1 EXTENDED_LIMITS 0 0 DEPOSIT ABSOLUTE /end AXIS_DESCR
 /begin AXIS_DESCR COM_AXIS BMWtchsp_mf_CmprNorm_uw CByjozc_eCmpBAb_pljBAmd_k__0oa0 16 -32768 32767 AXIS_PTS_REF BMWtchctr_pwr_Pctl_Ay___MGF_CC_PF_Slot1 EXTENDED_LIMITS 0 0 DEPOSIT ABSOLUTE /end AXIS_DESCR
/end CHARACTERISTIC
/begin CHARACTERISTIC BMWtchctr_pwr_Pctl_M___MGF_CC_PF_Slot2 "Compressor map with required compressor / turbine performance (X-Axis does not switch, Slot 2, CCv7.1.1, Pump Fuel)" MAP 0x807C1AC8 _REC_A1CUR_1_MBSE_U2_S1 127.998046875 jucyrzb_bpFgwfd_uqrfhgc_k__aoa0 0 127.998046875 FORMAT "%11.4"
 /begin AXIS_DESCR COM_AXIS BMWtchsp_rat_p_CmprLim_uw acriqBc_tfkBqod_ocgjxzc_nR_8oa0 20 -32768 32767 AXIS_PTS_REF BMWtchctr_pwr_Pctl_Ax___MGF_CC_PF_Slot2 EXTENDED_LIMITS 0 0 DEPOSIT ABSOLUTE /end AXIS_DESCR
 /begin AXIS_DESCR COM_AXIS BMWtchsp_mf_CmprNorm_uw CByjozc_eCmpBAb_pljBAmd_k__0oa0 16 -32768 32767 AXIS_PTS_REF BMWtchctr_pwr_Pctl_Ay___MGF_CC_PF_Slot2 EXTENDED_LIMITS 0 0 DEPOSIT ABSOLUTE /end AXIS_DESCR
/end CHARACTERISTIC
/begin CHARACTERISTIC BMWtchctr_pwr_Pctl_M___MGF_CC_PF_Slot3 "Compressor map with required compressor / turbine performance (X-Axis does not switch, Slot 3, CCv7.1.1, Pump Fuel)" MAP 0x807C1D48 _REC_A1CUR_1_MBSE_U2_S1 127.998046875 jucyrzb_bpFgwfd_uqrfhgc_k__aoa0 0 127.998046875 FORMAT "%11.4"
 /begin AXIS_DESCR COM_AXIS BMWtchsp_rat_p_CmprLim_uw acriqBc_tfkBqod_ocgjxzc_nR_8oa0 20 -32768 32767 AXIS_PTS_REF BMWtchctr_pwr_Pctl_Ax___MGF_CC_PF_Slot3 EXTENDED_LIMITS 0 0 DEPOSIT ABSOLUTE /end AXIS_DESCR
 /begin AXIS_DESCR COM_AXIS BMWtchsp_mf_CmprNorm_uw CByjozc_eCmpBAb_pljBAmd_k__0oa0 16 -32768 32767 AXIS_PTS_REF BMWtchctr_pwr_Pctl_Ay___MGF_CC_PF_Slot3 EXTENDED_LIMITS 0 0 DEPOSIT ABSOLUTE /end AXIS_DESCR
/end CHARACTERISTIC
/begin CHARACTERISTIC BMWtchctr_pwr_Pctl_M___MGF_CC_PF_Slot4 "Compressor map with required compressor / turbine performance (X-Axis does not switch, Slot 4, CCv7.1.1, Pump Fuel)" MAP 0x807C1FC8 _REC_A1CUR_1_MBSE_U2_S1 127.998046875 jucyrzb_bpFgwfd_uqrfhgc_k__aoa0 0 127.998046875 FORMAT "%11.4"
 /begin AXIS_DESCR COM_AXIS BMWtchsp_rat_p_CmprLim_uw acriqBc_tfkBqod_ocgjxzc_nR_8oa0 20 -32768 32767 AXIS_PTS_REF BMWtchctr_pwr_Pctl_Ax___MGF_CC_PF_Slot4 EXTENDED_LIMITS 0 0 DEPOSIT ABSOLUTE /end AXIS_DESCR
 /begin AXIS_DESCR COM_AXIS BMWtchsp_mf_CmprNorm_uw CByjozc_eCmpBAb_pljBAmd_k__0oa0 16 -32768 32767 AXIS_PTS_REF BMWtchctr_pwr_Pctl_Ay___MGF_CC_PF_Slot4 EXTENDED_LIMITS 0 0 DEPOSIT ABSOLUTE /end AXIS_DESCR
/end CHARACTERISTIC
/begin CHARACTERISTIC BMWtchsp_rat_p_CmprMax_M___MGF_CC_PF_Slot0 "KF_FPLDMAX (Slot 0, OEM Address)" MAP 0x80721C46 _REC_A1CUR_1_MBSE_U2_S1 3.99993896484375 ilxsavd_hkzmBfc_lAzCpAb_nR_1oa0 0 3.99993896484375
 /begin AXIS_DESCR COM_AXIS BMWtchsp_mf_CmprNorm_uw CByjozc_eCmpBAb_pljBAmd_k__0oa0 8 0 2047.96875 AXIS_PTS_REF BMWtchsp_rat_p_CmprMax_Ax FORMAT "%10.3" MONOTONY STRICT_INCREASE DEPOSIT ABSOLUTE /end AXIS_DESCR
 /begin AXIS_DESCR COM_AXIS BMWtchtbc_t_BefCmpr_sw BMW_q0p1_degC 6 -3276.8 3276.7 AXIS_PTS_REF BMWtchsp_rat_p_CmprMax_Ay FORMAT "%6.1" MONOTONY STRICT_INCREASE DEPOSIT ABSOLUTE /end AXIS_DESCR
/end CHARACTERISTIC
/begin CHARACTERISTIC BMWtchsp_rat_p_CmprMax_M___MGF_CC_PF_Slot1 "KF_FPLDMAX (Slot 1, CCv7.1.1, Pump Fuel)" MAP 0x807C2250 _REC_A1CUR_1_MBSE_U2_S1 3.99993896484375 ilxsavd_hkzmBfc_lAzCpAb_nR_1oa0 0 3.99993896484375
 /begin AXIS_DESCR COM_AXIS BMWtchsp_mf_CmprNorm_uw CByjozc_eCmpBAb_pljBAmd_k__0oa0 8 0 2047.96875 AXIS_PTS_REF BMWtchsp_rat_p_CmprMax_Ax FORMAT "%10.3" MONOTONY STRICT_INCREASE DEPOSIT ABSOLUTE /end AXIS_DESCR
 /begin AXIS_DESCR COM_AXIS BMWtchtbc_t_BefCmpr_sw BMW_q0p1_degC 6 -3276.8 3276.7 AXIS_PTS_REF BMWtchsp_rat_p_CmprMax_Ay FORMAT "%6.1" MONOTONY STRICT_INCREASE DEPOSIT ABSOLUTE /end AXIS_DESCR
/end CHARACTERISTIC
/begin CHARACTERISTIC BMWtchsp_rat_p_CmprMax_M___MGF_CC_PF_Slot2 "KF_FPLDMAX (Slot 2, CCv7.1.1, Pump Fuel)" MAP 0x807C22B0 _REC_A1CUR_1_MBSE_U2_S1 3.99993896484375 ilxsavd_hkzmBfc_lAzCpAb_nR_1oa0 0 3.99993896484375
 /begin AXIS_DESCR COM_AXIS BMWtchsp_mf_CmprNorm_uw CByjozc_eCmpBAb_pljBAmd_k__0oa0 8 0 2047.96875 AXIS_PTS_REF BMWtchsp_rat_p_CmprMax_Ax FORMAT "%10.3" MONOTONY STRICT_INCREASE DEPOSIT ABSOLUTE /end AXIS_DESCR
 /begin AXIS_DESCR COM_AXIS BMWtchtbc_t_BefCmpr_sw BMW_q0p1_degC 6 -3276.8 3276.7 AXIS_PTS_REF BMWtchsp_rat_p_CmprMax_Ay FORMAT "%6.1" MONOTONY STRICT_INCREASE DEPOSIT ABSOLUTE /end AXIS_DESCR
/end CHARACTERISTIC
/begin CHARACTERISTIC BMWtchsp_rat_p_CmprMax_M___MGF_CC_PF_Slot3 "KF_FPLDMAX (Slot 3, CCv7.1.1, Pump Fuel)" MAP 0x807C2310 _REC_A1CUR_1_MBSE_U2_S1 3.99993896484375 ilxsavd_hkzmBfc_lAzCpAb_nR_1oa0 0 3.99993896484375
 /begin AXIS_DESCR COM_AXIS BMWtchsp_mf_CmprNorm_uw CByjozc_eCmpBAb_pljBAmd_k__0oa0 8 0 2047.96875 AXIS_PTS_REF BMWtchsp_rat_p_CmprMax_Ax FORMAT "%10.3" MONOTONY STRICT_INCREASE DEPOSIT ABSOLUTE /end AXIS_DESCR
 /begin AXIS_DESCR COM_AXIS BMWtchtbc_t_BefCmpr_sw BMW_q0p1_degC 6 -3276.8 3276.7 AXIS_PTS_REF BMWtchsp_rat_p_CmprMax_Ay FORMAT "%6.1" MONOTONY STRICT_INCREASE DEPOSIT ABSOLUTE /end AXIS_DESCR
/end CHARACTERISTIC
/begin CHARACTERISTIC BMWtchsp_rat_p_CmprMax_M___MGF_CC_PF_Slot4 "KF_FPLDMAX (Slot 4, CCv7.1.1, Pump Fuel)" MAP 0x807C2370 _REC_A1CUR_1_MBSE_U2_S1 3.99993896484375 ilxsavd_hkzmBfc_lAzCpAb_nR_1oa0 0 3.99993896484375
 /begin AXIS_DESCR COM_AXIS BMWtchsp_mf_CmprNorm_uw CByjozc_eCmpBAb_pljBAmd_k__0oa0 8 0 2047.96875 AXIS_PTS_REF BMWtchsp_rat_p_CmprMax_Ax FORMAT "%10.3" MONOTONY STRICT_INCREASE DEPOSIT ABSOLUTE /end AXIS_DESCR
 /begin AXIS_DESCR COM_AXIS BMWtchtbc_t_BefCmpr_sw BMW_q0p1_degC 6 -3276.8 3276.7 AXIS_PTS_REF BMWtchsp_rat_p_CmprMax_Ay FORMAT "%6.1" MONOTONY STRICT_INCREASE DEPOSIT ABSOLUTE /end AXIS_DESCR
/end CHARACTERISTIC
/begin CHARACTERISTIC KF_FDZWT_PF1___MGF_CC_PF_Slot0 "Factor temperature correction ZW knock limit path 1 (Slot 0, OEM Address)" MAP 0x80730296 _REC_A1CUR_1_MBSE_S2_S1 3.9998779296875 ilxsavd_hkzmBfc_lAzCpAb_nR_1oa0 -2 1.9998779296875 FORMAT "%14.5"
 /begin AXIS_DESCR COM_AXIS Tmot DchEpAd_DBCFgoa_Ckhahgc_q__aoa0 6 -327.68 327.67 AXIS_PTS_REF AXX_KF_FDZWT_PF1 FORMAT "%7.2" MONOTONY STRICT_INCREASE DEPOSIT ABSOLUTE /end AXIS_DESCR
 /begin AXIS_DESCR COM_AXIS Tans BMW_q0p1_degC 6 -3276.8 3276.7 AXIS_PTS_REF AXY_KF_FDZWT_PF1 FORMAT "%6.1" MONOTONY STRICT_INCREASE DEPOSIT ABSOLUTE /end AXIS_DESCR
/end CHARACTERISTIC
/begin CHARACTERISTIC KF_FDZWT_PF1___MGF_CC_PF_Slot1 "Factor temperature correction ZW knock limit path 1 (Slot 1, CCv7.1.1, Pump Fuel)" MAP 0x807C25C8 _REC_A1CUR_1_MBSE_S2_S1 3.9998779296875 ilxsavd_hkzmBfc_lAzCpAb_nR_1oa0 -2 1.9998779296875 FORMAT "%14.5"
 /begin AXIS_DESCR COM_AXIS Tmot DchEpAd_DBCFgoa_Ckhahgc_q__aoa0 6 -327.68 327.67 AXIS_PTS_REF AXX_KF_FDZWT_PF1 FORMAT "%7.2" MONOTONY STRICT_INCREASE DEPOSIT ABSOLUTE /end AXIS_DESCR
 /begin AXIS_DESCR COM_AXIS Tans BMW_q0p1_degC 6 -3276.8 3276.7 AXIS_PTS_REF AXY_KF_FDZWT_PF1 FORMAT "%6.1" MONOTONY STRICT_INCREASE DEPOSIT ABSOLUTE /end AXIS_DESCR
/end CHARACTERISTIC
/begin CHARACTERISTIC KF_FDZWT_PF1___MGF_CC_PF_Slot2 "Factor temperature correction ZW knock limit path 1 (Slot 2, CCv7.1.1, Pump Fuel)" MAP 0x807C2610 _REC_A1CUR_1_MBSE_S2_S1 3.9998779296875 ilxsavd_hkzmBfc_lAzCpAb_nR_1oa0 -2 1.9998779296875 FORMAT "%14.5"
 /begin AXIS_DESCR COM_AXIS Tmot DchEpAd_DBCFgoa_Ckhahgc_q__aoa0 6 -327.68 327.67 AXIS_PTS_REF AXX_KF_FDZWT_PF1 FORMAT "%7.2" MONOTONY STRICT_INCREASE DEPOSIT ABSOLUTE /end AXIS_DESCR
 /begin AXIS_DESCR COM_AXIS Tans BMW_q0p1_degC 6 -3276.8 3276.7 AXIS_PTS_REF AXY_KF_FDZWT_PF1 FORMAT "%6.1" MONOTONY STRICT_INCREASE DEPOSIT ABSOLUTE /end AXIS_DESCR
/end CHARACTERISTIC
/begin CHARACTERISTIC KF_FDZWT_PF1___MGF_CC_PF_Slot3 "Factor temperature correction ZW knock limit path 1 (Slot 3, CCv7.1.1, Pump Fuel)" MAP 0x807C2658 _REC_A1CUR_1_MBSE_S2_S1 3.9998779296875 ilxsavd_hkzmBfc_lAzCpAb_nR_1oa0 -2 1.9998779296875 FORMAT "%14.5"
 /begin AXIS_DESCR COM_AXIS Tmot DchEpAd_DBCFgoa_Ckhahgc_q__aoa0 6 -327.68 327.67 AXIS_PTS_REF AXX_KF_FDZWT_PF1 FORMAT "%7.2" MONOTONY STRICT_INCREASE DEPOSIT ABSOLUTE /end AXIS_DESCR
 /begin AXIS_DESCR COM_AXIS Tans BMW_q0p1_degC 6 -3276.8 3276.7 AXIS_PTS_REF AXY_KF_FDZWT_PF1 FORMAT "%6.1" MONOTONY STRICT_INCREASE DEPOSIT ABSOLUTE /end AXIS_DESCR
/end CHARACTERISTIC
/begin CHARACTERISTIC KF_FDZWT_PF1___MGF_CC_PF_Slot4 "Factor temperature correction ZW knock limit path 1 (Slot 4, CCv7.1.1, Pump Fuel)" MAP 0x807C26A0 _REC_A1CUR_1_MBSE_S2_S1 3.9998779296875 ilxsavd_hkzmBfc_lAzCpAb_nR_1oa0 -2 1.9998779296875 FORMAT "%14.5"
 /begin AXIS_DESCR COM_AXIS Tmot DchEpAd_DBCFgoa_Ckhahgc_q__aoa0 6 -327.68 327.67 AXIS_PTS_REF AXX_KF_FDZWT_PF1 FORMAT "%7.2" MONOTONY STRICT_INCREASE DEPOSIT ABSOLUTE /end AXIS_DESCR
 /begin AXIS_DESCR COM_AXIS Tans BMW_q0p1_degC 6 -3276.8 3276.7 AXIS_PTS_REF AXY_KF_FDZWT_PF1 FORMAT "%6.1" MONOTONY STRICT_INCREASE DEPOSIT ABSOLUTE /end AXIS_DESCR
/end CHARACTERISTIC
/begin CHARACTERISTIC KF_FDZWT_PF2___MGF_CC_PF_Slot0 "Factor temperature correction ZW knock limit path 2 (Slot 0, OEM Address)" MAP 0x8073024E _REC_A1CUR_1_MBSE_S2_S1 3.9998779296875 ilxsavd_hkzmBfc_lAzCpAb_nR_1oa0 -2 1.9998779296875 FORMAT "%14.5"
 /begin AXIS_DESCR COM_AXIS Tmot DchEpAd_DBCFgoa_Ckhahgc_q__aoa0 6 -327.68 327.67 AXIS_PTS_REF AXX_KF_FDZWT_PF2 FORMAT "%7.2" MONOTONY STRICT_INCREASE DEPOSIT ABSOLUTE /end AXIS_DESCR
 /begin AXIS_DESCR COM_AXIS Tans BMW_q0p1_degC 6 -3276.8 3276.7 AXIS_PTS_REF AXY_KF_FDZWT_PF2 FORMAT "%6.1" MONOTONY STRICT_INCREASE DEPOSIT ABSOLUTE /end AXIS_DESCR
/end CHARACTERISTIC
/begin CHARACTERISTIC KF_FDZWT_PF2___MGF_CC_PF_Slot1 "Factor temperature correction ZW knock limit path 2 (Slot 1, CCv7.1.1, Pump Fuel)" MAP 0x807C26E8 _REC_A1CUR_1_MBSE_S2_S1 3.9998779296875 ilxsavd_hkzmBfc_lAzCpAb_nR_1oa0 -2 1.9998779296875 FORMAT "%14.5"
 /begin AXIS_DESCR COM_AXIS Tmot DchEpAd_DBCFgoa_Ckhahgc_q__aoa0 6 -327.68 327.67 AXIS_PTS_REF AXX_KF_FDZWT_PF2 FORMAT "%7.2" MONOTONY STRICT_INCREASE DEPOSIT ABSOLUTE /end AXIS_DESCR
 /begin AXIS_DESCR COM_AXIS Tans BMW_q0p1_degC 6 -3276.8 3276.7 AXIS_PTS_REF AXY_KF_FDZWT_PF2 FORMAT "%6.1" MONOTONY STRICT_INCREASE DEPOSIT ABSOLUTE /end AXIS_DESCR
/end CHARACTERISTIC
/begin CHARACTERISTIC KF_FDZWT_PF2___MGF_CC_PF_Slot2 "Factor temperature correction ZW knock limit path 2 (Slot 2, CCv7.1.1, Pump Fuel)" MAP 0x807C2730 _REC_A1CUR_1_MBSE_S2_S1 3.9998779296875 ilxsavd_hkzmBfc_lAzCpAb_nR_1oa0 -2 1.9998779296875 FORMAT "%14.5"
 /begin AXIS_DESCR COM_AXIS Tmot DchEpAd_DBCFgoa_Ckhahgc_q__aoa0 6 -327.68 327.67 AXIS_PTS_REF AXX_KF_FDZWT_PF2 FORMAT "%7.2" MONOTONY STRICT_INCREASE DEPOSIT ABSOLUTE /end AXIS_DESCR
 /begin AXIS_DESCR COM_AXIS Tans BMW_q0p1_degC 6 -3276.8 3276.7 AXIS_PTS_REF AXY_KF_FDZWT_PF2 FORMAT "%6.1" MONOTONY STRICT_INCREASE DEPOSIT ABSOLUTE /end AXIS_DESCR
/end CHARACTERISTIC
/begin CHARACTERISTIC KF_FDZWT_PF2___MGF_CC_PF_Slot3 "Factor temperature correction ZW knock limit path 2 (Slot 3, CCv7.1.1, Pump Fuel)" MAP 0x807C2778 _REC_A1CUR_1_MBSE_S2_S1 3.9998779296875 ilxsavd_hkzmBfc_lAzCpAb_nR_1oa0 -2 1.9998779296875 FORMAT "%14.5"
 /begin AXIS_DESCR COM_AXIS Tmot DchEpAd_DBCFgoa_Ckhahgc_q__aoa0 6 -327.68 327.67 AXIS_PTS_REF AXX_KF_FDZWT_PF2 FORMAT "%7.2" MONOTONY STRICT_INCREASE DEPOSIT ABSOLUTE /end AXIS_DESCR
 /begin AXIS_DESCR COM_AXIS Tans BMW_q0p1_degC 6 -3276.8 3276.7 AXIS_PTS_REF AXY_KF_FDZWT_PF2 FORMAT "%6.1" MONOTONY STRICT_INCREASE DEPOSIT ABSOLUTE /end AXIS_DESCR
/end CHARACTERISTIC
/begin CHARACTERISTIC KF_FDZWT_PF2___MGF_CC_PF_Slot4 "Factor temperature correction ZW knock limit path 2 (Slot 4, CCv7.1.1, Pump Fuel)" MAP 0x807C27C0 _REC_A1CUR_1_MBSE_S2_S1 3.9998779296875 ilxsavd_hkzmBfc_lAzCpAb_nR_1oa0 -2 1.9998779296875 FORMAT "%14.5"
 /begin AXIS_DESCR COM_AXIS Tmot DchEpAd_DBCFgoa_Ckhahgc_q__aoa0 6 -327.68 327.67 AXIS_PTS_REF AXX_KF_FDZWT_PF2 FORMAT "%7.2" MONOTONY STRICT_INCREASE DEPOSIT ABSOLUTE /end AXIS_DESCR
 /begin AXIS_DESCR COM_AXIS Tans BMW_q0p1_degC 6 -3276.8 3276.7 AXIS_PTS_REF AXY_KF_FDZWT_PF2 FORMAT "%6.1" MONOTONY STRICT_INCREASE DEPOSIT ABSOLUTE /end AXIS_DESCR
/end CHARACTERISTIC
/begin CHARACTERISTIC KF_FRKKORRF_1___MGF_CC_PF_Slot0 "Map pre-control correction bank 1 (Slot 0, OEM Address)" MAP 0x807110E8 _REC_A1CUR_1_MBSE_U2_S1 1.99996948242188 Bhvfwhc_bigEubd_BBEupBd_nR_3oa0 0 1.99996948242188 FORMAT "%14.5"
 /begin AXIS_DESCR COM_AXIS Nkw caoddzd_oAjpfzb_cAcEEha_1nR_oa0 16 -32768 32767 AXIS_PTS_REF AXX_KF_FRKKORRF_1 FORMAT "%5.0" MONOTONY STRICT_INCREASE DEPOSIT ABSOLUTE /end AXIS_DESCR
 /begin AXIS_DESCR COM_AXIS Rf CgkBooc_wkiDfEd_Czglhgc_fR_1a0o 16 -327.68 327.67 AXIS_PTS_REF AXY_KF_FRKKORRF_1 FORMAT "%7.2" MONOTONY STRICT_INCREASE DEPOSIT ABSOLUTE /end AXIS_DESCR
/end CHARACTERISTIC
/begin CHARACTERISTIC KF_FRKKORRF_1___MGF_CC_PF_Slot1 "Map pre-control correction bank 1 (Slot 1, CCv7.1.1, Pump Fuel)" MAP 0x807C2808 _REC_A1CUR_1_MBSE_U2_S1 1.99996948242188 Bhvfwhc_bigEubd_BBEupBd_nR_3oa0 0 1.99996948242188 FORMAT "%14.5"
 /begin AXIS_DESCR COM_AXIS Nkw caoddzd_oAjpfzb_cAcEEha_1nR_oa0 16 -32768 32767 AXIS_PTS_REF AXX_KF_FRKKORRF_1 FORMAT "%5.0" MONOTONY STRICT_INCREASE DEPOSIT ABSOLUTE /end AXIS_DESCR
 /begin AXIS_DESCR COM_AXIS Rf CgkBooc_wkiDfEd_Czglhgc_fR_1a0o 16 -327.68 327.67 AXIS_PTS_REF AXY_KF_FRKKORRF_1 FORMAT "%7.2" MONOTONY STRICT_INCREASE DEPOSIT ABSOLUTE /end AXIS_DESCR
/end CHARACTERISTIC
/begin CHARACTERISTIC KF_FRKKORRF_1___MGF_CC_PF_Slot2 "Map pre-control correction bank 1 (Slot 2, CCv7.1.1, Pump Fuel)" MAP 0x807C2A08 _REC_A1CUR_1_MBSE_U2_S1 1.99996948242188 Bhvfwhc_bigEubd_BBEupBd_nR_3oa0 0 1.99996948242188 FORMAT "%14.5"
 /begin AXIS_DESCR COM_AXIS Nkw caoddzd_oAjpfzb_cAcEEha_1nR_oa0 16 -32768 32767 AXIS_PTS_REF AXX_KF_FRKKORRF_1 FORMAT "%5.0" MONOTONY STRICT_INCREASE DEPOSIT ABSOLUTE /end AXIS_DESCR
 /begin AXIS_DESCR COM_AXIS Rf CgkBooc_wkiDfEd_Czglhgc_fR_1a0o 16 -327.68 327.67 AXIS_PTS_REF AXY_KF_FRKKORRF_1 FORMAT "%7.2" MONOTONY STRICT_INCREASE DEPOSIT ABSOLUTE /end AXIS_DESCR
/end CHARACTERISTIC
/begin CHARACTERISTIC KF_FRKKORRF_1___MGF_CC_PF_Slot3 "Map pre-control correction bank 1 (Slot 3, CCv7.1.1, Pump Fuel)" MAP 0x807C2C08 _REC_A1CUR_1_MBSE_U2_S1 1.99996948242188 Bhvfwhc_bigEubd_BBEupBd_nR_3oa0 0 1.99996948242188 FORMAT "%14.5"
 /begin AXIS_DESCR COM_AXIS Nkw caoddzd_oAjpfzb_cAcEEha_1nR_oa0 16 -32768 32767 AXIS_PTS_REF AXX_KF_FRKKORRF_1 FORMAT "%5.0" MONOTONY STRICT_INCREASE DEPOSIT ABSOLUTE /end AXIS_DESCR
 /begin AXIS_DESCR COM_AXIS Rf CgkBooc_wkiDfEd_Czglhgc_fR_1a0o 16 -327.68 327.67 AXIS_PTS_REF AXY_KF_FRKKORRF_1 FORMAT "%7.2" MONOTONY STRICT_INCREASE DEPOSIT ABSOLUTE /end AXIS_DESCR
/end CHARACTERISTIC
/begin CHARACTERISTIC KF_FRKKORRF_1___MGF_CC_PF_Slot4 "Map pre-control correction bank 1 (Slot 4, CCv7.1.1, Pump Fuel)" MAP 0x807C2E08 _REC_A1CUR_1_MBSE_U2_S1 1.99996948242188 Bhvfwhc_bigEubd_BBEupBd_nR_3oa0 0 1.99996948242188 FORMAT "%14.5"
 /begin AXIS_DESCR COM_AXIS Nkw caoddzd_oAjpfzb_cAcEEha_1nR_oa0 16 -32768 32767 AXIS_PTS_REF AXX_KF_FRKKORRF_1 FORMAT "%5.0" MONOTONY STRICT_INCREASE DEPOSIT ABSOLUTE /end AXIS_DESCR
 /begin AXIS_DESCR COM_AXIS Rf CgkBooc_wkiDfEd_Czglhgc_fR_1a0o 16 -327.68 327.67 AXIS_PTS_REF AXY_KF_FRKKORRF_1 FORMAT "%7.2" MONOTONY STRICT_INCREASE DEPOSIT ABSOLUTE /end AXIS_DESCR
/end CHARACTERISTIC
/begin CHARACTERISTIC KF_LABAS_1___MGF_CC_PF_Slot0 "Base lambda in the homogeneous bank 1 (Slot 0, OEM Address)" MAP 0x80746BD8 _REC_A1CUR_1_MBSE_U2_S1 15.999755859375 BumqDkc_mryszAa_EcglxAc_nR_4oa0 0 15.999755859375 FORMAT "%9.4"
 /begin AXIS_DESCR COM_AXIS Nkw caoddzd_oAjpfzb_cAcEEha_1nR_oa0 18 -32768 32767 AXIS_PTS_REF GXX_KF_LABAS FORMAT "%5.0" MONOTONY STRICT_INCREASE DEPOSIT ABSOLUTE /end AXIS_DESCR
 /begin AXIS_DESCR COM_AXIS Rf CgkBooc_wkiDfEd_Czglhgc_fR_1a0o 17 -327.68 327.67 AXIS_PTS_REF GXY_KF_LABAS FORMAT "%7.2" MONOTONY STRICT_INCREASE DEPOSIT ABSOLUTE /end AXIS_DESCR
/end CHARACTERISTIC
/begin CHARACTERISTIC KF_LABAS_1___MGF_CC_PF_Slot1 "Base lambda in the homogeneous bank 1 (Slot 1, CCv7.1.1, Pump Fuel)" MAP 0x807C3008 _REC_A1CUR_1_MBSE_U2_S1 15.999755859375 BumqDkc_mryszAa_EcglxAc_nR_4oa0 0 15.999755859375 FORMAT "%9.4"
 /begin AXIS_DESCR COM_AXIS Nkw caoddzd_oAjpfzb_cAcEEha_1nR_oa0 18 -32768 32767 AXIS_PTS_REF GXX_KF_LABAS FORMAT "%5.0" MONOTONY STRICT_INCREASE DEPOSIT ABSOLUTE /end AXIS_DESCR
 /begin AXIS_DESCR COM_AXIS Rf CgkBooc_wkiDfEd_Czglhgc_fR_1a0o 17 -327.68 327.67 AXIS_PTS_REF GXY_KF_LABAS FORMAT "%7.2" MONOTONY STRICT_INCREASE DEPOSIT ABSOLUTE /end AXIS_DESCR
/end CHARACTERISTIC
/begin CHARACTERISTIC KF_LABAS_1___MGF_CC_PF_Slot2 "Base lambda in the homogeneous bank 1 (Slot 2, CCv7.1.1, Pump Fuel)" MAP 0x807C326C _REC_A1CUR_1_MBSE_U2_S1 15.999755859375 BumqDkc_mryszAa_EcglxAc_nR_4oa0 0 15.999755859375 FORMAT "%9.4"
 /begin AXIS_DESCR COM_AXIS Nkw caoddzd_oAjpfzb_cAcEEha_1nR_oa0 18 -32768 32767 AXIS_PTS_REF GXX_KF_LABAS FORMAT "%5.0" MONOTONY STRICT_INCREASE DEPOSIT ABSOLUTE /end AXIS_DESCR
 /begin AXIS_DESCR COM_AXIS Rf CgkBooc_wkiDfEd_Czglhgc_fR_1a0o 17 -327.68 327.67 AXIS_PTS_REF GXY_KF_LABAS FORMAT "%7.2" MONOTONY STRICT_INCREASE DEPOSIT ABSOLUTE /end AXIS_DESCR
/end CHARACTERISTIC
/begin CHARACTERISTIC KF_LABAS_1___MGF_CC_PF_Slot3 "Base lambda in the homogeneous bank 1 (Slot 3, CCv7.1.1, Pump Fuel)" MAP 0x807C34D0 _REC_A1CUR_1_MBSE_U2_S1 15.999755859375 BumqDkc_mryszAa_EcglxAc_nR_4oa0 0 15.999755859375 FORMAT "%9.4"
 /begin AXIS_DESCR COM_AXIS Nkw caoddzd_oAjpfzb_cAcEEha_1nR_oa0 18 -32768 32767 AXIS_PTS_REF GXX_KF_LABAS FORMAT "%5.0" MONOTONY STRICT_INCREASE DEPOSIT ABSOLUTE /end AXIS_DESCR
 /begin AXIS_DESCR COM_AXIS Rf CgkBooc_wkiDfEd_Czglhgc_fR_1a0o 17 -327.68 327.67 AXIS_PTS_REF GXY_KF_LABAS FORMAT "%7.2" MONOTONY STRICT_INCREASE DEPOSIT ABSOLUTE /end AXIS_DESCR
/end CHARACTERISTIC
/begin CHARACTERISTIC KF_LABAS_1___MGF_CC_PF_Slot4 "Base lambda in the homogeneous bank 1 (Slot 4, CCv7.1.1, Pump Fuel)" MAP 0x807C3734 _REC_A1CUR_1_MBSE_U2_S1 15.999755859375 BumqDkc_mryszAa_EcglxAc_nR_4oa0 0 15.999755859375 FORMAT "%9.4"
 /begin AXIS_DESCR COM_AXIS Nkw caoddzd_oAjpfzb_cAcEEha_1nR_oa0 18 -32768 32767 AXIS_PTS_REF GXX_KF_LABAS FORMAT "%5.0" MONOTONY STRICT_INCREASE DEPOSIT ABSOLUTE /end AXIS_DESCR
 /begin AXIS_DESCR COM_AXIS Rf CgkBooc_wkiDfEd_Czglhgc_fR_1a0o 17 -327.68 327.67 AXIS_PTS_REF GXY_KF_LABAS FORMAT "%7.2" MONOTONY STRICT_INCREASE DEPOSIT ABSOLUTE /end AXIS_DESCR
/end CHARACTERISTIC
/begin CHARACTERISTIC KF_LABAS_2___MGF_CC_PF_Slot0 "Base lambda in the homogeneous bank 2 (Slot 0, OEM Address)" MAP 0x80746974 _REC_A1CUR_1_MBSE_U2_S1 15.999755859375 BumqDkc_mryszAa_EcglxAc_nR_4oa0 0 15.999755859375 FORMAT "%9.4"
 /begin AXIS_DESCR COM_AXIS Nkw caoddzd_oAjpfzb_cAcEEha_1nR_oa0 18 -32768 32767 AXIS_PTS_REF GXX_KF_LABAS FORMAT "%5.0" MONOTONY STRICT_INCREASE DEPOSIT ABSOLUTE /end AXIS_DESCR
 /begin AXIS_DESCR COM_AXIS Rf CgkBooc_wkiDfEd_Czglhgc_fR_1a0o 17 -327.68 327.67 AXIS_PTS_REF GXY_KF_LABAS FORMAT "%7.2" MONOTONY STRICT_INCREASE DEPOSIT ABSOLUTE /end AXIS_DESCR
/end CHARACTERISTIC
/begin CHARACTERISTIC KF_LABAS_2___MGF_CC_PF_Slot1 "Base lambda in the homogeneous bank 2 (Slot 1, CCv7.1.1, Pump Fuel)" MAP 0x807C3998 _REC_A1CUR_1_MBSE_U2_S1 15.999755859375 BumqDkc_mryszAa_EcglxAc_nR_4oa0 0 15.999755859375 FORMAT "%9.4"
 /begin AXIS_DESCR COM_AXIS Nkw caoddzd_oAjpfzb_cAcEEha_1nR_oa0 18 -32768 32767 AXIS_PTS_REF GXX_KF_LABAS FORMAT "%5.0" MONOTONY STRICT_INCREASE DEPOSIT ABSOLUTE /end AXIS_DESCR
 /begin AXIS_DESCR COM_AXIS Rf CgkBooc_wkiDfEd_Czglhgc_fR_1a0o 17 -327.68 327.67 AXIS_PTS_REF GXY_KF_LABAS FORMAT "%7.2" MONOTONY STRICT_INCREASE DEPOSIT ABSOLUTE /end AXIS_DESCR
/end CHARACTERISTIC
/begin CHARACTERISTIC KF_LABAS_2___MGF_CC_PF_Slot2 "Base lambda in the homogeneous bank 2 (Slot 2, CCv7.1.1, Pump Fuel)" MAP 0x807C3BFC _REC_A1CUR_1_MBSE_U2_S1 15.999755859375 BumqDkc_mryszAa_EcglxAc_nR_4oa0 0 15.999755859375 FORMAT "%9.4"
 /begin AXIS_DESCR COM_AXIS Nkw caoddzd_oAjpfzb_cAcEEha_1nR_oa0 18 -32768 32767 AXIS_PTS_REF GXX_KF_LABAS FORMAT "%5.0" MONOTONY STRICT_INCREASE DEPOSIT ABSOLUTE /end AXIS_DESCR
 /begin AXIS_DESCR COM_AXIS Rf CgkBooc_wkiDfEd_Czglhgc_fR_1a0o 17 -327.68 327.67 AXIS_PTS_REF GXY_KF_LABAS FORMAT "%7.2" MONOTONY STRICT_INCREASE DEPOSIT ABSOLUTE /end AXIS_DESCR
/end CHARACTERISTIC
/begin CHARACTERISTIC KF_LABAS_2___MGF_CC_PF_Slot3 "Base lambda in the homogeneous bank 2 (Slot 3, CCv7.1.1, Pump Fuel)" MAP 0x807C3E60 _REC_A1CUR_1_MBSE_U2_S1 15.999755859375 BumqDkc_mryszAa_EcglxAc_nR_4oa0 0 15.999755859375 FORMAT "%9.4"
 /begin AXIS_DESCR COM_AXIS Nkw caoddzd_oAjpfzb_cAcEEha_1nR_oa0 18 -32768 32767 AXIS_PTS_REF GXX_KF_LABAS FORMAT "%5.0" MONOTONY STRICT_INCREASE DEPOSIT ABSOLUTE /end AXIS_DESCR
 /begin AXIS_DESCR COM_AXIS Rf CgkBooc_wkiDfEd_Czglhgc_fR_1a0o 17 -327.68 327.67 AXIS_PTS_REF GXY_KF_LABAS FORMAT "%7.2" MONOTONY STRICT_INCREASE DEPOSIT ABSOLUTE /end AXIS_DESCR
/end CHARACTERISTIC
/begin CHARACTERISTIC KF_LABAS_2___MGF_CC_PF_Slot4 "Base lambda in the homogeneous bank 2 (Slot 4, CCv7.1.1, Pump Fuel)" MAP 0x807C40C4 _REC_A1CUR_1_MBSE_U2_S1 15.999755859375 BumqDkc_mryszAa_EcglxAc_nR_4oa0 0 15.999755859375 FORMAT "%9.4"
 /begin AXIS_DESCR COM_AXIS Nkw caoddzd_oAjpfzb_cAcEEha_1nR_oa0 18 -32768 32767 AXIS_PTS_REF GXX_KF_LABAS FORMAT "%5.0" MONOTONY STRICT_INCREASE DEPOSIT ABSOLUTE /end AXIS_DESCR
 /begin AXIS_DESCR COM_AXIS Rf CgkBooc_wkiDfEd_Czglhgc_fR_1a0o 17 -327.68 327.67 AXIS_PTS_REF GXY_KF_LABAS FORMAT "%7.2" MONOTONY STRICT_INCREASE DEPOSIT ABSOLUTE /end AXIS_DESCR
/end CHARACTERISTIC
/begin CHARACTERISTIC KF_MDIOP_1_TQE___MGF_CC_PF_Slot0 "ONLY X-AXIS IS SWITCHED (Available only in Slot 2) optimal reference torque from filling and speed (Slot 0, OEM Address)" MAP 0x80726950 _REC_A1CUR_1_MBSE_S2_S1 6553.5 BMW_dm_sw_q0p1_Nm -3276.8 3276.7
 /begin AXIS_DESCR COM_AXIS Rf_zh_ber CgkBooc_wkiDfEd_Czglhgc_fR_1a0o 18 -32768 32767 AXIS_PTS_REF AXX_KF_MDIOP_1_TQE___MGF_CC_PF_Slot0 EXTENDED_LIMITS 0 0 DEPOSIT ABSOLUTE /end AXIS_DESCR
 /begin AXIS_DESCR COM_AXIS Nkw caoddzd_oAjpfzb_cAcEEha_1nR_oa0 20 -32768 32767 AXIS_PTS_REF AXY_KF_MDIOP_1_TQE EXTENDED_LIMITS 0 0 DEPOSIT ABSOLUTE /end AXIS_DESCR
/end CHARACTERISTIC
/begin CHARACTERISTIC KF_MDIOP_1_TQE___MGF_CC_PF_Slot1 "ONLY X-AXIS IS SWITCHED (Available only in Slot 2) optimal reference torque from filling and speed (Slot 1, CCv7.1.1, Pump Fuel)" MAP 0x80726950 _REC_A1CUR_1_MBSE_S2_S1 6553.5 BMW_dm_sw_q0p1_Nm -3276.8 3276.7
 /begin AXIS_DESCR COM_AXIS NO_INPUT_QUANTITY CgkBooc_wkiDfEd_Czglhgc_fR_1a0o 18 -327.68 327.67 AXIS_PTS_REF AXX_KF_MDIOP_1_TQE FORMAT "%6.2" MONOTONY STRICT_INCREASE DEPOSIT ABSOLUTE /end AXIS_DESCR
 /begin AXIS_DESCR COM_AXIS NO_INPUT_QUANTITY caoddzd_oAjpfzb_cAcEEha_1nR_oa0 20 -32768 32767 AXIS_PTS_REF AXY_KF_MDIOP_1_TQE FORMAT "%5.0" MONOTONY STRICT_INCREASE DEPOSIT ABSOLUTE /end AXIS_DESCR
/end CHARACTERISTIC
/begin CHARACTERISTIC KF_MDIOP_1_TQE___MGF_CC_PF_Slot2 "ONLY X-AXIS IS SWITCHED (Available only in Slot 2) optimal reference torque from filling and speed (Slot 2, CCv7.1.1, Pump Fuel)" MAP 0x80726950 _REC_A1CUR_1_MBSE_S2_S1 6553.5 BMW_dm_sw_q0p1_Nm -3276.8 3276.7
 /begin AXIS_DESCR COM_AXIS Rf_zh_ber CgkBooc_wkiDfEd_Czglhgc_fR_1a0o 18 -32768 32767 AXIS_PTS_REF AXX_KF_MDIOP_1_TQE___MGF_CC_PF_Slot2 EXTENDED_LIMITS 0 0 DEPOSIT ABSOLUTE /end AXIS_DESCR
 /begin AXIS_DESCR COM_AXIS Nkw caoddzd_oAjpfzb_cAcEEha_1nR_oa0 20 -32768 32767 AXIS_PTS_REF AXY_KF_MDIOP_1_TQE EXTENDED_LIMITS 0 0 DEPOSIT ABSOLUTE /end AXIS_DESCR
/end CHARACTERISTIC
/begin CHARACTERISTIC KF_MDIOP_1_TQE___MGF_CC_PF_Slot3 "ONLY X-AXIS IS SWITCHED (Available only in Slot 2) optimal reference torque from filling and speed (Slot 3, CCv7.1.1, Pump Fuel)" MAP 0x80726950 _REC_A1CUR_1_MBSE_S2_S1 6553.5 BMW_dm_sw_q0p1_Nm -3276.8 3276.7
 /begin AXIS_DESCR COM_AXIS NO_INPUT_QUANTITY CgkBooc_wkiDfEd_Czglhgc_fR_1a0o 18 -327.68 327.67 AXIS_PTS_REF AXX_KF_MDIOP_1_TQE FORMAT "%6.2" MONOTONY STRICT_INCREASE DEPOSIT ABSOLUTE /end AXIS_DESCR
 /begin AXIS_DESCR COM_AXIS NO_INPUT_QUANTITY caoddzd_oAjpfzb_cAcEEha_1nR_oa0 20 -32768 32767 AXIS_PTS_REF AXY_KF_MDIOP_1_TQE FORMAT "%5.0" MONOTONY STRICT_INCREASE DEPOSIT ABSOLUTE /end AXIS_DESCR
/end CHARACTERISTIC
/begin CHARACTERISTIC KF_MDIOP_1_TQE___MGF_CC_PF_Slot4 "ONLY X-AXIS IS SWITCHED (Available only in Slot 2) optimal reference torque from filling and speed (Slot 4, CCv7.1.1, Pump Fuel)" MAP 0x80726950 _REC_A1CUR_1_MBSE_S2_S1 6553.5 BMW_dm_sw_q0p1_Nm -3276.8 3276.7
 /begin AXIS_DESCR COM_AXIS NO_INPUT_QUANTITY CgkBooc_wkiDfEd_Czglhgc_fR_1a0o 18 -327.68 327.67 AXIS_PTS_REF AXX_KF_MDIOP_1_TQE FORMAT "%6.2" MONOTONY STRICT_INCREASE DEPOSIT ABSOLUTE /end AXIS_DESCR
 /begin AXIS_DESCR COM_AXIS NO_INPUT_QUANTITY caoddzd_oAjpfzb_cAcEEha_1nR_oa0 20 -32768 32767 AXIS_PTS_REF AXY_KF_MDIOP_1_TQE FORMAT "%5.0" MONOTONY STRICT_INCREASE DEPOSIT ABSOLUTE /end AXIS_DESCR
/end CHARACTERISTIC
/begin CHARACTERISTIC KF_ZW_PF1___MGF_CC_PF_Slot0 "Basic firing angle path 1 (Slot 0, OEM Address)" MAP 0x80753C57 _REC_A1CUR_1_MBSE_S1_S1 127.5 aAwkuzc_BFpgCmb_tmDukma_q__aa0o -64 63.5 FORMAT "%4.1"
 /begin AXIS_DESCR COM_AXIS Nkw caoddzd_oAjpfzb_cAcEEha_1nR_oa0 20 -32768 32767 AXIS_PTS_REF AXX_KF_ZW_PF1 FORMAT "%5.0" MONOTONY STRICT_INCREASE DEPOSIT ABSOLUTE /end AXIS_DESCR
 /begin AXIS_DESCR COM_AXIS NO_INPUT_QUANTITY CgkBooc_wkiDfEd_Czglhgc_fR_1a0o 20 -327.68 327.67 AXIS_PTS_REF AXY_KF_ZW_PF1 FORMAT "%9.2" MONOTONY STRICT_INCREASE DEPOSIT ABSOLUTE /end AXIS_DESCR
/end CHARACTERISTIC
/begin CHARACTERISTIC KF_ZW_PF1___MGF_CC_PF_Slot1 "Basic firing angle path 1 (Slot 1, CCv7.1.1, Pump Fuel)" MAP 0x807C5046 _REC_A1CUR_1_MBSE_S1_S1 127.5 aAwkuzc_BFpgCmb_tmDukma_q__aa0o -64 63.5 FORMAT "%4.1"
 /begin AXIS_DESCR COM_AXIS Nkw caoddzd_oAjpfzb_cAcEEha_1nR_oa0 20 -32768 32767 AXIS_PTS_REF AXX_KF_ZW_PF1 FORMAT "%5.0" MONOTONY STRICT_INCREASE DEPOSIT ABSOLUTE /end AXIS_DESCR
 /begin AXIS_DESCR COM_AXIS NO_INPUT_QUANTITY CgkBooc_wkiDfEd_Czglhgc_fR_1a0o 20 -327.68 327.67 AXIS_PTS_REF AXY_KF_ZW_PF1 FORMAT "%9.2" MONOTONY STRICT_INCREASE DEPOSIT ABSOLUTE /end AXIS_DESCR
/end CHARACTERISTIC
/begin CHARACTERISTIC KF_ZW_PF1___MGF_CC_PF_Slot2 "Basic firing angle path 1 (Slot 2, CCv7.1.1, Pump Fuel)" MAP 0x807C51D6 _REC_A1CUR_1_MBSE_S1_S1 127.5 aAwkuzc_BFpgCmb_tmDukma_q__aa0o -64 63.5 FORMAT "%4.1"
 /begin AXIS_DESCR COM_AXIS Nkw caoddzd_oAjpfzb_cAcEEha_1nR_oa0 20 -32768 32767 AXIS_PTS_REF AXX_KF_ZW_PF1 FORMAT "%5.0" MONOTONY STRICT_INCREASE DEPOSIT ABSOLUTE /end AXIS_DESCR
 /begin AXIS_DESCR COM_AXIS NO_INPUT_QUANTITY CgkBooc_wkiDfEd_Czglhgc_fR_1a0o 20 -327.68 327.67 AXIS_PTS_REF AXY_KF_ZW_PF1 FORMAT "%9.2" MONOTONY STRICT_INCREASE DEPOSIT ABSOLUTE /end AXIS_DESCR
/end CHARACTERISTIC
/begin CHARACTERISTIC KF_ZW_PF1___MGF_CC_PF_Slot3 "Basic firing angle path 1 (Slot 3, CCv7.1.1, Pump Fuel)" MAP 0x807C5366 _REC_A1CUR_1_MBSE_S1_S1 127.5 aAwkuzc_BFpgCmb_tmDukma_q__aa0o -64 63.5 FORMAT "%4.1"
 /begin AXIS_DESCR COM_AXIS Nkw caoddzd_oAjpfzb_cAcEEha_1nR_oa0 20 -32768 32767 AXIS_PTS_REF AXX_KF_ZW_PF1 FORMAT "%5.0" MONOTONY STRICT_INCREASE DEPOSIT ABSOLUTE /end AXIS_DESCR
 /begin AXIS_DESCR COM_AXIS NO_INPUT_QUANTITY CgkBooc_wkiDfEd_Czglhgc_fR_1a0o 20 -327.68 327.67 AXIS_PTS_REF AXY_KF_ZW_PF1 FORMAT "%9.2" MONOTONY STRICT_INCREASE DEPOSIT ABSOLUTE /end AXIS_DESCR
/end CHARACTERISTIC
/begin CHARACTERISTIC KF_ZW_PF1___MGF_CC_PF_Slot4 "Basic firing angle path 1 (Slot 4, CCv7.1.1, Pump Fuel)" MAP 0x807C54F6 _REC_A1CUR_1_MBSE_S1_S1 127.5 aAwkuzc_BFpgCmb_tmDukma_q__aa0o -64 63.5 FORMAT "%4.1"
 /begin AXIS_DESCR COM_AXIS Nkw caoddzd_oAjpfzb_cAcEEha_1nR_oa0 20 -32768 32767 AXIS_PTS_REF AXX_KF_ZW_PF1 FORMAT "%5.0" MONOTONY STRICT_INCREASE DEPOSIT ABSOLUTE /end AXIS_DESCR
 /begin AXIS_DESCR COM_AXIS NO_INPUT_QUANTITY CgkBooc_wkiDfEd_Czglhgc_fR_1a0o 20 -327.68 327.67 AXIS_PTS_REF AXY_KF_ZW_PF1 FORMAT "%9.2" MONOTONY STRICT_INCREASE DEPOSIT ABSOLUTE /end AXIS_DESCR
/end CHARACTERISTIC
/begin CHARACTERISTIC KF_ZW_PF2___MGF_CC_PF_Slot0 "Basic firing angle path 2 (Slot 0, OEM Address)" MAP 0x80753AC7 _REC_A1CUR_1_MBSE_S1_S1 127.5 aAwkuzc_BFpgCmb_tmDukma_q__aa0o -64 63.5 FORMAT "%4.1"
 /begin AXIS_DESCR COM_AXIS Nkw caoddzd_oAjpfzb_cAcEEha_1nR_oa0 20 -32768 32767 AXIS_PTS_REF AXX_KF_ZW_PF2 FORMAT "%5.0" MONOTONY STRICT_INCREASE DEPOSIT ABSOLUTE /end AXIS_DESCR
 /begin AXIS_DESCR COM_AXIS NO_INPUT_QUANTITY CgkBooc_wkiDfEd_Czglhgc_fR_1a0o 20 -327.68 327.67 AXIS_PTS_REF AXY_KF_ZW_PF2 FORMAT "%9.2" MONOTONY STRICT_INCREASE DEPOSIT ABSOLUTE /end AXIS_DESCR
/end CHARACTERISTIC
/begin CHARACTERISTIC KF_ZW_PF2___MGF_CC_PF_Slot1 "Basic firing angle path 2 (Slot 1, CCv7.1.1, Pump Fuel)" MAP 0x807C5686 _REC_A1CUR_1_MBSE_S1_S1 127.5 aAwkuzc_BFpgCmb_tmDukma_q__aa0o -64 63.5 FORMAT "%4.1"
 /begin AXIS_DESCR COM_AXIS Nkw caoddzd_oAjpfzb_cAcEEha_1nR_oa0 20 -32768 32767 AXIS_PTS_REF AXX_KF_ZW_PF2 FORMAT "%5.0" MONOTONY STRICT_INCREASE DEPOSIT ABSOLUTE /end AXIS_DESCR
 /begin AXIS_DESCR COM_AXIS NO_INPUT_QUANTITY CgkBooc_wkiDfEd_Czglhgc_fR_1a0o 20 -327.68 327.67 AXIS_PTS_REF AXY_KF_ZW_PF2 FORMAT "%9.2" MONOTONY STRICT_INCREASE DEPOSIT ABSOLUTE /end AXIS_DESCR
/end CHARACTERISTIC
/begin CHARACTERISTIC KF_ZW_PF2___MGF_CC_PF_Slot2 "Basic firing angle path 2 (Slot 2, CCv7.1.1, Pump Fuel)" MAP 0x807C5816 _REC_A1CUR_1_MBSE_S1_S1 127.5 aAwkuzc_BFpgCmb_tmDukma_q__aa0o -64 63.5 FORMAT "%4.1"
 /begin AXIS_DESCR COM_AXIS Nkw caoddzd_oAjpfzb_cAcEEha_1nR_oa0 20 -32768 32767 AXIS_PTS_REF AXX_KF_ZW_PF2 FORMAT "%5.0" MONOTONY STRICT_INCREASE DEPOSIT ABSOLUTE /end AXIS_DESCR
 /begin AXIS_DESCR COM_AXIS NO_INPUT_QUANTITY CgkBooc_wkiDfEd_Czglhgc_fR_1a0o 20 -327.68 327.67 AXIS_PTS_REF AXY_KF_ZW_PF2 FORMAT "%9.2" MONOTONY STRICT_INCREASE DEPOSIT ABSOLUTE /end AXIS_DESCR
/end CHARACTERISTIC
/begin CHARACTERISTIC KF_ZW_PF2___MGF_CC_PF_Slot3 "Basic firing angle path 2 (Slot 3, CCv7.1.1, Pump Fuel)" MAP 0x807C59A6 _REC_A1CUR_1_MBSE_S1_S1 127.5 aAwkuzc_BFpgCmb_tmDukma_q__aa0o -64 63.5 FORMAT "%4.1"
 /begin AXIS_DESCR COM_AXIS Nkw caoddzd_oAjpfzb_cAcEEha_1nR_oa0 20 -32768 32767 AXIS_PTS_REF AXX_KF_ZW_PF2 FORMAT "%5.0" MONOTONY STRICT_INCREASE DEPOSIT ABSOLUTE /end AXIS_DESCR
 /begin AXIS_DESCR COM_AXIS NO_INPUT_QUANTITY CgkBooc_wkiDfEd_Czglhgc_fR_1a0o 20 -327.68 327.67 AXIS_PTS_REF AXY_KF_ZW_PF2 FORMAT "%9.2" MONOTONY STRICT_INCREASE DEPOSIT ABSOLUTE /end AXIS_DESCR
/end CHARACTERISTIC
/begin CHARACTERISTIC KF_ZW_PF2___MGF_CC_PF_Slot4 "Basic firing angle path 2 (Slot 4, CCv7.1.1, Pump Fuel)" MAP 0x807C5B36 _REC_A1CUR_1_MBSE_S1_S1 127.5 aAwkuzc_BFpgCmb_tmDukma_q__aa0o -64 63.5 FORMAT "%4.1"
 /begin AXIS_DESCR COM_AXIS Nkw caoddzd_oAjpfzb_cAcEEha_1nR_oa0 20 -32768 32767 AXIS_PTS_REF AXX_KF_ZW_PF2 FORMAT "%5.0" MONOTONY STRICT_INCREASE DEPOSIT ABSOLUTE /end AXIS_DESCR
 /begin AXIS_DESCR COM_AXIS NO_INPUT_QUANTITY CgkBooc_wkiDfEd_Czglhgc_fR_1a0o 20 -327.68 327.67 AXIS_PTS_REF AXY_KF_ZW_PF2 FORMAT "%9.2" MONOTONY STRICT_INCREASE DEPOSIT ABSOLUTE /end AXIS_DESCR
/end CHARACTERISTIC
/begin CHARACTERISTIC KF_ZW_S_PF1___MGF_CC_PF_Slot0 "Basic ignition angle path 1 safe (Slot 0, OEM Address)" MAP 0x80753937 _REC_A1CUR_1_MBSE_S1_S1 127.5 aAwkuzc_BFpgCmb_tmDukma_q__aa0o -64 63.5 FORMAT "%4.1"
 /begin AXIS_DESCR COM_AXIS Nkw caoddzd_oAjpfzb_cAcEEha_1nR_oa0 20 -32768 32767 AXIS_PTS_REF AXX_KF_ZW_S_PF1 FORMAT "%5.0" MONOTONY STRICT_INCREASE DEPOSIT ABSOLUTE /end AXIS_DESCR
 /begin AXIS_DESCR COM_AXIS NO_INPUT_QUANTITY CgkBooc_wkiDfEd_Czglhgc_fR_1a0o 20 -327.68 327.67 AXIS_PTS_REF AXY_KF_ZW_S_PF1 FORMAT "%9.2" MONOTONY STRICT_INCREASE DEPOSIT ABSOLUTE /end AXIS_DESCR
/end CHARACTERISTIC
/begin CHARACTERISTIC KF_ZW_S_PF1___MGF_CC_PF_Slot1 "Basic ignition angle path 1 safe (Slot 1, CCv7.1.1, Pump Fuel)" MAP 0x807C5CC6 _REC_A1CUR_1_MBSE_S1_S1 127.5 aAwkuzc_BFpgCmb_tmDukma_q__aa0o -64 63.5 FORMAT "%4.1"
 /begin AXIS_DESCR COM_AXIS Nkw caoddzd_oAjpfzb_cAcEEha_1nR_oa0 20 -32768 32767 AXIS_PTS_REF AXX_KF_ZW_S_PF1 FORMAT "%5.0" MONOTONY STRICT_INCREASE DEPOSIT ABSOLUTE /end AXIS_DESCR
 /begin AXIS_DESCR COM_AXIS NO_INPUT_QUANTITY CgkBooc_wkiDfEd_Czglhgc_fR_1a0o 20 -327.68 327.67 AXIS_PTS_REF AXY_KF_ZW_S_PF1 FORMAT "%9.2" MONOTONY STRICT_INCREASE DEPOSIT ABSOLUTE /end AXIS_DESCR
/end CHARACTERISTIC
/begin CHARACTERISTIC KF_ZW_S_PF1___MGF_CC_PF_Slot2 "Basic ignition angle path 1 safe (Slot 2, CCv7.1.1, Pump Fuel)" MAP 0x807C5E56 _REC_A1CUR_1_MBSE_S1_S1 127.5 aAwkuzc_BFpgCmb_tmDukma_q__aa0o -64 63.5 FORMAT "%4.1"
 /begin AXIS_DESCR COM_AXIS Nkw caoddzd_oAjpfzb_cAcEEha_1nR_oa0 20 -32768 32767 AXIS_PTS_REF AXX_KF_ZW_S_PF1 FORMAT "%5.0" MONOTONY STRICT_INCREASE DEPOSIT ABSOLUTE /end AXIS_DESCR
 /begin AXIS_DESCR COM_AXIS NO_INPUT_QUANTITY CgkBooc_wkiDfEd_Czglhgc_fR_1a0o 20 -327.68 327.67 AXIS_PTS_REF AXY_KF_ZW_S_PF1 FORMAT "%9.2" MONOTONY STRICT_INCREASE DEPOSIT ABSOLUTE /end AXIS_DESCR
/end CHARACTERISTIC
/begin CHARACTERISTIC KF_ZW_S_PF1___MGF_CC_PF_Slot3 "Basic ignition angle path 1 safe (Slot 3, CCv7.1.1, Pump Fuel)" MAP 0x807C5FE6 _REC_A1CUR_1_MBSE_S1_S1 127.5 aAwkuzc_BFpgCmb_tmDukma_q__aa0o -64 63.5 FORMAT "%4.1"
 /begin AXIS_DESCR COM_AXIS Nkw caoddzd_oAjpfzb_cAcEEha_1nR_oa0 20 -32768 32767 AXIS_PTS_REF AXX_KF_ZW_S_PF1 FORMAT "%5.0" MONOTONY STRICT_INCREASE DEPOSIT ABSOLUTE /end AXIS_DESCR
 /begin AXIS_DESCR COM_AXIS NO_INPUT_QUANTITY CgkBooc_wkiDfEd_Czglhgc_fR_1a0o 20 -327.68 327.67 AXIS_PTS_REF AXY_KF_ZW_S_PF1 FORMAT "%9.2" MONOTONY STRICT_INCREASE DEPOSIT ABSOLUTE /end AXIS_DESCR
/end CHARACTERISTIC
/begin CHARACTERISTIC KF_ZW_S_PF1___MGF_CC_PF_Slot4 "Basic ignition angle path 1 safe (Slot 4, CCv7.1.1, Pump Fuel)" MAP 0x807C6176 _REC_A1CUR_1_MBSE_S1_S1 127.5 aAwkuzc_BFpgCmb_tmDukma_q__aa0o -64 63.5 FORMAT "%4.1"
 /begin AXIS_DESCR COM_AXIS Nkw caoddzd_oAjpfzb_cAcEEha_1nR_oa0 20 -32768 32767 AXIS_PTS_REF AXX_KF_ZW_S_PF1 FORMAT "%5.0" MONOTONY STRICT_INCREASE DEPOSIT ABSOLUTE /end AXIS_DESCR
 /begin AXIS_DESCR COM_AXIS NO_INPUT_QUANTITY CgkBooc_wkiDfEd_Czglhgc_fR_1a0o 20 -327.68 327.67 AXIS_PTS_REF AXY_KF_ZW_S_PF1 FORMAT "%9.2" MONOTONY STRICT_INCREASE DEPOSIT ABSOLUTE /end AXIS_DESCR
/end CHARACTERISTIC
/begin CHARACTERISTIC KF_ZW_S_PF2___MGF_CC_PF_Slot0 "Basic ignition angle path 2 safe (Slot 0, OEM Address)" MAP 0x807537A7 _REC_A1CUR_1_MBSE_S1_S1 127.5 aAwkuzc_BFpgCmb_tmDukma_q__aa0o -64 63.5 FORMAT "%4.1"
 /begin AXIS_DESCR COM_AXIS Nkw caoddzd_oAjpfzb_cAcEEha_1nR_oa0 20 -32768 32767 AXIS_PTS_REF AXX_KF_ZW_S_PF2 FORMAT "%5.0" MONOTONY STRICT_INCREASE DEPOSIT ABSOLUTE /end AXIS_DESCR
 /begin AXIS_DESCR COM_AXIS NO_INPUT_QUANTITY CgkBooc_wkiDfEd_Czglhgc_fR_1a0o 20 -327.68 327.67 AXIS_PTS_REF AXY_KF_ZW_S_PF2 FORMAT "%9.2" MONOTONY STRICT_INCREASE DEPOSIT ABSOLUTE /end AXIS_DESCR
/end CHARACTERISTIC
/begin CHARACTERISTIC KF_ZW_S_PF2___MGF_CC_PF_Slot1 "Basic ignition angle path 2 safe (Slot 1, CCv7.1.1, Pump Fuel)" MAP 0x807C6306 _REC_A1CUR_1_MBSE_S1_S1 127.5 aAwkuzc_BFpgCmb_tmDukma_q__aa0o -64 63.5 FORMAT "%4.1"
 /begin AXIS_DESCR COM_AXIS Nkw caoddzd_oAjpfzb_cAcEEha_1nR_oa0 20 -32768 32767 AXIS_PTS_REF AXX_KF_ZW_S_PF2 FORMAT "%5.0" MONOTONY STRICT_INCREASE DEPOSIT ABSOLUTE /end AXIS_DESCR
 /begin AXIS_DESCR COM_AXIS NO_INPUT_QUANTITY CgkBooc_wkiDfEd_Czglhgc_fR_1a0o 20 -327.68 327.67 AXIS_PTS_REF AXY_KF_ZW_S_PF2 FORMAT "%9.2" MONOTONY STRICT_INCREASE DEPOSIT ABSOLUTE /end AXIS_DESCR
/end CHARACTERISTIC
/begin CHARACTERISTIC KF_ZW_S_PF2___MGF_CC_PF_Slot2 "Basic ignition angle path 2 safe (Slot 2, CCv7.1.1, Pump Fuel)" MAP 0x807C6496 _REC_A1CUR_1_MBSE_S1_S1 127.5 aAwkuzc_BFpgCmb_tmDukma_q__aa0o -64 63.5 FORMAT "%4.1"
 /begin AXIS_DESCR COM_AXIS Nkw caoddzd_oAjpfzb_cAcEEha_1nR_oa0 20 -32768 32767 AXIS_PTS_REF AXX_KF_ZW_S_PF2 FORMAT "%5.0" MONOTONY STRICT_INCREASE DEPOSIT ABSOLUTE /end AXIS_DESCR
 /begin AXIS_DESCR COM_AXIS NO_INPUT_QUANTITY CgkBooc_wkiDfEd_Czglhgc_fR_1a0o 20 -327.68 327.67 AXIS_PTS_REF AXY_KF_ZW_S_PF2 FORMAT "%9.2" MONOTONY STRICT_INCREASE DEPOSIT ABSOLUTE /end AXIS_DESCR
/end CHARACTERISTIC
/begin CHARACTERISTIC KF_ZW_S_PF2___MGF_CC_PF_Slot3 "Basic ignition angle path 2 safe (Slot 3, CCv7.1.1, Pump Fuel)" MAP 0x807C6626 _REC_A1CUR_1_MBSE_S1_S1 127.5 aAwkuzc_BFpgCmb_tmDukma_q__aa0o -64 63.5 FORMAT "%4.1"
 /begin AXIS_DESCR COM_AXIS Nkw caoddzd_oAjpfzb_cAcEEha_1nR_oa0 20 -32768 32767 AXIS_PTS_REF AXX_KF_ZW_S_PF2 FORMAT "%5.0" MONOTONY STRICT_INCREASE DEPOSIT ABSOLUTE /end AXIS_DESCR
 /begin AXIS_DESCR COM_AXIS NO_INPUT_QUANTITY CgkBooc_wkiDfEd_Czglhgc_fR_1a0o 20 -327.68 327.67 AXIS_PTS_REF AXY_KF_ZW_S_PF2 FORMAT "%9.2" MONOTONY STRICT_INCREASE DEPOSIT ABSOLUTE /end AXIS_DESCR
/end CHARACTERISTIC
/begin CHARACTERISTIC KF_ZW_S_PF2___MGF_CC_PF_Slot4 "Basic ignition angle path 2 safe (Slot 4, CCv7.1.1, Pump Fuel)" MAP 0x807C67B6 _REC_A1CUR_1_MBSE_S1_S1 127.5 aAwkuzc_BFpgCmb_tmDukma_q__aa0o -64 63.5 FORMAT "%4.1"
 /begin AXIS_DESCR COM_AXIS Nkw caoddzd_oAjpfzb_cAcEEha_1nR_oa0 20 -32768 32767 AXIS_PTS_REF AXX_KF_ZW_S_PF2 FORMAT "%5.0" MONOTONY STRICT_INCREASE DEPOSIT ABSOLUTE /end AXIS_DESCR
 /begin AXIS_DESCR COM_AXIS NO_INPUT_QUANTITY CgkBooc_wkiDfEd_Czglhgc_fR_1a0o 20 -327.68 327.67 AXIS_PTS_REF AXY_KF_ZW_S_PF2 FORMAT "%9.2" MONOTONY STRICT_INCREASE DEPOSIT ABSOLUTE /end AXIS_DESCR
/end CHARACTERISTIC
/begin CHARACTERISTIC KF_ZW_VP_PF1___MGF_CC_PF_Slot0 "Map for ignition angle vanos in stop F_basis=1 path 1 (Slot 0, OEM Address)" MAP 0x8075A639 _REC_A1CUR_1_MBSE_S1_S1 127.5 aAwkuzc_BFpgCmb_tmDukma_q__aa0o -64 63.5 FORMAT "%4.1"
 /begin AXIS_DESCR COM_AXIS Nkw caoddzd_oAjpfzb_cAcEEha_1nR_oa0 20 -32768 32767 AXIS_PTS_REF AXX_KF_ZW_VP_PF1 FORMAT "%5.0" MONOTONY STRICT_INCREASE DEPOSIT ABSOLUTE /end AXIS_DESCR
 /begin AXIS_DESCR COM_AXIS Rf_zwv CgkBooc_wkiDfEd_Czglhgc_fR_1a0o 16 -327.68 327.67 AXIS_PTS_REF AXY_KF_ZW_VP_PF1 FORMAT "%9.2" MONOTONY STRICT_INCREASE DEPOSIT ABSOLUTE /end AXIS_DESCR
/end CHARACTERISTIC
/begin CHARACTERISTIC KF_ZW_VP_PF1___MGF_CC_PF_Slot1 "Map for ignition angle vanos in stop F_basis=1 path 1 (Slot 1, CCv7.1.1, Pump Fuel)" MAP 0x807C6DA6 _REC_A1CUR_1_MBSE_S1_S1 127.5 aAwkuzc_BFpgCmb_tmDukma_q__aa0o -64 63.5 FORMAT "%4.1"
 /begin AXIS_DESCR COM_AXIS Nkw caoddzd_oAjpfzb_cAcEEha_1nR_oa0 20 -32768 32767 AXIS_PTS_REF AXX_KF_ZW_VP_PF1 FORMAT "%5.0" MONOTONY STRICT_INCREASE DEPOSIT ABSOLUTE /end AXIS_DESCR
 /begin AXIS_DESCR COM_AXIS Rf_zwv CgkBooc_wkiDfEd_Czglhgc_fR_1a0o 16 -327.68 327.67 AXIS_PTS_REF AXY_KF_ZW_VP_PF1 FORMAT "%9.2" MONOTONY STRICT_INCREASE DEPOSIT ABSOLUTE /end AXIS_DESCR
/end CHARACTERISTIC
/begin CHARACTERISTIC KF_ZW_VP_PF1___MGF_CC_PF_Slot2 "Map for ignition angle vanos in stop F_basis=1 path 1 (Slot 2, CCv7.1.1, Pump Fuel)" MAP 0x807C6EE6 _REC_A1CUR_1_MBSE_S1_S1 127.5 aAwkuzc_BFpgCmb_tmDukma_q__aa0o -64 63.5 FORMAT "%4.1"
 /begin AXIS_DESCR COM_AXIS Nkw caoddzd_oAjpfzb_cAcEEha_1nR_oa0 20 -32768 32767 AXIS_PTS_REF AXX_KF_ZW_VP_PF1 FORMAT "%5.0" MONOTONY STRICT_INCREASE DEPOSIT ABSOLUTE /end AXIS_DESCR
 /begin AXIS_DESCR COM_AXIS Rf_zwv CgkBooc_wkiDfEd_Czglhgc_fR_1a0o 16 -327.68 327.67 AXIS_PTS_REF AXY_KF_ZW_VP_PF1 FORMAT "%9.2" MONOTONY STRICT_INCREASE DEPOSIT ABSOLUTE /end AXIS_DESCR
/end CHARACTERISTIC
/begin CHARACTERISTIC KF_ZW_VP_PF1___MGF_CC_PF_Slot3 "Map for ignition angle vanos in stop F_basis=1 path 1 (Slot 3, CCv7.1.1, Pump Fuel)" MAP 0x807C7026 _REC_A1CUR_1_MBSE_S1_S1 127.5 aAwkuzc_BFpgCmb_tmDukma_q__aa0o -64 63.5 FORMAT "%4.1"
 /begin AXIS_DESCR COM_AXIS Nkw caoddzd_oAjpfzb_cAcEEha_1nR_oa0 20 -32768 32767 AXIS_PTS_REF AXX_KF_ZW_VP_PF1 FORMAT "%5.0" MONOTONY STRICT_INCREASE DEPOSIT ABSOLUTE /end AXIS_DESCR
 /begin AXIS_DESCR COM_AXIS Rf_zwv CgkBooc_wkiDfEd_Czglhgc_fR_1a0o 16 -327.68 327.67 AXIS_PTS_REF AXY_KF_ZW_VP_PF1 FORMAT "%9.2" MONOTONY STRICT_INCREASE DEPOSIT ABSOLUTE /end AXIS_DESCR
/end CHARACTERISTIC
/begin CHARACTERISTIC KF_ZW_VP_PF1___MGF_CC_PF_Slot4 "Map for ignition angle vanos in stop F_basis=1 path 1 (Slot 4, CCv7.1.1, Pump Fuel)" MAP 0x807C7166 _REC_A1CUR_1_MBSE_S1_S1 127.5 aAwkuzc_BFpgCmb_tmDukma_q__aa0o -64 63.5 FORMAT "%4.1"
 /begin AXIS_DESCR COM_AXIS Nkw caoddzd_oAjpfzb_cAcEEha_1nR_oa0 20 -32768 32767 AXIS_PTS_REF AXX_KF_ZW_VP_PF1 FORMAT "%5.0" MONOTONY STRICT_INCREASE DEPOSIT ABSOLUTE /end AXIS_DESCR
 /begin AXIS_DESCR COM_AXIS Rf_zwv CgkBooc_wkiDfEd_Czglhgc_fR_1a0o 16 -327.68 327.67 AXIS_PTS_REF AXY_KF_ZW_VP_PF1 FORMAT "%9.2" MONOTONY STRICT_INCREASE DEPOSIT ABSOLUTE /end AXIS_DESCR
/end CHARACTERISTIC
/begin CHARACTERISTIC KF_ZW_VP_PF2___MGF_CC_PF_Slot0 "Map for ignition angle vanos in stop F_basis=1 path 2 (Slot 0, OEM Address)" MAP 0x8075A4F9 _REC_A1CUR_1_MBSE_S1_S1 127.5 aAwkuzc_BFpgCmb_tmDukma_q__aa0o -64 63.5 FORMAT "%4.1"
 /begin AXIS_DESCR COM_AXIS Nkw caoddzd_oAjpfzb_cAcEEha_1nR_oa0 20 -32768 32767 AXIS_PTS_REF AXX_KF_ZW_VP_PF2 FORMAT "%5.0" MONOTONY STRICT_INCREASE DEPOSIT ABSOLUTE /end AXIS_DESCR
 /begin AXIS_DESCR COM_AXIS Rf_zwv CgkBooc_wkiDfEd_Czglhgc_fR_1a0o 16 -327.68 327.67 AXIS_PTS_REF AXY_KF_ZW_VP_PF2 FORMAT "%9.2" MONOTONY STRICT_INCREASE DEPOSIT ABSOLUTE /end AXIS_DESCR
/end CHARACTERISTIC
/begin CHARACTERISTIC KF_ZW_VP_PF2___MGF_CC_PF_Slot1 "Map for ignition angle vanos in stop F_basis=1 path 2 (Slot 1, CCv7.1.1, Pump Fuel)" MAP 0x807C72A6 _REC_A1CUR_1_MBSE_S1_S1 127.5 aAwkuzc_BFpgCmb_tmDukma_q__aa0o -64 63.5 FORMAT "%4.1"
 /begin AXIS_DESCR COM_AXIS Nkw caoddzd_oAjpfzb_cAcEEha_1nR_oa0 20 -32768 32767 AXIS_PTS_REF AXX_KF_ZW_VP_PF2 FORMAT "%5.0" MONOTONY STRICT_INCREASE DEPOSIT ABSOLUTE /end AXIS_DESCR
 /begin AXIS_DESCR COM_AXIS Rf_zwv CgkBooc_wkiDfEd_Czglhgc_fR_1a0o 16 -327.68 327.67 AXIS_PTS_REF AXY_KF_ZW_VP_PF2 FORMAT "%9.2" MONOTONY STRICT_INCREASE DEPOSIT ABSOLUTE /end AXIS_DESCR
/end CHARACTERISTIC
/begin CHARACTERISTIC KF_ZW_VP_PF2___MGF_CC_PF_Slot2 "Map for ignition angle vanos in stop F_basis=1 path 2 (Slot 2, CCv7.1.1, Pump Fuel)" MAP 0x807C73E6 _REC_A1CUR_1_MBSE_S1_S1 127.5 aAwkuzc_BFpgCmb_tmDukma_q__aa0o -64 63.5 FORMAT "%4.1"
 /begin AXIS_DESCR COM_AXIS Nkw caoddzd_oAjpfzb_cAcEEha_1nR_oa0 20 -32768 32767 AXIS_PTS_REF AXX_KF_ZW_VP_PF2 FORMAT "%5.0" MONOTONY STRICT_INCREASE DEPOSIT ABSOLUTE /end AXIS_DESCR
 /begin AXIS_DESCR COM_AXIS Rf_zwv CgkBooc_wkiDfEd_Czglhgc_fR_1a0o 16 -327.68 327.67 AXIS_PTS_REF AXY_KF_ZW_VP_PF2 FORMAT "%9.2" MONOTONY STRICT_INCREASE DEPOSIT ABSOLUTE /end AXIS_DESCR
/end CHARACTERISTIC
/begin CHARACTERISTIC KF_ZW_VP_PF2___MGF_CC_PF_Slot3 "Map for ignition angle vanos in stop F_basis=1 path 2 (Slot 3, CCv7.1.1, Pump Fuel)" MAP 0x807C7526 _REC_A1CUR_1_MBSE_S1_S1 127.5 aAwkuzc_BFpgCmb_tmDukma_q__aa0o -64 63.5 FORMAT "%4.1"
 /begin AXIS_DESCR COM_AXIS Nkw caoddzd_oAjpfzb_cAcEEha_1nR_oa0 20 -32768 32767 AXIS_PTS_REF AXX_KF_ZW_VP_PF2 FORMAT "%5.0" MONOTONY STRICT_INCREASE DEPOSIT ABSOLUTE /end AXIS_DESCR
 /begin AXIS_DESCR COM_AXIS Rf_zwv CgkBooc_wkiDfEd_Czglhgc_fR_1a0o 16 -327.68 327.67 AXIS_PTS_REF AXY_KF_ZW_VP_PF2 FORMAT "%9.2" MONOTONY STRICT_INCREASE DEPOSIT ABSOLUTE /end AXIS_DESCR
/end CHARACTERISTIC
/begin CHARACTERISTIC KF_ZW_VP_PF2___MGF_CC_PF_Slot4 "Map for ignition angle vanos in stop F_basis=1 path 2 (Slot 4, CCv7.1.1, Pump Fuel)" MAP 0x807C7666 _REC_A1CUR_1_MBSE_S1_S1 127.5 aAwkuzc_BFpgCmb_tmDukma_q__aa0o -64 63.5 FORMAT "%4.1"
 /begin AXIS_DESCR COM_AXIS Nkw caoddzd_oAjpfzb_cAcEEha_1nR_oa0 20 -32768 32767 AXIS_PTS_REF AXX_KF_ZW_VP_PF2 FORMAT "%5.0" MONOTONY STRICT_INCREASE DEPOSIT ABSOLUTE /end AXIS_DESCR
 /begin AXIS_DESCR COM_AXIS Rf_zwv CgkBooc_wkiDfEd_Czglhgc_fR_1a0o 16 -327.68 327.67 AXIS_PTS_REF AXY_KF_ZW_VP_PF2 FORMAT "%9.2" MONOTONY STRICT_INCREASE DEPOSIT ABSOLUTE /end AXIS_DESCR
/end CHARACTERISTIC
/begin CHARACTERISTIC KF_ZWMIN_KSOT___MGF_CC_PF_Slot0 "Zwmin for sound tuning cold (Slot 0, at 0 RPM, OEM Address)" MAP 0x80754C30 _REC_A1CUR_1_MBSE_S1_S1 127.5 aAwkuzc_BFpgCmb_tmDukma_q__aa0o -64 63.5
 /begin AXIS_DESCR COM_AXIS Nkw caoddzd_oAjpfzb_cAcEEha_1nR_oa0 8 -32768 32767 AXIS_PTS_REF AXX_KF_ZWMIN_KSOT FORMAT "%5.0" MONOTONY STRICT_INCREASE DEPOSIT ABSOLUTE /end AXIS_DESCR
 /begin AXIS_DESCR COM_AXIS NO_INPUT_QUANTITY CgkBooc_wkiDfEd_Czglhgc_fR_1a0o 8 -327.68 327.67 AXIS_PTS_REF AXY_KF_ZWMIN_KSOT FORMAT "%9.4" MONOTONY STRICT_INCREASE DEPOSIT ABSOLUTE /end AXIS_DESCR
/end CHARACTERISTIC
/begin CHARACTERISTIC KF_ZWMIN_KSOT___MGF_CC_PF_Slot1 "Zwmin for sound tuning cold (Slot 1, at 1000 RPM, CCv7.1.1, Pump Fuel)" MAP 0x807C77A6 _REC_A1CUR_1_MBSE_S1_S1 127.5 aAwkuzc_BFpgCmb_tmDukma_q__aa0o -64 63.5
 /begin AXIS_DESCR COM_AXIS Nkw caoddzd_oAjpfzb_cAcEEha_1nR_oa0 8 -32768 32767 AXIS_PTS_REF AXX_KF_ZWMIN_KSOT FORMAT "%5.0" MONOTONY STRICT_INCREASE DEPOSIT ABSOLUTE /end AXIS_DESCR
 /begin AXIS_DESCR COM_AXIS NO_INPUT_QUANTITY CgkBooc_wkiDfEd_Czglhgc_fR_1a0o 8 -327.68 327.67 AXIS_PTS_REF AXY_KF_ZWMIN_KSOT FORMAT "%9.4" MONOTONY STRICT_INCREASE DEPOSIT ABSOLUTE /end AXIS_DESCR
/end CHARACTERISTIC
/begin CHARACTERISTIC KF_ZWMIN_KSOT___MGF_CC_PF_Slot2 "Zwmin for sound tuning cold (Slot 2, at 2000 RPM, CCv7.1.1, Pump Fuel)" MAP 0x807C77E6 _REC_A1CUR_1_MBSE_S1_S1 127.5 aAwkuzc_BFpgCmb_tmDukma_q__aa0o -64 63.5
 /begin AXIS_DESCR COM_AXIS Nkw caoddzd_oAjpfzb_cAcEEha_1nR_oa0 8 -32768 32767 AXIS_PTS_REF AXX_KF_ZWMIN_KSOT FORMAT "%5.0" MONOTONY STRICT_INCREASE DEPOSIT ABSOLUTE /end AXIS_DESCR
 /begin AXIS_DESCR COM_AXIS NO_INPUT_QUANTITY CgkBooc_wkiDfEd_Czglhgc_fR_1a0o 8 -327.68 327.67 AXIS_PTS_REF AXY_KF_ZWMIN_KSOT FORMAT "%9.4" MONOTONY STRICT_INCREASE DEPOSIT ABSOLUTE /end AXIS_DESCR
/end CHARACTERISTIC
/begin CHARACTERISTIC KF_ZWMIN_KSOT___MGF_CC_PF_Slot3 "Zwmin for sound tuning cold (Slot 3, at 3000 RPM, CCv7.1.1, Pump Fuel)" MAP 0x807C7826 _REC_A1CUR_1_MBSE_S1_S1 127.5 aAwkuzc_BFpgCmb_tmDukma_q__aa0o -64 63.5
 /begin AXIS_DESCR COM_AXIS Nkw caoddzd_oAjpfzb_cAcEEha_1nR_oa0 8 -32768 32767 AXIS_PTS_REF AXX_KF_ZWMIN_KSOT FORMAT "%5.0" MONOTONY STRICT_INCREASE DEPOSIT ABSOLUTE /end AXIS_DESCR
 /begin AXIS_DESCR COM_AXIS NO_INPUT_QUANTITY CgkBooc_wkiDfEd_Czglhgc_fR_1a0o 8 -327.68 327.67 AXIS_PTS_REF AXY_KF_ZWMIN_KSOT FORMAT "%9.4" MONOTONY STRICT_INCREASE DEPOSIT ABSOLUTE /end AXIS_DESCR
/end CHARACTERISTIC
/begin CHARACTERISTIC KF_ZWMIN_KSOT___MGF_CC_PF_Slot4 "Zwmin for sound tuning cold (Slot 4, at 4000 RPM, CCv7.1.1, Pump Fuel)" MAP 0x807C7866 _REC_A1CUR_1_MBSE_S1_S1 127.5 aAwkuzc_BFpgCmb_tmDukma_q__aa0o -64 63.5
 /begin AXIS_DESCR COM_AXIS Nkw caoddzd_oAjpfzb_cAcEEha_1nR_oa0 8 -32768 32767 AXIS_PTS_REF AXX_KF_ZWMIN_KSOT FORMAT "%5.0" MONOTONY STRICT_INCREASE DEPOSIT ABSOLUTE /end AXIS_DESCR
 /begin AXIS_DESCR COM_AXIS NO_INPUT_QUANTITY CgkBooc_wkiDfEd_Czglhgc_fR_1a0o 8 -327.68 327.67 AXIS_PTS_REF AXY_KF_ZWMIN_KSOT FORMAT "%9.4" MONOTONY STRICT_INCREASE DEPOSIT ABSOLUTE /end AXIS_DESCR
/end CHARACTERISTIC
/begin CHARACTERISTIC KF_ZWMIN_KSOT___MGF_CC_PF_Slot5 "Zwmin for sound tuning cold (Slot 5, at 5000 RPM, CCv7.1.1, Pump Fuel)" MAP 0x807C78A6 _REC_A1CUR_1_MBSE_S1_S1 127.5 aAwkuzc_BFpgCmb_tmDukma_q__aa0o -64 63.5
 /begin AXIS_DESCR COM_AXIS Nkw caoddzd_oAjpfzb_cAcEEha_1nR_oa0 8 -32768 32767 AXIS_PTS_REF AXX_KF_ZWMIN_KSOT FORMAT "%5.0" MONOTONY STRICT_INCREASE DEPOSIT ABSOLUTE /end AXIS_DESCR
 /begin AXIS_DESCR COM_AXIS NO_INPUT_QUANTITY CgkBooc_wkiDfEd_Czglhgc_fR_1a0o 8 -327.68 327.67 AXIS_PTS_REF AXY_KF_ZWMIN_KSOT FORMAT "%9.4" MONOTONY STRICT_INCREASE DEPOSIT ABSOLUTE /end AXIS_DESCR
/end CHARACTERISTIC
/begin CHARACTERISTIC KF_ZWMIN_WSOT___MGF_CC_PF_Slot0 "Zwmin for sound tuning warm (Slot 0, at 0 RPM, OEM Address)" MAP 0x80754BF0 _REC_A1CUR_1_MBSE_S1_S1 127.5 aAwkuzc_BFpgCmb_tmDukma_q__aa0o -64 63.5
 /begin AXIS_DESCR COM_AXIS Nkw caoddzd_oAjpfzb_cAcEEha_1nR_oa0 8 -32768 32767 AXIS_PTS_REF AXX_KF_ZWMIN_WSOT FORMAT "%5.0" MONOTONY STRICT_INCREASE DEPOSIT ABSOLUTE /end AXIS_DESCR
 /begin AXIS_DESCR COM_AXIS NO_INPUT_QUANTITY CgkBooc_wkiDfEd_Czglhgc_fR_1a0o 8 -327.68 327.67 AXIS_PTS_REF AXY_KF_ZWMIN_WSOT FORMAT "%9.4" MONOTONY STRICT_INCREASE DEPOSIT ABSOLUTE /end AXIS_DESCR
/end CHARACTERISTIC
/begin CHARACTERISTIC KF_ZWMIN_WSOT___MGF_CC_PF_Slot1 "Zwmin for sound tuning warm (Slot 1, at 1000 RPM, CCv7.1.1, Pump Fuel)" MAP 0x807C78E6 _REC_A1CUR_1_MBSE_S1_S1 127.5 aAwkuzc_BFpgCmb_tmDukma_q__aa0o -64 63.5
 /begin AXIS_DESCR COM_AXIS Nkw caoddzd_oAjpfzb_cAcEEha_1nR_oa0 8 -32768 32767 AXIS_PTS_REF AXX_KF_ZWMIN_WSOT FORMAT "%5.0" MONOTONY STRICT_INCREASE DEPOSIT ABSOLUTE /end AXIS_DESCR
 /begin AXIS_DESCR COM_AXIS NO_INPUT_QUANTITY CgkBooc_wkiDfEd_Czglhgc_fR_1a0o 8 -327.68 327.67 AXIS_PTS_REF AXY_KF_ZWMIN_WSOT FORMAT "%9.4" MONOTONY STRICT_INCREASE DEPOSIT ABSOLUTE /end AXIS_DESCR
/end CHARACTERISTIC
/begin CHARACTERISTIC KF_ZWMIN_WSOT___MGF_CC_PF_Slot2 "Zwmin for sound tuning warm (Slot 2, at 2000 RPM, CCv7.1.1, Pump Fuel)" MAP 0x807C7926 _REC_A1CUR_1_MBSE_S1_S1 127.5 aAwkuzc_BFpgCmb_tmDukma_q__aa0o -64 63.5
 /begin AXIS_DESCR COM_AXIS Nkw caoddzd_oAjpfzb_cAcEEha_1nR_oa0 8 -32768 32767 AXIS_PTS_REF AXX_KF_ZWMIN_WSOT FORMAT "%5.0" MONOTONY STRICT_INCREASE DEPOSIT ABSOLUTE /end AXIS_DESCR
 /begin AXIS_DESCR COM_AXIS NO_INPUT_QUANTITY CgkBooc_wkiDfEd_Czglhgc_fR_1a0o 8 -327.68 327.67 AXIS_PTS_REF AXY_KF_ZWMIN_WSOT FORMAT "%9.4" MONOTONY STRICT_INCREASE DEPOSIT ABSOLUTE /end AXIS_DESCR
/end CHARACTERISTIC
/begin CHARACTERISTIC KF_ZWMIN_WSOT___MGF_CC_PF_Slot3 "Zwmin for sound tuning warm (Slot 3, at 3000 RPM, CCv7.1.1, Pump Fuel)" MAP 0x807C7966 _REC_A1CUR_1_MBSE_S1_S1 127.5 aAwkuzc_BFpgCmb_tmDukma_q__aa0o -64 63.5
 /begin AXIS_DESCR COM_AXIS Nkw caoddzd_oAjpfzb_cAcEEha_1nR_oa0 8 -32768 32767 AXIS_PTS_REF AXX_KF_ZWMIN_WSOT FORMAT "%5.0" MONOTONY STRICT_INCREASE DEPOSIT ABSOLUTE /end AXIS_DESCR
 /begin AXIS_DESCR COM_AXIS NO_INPUT_QUANTITY CgkBooc_wkiDfEd_Czglhgc_fR_1a0o 8 -327.68 327.67 AXIS_PTS_REF AXY_KF_ZWMIN_WSOT FORMAT "%9.4" MONOTONY STRICT_INCREASE DEPOSIT ABSOLUTE /end AXIS_DESCR
/end CHARACTERISTIC
/begin CHARACTERISTIC KF_ZWMIN_WSOT___MGF_CC_PF_Slot4 "Zwmin for sound tuning warm (Slot 4, at 4000 RPM, CCv7.1.1, Pump Fuel)" MAP 0x807C79A6 _REC_A1CUR_1_MBSE_S1_S1 127.5 aAwkuzc_BFpgCmb_tmDukma_q__aa0o -64 63.5
 /begin AXIS_DESCR COM_AXIS Nkw caoddzd_oAjpfzb_cAcEEha_1nR_oa0 8 -32768 32767 AXIS_PTS_REF AXX_KF_ZWMIN_WSOT FORMAT "%5.0" MONOTONY STRICT_INCREASE DEPOSIT ABSOLUTE /end AXIS_DESCR
 /begin AXIS_DESCR COM_AXIS NO_INPUT_QUANTITY CgkBooc_wkiDfEd_Czglhgc_fR_1a0o 8 -327.68 327.67 AXIS_PTS_REF AXY_KF_ZWMIN_WSOT FORMAT "%9.4" MONOTONY STRICT_INCREASE DEPOSIT ABSOLUTE /end AXIS_DESCR
/end CHARACTERISTIC
/begin CHARACTERISTIC KF_ZWMIN_WSOT___MGF_CC_PF_Slot5 "Zwmin for sound tuning warm (Slot 5, at 5000 RPM, CCv7.1.1, Pump Fuel)" MAP 0x807C79E6 _REC_A1CUR_1_MBSE_S1_S1 127.5 aAwkuzc_BFpgCmb_tmDukma_q__aa0o -64 63.5
 /begin AXIS_DESCR COM_AXIS Nkw caoddzd_oAjpfzb_cAcEEha_1nR_oa0 8 -32768 32767 AXIS_PTS_REF AXX_KF_ZWMIN_WSOT FORMAT "%5.0" MONOTONY STRICT_INCREASE DEPOSIT ABSOLUTE /end AXIS_DESCR
 /begin AXIS_DESCR COM_AXIS NO_INPUT_QUANTITY CgkBooc_wkiDfEd_Czglhgc_fR_1a0o 8 -327.68 327.67 AXIS_PTS_REF AXY_KF_ZWMIN_WSOT FORMAT "%9.4" MONOTONY STRICT_INCREASE DEPOSIT ABSOLUTE /end AXIS_DESCR
/end CHARACTERISTIC
/begin MEASUREMENT BMWtchbas_p_Dif_sw "Pld_diff (target boost pressure minus actual boost pressure)" SWORD BMW_p_sw_q0p125_hPa 1 100 -4096 4095.875 FORMAT "%10.3" ECU_ADDRESS 0x600024AC /end MEASUREMENT
/begin MEASUREMENT BMWtchbas_p_DifGra_sw "Gradient of the control difference normalized - bank-specific" SWORD BMW_p_sw_q0p125_hPa 1 100 -4096 4095.875 FORMAT "%10.3" ECU_ADDRESS 0x600024A8 /end MEASUREMENT
/begin MEASUREMENT BMWtchsp_mf_CmprNorm_uw "Target mass flow corrected for boost pressure control" UWORD CByjozc_eCmpBAb_pljBAmd_k__0oa0 1 100 0 2047.96875 FORMAT "%10.3" ECU_ADDRESS 0x60002528 /end MEASUREMENT
/begin MEASUREMENT BMWtchsp_mf_Ex_uw "Target mass flow at the exhaust manifold - inflow" UWORD CByjozc_eCmpBAb_pljBAmd_k__0oa0 1 100 0 2047.96875 FORMAT "%10.3" ECU_ADDRESS 0x6000252A /end MEASUREMENT
/begin MEASUREMENT BMWtchsp_rat_p_CmprLim_uw "Desired supercharging factor - boost pressure Desired value for pressure in front of the compressor" UWORD acriqBc_tfkBqod_ocgjxzc_nR_8oa0 1 100 0 7.9998779296875 FORMAT "%11.4" ECU_ADDRESS 0x6000251E /end MEASUREMENT
/begin MEASUREMENT BMWtchtbc_t_BefCmpr_sw "Temperature before charger - model or sensor value" SWORD BMW_q0p1_degC 1 100 -3276.8 3276.7 FORMAT "%6.1" ECU_ADDRESS 0x60023172 /end MEASUREMENT
/begin MEASUREMENT BMWtqe_idx_SpdMaxLimr_ub "Index shows who has limited N_vm_max" UBYTE raChrxc_kBtBrmb_FmDuEFa_n__aa0o 1 100 0 255 FORMAT "%3.0" ECU_ADDRESS 0x600046F2 /end MEASUREMENT
/begin MEASUREMENT FlexFuelEthanolContentValue___MGF_CC "Ethanol content percentage from Flex Fuel sensor or the overriding value" UWORD FlexFuelEthanolContentValue_CompuMethod 1 0 0 100 ECU_ADDRESS 0x60107EA4 /end MEASUREMENT
/begin MEASUREMENT Nkw "number of revolutions" SWORD caoddzd_oAjpfzb_cAcEEha_1nR_oa0 1 100 -32768 32767 ECU_ADDRESS 0x60003C6E /end MEASUREMENT
/begin MEASUREMENT Nkw_ref "ASD. Calculated truck speed reference." SWORD caoddzd_oAjpfzb_cAcEEha_1nR_oa0 1 100 -32768 32767 ECU_ADDRESS 0x60003A10 /end MEASUREMENT
/begin MEASUREMENT Ps "Saugrohrdruck, modelliert" UWORD BMW_p_sw_q0p125_hPa 1 100 0 8191.875 FORMAT "%8.3" ECU_ADDRESS 0x60003612 /end MEASUREMENT
/begin MEASUREMENT Rf "Relative air filling" SWORD CgkBooc_wkiDfEd_Czglhgc_fR_1a0o 1 100 -327.68 327.67 FORMAT "%7.2" ECU_ADDRESS 0x600033FA /end MEASUREMENT
/begin MEASUREMENT Rf_zh_ber "Relative air charge for the calculation of the detonator parameters" SWORD CgkBooc_wkiDfEd_Czglhgc_fR_1a0o 1 100 -327.68 327.67 FORMAT "%6.2" ECU_ADDRESS 0x50005D58 /end MEASUREMENT
/begin MEASUREMENT Rf_zwv "rel. Actual filling or actual volume for ignition angle calculation" SWORD CgkBooc_wkiDfEd_Czglhgc_fR_1a0o 1 100 -327.68 327.67 FORMAT "%9.2" ECU_ADDRESS 0x6000368A /end MEASUREMENT
/begin MEASUREMENT Tabg_vl_xab "Abgastemperatur vor Lader" SWORD BMW_q0p1_degC 1 100 -3276.8 3276.7 FORMAT "%6.1" ECU_ADDRESS 0x60023124 MATRIX_DIM 2 1 1 /end MEASUREMENT
/begin MEASUREMENT Tans "Mean intake air temperature" SWORD BMW_q0p1_degC 1 100 -3276.8 3276.7 ECU_ADDRESS 0x600231BC /end MEASUREMENT
/begin MEASUREMENT Tmot "cooling water temperature" SWORD DchEpAd_DBCFgoa_Ckhahgc_q__aoa0 1 100 -327.68 327.67 ECU_ADDRESS 0x6000293E /end MEASUREMENT
/begin FUNCTION "___CCv7.1.1_Antilag" "Custom Code" /begin OUT_MEASUREMENT /end OUT_MEASUREMENT
 /begin DEF_CHARACTERISTIC Antilag_ActivationDelay___MGF_CC_PF Antilag_BMWtqe_gra_NMaxEngLimdDwn_T___MGF_CC_PF Antilag_TargetNumberOfCylindersToSuppress___MGF_CC_PF Antilag_CutMethod___MGF_CC_PF Antilag_Pedal___MGF_CC_PF Antilag_Antilag_CW___MGF_CC /end DEF_CHARACTERISTIC
 /begin SUB_FUNCTION "___CCv7.1.1_Antilag[Rolling]" "___CCv7.1.1_Antilag[Standing]" "___CCv7.1.1_Antilag[PIDs]" "___CCv7.1.1_Antilag[Safety]" /end SUB_FUNCTION
/end FUNCTION
/begin FUNCTION "___CCv7.1.1_Antilag[PIDs]" "Custom Code" /begin OUT_MEASUREMENT /end OUT_MEASUREMENT
 /begin DEF_CHARACTERISTIC Antilag_BMWtchctr_p_DifCrtnPp_M___MGF_CC_PF Antilag_BMWtchctr_p_DifCrtnPpDyn_M___MGF_CC_PF Antilag_BMWtchctr_pwr_Dp_M___MGF_CC_PF Antilag_BMWtchctr_pwr_Pctl_M___MGF_CC_PF /end DEF_CHARACTERISTIC
/end FUNCTION
/begin FUNCTION "___CCv7.1.1_Antilag[Rolling]" "Custom Code" /begin OUT_MEASUREMENT /end OUT_MEASUREMENT
 /begin DEF_CHARACTERISTIC Antilag_IgnRoll___MGF_CC_PF Antilag_LambdaRoll___MGF_CC_PF Antilag_RollingSpeedThreshold___MGF_CC_PF Antilag_RollRpmMax___MGF_CC_PF Antilag_RollRpmMin___MGF_CC_PF Antilag_RpmDelayUntilCutRoll___MGF_CC_PF Antilag_TargetBoostRoll___MGF_CC_PF /end DEF_CHARACTERISTIC
/end FUNCTION
/begin FUNCTION "___CCv7.1.1_Antilag[Safety]" "Custom Code" /begin OUT_MEASUREMENT /end OUT_MEASUREMENT
 /begin DEF_CHARACTERISTIC Antilag_CoolantTempMax___MGF_CC_PF Antilag_CoolantTempMin___MGF_CC_PF Antilag_EgtTempMax___MGF_CC_PF Antilag_MaxDuration___MGF_CC_PF Antilag_OverBoostThreshold___MGF_CC_PF Antilag_SafetyTorqueCap___MGF_CC_PF Antilag_IatTempMax___MGF_CC_PF /end DEF_CHARACTERISTIC
/end FUNCTION
/begin FUNCTION "___CCv7.1.1_Antilag[Standing]" "Custom Code" /begin OUT_MEASUREMENT /end OUT_MEASUREMENT
 /begin DEF_CHARACTERISTIC Antilag_IgnStand___MGF_CC_PF Antilag_LambdaStand___MGF_CC_PF Antilag_RpmDelayUntilCutStand___MGF_CC_PF Antilag_RpmSetpoint___MGF_CC_PF Antilag_TargetBoostStand___MGF_CC_PF /end DEF_CHARACTERISTIC
/end FUNCTION
/begin FUNCTION "___CCv7.1.1_Burbles" "Custom Code" /begin OUT_MEASUREMENT /end OUT_MEASUREMENT
 /begin DEF_CHARACTERISTIC KF_ZWMIN_WSOT___MGF_CC_PF_Slot0 KF_ZWMIN_WSOT___MGF_CC_PF_Slot1 KF_ZWMIN_WSOT___MGF_CC_PF_Slot2 KF_ZWMIN_WSOT___MGF_CC_PF_Slot3 KF_ZWMIN_WSOT___MGF_CC_PF_Slot4 KF_ZWMIN_WSOT___MGF_CC_PF_Slot5 KF_ZWMIN_KSOT___MGF_CC_PF_Slot0 KF_ZWMIN_KSOT___MGF_CC_PF_Slot1 KF_ZWMIN_KSOT___MGF_CC_PF_Slot2 KF_ZWMIN_KSOT___MGF_CC_PF_Slot3 KF_ZWMIN_KSOT___MGF_CC_PF_Slot4 KF_ZWMIN_KSOT___MGF_CC_PF_Slot5 Burbles_Burbles_CW___MGF_CC /end DEF_CHARACTERISTIC
/end FUNCTION
/begin FUNCTION "___CCv7.1.1_CustomCodeMenu" "Custom Code" /begin OUT_MEASUREMENT /end OUT_MEASUREMENT
 /begin DEF_CHARACTERISTIC CcmEnterMenuDelay___MGF_CC_PF CcmTimeout___MGF_CC_PF UniRockerEnterDetectionDelay___MGF_CC_PF CustomCodeMenu_CustomCodeMenu_CW___MGF_CC CustomCodeMenu_CustomCodeMenu_CW_CruiseControlConfig___MGF_CC CustomCodeMenu_CustomCodeMenu_CW_UseAllCruiseControlCanBusData___MGF_CC /end DEF_CHARACTERISTIC
/end FUNCTION
/begin FUNCTION "___CCv7.1.1_ExhaustFlap" "Custom Code" /begin OUT_MEASUREMENT /end OUT_MEASUREMENT
 /begin DEF_CHARACTERISTIC ExhaustFlapClosedMaxLoad___MGF_CC_PF ExhaustFlap_ExhaustFlap_CW___MGF_CC /end DEF_CHARACTERISTIC
/end FUNCTION
/begin FUNCTION "___CCv7.1.1_FlexFuel" "Custom Code" /begin OUT_MEASUREMENT /end OUT_MEASUREMENT
 /begin DEF_CHARACTERISTIC FlexFuelEthanolDisplayActivationDelay___MGF_CC_PF FlexFuel_FlexFuel_CW___MGF_CC FlexFuel_FlexFuel_CW_Blending___MGF_CC FlexFuel_FlexFuel_CW_SensorEthanol___MGF_CC /end DEF_CHARACTERISTIC
 /begin SUB_FUNCTION "___CCv7.1.1_FlexFuel[Flex Fuel]" /end SUB_FUNCTION
/end FUNCTION
/begin FUNCTION "___CCv7.1.1_FlexFuel[Flex Fuel]" "Custom Code" /begin DEF_CHARACTERISTIC FlexFuelEthanolContentValue___MGF_CC /end DEF_CHARACTERISTIC /end FUNCTION
/begin FUNCTION "___CCv7.1.1_MaxCooling" "Custom Code" /begin OUT_MEASUREMENT /end OUT_MEASUREMENT
 /begin DEF_CHARACTERISTIC TargetPumpSpeed___MGF_CC TargetTemperature___MGF_CC MaxCooling_MaxCooling_CW___MGF_CC /end DEF_CHARACTERISTIC
/end FUNCTION
/begin FUNCTION "___CCv7.1.1_RadiatorFlap" "Custom Code" /begin OUT_MEASUREMENT /end OUT_MEASUREMENT /begin DEF_CHARACTERISTIC RadiatorFlap_RadiatorFlap_CW___MGF_CC /end DEF_CHARACTERISTIC /end FUNCTION
/begin FUNCTION "___CCv7.1.1_SwitchableMaps" "Custom Code" /begin OUT_MEASUREMENT /end OUT_MEASUREMENT
 /begin DEF_CHARACTERISTIC SwitchableMaps_SwitchableMaps_CW_Ethanol___MGF_CC SwitchableMaps_SwitchableMaps_CW_Octane___MGF_CC /end DEF_CHARACTERISTIC
 /begin SUB_FUNCTION "___CCv7.1.1_SwitchableMaps[Slot0]" "___CCv7.1.1_SwitchableMaps[Slot1]" "___CCv7.1.1_SwitchableMaps[Slot2]" "___CCv7.1.1_SwitchableMaps[Slot3]" "___CCv7.1.1_SwitchableMaps[Slot4]" /end SUB_FUNCTION
/end FUNCTION
/begin FUNCTION "___CCv7.1.1_SwitchableMaps[Slot0]" "Custom Code" /begin OUT_MEASUREMENT /end OUT_MEASUREMENT
 /begin DEF_CHARACTERISTIC BMWtchctr_pwr_Pctl_Ay___MGF_CC_PF_Slot0 BMWtchctr_pwr_Pctl_Ax___MGF_CC_PF_Slot0 BMWtchctr_p_DifCrtnPp_Ay___MGF_CC_PF_Slot0 AXY_KF_MDIOP_1_TQE___MGF_CC AXX_KF_MDIOP_1_TQE___MGF_CC_PF_Slot0 KF_LABAS_1___MGF_CC_PF_Slot0 KF_FRKKORRF_1___MGF_CC_PF_Slot0 KL_RF_MAX_UESP___MGF_CC_PF_Slot0 KL_RF_MAX___MGF_CC_PF_Slot0 BMWtchctr_pwr_Pctl_M___MGF_CC_PF_Slot0 BMWtchctr_pwr_Dp_M___MGF_CC_PF_Slot0 BMWtchctr_p_DifCrtnPp_M___MGF_CC_PF_Slot0 BMWtchsp_p_ReqMax_C___MGF_CC_PF_Slot0 BMWtchsp_rat_p_CmprMax_M___MGF_CC_PF_Slot0 BMWtchsp_rat_p_CmprPmp_T___MGF_CC_PF_Slot0 KF_MDIOP_1_TQE___MGF_CC_PF_Slot0 BMWtqe_tqc_FlApplStgNorm_T___MGF_CC_PF_Slot0 KF_FDZWT_PF2___MGF_CC_PF_Slot0 KF_FDZWT_PF1___MGF_CC_PF_Slot0 BMWtchctr_pct_WgBasc_M___MGF_CC_PF_Slot0 KF_LABAS_2___MGF_CC_PF_Slot0 KF_ZW_S_PF2___MGF_CC_PF_Slot0 KF_ZW_S_PF1___MGF_CC_PF_Slot0 KF_ZW_PF2___MGF_CC_PF_Slot0 KF_ZW_PF1___MGF_CC_PF_Slot0 KF_ZW_VP_PF2___MGF_CC_PF_Slot0 KF_ZW_VP_PF1___MGF_CC_PF_Slot0 /end DEF_CHARACTERISTIC
/end FUNCTION
/begin FUNCTION "___CCv7.1.1_SwitchableMaps[Slot1]" "Custom Code" /begin OUT_MEASUREMENT /end OUT_MEASUREMENT
 /begin DEF_CHARACTERISTIC BMWtchctr_pwr_Pctl_Ay___MGF_CC_PF_Slot1 BMWtchctr_pwr_Pctl_Ax___MGF_CC_PF_Slot1 BMWtchctr_p_DifCrtnPp_Ay___MGF_CC_PF_Slot1 AXX_KF_MDIOP_1_TQE___MGF_CC_PF_Slot1 KF_LABAS_1___MGF_CC_PF_Slot1 KF_FRKKORRF_1___MGF_CC_PF_Slot1 KL_RF_MAX_UESP___MGF_CC_PF_Slot1 KL_RF_MAX___MGF_CC_PF_Slot1 BMWtchctr_pwr_Pctl_M___MGF_CC_PF_Slot1 BMWtchctr_pwr_Dp_M___MGF_CC_PF_Slot1 BMWtchctr_p_DifCrtnPp_M___MGF_CC_PF_Slot1 BMWtchsp_p_ReqMax_C___MGF_CC_PF_Slot1 BMWtchsp_rat_p_CmprMax_M___MGF_CC_PF_Slot1 BMWtchsp_rat_p_CmprPmp_T___MGF_CC_PF_Slot1 KF_MDIOP_1_TQE___MGF_CC_PF_Slot1 BMWtqe_tqc_FlApplStgNorm_T___MGF_CC_PF_Slot1 KF_FDZWT_PF2___MGF_CC_PF_Slot1 KF_FDZWT_PF1___MGF_CC_PF_Slot1 BMWtchctr_pct_WgBasc_M___MGF_CC_PF_Slot1 KF_LABAS_2___MGF_CC_PF_Slot1 KF_ZW_S_PF2___MGF_CC_PF_Slot1 KF_ZW_S_PF1___MGF_CC_PF_Slot1 KF_ZW_PF2___MGF_CC_PF_Slot1 KF_ZW_PF1___MGF_CC_PF_Slot1 KF_ZW_VP_PF2___MGF_CC_PF_Slot1 KF_ZW_VP_PF1___MGF_CC_PF_Slot1 /end DEF_CHARACTERISTIC
/end FUNCTION
/begin FUNCTION "___CCv7.1.1_SwitchableMaps[Slot2]" "Custom Code" /begin OUT_MEASUREMENT /end OUT_MEASUREMENT
 /begin DEF_CHARACTERISTIC BMWtchctr_pwr_Pctl_Ay___MGF_CC_PF_Slot2 BMWtchctr_pwr_Pctl_Ax___MGF_CC_PF_Slot2 BMWtchctr_p_DifCrtnPp_Ay___MGF_CC_PF_Slot2 AXX_KF_MDIOP_1_TQE___MGF_CC_PF_Slot2 KF_LABAS_1___MGF_CC_PF_Slot2 KF_FRKKORRF_1___MGF_CC_PF_Slot2 KL_RF_MAX_UESP___MGF_CC_PF_Slot2 KL_RF_MAX___MGF_CC_PF_Slot2 BMWtchctr_pwr_Pctl_M___MGF_CC_PF_Slot2 BMWtchctr_pwr_Dp_M___MGF_CC_PF_Slot2 BMWtchctr_p_DifCrtnPp_M___MGF_CC_PF_Slot2 BMWtchsp_p_ReqMax_C___MGF_CC_PF_Slot2 BMWtchsp_rat_p_CmprMax_M___MGF_CC_PF_Slot2 BMWtchsp_rat_p_CmprPmp_T___MGF_CC_PF_Slot2 KF_MDIOP_1_TQE___MGF_CC_PF_Slot2 BMWtqe_tqc_FlApplStgNorm_T___MGF_CC_PF_Slot2 KF_FDZWT_PF2___MGF_CC_PF_Slot2 KF_FDZWT_PF1___MGF_CC_PF_Slot2 BMWtchctr_pct_WgBasc_M___MGF_CC_PF_Slot2 KF_LABAS_2___MGF_CC_PF_Slot2 KF_ZW_S_PF2___MGF_CC_PF_Slot2 KF_ZW_S_PF1___MGF_CC_PF_Slot2 KF_ZW_PF2___MGF_CC_PF_Slot2 KF_ZW_PF1___MGF_CC_PF_Slot2 KF_ZW_VP_PF2___MGF_CC_PF_Slot2 KF_ZW_VP_PF1___MGF_CC_PF_Slot2 /end DEF_CHARACTERISTIC
/end FUNCTION
/begin FUNCTION "___CCv7.1.1_SwitchableMaps[Slot3]" "Custom Code" /begin OUT_MEASUREMENT /end OUT_MEASUREMENT
 /begin DEF_CHARACTERISTIC BMWtchctr_pwr_Pctl_Ay___MGF_CC_PF_Slot3 BMWtchctr_pwr_Pctl_Ax___MGF_CC_PF_Slot3 BMWtchctr_p_DifCrtnPp_Ay___MGF_CC_PF_Slot3 AXX_KF_MDIOP_1_TQE___MGF_CC_PF_Slot3 KF_LABAS_1___MGF_CC_PF_Slot3 KF_FRKKORRF_1___MGF_CC_PF_Slot3 KL_RF_MAX_UESP___MGF_CC_PF_Slot3 KL_RF_MAX___MGF_CC_PF_Slot3 BMWtchctr_pwr_Pctl_M___MGF_CC_PF_Slot3 BMWtchctr_pwr_Dp_M___MGF_CC_PF_Slot3 BMWtchctr_p_DifCrtnPp_M___MGF_CC_PF_Slot3 BMWtchsp_p_ReqMax_C___MGF_CC_PF_Slot3 BMWtchsp_rat_p_CmprMax_M___MGF_CC_PF_Slot3 BMWtchsp_rat_p_CmprPmp_T___MGF_CC_PF_Slot3 KF_MDIOP_1_TQE___MGF_CC_PF_Slot3 BMWtqe_tqc_FlApplStgNorm_T___MGF_CC_PF_Slot3 KF_FDZWT_PF2___MGF_CC_PF_Slot3 KF_FDZWT_PF1___MGF_CC_PF_Slot3 BMWtchctr_pct_WgBasc_M___MGF_CC_PF_Slot3 KF_LABAS_2___MGF_CC_PF_Slot3 KF_ZW_S_PF2___MGF_CC_PF_Slot3 KF_ZW_S_PF1___MGF_CC_PF_Slot3 KF_ZW_PF2___MGF_CC_PF_Slot3 KF_ZW_PF1___MGF_CC_PF_Slot3 KF_ZW_VP_PF2___MGF_CC_PF_Slot3 KF_ZW_VP_PF1___MGF_CC_PF_Slot3 /end DEF_CHARACTERISTIC
/end FUNCTION
/begin FUNCTION "___CCv7.1.1_SwitchableMaps[Slot4]" "Custom Code" /begin OUT_MEASUREMENT /end OUT_MEASUREMENT
 /begin DEF_CHARACTERISTIC BMWtchctr_pwr_Pctl_Ay___MGF_CC_PF_Slot4 BMWtchctr_pwr_Pctl_Ax___MGF_CC_PF_Slot4 BMWtchctr_p_DifCrtnPp_Ay___MGF_CC_PF_Slot4 AXX_KF_MDIOP_1_TQE___MGF_CC_PF_Slot4 KF_LABAS_1___MGF_CC_PF_Slot4 KF_FRKKORRF_1___MGF_CC_PF_Slot4 KL_RF_MAX_UESP___MGF_CC_PF_Slot4 KL_RF_MAX___MGF_CC_PF_Slot4 BMWtchctr_pwr_Pctl_M___MGF_CC_PF_Slot4 BMWtchctr_pwr_Dp_M___MGF_CC_PF_Slot4 BMWtchctr_p_DifCrtnPp_M___MGF_CC_PF_Slot4 BMWtchsp_p_ReqMax_C___MGF_CC_PF_Slot4 BMWtchsp_rat_p_CmprMax_M___MGF_CC_PF_Slot4 BMWtchsp_rat_p_CmprPmp_T___MGF_CC_PF_Slot4 KF_MDIOP_1_TQE___MGF_CC_PF_Slot4 BMWtqe_tqc_FlApplStgNorm_T___MGF_CC_PF_Slot4 KF_FDZWT_PF2___MGF_CC_PF_Slot4 KF_FDZWT_PF1___MGF_CC_PF_Slot4 BMWtchctr_pct_WgBasc_M___MGF_CC_PF_Slot4 KF_LABAS_2___MGF_CC_PF_Slot4 KF_ZW_S_PF2___MGF_CC_PF_Slot4 KF_ZW_S_PF1___MGF_CC_PF_Slot4 KF_ZW_PF2___MGF_CC_PF_Slot4 KF_ZW_PF1___MGF_CC_PF_Slot4 KF_ZW_VP_PF2___MGF_CC_PF_Slot4 KF_ZW_VP_PF1___MGF_CC_PF_Slot4 /end DEF_CHARACTERISTIC
/end FUNCTION
/begin FUNCTION "___CCv7.1.1_TcuTorqueLimiter" "Custom Code" /begin OUT_MEASUREMENT /end OUT_MEASUREMENT /begin DEF_CHARACTERISTIC TcuTorqueLimiter_TcuTorqueLimiter_CW___MGF_CC /end DEF_CHARACTERISTIC /end FUNCTION
/begin FUNCTION "___CCv7.1.1_Valet" "Custom Code" /begin OUT_MEASUREMENT /end OUT_MEASUREMENT
 /begin DEF_CHARACTERISTIC ValetTorqueMap___MGF_CC_PF_Slot1 ValetTorqueMap___MGF_CC_PF_Slot2 ValetMaxRpm___MGF_CC_PF ValetMaxSpeed___MGF_CC_PF Valet_Valet_CW___MGF_CC ValetMaxPedal___MGF_CC_PF /end DEF_CHARACTERISTIC
/end FUNCTION
/begin COMPU_METHOD ___MGF_CC_EngineSpeed_d4 "default compuMethod" RAT_FUNC "%6.3" "RPM" COEFFS 0 4 0 0 0 1 /end COMPU_METHOD
/begin COMPU_METHOD ___MGF_CC_EngineSpeedCutMethodCompuMethod "default compuMethod" TAB_VERB "%6.3" "-" COMPU_TAB_REF ___MGF_CC_EngineSpeedCutMethodCompuVTab /end COMPU_METHOD
/begin COMPU_METHOD ___MGF_CC_Fueling_d10 "default compuMethod" RAT_FUNC "%8.3" "°" COEFFS 0 4096 0 0 0 1 /end COMPU_METHOD
/begin COMPU_METHOD ___MGF_CC_IgnitionTiming_d10 "default compuMethod" RAT_FUNC "%8.3" "°" COEFFS 0 10 0 0 0 1 /end COMPU_METHOD
/begin COMPU_METHOD ___MGF_CC_Pedal_x100_d256 "default compuMethod" RAT_FUNC "%6.3" "%" COEFFS 0 256 0 0 0 100 /end COMPU_METHOD
/begin COMPU_METHOD ___MGF_CC_Speedkmh_d64 "default compuMethod" RAT_FUNC "%6.4" "km/h" COEFFS 0 64 0 0 0 1 /end COMPU_METHOD
/begin COMPU_METHOD ___MGF_CC_Temperature_2 "default compuMethod" RAT_FUNC "%6.3" "L/h" COEFFS 0 2 0 0 0 1 /end COMPU_METHOD
/begin COMPU_METHOD ___MGF_CC_TemperatureCelsius_x3_d4_s48 "default compuMethod" RAT_FUNC "%6.2" "°C" COEFFS 0 1 48 0 0 0.75 /end COMPU_METHOD
/begin COMPU_METHOD aAwkuzc_BFpgCmb_tmDukma_q__aa0o "aAwkuzc_BFpgCmb_tmDukma_q__aa0o" RAT_FUNC "%6.3" "°" COEFFS 0 2 0 0 0 1 /end COMPU_METHOD
/begin COMPU_METHOD acriqBc_tfkBqod_ocgjxzc_nR_8oa0 "acriqBc_tfkBqod_ocgjxzc_nR_8oa0" RAT_FUNC "%6.3" "-" COEFFS 0 8192 0 0 0 1 /end COMPU_METHOD
/begin COMPU_METHOD B_TRUE "" TAB_VERB "%6.3" "" COMPU_TAB_REF ACCMPR_CODAVL_SY_Compu /end COMPU_METHOD
/begin COMPU_METHOD Bhvfwhc_bigEubd_BBEupBd_nR_3oa0 "Bhvfwhc_bigEubd_BBEupBd_nR_3oa0" RAT_FUNC "%6.3" "-" COEFFS 0 32768 0 0 0 1 /end COMPU_METHOD
/begin COMPU_METHOD BMW_dm_sw_q0p1_Nm "" RAT_FUNC "%6.3" "Nm" COEFFS 0 10 0 0 0 1 /end COMPU_METHOD
/begin COMPU_METHOD BMW_p_sw_q0p125_hPa "" RAT_FUNC "%6.3" "hPa" COEFFS 0 8 0 0 0 1 /end COMPU_METHOD
/begin COMPU_METHOD BMW_q0p1_degC "" RAT_FUNC "%6.3" "°C" COEFFS 0 10 0 0 0 1 /end COMPU_METHOD
/begin COMPU_METHOD BumqDkc_mryszAa_EcglxAc_nR_4oa0 "BumqDkc_mryszAa_EcglxAc_nR_4oa0" RAT_FUNC "%6.3" "-" COEFFS 0 4096 0 0 0 1 /end COMPU_METHOD
/begin COMPU_METHOD camcxxd_bxlpdsa_Cshlhgc_sR_1a0o "Def_q0p01" RAT_FUNC "%6.3" "s" COEFFS 0 100 0 0 0 1 /end COMPU_METHOD
/begin COMPU_METHOD caoddzd_oAjpfzb_cAcEEha_1nR_oa0 "Def_q1" RAT_FUNC "%6.3" "1/min" COEFFS 0 1 0 0 0 1 /end COMPU_METHOD
/begin COMPU_METHOD CByjozc_eCmpBAb_pljBAmd_k__0oa0 "CByjozc_eCmpBAb_pljBAmd_k__0oa0" RAT_FUNC "%6.3" "kg/h" COEFFS 0 32 0 0 0 1 /end COMPU_METHOD
/begin COMPU_METHOD CgkBooc_wkiDfEd_Czglhgc_fR_1a0o "Def_q0p01" RAT_FUNC "%6.3" "%" COEFFS 0 100 0 0 0 1 /end COMPU_METHOD
/begin COMPU_METHOD DchEpAd_DBCFgoa_Ckhahgc_q__aoa0 "DchEpAd_DBCFgoa_Ckhahgc_q__aoa0" RAT_FUNC "%6.3" "°C" COEFFS 0 100 0 0 0 1 /end COMPU_METHOD
/begin COMPU_METHOD EngN "" RAT_FUNC "%6.3" "rpm" COEFFS 0 2 0 0 0 1 /end COMPU_METHOD
/begin COMPU_METHOD FlexFuelEthanolContentValue_CompuMethod "FlexFuelEthanolContentValueCompuMethod" RAT_FUNC "%8.3" "%" COEFFS 0 1 0 0 0 1 /end COMPU_METHOD
/begin COMPU_METHOD ilxsavd_hkzmBfc_lAzCpAb_nR_1oa0 "ilxsavd_hkzmBfc_lAzCpAb_nR_1oa0" RAT_FUNC "%6.3" "-" COEFFS 0 16384 0 0 0 1 /end COMPU_METHOD
/begin COMPU_METHOD jucyrzb_bpFgwfd_uqrfhgc_k__aoa0 "jucyrzb_bpFgwfd_uqrfhgc_k__aoa0" RAT_FUNC "%6.3" "kW" COEFFS 0 512 0 0 0 1 /end COMPU_METHOD
/begin COMPU_METHOD raChrxc_kBtBrmb_FmDuEFa_n__aa0o "Def_q1" RAT_FUNC "%6.3" "-" COEFFS 0 1 0 0 0 1 /end COMPU_METHOD
/begin COMPU_METHOD wDDoctd_cCDyaFa_AvCkvFb_nR_6o0o "wDDoctd_cCDyaFa_AvCkvFb_nR_6o0o" RAT_FUNC "%6.3" "-" COEFFS 0 16384 0 0 0 25 /end COMPU_METHOD
/begin COMPU_VTAB ___MGF_CC_EngineSpeedCutMethodCompuVTab "" TAB_VERB 3 0 "Fuel" 1 "Ignition" 3 "Factory" DEFAULT_VALUE "Not Defined, unexpected results" /end COMPU_VTAB
/begin COMPU_VTAB ACCMPR_CODAVL_SY_Compu "" TAB_VERB 2 0 "FALSE" 1 "TRUE" /end COMPU_VTAB
/begin RECORD_LAYOUT ___MGF_CC_Antilag_Ign_Roll_xAxis AXIS_PTS_X 0 SWORD INDEX_INCR PLONG /end RECORD_LAYOUT
/begin RECORD_LAYOUT _REC_A1AXS_1_MBSE_S2 ALIGNMENT_BYTE 1 ALIGNMENT_WORD 2 ALIGNMENT_LONG 4 ALIGNMENT_FLOAT32_IEEE 4 ALIGNMENT_FLOAT64_IEEE 4 AXIS_PTS_X 1 SWORD INDEX_INCR DIRECT /end RECORD_LAYOUT
/begin RECORD_LAYOUT _REC_A1AXS_1_MBSE_U1 ALIGNMENT_BYTE 1 ALIGNMENT_WORD 2 ALIGNMENT_LONG 4 ALIGNMENT_FLOAT32_IEEE 4 ALIGNMENT_FLOAT64_IEEE 4 AXIS_PTS_X 1 UBYTE INDEX_INCR DIRECT /end RECORD_LAYOUT
/begin RECORD_LAYOUT _REC_A1AXS_1_MBSE_U2 ALIGNMENT_BYTE 1 ALIGNMENT_WORD 2 ALIGNMENT_LONG 4 ALIGNMENT_FLOAT32_IEEE 4 ALIGNMENT_FLOAT64_IEEE 4 AXIS_PTS_X 1 UWORD INDEX_INCR DIRECT /end RECORD_LAYOUT
/begin RECORD_LAYOUT _REC_A1CUR_1_MBSE_S1_S1 ALIGNMENT_BYTE 1 ALIGNMENT_WORD 2 ALIGNMENT_LONG 4 ALIGNMENT_FLOAT32_IEEE 4 ALIGNMENT_FLOAT64_IEEE 4 FNC_VALUES 1 SBYTE ROW_DIR DIRECT /end RECORD_LAYOUT
/begin RECORD_LAYOUT _REC_A1CUR_1_MBSE_S2_S1 ALIGNMENT_BYTE 1 ALIGNMENT_WORD 2 ALIGNMENT_LONG 4 ALIGNMENT_FLOAT32_IEEE 4 ALIGNMENT_FLOAT64_IEEE 4 FNC_VALUES 1 SWORD ROW_DIR DIRECT /end RECORD_LAYOUT
/begin RECORD_LAYOUT _REC_A1CUR_1_MBSE_U2_S1 ALIGNMENT_BYTE 1 ALIGNMENT_WORD 2 ALIGNMENT_LONG 4 ALIGNMENT_FLOAT32_IEEE 4 ALIGNMENT_FLOAT64_IEEE 4 FNC_VALUES 1 UWORD ROW_DIR DIRECT /end RECORD_LAYOUT
/begin RECORD_LAYOUT CurG_Ws16 ALIGNMENT_BYTE 1 ALIGNMENT_WORD 2 ALIGNMENT_LONG 4 ALIGNMENT_FLOAT32_IEEE 4 ALIGNMENT_FLOAT64_IEEE 4 FNC_VALUES 1 SWORD COLUMN_DIR DIRECT /end RECORD_LAYOUT
/begin RECORD_LAYOUT FklWUb ALIGNMENT_BYTE 1 ALIGNMENT_WORD 2 ALIGNMENT_LONG 4 ALIGNMENT_FLOAT32_IEEE 4 ALIGNMENT_FLOAT64_IEEE 4 FNC_VALUES 1 UBYTE COLUMN_DIR DIRECT /end RECORD_LAYOUT
/begin RECORD_LAYOUT KwUw ALIGNMENT_BYTE 1 ALIGNMENT_WORD 2 ALIGNMENT_LONG 4 ALIGNMENT_FLOAT32_IEEE 4 ALIGNMENT_FLOAT64_IEEE 4 FNC_VALUES 1 UWORD COLUMN_DIR DIRECT /end RECORD_LAYOUT
/end MODULE
/end PROJECT
