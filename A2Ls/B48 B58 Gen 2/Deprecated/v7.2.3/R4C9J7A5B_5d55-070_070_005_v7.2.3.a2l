/*
The MG Flasher Team
2/18/2025 Migrated from v7.2.2
Created with optimization mode
*/
ASAP2_VERSION 1 60
/begin PROJECT MG1CS201_BX8TUE_R4C2J7A5B "MG1CS201"
/begin HEADER "" VERSION "R4C2J7A5B" PROJECT_NO MG1CS201_BX8TUE_R4C2J7A5B /end HEADER
/begin MODULE DIM ""
/begin MOD_PAR "MG1CS201" VERSION "R4C2J7A5B" CUSTOMER_NO "11" USER "APPLICATOR" ECU "MG1CS201" CPU_TYPE "IFX" EPK "56/1/MG1CS201/11/MG1CS201_BX8TUE_R4C2J7A5B//R4C2J7A5B///" ADDR_EPK 0x8075E7E9
 /begin MEMORY_SEGMENT Pst80000000 "" RESERVED FLASH INTERN 0x80000000 0x20 -1 -1 -1 -1 -1 /end MEMORY_SEGMENT
 /begin MEMORY_SEGMENT Pst80000020 "" RESERVED FLASH INTERN 0x80000020 0xBFE0 -1 -1 -1 -1 -1 /end MEMORY_SEGMENT
 /begin MEMORY_SEGMENT Pst80010000 "" RESERVED FLASH INTERN 0x80010000 0x8000 -1 -1 -1 -1 -1 /end MEMORY_SEGMENT
 /begin MEMORY_SEGMENT Pst80080000 "" CODE FLASH INTERN 0x80080000 0x67F7E0 -1 -1 -1 -1 -1
  /begin IF_DATA ETK_XETK
   /begin ETK_XETK_ACCESS SERIAL_INTERFACE /end ETK_XETK_ACCESS
  /end IF_DATA
  /begin IF_DATA XCPplus 0x0102
   /begin SEGMENT 0x0 0x1 0x0 0x0 0x0 /begin CHECKSUM XCP_CRC_32 /end CHECKSUM
    /begin PAGE 0x0 ECU_ACCESS_WITH_XCP_ONLY XCP_READ_ACCESS_WITH_ECU_ONLY XCP_WRITE_ACCESS_NOT_ALLOWED /end PAGE
   /end SEGMENT
  /end IF_DATA
 /end MEMORY_SEGMENT
 /begin MEMORY_SEGMENT Pst806FF7E0 "" RESERVED FLASH INTERN 0x806FF7E0 0x520 -1 -1 -1 -1 -1 /end MEMORY_SEGMENT
 /begin MEMORY_SEGMENT Pst807FF7E0 "" RESERVED FLASH INTERN 0x807FF7E0 0x520 -1 -1 -1 -1 -1
  /begin IF_DATA ETK_XETK WRITE_AT_DATA_UPDATE USE_FILE ETK_XETK_REF 1 2 3 4 /end IF_DATA
 /end MEMORY_SEGMENT
 /begin MEMORY_SEGMENT Pst80028000 "" CODE FLASH INTERN 0x80028000 0x37D00 -1 -1 -1 -1 -1
  /begin IF_DATA ETK_XETK
   /begin ETK_XETK_ACCESS SERIAL_INTERFACE /end ETK_XETK_ACCESS
  /end IF_DATA
  /begin IF_DATA XCPplus 0x0102
   /begin SEGMENT 0x2 0x1 0x0 0x0 0x0 /begin CHECKSUM XCP_CRC_32 /end CHECKSUM
    /begin PAGE 0x0 ECU_ACCESS_WITH_XCP_ONLY XCP_READ_ACCESS_WITH_ECU_ONLY XCP_WRITE_ACCESS_NOT_ALLOWED /end PAGE
   /end SEGMENT
  /end IF_DATA
 /end MEMORY_SEGMENT
 /begin MEMORY_SEGMENT Pst80018100 "" RESERVED FLASH INTERN 0x80018100 0x3F00 -1 -1 -1 -1 -1 /end MEMORY_SEGMENT
 /begin MEMORY_SEGMENT Pst80060100 "" RESERVED FLASH INTERN 0x80060100 0x1FF00 -1 -1 -1 -1 -1 /end MEMORY_SEGMENT
 /begin MEMORY_SEGMENT Pst80018000 "" RESERVED FLASH INTERN 0x80018000 0x100 -1 -1 -1 -1 -1 /end MEMORY_SEGMENT
 /begin MEMORY_SEGMENT Pst80060000 "" RESERVED FLASH INTERN 0x80060000 0x100 -1 -1 -1 -1 -1 /end MEMORY_SEGMENT
 /begin MEMORY_SEGMENT Pst80020000 "" RESERVED FLASH INTERN 0x80020000 0x300 -1 -1 -1 -1 -1 /end MEMORY_SEGMENT
 /begin MEMORY_SEGMENT Pst8005FD00 "" RESERVED FLASH INTERN 0x8005FD00 0x300 -1 -1 -1 -1 -1 /end MEMORY_SEGMENT
 /begin MEMORY_SEGMENT Pst806FFD00 "" RESERVED FLASH INTERN 0x806FFD00 0x300 -1 -1 -1 -1 -1 /end MEMORY_SEGMENT
 /begin MEMORY_SEGMENT Pst807FFD08 "" RESERVED FLASH INTERN 0x807FFD08 0x104 -1 -1 -1 -1 -1 /end MEMORY_SEGMENT
 /begin MEMORY_SEGMENT Pst807FFFDC "" RESERVED FLASH INTERN 0x807FFFDC 0x24 -1 -1 -1 -1 -1 /end MEMORY_SEGMENT
 /begin MEMORY_SEGMENT Dst80700000 "" DATA FLASH INTERN 0x80700000 0xFF7E0 -1 -1 -1 -1 -1
  /begin IF_DATA ETK_XETK
   /begin ETK_XETK_ACCESS SERIAL_INTERFACE /end ETK_XETK_ACCESS
  /end IF_DATA
  /begin IF_DATA XCPplus 0x0102
   /begin SEGMENT 0x1 0x2 0x0 0x0 0x0 /begin CHECKSUM XCP_CRC_32 /end CHECKSUM
    /begin PAGE 0x0 ECU_ACCESS_DONT_CARE XCP_READ_ACCESS_DONT_CARE XCP_WRITE_ACCESS_NOT_ALLOWED /end PAGE
    /begin PAGE 0x1 ECU_ACCESS_DONT_CARE XCP_READ_ACCESS_DONT_CARE XCP_WRITE_ACCESS_WITH_ECU_ONLY /end PAGE
   /end SEGMENT
  /end IF_DATA
 /end MEMORY_SEGMENT
 /begin MEMORY_SEGMENT Dst807FFD00 "" DATA FLASH INTERN 0x807FFD00 0x8 -1 -1 -1 -1 -1
  /begin IF_DATA ETK_XETK
   /begin ETK_XETK_ACCESS SERIAL_INTERFACE /end ETK_XETK_ACCESS
  /end IF_DATA
  /begin IF_DATA XCPplus 0x0102
   /begin SEGMENT 0x3 0x2 0x0 0x0 0x0 /begin CHECKSUM XCP_CRC_32 /end CHECKSUM
    /begin PAGE 0x0 ECU_ACCESS_DONT_CARE XCP_READ_ACCESS_DONT_CARE XCP_WRITE_ACCESS_NOT_ALLOWED /end PAGE
    /begin PAGE 0x1 ECU_ACCESS_DONT_CARE XCP_READ_ACCESS_DONT_CARE XCP_WRITE_ACCESS_WITH_ECU_ONLY /end PAGE
   /end SEGMENT
  /end IF_DATA
 /end MEMORY_SEGMENT
 /begin MEMORY_SEGMENT Dst807FFE0C "" DATA FLASH INTERN 0x807FFE0C 0x1D0 -1 -1 -1 -1 -1
  /begin IF_DATA ETK_XETK
   /begin ETK_XETK_ACCESS SERIAL_INTERFACE /end ETK_XETK_ACCESS
  /end IF_DATA
  /begin IF_DATA XCPplus 0x0102
   /begin SEGMENT 0x4 0x2 0x0 0x0 0x0 /begin CHECKSUM XCP_CRC_32 /end CHECKSUM
    /begin PAGE 0x0 ECU_ACCESS_DONT_CARE XCP_READ_ACCESS_DONT_CARE XCP_WRITE_ACCESS_NOT_ALLOWED /end PAGE
    /begin PAGE 0x1 ECU_ACCESS_DONT_CARE XCP_READ_ACCESS_DONT_CARE XCP_WRITE_ACCESS_WITH_ECU_ONLY /end PAGE
   /end SEGMENT
  /end IF_DATA
 /end MEMORY_SEGMENT
 /begin MEMORY_SEGMENT RamAFE70000 "" VARIABLES RAM INTERN 0xAFE70000 0x8000 -1 -1 -1 -1 -1
  /begin IF_DATA ETK_XETK
   /begin ETK_XETK_ACCESS SERIAL_INTERFACE /end ETK_XETK_ACCESS
  /end IF_DATA
  /begin IF_DATA XCPplus 0x0102
   /begin SEGMENT 0x5 0x0 0x0 0x0 0x0 /end SEGMENT
  /end IF_DATA
 /end MEMORY_SEGMENT
 /begin MEMORY_SEGMENT RamB0000000 "" VARIABLES RAM INTERN 0xB0000000 0x8000 -1 -1 -1 -1 -1
  /begin IF_DATA ETK_XETK
   /begin ETK_XETK_ACCESS SERIAL_INTERFACE /end ETK_XETK_ACCESS
  /end IF_DATA
  /begin IF_DATA XCPplus 0x0102
   /begin SEGMENT 0x6 0x0 0x0 0x0 0x0 /end SEGMENT
  /end IF_DATA
 /end MEMORY_SEGMENT
 /begin MEMORY_SEGMENT Ram70100000 "" VARIABLES RAM INTERN 0x70100000 0x8000 -1 -1 -1 -1 -1
  /begin IF_DATA ETK_XETK
   /begin ETK_XETK_ACCESS SERIAL_INTERFACE /end ETK_XETK_ACCESS
  /end IF_DATA
  /begin IF_DATA XCPplus 0x0102
   /begin SEGMENT 0x7 0x0 0x0 0x0 0x0 /end SEGMENT
  /end IF_DATA
 /end MEMORY_SEGMENT
 /begin MEMORY_SEGMENT Ram60100000 "" VARIABLES RAM INTERN 0x60100000 0x8000 -1 -1 -1 -1 -1
  /begin IF_DATA ETK_XETK
   /begin ETK_XETK_ACCESS SERIAL_INTERFACE /end ETK_XETK_ACCESS
  /end IF_DATA
  /begin IF_DATA XCPplus 0x0102
   /begin SEGMENT 0x8 0x0 0x0 0x0 0x0 /end SEGMENT
  /end IF_DATA
 /end MEMORY_SEGMENT
 /begin MEMORY_SEGMENT Ram50100000 "" VARIABLES RAM INTERN 0x50100000 0x8000 -1 -1 -1 -1 -1
  /begin IF_DATA ETK_XETK
   /begin ETK_XETK_ACCESS SERIAL_INTERFACE /end ETK_XETK_ACCESS
  /end IF_DATA
  /begin IF_DATA XCPplus 0x0102
   /begin SEGMENT 0x9 0x0 0x0 0x0 0x0 /end SEGMENT
  /end IF_DATA
 /end MEMORY_SEGMENT
 /begin MEMORY_SEGMENT Ram70000000 "" VARIABLES RAM INTERN 0x70000000 0x1E000 -1 -1 -1 -1 -1
  /begin IF_DATA ETK_XETK
   /begin ETK_XETK_ACCESS SERIAL_INTERFACE /end ETK_XETK_ACCESS
  /end IF_DATA
  /begin IF_DATA XCPplus 0x0102
   /begin SEGMENT 0xA 0x0 0x0 0x0 0x0 /end SEGMENT
  /end IF_DATA
 /end MEMORY_SEGMENT
 /begin MEMORY_SEGMENT Ram60000000 "" VARIABLES RAM INTERN 0x60000000 0x3C000 -1 -1 -1 -1 -1
  /begin IF_DATA ETK_XETK
   /begin ETK_XETK_ACCESS SERIAL_INTERFACE /end ETK_XETK_ACCESS
  /end IF_DATA
  /begin IF_DATA XCPplus 0x0102
   /begin SEGMENT 0xB 0x0 0x0 0x0 0x0 /end SEGMENT
  /end IF_DATA
 /end MEMORY_SEGMENT
 /begin MEMORY_SEGMENT Ram50000000 "" VARIABLES RAM INTERN 0x50000000 0x3C000 -1 -1 -1 -1 -1
  /begin IF_DATA ETK_XETK
   /begin ETK_XETK_ACCESS SERIAL_INTERFACE /end ETK_XETK_ACCESS
  /end IF_DATA
  /begin IF_DATA XCPplus 0x0102
   /begin SEGMENT 0xC 0x0 0x0 0x0 0x0 /end SEGMENT
  /end IF_DATA
 /end MEMORY_SEGMENT
 /begin MEMORY_SEGMENT RamBF1F0E70 "" VARIABLES RAM INTERN 0xBF1F0E70 0xF190 -1 -1 -1 -1 -1
  /begin IF_DATA ETK_XETK
   /begin ETK_XETK_ACCESS SERIAL_INTERFACE /end ETK_XETK_ACCESS
  /end IF_DATA
  /begin IF_DATA XCPplus 0x0102
   /begin SEGMENT 0xD 0x0 0x0 0x0 0x0 /end SEGMENT
  /end IF_DATA
 /end MEMORY_SEGMENT
 /begin MEMORY_SEGMENT RamBF1E0000 "" CALIBRATION_VARIABLES RAM INTERN 0xBF1E0000 0x10E70 -1 -1 -1 -1 -1
  /begin IF_DATA ETK_XETK
   /begin ETK_XETK_ACCESS SERIAL_INTERFACE /end ETK_XETK_ACCESS
  /end IF_DATA
  /begin IF_DATA XCPplus 0x0102
   /begin SEGMENT 0xE 0x0 0x0 0x0 0x0 /end SEGMENT
  /end IF_DATA
 /end MEMORY_SEGMENT
/end MOD_PAR
/begin MOD_COMMON "" BYTE_ORDER MSB_LAST DEPOSIT ABSOLUTE ALIGNMENT_BYTE 1 ALIGNMENT_WORD 2 ALIGNMENT_LONG 4 ALIGNMENT_FLOAT32_IEEE 4 ALIGNMENT_FLOAT64_IEEE 4 /end MOD_COMMON
/begin AXIS_PTS Antilag_BMWtchctr_p_DifCrtnPp_Ax___MGF_CC_PF "AXX_KF_PDIFF_ATLR_P" 0x8072466E BMWtchbas_p_Dif_sw _REC_A1AXS_1_MBSE_S2 8191.875 BMW_p_sw_q0p125_hPa 12 -4096 4095.875 FORMAT "%10.3" DEPOSIT ABSOLUTE /end AXIS_PTS
/begin AXIS_PTS Antilag_BMWtchctr_p_DifCrtnPp_Ay___MGF_CC_PF "AXY_KF_PDIFF_ATLR_P" 0x807C0002 BMWtchsp_mf_Ex_uw _REC_A1AXS_1_MBSE_U2 2047.96875 CByjozc_eCmpBAb_pljBAmd_k__0oa0 6 0 2047.96875 FORMAT "%10.3" DEPOSIT ABSOLUTE /end AXIS_PTS
/begin AXIS_PTS Antilag_BMWtchctr_p_DifCrtnPpDyn_Ax___MGF_CC_PF "AXX_KF_PDIFF_ATLR_P" 0x80724692 BMWtchbas_p_Dif_sw _REC_A1AXS_1_MBSE_S2 8191.875 BMW_p_sw_q0p125_hPa 12 -4096 4095.875 FORMAT "%10.3" DEPOSIT ABSOLUTE /end AXIS_PTS
/begin AXIS_PTS Antilag_BMWtchctr_p_DifCrtnPpDyn_Ay___MGF_CC_PF "AXY_KF_PDIFF_ATLR_P" 0x807C009E BMWtchsp_mf_Ex_uw _REC_A1AXS_1_MBSE_U2 2047.96875 CByjozc_eCmpBAb_pljBAmd_k__0oa0 6 0 2047.96875 FORMAT "%10.3" DEPOSIT ABSOLUTE /end AXIS_PTS
/begin AXIS_PTS Antilag_BMWtchctr_pwr_Pctl_Ax___MGF_CC_PF "AXX_KF_ATL_PVERD" 0x807C02C2 BMWtchsp_rat_p_CmprLim_uw _REC_A1AXS_1_MBSE_U2 7.9998779296875 acriqBc_tfkBqod_ocgjxzc_nR_8oa0 20 0 7.9998779296875 FORMAT "%11.4" DEPOSIT ABSOLUTE /end AXIS_PTS
/begin AXIS_PTS Antilag_BMWtchctr_pwr_Pctl_Ay___MGF_CC_PF "AXY_KF_ATL_PVERD" 0x807C02EA BMWtchsp_mf_CmprNorm_uw _REC_A1AXS_1_MBSE_U2 2047.96875 CByjozc_eCmpBAb_pljBAmd_k__0oa0 16 0 2047.96875 FORMAT "%10.3" DEPOSIT ABSOLUTE /end AXIS_PTS
/begin AXIS_PTS Antilag_BMWtqe_gra_NMaxEngLimd_Ax___MGF_CC_PF "Torque Engine(Moment Verbrennungsmotor) gradient(Steigung) Speed in rpm( Drezahl ) maximum(Maximum, Max) engine(Verbrennungsmotor) limited(begrenzt) axis x direction(X-Achse)" 0x8075554B BMWtqe_idx_SpdMaxLimr_ub _REC_A1AXS_1_MBSE_U1 255 raChrxc_kBtBrmb_FmDuEFa_n__aa0o 10 0 255 FORMAT "%3.0" DEPOSIT ABSOLUTE /end AXIS_PTS
/begin AXIS_PTS Antilag_IgnRoll_X_Axis___MGF_CC_PF "Ignition setpoint: Engine speed [Nkw] vs Boost actual [Ps]" 0x807C08E8 Nkw ___MGF_CC_Antilag_Ign_Roll_xAxis 0 caoddzd_oAjpfzb_cAcEEha_1nR_oa0 10 0 15000 /end AXIS_PTS
/begin AXIS_PTS Antilag_IgnRoll_Y_Axis___MGF_CC_PF "Ignition setpoint: Engine speed [Nkw] vs Boost actual [Ps]" 0x807C09C8 Ps ___MGF_CC_Antilag_Ign_Roll_xAxis 0 BMW_p_sw_q0p125_hPa 10 -3000 3000 /end AXIS_PTS
/begin AXIS_PTS Antilag_IgnStand_X_Axis___MGF_CC_PF "Ignition setpoint: Engine speed [Nkw] vs Boost actual [Ps]" 0x807C08FC Nkw ___MGF_CC_Antilag_Ign_Roll_xAxis 0 caoddzd_oAjpfzb_cAcEEha_1nR_oa0 10 0 15000 /end AXIS_PTS
/begin AXIS_PTS Antilag_IgnStand_Y_Axis___MGF_CC_PF "Ignition setpoint: Engine speed [Nkw] vs Boost actual [Ps]" 0x807C09DC Ps ___MGF_CC_Antilag_Ign_Roll_xAxis 0 BMW_p_sw_q0p125_hPa 10 -3000 3000 /end AXIS_PTS
/begin AXIS_PTS Antilag_LambdaRoll_X_Axis___MGF_CC_PF "Fueling setpoint: Engine speed [Nkw] vs Exhaust Gas Temperature [EGT] before turbine [Tabg_vl_xab]" 0x807C0910 Nkw ___MGF_CC_Antilag_Ign_Roll_xAxis 0 caoddzd_oAjpfzb_cAcEEha_1nR_oa0 10 0 15000 /end AXIS_PTS
/begin AXIS_PTS Antilag_LambdaRoll_Y_Axis___MGF_CC_PF "Fueling setpoint: Engine speed [Nkw] vs Exhaust Gas Temperature [EGT] before turbine [Tabg_vl_xab]" 0x807C09F0 Tabg_vl_xab ___MGF_CC_Antilag_Ign_Roll_xAxis 0 BMW_q0p1_degC 10 -3000 3000 /end AXIS_PTS
/begin AXIS_PTS Antilag_LambdaStand_X_Axis___MGF_CC_PF "Fueling setpoint: Engine speed [Nkw] vs Exhaust Gas Temperature [EGT] before turbine [Tabg_vl_xab]" 0x807C0924 Nkw ___MGF_CC_Antilag_Ign_Roll_xAxis 0 caoddzd_oAjpfzb_cAcEEha_1nR_oa0 10 0 15000 /end AXIS_PTS
/begin AXIS_PTS Antilag_LambdaStand_Y_Axis___MGF_CC_PF "Fueling setpoint: Engine speed [Nkw] vs Exhaust Gas Temperature [EGT] before turbine [Tabg_vl_xab]" 0x807C0A04 Tabg_vl_xab ___MGF_CC_Antilag_Ign_Roll_xAxis 0 BMW_q0p1_degC 10 -3000 3000 /end AXIS_PTS
/begin AXIS_PTS AXX_KF_BSLGF "AXX_KF_BSLGF" 0x807178DA Nkw_atm _REC_A1AXS_1_MBSE_S2 65535 caoddzd_oAjpfzb_cAcEEha_1nR_oa0 4 -32768 32767 DEPOSIT ABSOLUTE /end AXIS_PTS
/begin AXIS_PTS AXX_KF_DLAMBSVST_TABG "AXX_KF_DLAMBSVST_TABG" 0x80717BA4 Nkw_atm _REC_A1AXS_1_MBSE_S2 65535 caoddzd_oAjpfzb_cAcEEha_1nR_oa0 8 -32768 32767 DEPOSIT ABSOLUTE /end AXIS_PTS
/begin AXIS_PTS AXX_KF_DPLDS_PRED "Nkw" 0x80741948 Nkw _REC_A1AXS_1_MBSE_S2 32767 caoddzd_oAjpfzb_cAcEEha_1nR_oa0 6 0 32767 FORMAT "%5.0" DEPOSIT ABSOLUTE /end AXIS_PTS
/begin AXIS_PTS AXX_KF_DPLDSOLL_SPORT "Nkw" 0x8072098E NO_INPUT_QUANTITY _REC_A1AXS_1_MBSE_S2 32767 caoddzd_oAjpfzb_cAcEEha_1nR_oa0 6 0 32767 FORMAT "%5.0" DEPOSIT ABSOLUTE /end AXIS_PTS
/begin AXIS_PTS AXX_KF_DZW_DYN "AXX_KF_DZW_DYN" 0x807341A0 Nkw _REC_A1AXS_1_MBSE_S2 65535 caoddzd_oAjpfzb_cAcEEha_1nR_oa0 4 -32768 32767 FORMAT "%5.0" DEPOSIT ABSOLUTE /end AXIS_PTS
/begin AXIS_PTS AXX_KF_DZWMIN_NORMAL_SOT "AXX_KF_DZWMIN_NORMAL_SOT" 0x80734C64 Nkw _REC_A1AXS_1_MBSE_S2 65535 caoddzd_oAjpfzb_cAcEEha_1nR_oa0 6 -32768 32767 FORMAT "%5.0" DEPOSIT ABSOLUTE /end AXIS_PTS
/begin AXIS_PTS AXX_KF_DZWMIN_SPORT_SOT "AXX_KF_DZWMIN_SPORT_SOT" 0x80734C48 Nkw _REC_A1AXS_1_MBSE_S2 65535 caoddzd_oAjpfzb_cAcEEha_1nR_oa0 6 -32768 32767 FORMAT "%5.0" DEPOSIT ABSOLUTE /end AXIS_PTS
/begin AXIS_PTS AXX_KF_DZWT_PF1 "AXX_KF_DZWT_PF1" 0x807345CC Nkw _REC_A1AXS_1_MBSE_S2 65535 caoddzd_oAjpfzb_cAcEEha_1nR_oa0 20 -32768 32767 FORMAT "%5.0" DEPOSIT ABSOLUTE /end AXIS_PTS
/begin AXIS_PTS AXX_KF_DZWT_PF2 "AXX_KF_DZWT_PF2" 0x807345A4 Nkw _REC_A1AXS_1_MBSE_S2 65535 caoddzd_oAjpfzb_cAcEEha_1nR_oa0 20 -32768 32767 FORMAT "%5.0" DEPOSIT ABSOLUTE /end AXIS_PTS
/begin AXIS_PTS AXX_KF_DZWT_UESP_PF1 "AXX_KF_DZWT_UESP_PF1" 0x80734590 Nkw _REC_A1AXS_1_MBSE_S2 65535 caoddzd_oAjpfzb_cAcEEha_1nR_oa0 10 -32768 32767 FORMAT "%5.0" DEPOSIT ABSOLUTE /end AXIS_PTS
/begin AXIS_PTS AXX_KF_DZWT_UESP_PF2 "AXX_KF_DZWT_UESP_PF2" 0x8073457C Nkw _REC_A1AXS_1_MBSE_S2 65535 caoddzd_oAjpfzb_cAcEEha_1nR_oa0 10 -32768 32767 FORMAT "%5.0" DEPOSIT ABSOLUTE /end AXIS_PTS
/begin AXIS_PTS AXX_KF_EDA_ANZ_SPORT_MD_EM1_IST "KF_EDA_ANZ_SPORT_MD_EM1_IST" 0x8070C7CE NO_INPUT_QUANTITY _REC_A1AXS_1_MBSE_S2 6553.5 BMW_dm_sw_q0p1_Nm 6 -3276.8 3276.7 FORMAT "%7.2" DEPOSIT ABSOLUTE /end AXIS_PTS
/begin AXIS_PTS AXX_KF_FDZW_DYN1 "AXX_KF_FDZW_DYN1" 0x80747682 Tans _REC_A1AXS_1_MBSE_S2 6553.5 BMW_q0p1_degC 4 -3276.8 3276.7 FORMAT "%6.1" DEPOSIT ABSOLUTE /end AXIS_PTS
/begin AXIS_PTS AXX_KF_FDZW_DYN2 "AXX_KF_FDZW_DYN2" 0x8075CBAA Gangi _REC_A1AXS_1_MBSE_U1 255 raChrxc_kBtBrmb_FmDuEFa_n__aa0o 10 0 255 FORMAT "%3.0" DEPOSIT ABSOLUTE /end AXIS_PTS
/begin AXIS_PTS AXX_KF_FDZW_DYN3 "AXX_KF_FDZW_DYN3" 0x8074767A Tans _REC_A1AXS_1_MBSE_S2 6553.5 BMW_q0p1_degC 4 -3276.8 3276.7 FORMAT "%6.1" DEPOSIT ABSOLUTE /end AXIS_PTS
/begin AXIS_PTS AXX_KF_FDZW_DYN4 "AXX_KF_FDZW_DYN4" 0x8075CBA0 Gangi _REC_A1AXS_1_MBSE_U1 255 raChrxc_kBtBrmb_FmDuEFa_n__aa0o 10 0 255 FORMAT "%3.0" DEPOSIT ABSOLUTE /end AXIS_PTS
/begin AXIS_PTS AXX_KF_FDZWT_BEST_PF1 "Factor temperature correction ZW-Best path 1" 0x80733F94 Tmot _REC_A1AXS_1_MBSE_S2 655.35 DchEpAd_DBCFgoa_Ckhahgc_q__aoa0 6 -327.68 327.67 FORMAT "%7.2" DEPOSIT ABSOLUTE /end AXIS_PTS
/begin AXIS_PTS AXX_KF_FDZWT_BEST_PF2 "Factor temperature correction ZW-Best path 2" 0x80733F88 Tmot _REC_A1AXS_1_MBSE_S2 655.35 DchEpAd_DBCFgoa_Ckhahgc_q__aoa0 6 -327.68 327.67 FORMAT "%7.2" DEPOSIT ABSOLUTE /end AXIS_PTS
/begin AXIS_PTS AXX_KF_FDZWT_PF1 "AXX_KF_FDZWT_PF1" 0x80734054 Tmot _REC_A1AXS_1_MBSE_S2 655.35 DchEpAd_DBCFgoa_Ckhahgc_q__aoa0 6 -327.68 327.67 FORMAT "%7.2" DEPOSIT ABSOLUTE /end AXIS_PTS
/begin AXIS_PTS AXX_KF_FDZWT_PF2 "AXX_KF_FDZWT_PF2" 0x80734048 Tmot _REC_A1AXS_1_MBSE_S2 655.35 DchEpAd_DBCFgoa_Ckhahgc_q__aoa0 6 -327.68 327.67 FORMAT "%7.2" DEPOSIT ABSOLUTE /end AXIS_PTS
/begin AXIS_PTS AXX_KF_FRKKORRF_1 "AXX_KF_FRKKORRF_1" 0x80713AE6 Nkw _REC_A1AXS_1_MBSE_S2 65535 caoddzd_oAjpfzb_cAcEEha_1nR_oa0 16 -32768 32767 FORMAT "%5.0" DEPOSIT ABSOLUTE /end AXIS_PTS
/begin AXIS_PTS AXX_KF_KOEFF_B_LA "AXX_KF_KOEFF_B_LA" 0x807343AC Nkw _REC_A1AXS_1_MBSE_S2 65535 caoddzd_oAjpfzb_cAcEEha_1nR_oa0 6 -32768 32767 FORMAT "%5.0" DEPOSIT ABSOLUTE /end AXIS_PTS
/begin AXIS_PTS AXX_KF_LA_BEZ "AXX_KF_LA_BEZ" 0x807343A0 Nkw _REC_A1AXS_1_MBSE_S2 65535 caoddzd_oAjpfzb_cAcEEha_1nR_oa0 6 -32768 32767 FORMAT "%5.0" DEPOSIT ABSOLUTE /end AXIS_PTS
/begin AXIS_PTS AXX_KF_LAMIN_H "AXX_KF_LAMIN_H" 0x8071C12E Nkw _REC_A1AXS_1_MBSE_S2 65535 caoddzd_oAjpfzb_cAcEEha_1nR_oa0 6 -32768 32767 FORMAT "%5.0" DEPOSIT ABSOLUTE /end AXIS_PTS
/begin AXIS_PTS AXX_KF_MD_RES_NST_KEY "AXX_KF_MD_RES_NST_KEY" 0x8072E046 Tn_start_10 _REC_A1AXS_1_MBSE_U2 655.35 camcxxd_bxlpdsa_Cshlhgc_sR_1a0o 4 0 655.35 FORMAT "%7.2" DEPOSIT ABSOLUTE /end AXIS_PTS
/begin AXIS_PTS AXX_KF_MDIOP_1_TQE "Filling / Filling Rf" 0x8072A340 NO_INPUT_QUANTITY _REC_A1AXS_1_MBSE_S2 655.35 CgkBooc_wkiDfEd_Czglhgc_fR_1a0o 18 -327.68 327.67 FORMAT "%6.2" DEPOSIT ABSOLUTE /end AXIS_PTS
/begin AXIS_PTS AXX_KF_MDK_MAX_GANG_NKW "x-axis (Gang_gb1_ist) for KF_MDK_MAX_GANG_NKW" 0x8075918C Gang_gb1_ist _REC_A1AXS_1_MBSE_S1 255 raChrxc_kBtBrmb_FmDuEFa_n__aa0o 10 -128 127 FORMAT "%6.0" DEPOSIT ABSOLUTE /end AXIS_PTS
/begin AXIS_PTS AXX_KF_NEWP_LLK_TANS "AXX_KF_NEWP_LLK_TANS" 0x80747232 Dtans_tumg_wm _REC_A1AXS_1_MBSE_S2 6553.5 BMW_q0p1_degC 6 -3276.8 3276.7 DEPOSIT ABSOLUTE /end AXIS_PTS
/begin AXIS_PTS AXX_KF_PHA_H_E1 "AXX_KF_PHA_H_E1" 0x80716DA2 Nkw _REC_A1AXS_1_MBSE_S2 65535 caoddzd_oAjpfzb_cAcEEha_1nR_oa0 8 -32768 32767 FORMAT "%5.0" DEPOSIT ABSOLUTE /end AXIS_PTS
/begin AXIS_PTS AXX_KF_PRAIL_H "AXX_KF_PRAIL_H" 0x80722F20 Nkw _REC_A1AXS_1_MBSE_S2 65535 caoddzd_oAjpfzb_cAcEEha_1nR_oa0 8 -32768 32767 FORMAT "%5.0" DEPOSIT ABSOLUTE /end AXIS_PTS
/begin AXIS_PTS AXX_KF_PRAIL_H_K "AXX_KF_PRAIL_H_K" 0x80722EE0 Nkw _REC_A1AXS_1_MBSE_S2 65535 caoddzd_oAjpfzb_cAcEEha_1nR_oa0 8 -32768 32767 FORMAT "%5.0" DEPOSIT ABSOLUTE /end AXIS_PTS
/begin AXIS_PTS AXX_KF_PRAIL_HGD "axis" 0x80722F00 Nkw _REC_A1AXS_1_MBSE_S2 65535 caoddzd_oAjpfzb_cAcEEha_1nR_oa0 8 -32768 32767 FORMAT "%5.0" DEPOSIT ABSOLUTE /end AXIS_PTS
/begin AXIS_PTS AXX_KF_PRAIL_HGD_K "axis" 0x80722EF0 Nkw _REC_A1AXS_1_MBSE_S2 65535 caoddzd_oAjpfzb_cAcEEha_1nR_oa0 8 -32768 32767 FORMAT "%5.0" DEPOSIT ABSOLUTE /end AXIS_PTS
/begin AXIS_PTS AXX_KF_ST_RKBAS_GD "AXX_KF_ST_RKBAS_GD" 0x8074A408 Nkw _REC_A1AXS_1_MBSE_S2 65535 caoddzd_oAjpfzb_cAcEEha_1nR_oa0 10 -32768 32767 FORMAT "%5.0" DEPOSIT ABSOLUTE /end AXIS_PTS
/begin AXIS_PTS AXX_KF_ST_RKBAS_VVT "AXX_KF_ST_RKBAS_VVT" 0x8074A27E Nkw _REC_A1AXS_1_MBSE_S2 65535 caoddzd_oAjpfzb_cAcEEha_1nR_oa0 12 -32768 32767 FORMAT "%5.0" DEPOSIT ABSOLUTE /end AXIS_PTS
/begin AXIS_PTS AXX_KF_TA_ATLSOLL "AXX_KF_TA_ATLSOLL" 0x80717B8C Nkw_atm _REC_A1AXS_1_MBSE_S2 65535 caoddzd_oAjpfzb_cAcEEha_1nR_oa0 4 -32768 32767 DEPOSIT ABSOLUTE /end AXIS_PTS
/begin AXIS_PTS AXX_KF_TA_IKSOLL "AXX_KF_TA_IKSOLL" 0x80717B84 Nkw_atm _REC_A1AXS_1_MBSE_S2 65535 caoddzd_oAjpfzb_cAcEEha_1nR_oa0 4 -32768 32767 DEPOSIT ABSOLUTE /end AXIS_PTS
/begin AXIS_PTS AXX_KF_TA_VKSOLL "AXX_KF_TA_VKSOLL" 0x80717B7C Nkw_atm _REC_A1AXS_1_MBSE_S2 65535 caoddzd_oAjpfzb_cAcEEha_1nR_oa0 4 -32768 32767 DEPOSIT ABSOLUTE /end AXIS_PTS
/begin AXIS_PTS AXX_KF_TD_FETTDELAY_TABG "AXX_KF_TD_FETTDELAY_TABG" 0x8074940E Tw_r1 _REC_A1AXS_1_MBSE_S2 6553.5 BMW_q0p1_degC 6 -3276.8 3276.7 FORMAT "%6.1" DEPOSIT ABSOLUTE /end AXIS_PTS
/begin AXIS_PTS AXX_KF_ZW_PF1 "AXX_KF_ZW_PF1" 0x80733E8C Nkw _REC_A1AXS_1_MBSE_S2 65535 caoddzd_oAjpfzb_cAcEEha_1nR_oa0 20 -32768 32767 FORMAT "%5.0" DEPOSIT ABSOLUTE /end AXIS_PTS
/begin AXIS_PTS AXX_KF_ZW_PF2 "AXX_KF_ZW_PF2" 0x80733E64 Nkw _REC_A1AXS_1_MBSE_S2 65535 caoddzd_oAjpfzb_cAcEEha_1nR_oa0 20 -32768 32767 FORMAT "%5.0" DEPOSIT ABSOLUTE /end AXIS_PTS
/begin AXIS_PTS AXX_KF_ZW_S_PF1 "AXX_KF_ZW_S_PF1" 0x80733E3C Nkw _REC_A1AXS_1_MBSE_S2 65535 caoddzd_oAjpfzb_cAcEEha_1nR_oa0 20 -32768 32767 FORMAT "%5.0" DEPOSIT ABSOLUTE /end AXIS_PTS
/begin AXIS_PTS AXX_KF_ZW_S_PF2 "AXX_KF_ZW_S_PF2" 0x80733E14 Nkw _REC_A1AXS_1_MBSE_S2 65535 caoddzd_oAjpfzb_cAcEEha_1nR_oa0 20 -32768 32767 FORMAT "%5.0" DEPOSIT ABSOLUTE /end AXIS_PTS
/begin AXIS_PTS AXX_KF_ZW_UESP_PF1 "AXX_KF_ZW_UESP_PF1" 0x80733E00 Nkw _REC_A1AXS_1_MBSE_S2 65535 caoddzd_oAjpfzb_cAcEEha_1nR_oa0 10 -32768 32767 FORMAT "%5.0" DEPOSIT ABSOLUTE /end AXIS_PTS
/begin AXIS_PTS AXX_KF_ZW_UESP_PF2 "AXX_KF_ZW_UESP_PF2" 0x80733DEC Nkw _REC_A1AXS_1_MBSE_S2 65535 caoddzd_oAjpfzb_cAcEEha_1nR_oa0 10 -32768 32767 FORMAT "%5.0" DEPOSIT ABSOLUTE /end AXIS_PTS
/begin AXIS_PTS AXX_KF_ZW_VP_PF1 "AXX_KF_ZW_VP_PF1" 0x807472D2 Nkw _REC_A1AXS_1_MBSE_S2 65535 caoddzd_oAjpfzb_cAcEEha_1nR_oa0 20 -32768 32767 FORMAT "%5.0" DEPOSIT ABSOLUTE /end AXIS_PTS
/begin AXIS_PTS AXX_KF_ZW_VP_PF2 "AXX_KF_ZW_VP_PF2" 0x807472AA Nkw _REC_A1AXS_1_MBSE_S2 65535 caoddzd_oAjpfzb_cAcEEha_1nR_oa0 20 -32768 32767 FORMAT "%5.0" DEPOSIT ABSOLUTE /end AXIS_PTS
/begin AXIS_PTS AXX_KF_ZWMIN_KSOT "AXX_KF_ZWMIN_KSOT" 0x80734C38 Nkw _REC_A1AXS_1_MBSE_S2 65535 caoddzd_oAjpfzb_cAcEEha_1nR_oa0 8 -32768 32767 FORMAT "%5.0" DEPOSIT ABSOLUTE /end AXIS_PTS
/begin AXIS_PTS AXX_KF_ZWMIN_WSOT "AXX_KF_ZWMIN_WSOT" 0x80734C28 Nkw _REC_A1AXS_1_MBSE_S2 65535 caoddzd_oAjpfzb_cAcEEha_1nR_oa0 8 -32768 32767 FORMAT "%5.0" DEPOSIT ABSOLUTE /end AXIS_PTS
/begin AXIS_PTS AXX_KL_FLD_KKS "AXX_KL_FLD_KKS" 0x80746B08 F_pld_wm_f _REC_A1AXS_1_MBSE_U2 7.9998779296875 acriqBc_tfkBqod_ocgjxzc_nR_8oa0 6 0 7.9998779296875 DEPOSIT ABSOLUTE /end AXIS_PTS
/begin AXIS_PTS AXX_KL_FRFMXBS "AXX_KL_FRFMXBS" 0x807178D2 NO_INPUT_QUANTITY _REC_A1AXS_1_MBSE_U2 1.99996948242188 Bhvfwhc_bigEubd_BBEupBd_nR_3oa0 4 0 1.99996948242188 FORMAT "%14.5" DEPOSIT ABSOLUTE /end AXIS_PTS
/begin AXIS_PTS AXX_KL_LA_SBL "AXX_KL_LA_SBL" 0x80749468 Nkw _REC_A1AXS_1_MBSE_S2 65535 caoddzd_oAjpfzb_cAcEEha_1nR_oa0 6 -32768 32767 FORMAT "%5.0" DEPOSIT ABSOLUTE /end AXIS_PTS
/begin AXIS_PTS AXX_KL_LAMX "Commercial vehicle * kl_taschen_aus" 0x8071E52A NO_INPUT_QUANTITY _REC_A1AXS_1_MBSE_S2 65535 caoddzd_oAjpfzb_cAcEEha_1nR_oa0 18 -32768 32767 FORMAT "%5.0" DEPOSIT ABSOLUTE /end AXIS_PTS
/begin AXIS_PTS AXX_KL_NEL_TMOT "AXX_KL_NEL_TMOT" 0x8074692E Dtmot_tkwsoll_f _REC_A1AXS_1_MBSE_S2 655.35 DchEpAd_DBCFgoa_Ckhahgc_q__aoa0 12 -327.68 327.67 FORMAT "%6.2" DEPOSIT ABSOLUTE /end AXIS_PTS
/begin AXIS_PTS AXX_KL_NKW_SOUND_MNMX "AXX_KL_NKW_SOUND_MNMX" 0x80752CB6 Gangi _REC_A1AXS_1_MBSE_U1 255 raChrxc_kBtBrmb_FmDuEFa_n__aa0o 8 0 255 FORMAT "%3.0" DEPOSIT ABSOLUTE /end AXIS_PTS
/begin AXIS_PTS AXX_KL_RF_MAX "Nkw" 0x8071E4EE NO_INPUT_QUANTITY _REC_A1AXS_1_MBSE_S2 65535 caoddzd_oAjpfzb_cAcEEha_1nR_oa0 12 -32768 32767 FORMAT "%5.0" DEPOSIT ABSOLUTE /end AXIS_PTS
/begin AXIS_PTS AXX_KL_RF_MAX_UESP "Nkw" 0x8071E4D6 NO_INPUT_QUANTITY _REC_A1AXS_1_MBSE_S2 65535 caoddzd_oAjpfzb_cAcEEha_1nR_oa0 12 -32768 32767 FORMAT "%5.0" DEPOSIT ABSOLUTE /end AXIS_PTS
/begin AXIS_PTS AXX_KL_RFMIN_KRSTSYS "x-axis for KL_RFMIN_KRSTSYS" 0x8073ABD4 Nkw _REC_A1AXS_1_MBSE_S2 65535 caoddzd_oAjpfzb_cAcEEha_1nR_oa0 8 -32768 32767 FORMAT "%5.0" DEPOSIT ABSOLUTE /end AXIS_PTS
/begin AXIS_PTS AXX_KL_RFTNLMX "Nkw" 0x8071C89E NO_INPUT_QUANTITY _REC_A1AXS_1_MBSE_S2 32767 caoddzd_oAjpfzb_cAcEEha_1nR_oa0 10 0 32767 FORMAT "%5.0" DEPOSIT ABSOLUTE /end AXIS_PTS
/begin AXIS_PTS AXX_KL_RFVHUBDYNKOR "Nkw" 0x8071C966 NO_INPUT_QUANTITY _REC_A1AXS_1_MBSE_S2 65535 caoddzd_oAjpfzb_cAcEEha_1nR_oa0 20 -32768 32767 FORMAT "%5.0" DEPOSIT ABSOLUTE /end AXIS_PTS
/begin AXIS_PTS AXX_KL_T_IKAT_SOUND_MX "AXX_KL_T_IKAT_SOUND_MX" 0x80752CB2 Anz_b_sound _REC_A1AXS_1_MBSE_U1 255 raChrxc_kBtBrmb_FmDuEFa_n__aa0o 4 0 255 FORMAT "%5.0" DEPOSIT ABSOLUTE /end AXIS_PTS
/begin AXIS_PTS AXX_KL_TD_SOUND_MX "AXX_KL_TD_SOUND_MX" 0x8072AD86 V_fzg_plaus _REC_A1AXS_1_MBSE_S2 1310.7 jgbhAma_smpAegb_hlEBAmd_k__0oa0 4 -655.36 655.34 FORMAT "%6.2" DEPOSIT ABSOLUTE /end AXIS_PTS
/begin AXIS_PTS AXX_KL_TD_SOUND_MX_FREI "AXX_KL_TD_SOUND_MX_FREE" 0x8072AD7E V_fzg_plaus _REC_A1AXS_1_MBSE_S2 1310.7 jgbhAma_smpAegb_hlEBAmd_k__0oa0 4 -655.36 655.34 FORMAT "%6.2" DEPOSIT ABSOLUTE /end AXIS_PTS
/begin AXIS_PTS AXX_KL_TD_SOUND_MX_SPORT "AXX_KL_TD_SOUND_MX_SPORT" 0x8072AD76 V_fzg_plaus _REC_A1AXS_1_MBSE_S2 1310.7 jgbhAma_smpAegb_hlEBAmd_k__0oa0 4 -655.36 655.34 FORMAT "%6.2" DEPOSIT ABSOLUTE /end AXIS_PTS
/begin AXIS_PTS AXX_KL_TKW_HI "Coolant target temperature in High operating mode depending on the ambient temperature" 0x80733CC2 Tumg_wm _REC_A1AXS_1_MBSE_S2 6553.5 BMW_q0p1_degC 4 -3276.8 3276.7 DEPOSIT ABSOLUTE /end AXIS_PTS
/begin AXIS_PTS AXX_KL_TKW_NO "AXX_KL_TKW_NO" 0x80733CBA Tumg_wm _REC_A1AXS_1_MBSE_S2 6553.5 BMW_q0p1_degC 4 -3276.8 3276.7 DEPOSIT ABSOLUTE /end AXIS_PTS
/begin AXIS_PTS AXY_KF_BSLGF "AXY_KF_BSLGF" 0x807178CA Rf_atm _REC_A1AXS_1_MBSE_S2 655.35 CgkBooc_wkiDfEd_Czglhgc_fR_1a0o 4 -327.68 327.67 DEPOSIT ABSOLUTE /end AXIS_PTS
/begin AXIS_PTS AXY_KF_DLAMBSVST_TABG "AXY_KF_DLAMBSVST_TABG" 0x80717B34 Rf_atm _REC_A1AXS_1_MBSE_S2 655.35 CgkBooc_wkiDfEd_Czglhgc_fR_1a0o 8 -327.68 327.67 DEPOSIT ABSOLUTE /end AXIS_PTS
/begin AXIS_PTS AXY_KF_DPLDS_PRED "Drf_s2spred" 0x80741934 Drf_s2spred _REC_A1AXS_1_MBSE_U2 655.35 CgkBooc_wkiDfEd_Czglhgc_fR_1a0o 6 0 655.35 DEPOSIT ABSOLUTE /end AXIS_PTS
/begin AXIS_PTS AXY_KF_DPLDSOLL_SPORT "F_psspu" 0x80720962 NO_INPUT_QUANTITY _REC_A1AXS_1_MBSE_U2 7.9998779296875 acriqBc_tfkBqod_ocgjxzc_nR_8oa0 6 0 7.9998779296875 FORMAT "%7.5" DEPOSIT ABSOLUTE /end AXIS_PTS
/begin AXIS_PTS AXY_KF_DZW_DYN "AXY_KF_DZW_MAN" 0x80734140 NO_INPUT_QUANTITY _REC_A1AXS_1_MBSE_S2 655.35 CgkBooc_wkiDfEd_Czglhgc_fR_1a0o 4 -327.68 327.67 FORMAT "%9.2" DEPOSIT ABSOLUTE /end AXIS_PTS
/begin AXIS_PTS AXY_KF_DZWMIN_NORMAL_SOT "AXY_KF_DZWMIN_NORMAL_SOT" 0x80734C20 V _REC_A1AXS_1_MBSE_U2 65535 AFeDmkb_cAbjmcc_kAkskhd_k__0oa0 4 0 65535 FORMAT "%5.0" DEPOSIT ABSOLUTE /end AXIS_PTS
/begin AXIS_PTS AXY_KF_DZWMIN_SPORT_SOT "AXY_KF_DZWMIN_SPORT_JUMP" 0x80734C08 V _REC_A1AXS_1_MBSE_U2 65535 AFeDmkb_cAbjmcc_kAkskhd_k__0oa0 4 0 65535 FORMAT "%5.0" DEPOSIT ABSOLUTE /end AXIS_PTS
/begin AXIS_PTS AXY_KF_DZWT_PF1 "AXY_KF_DZWT_PF1" 0x80734504 NO_INPUT_QUANTITY _REC_A1AXS_1_MBSE_S2 655.35 CgkBooc_wkiDfEd_Czglhgc_fR_1a0o 16 -327.68 327.67 FORMAT "%9.2" DEPOSIT ABSOLUTE /end AXIS_PTS
/begin AXIS_PTS AXY_KF_DZWT_PF2 "AXY_KF_DZWT_PF2" 0x807344E4 NO_INPUT_QUANTITY _REC_A1AXS_1_MBSE_S2 655.35 CgkBooc_wkiDfEd_Czglhgc_fR_1a0o 16 -327.68 327.67 FORMAT "%9.2" DEPOSIT ABSOLUTE /end AXIS_PTS
/begin AXIS_PTS AXY_KF_DZWT_UESP_PF1 "AXY_KF_DZWT_UESP_PF1" 0x807344CC NO_INPUT_QUANTITY _REC_A1AXS_1_MBSE_S2 655.35 CgkBooc_wkiDfEd_Czglhgc_fR_1a0o 12 -327.68 327.67 FORMAT "%9.2" DEPOSIT ABSOLUTE /end AXIS_PTS
/begin AXIS_PTS AXY_KF_DZWT_UESP_PF2 "AXY_KF_DZWT_UESP_PF2" 0x807344B4 NO_INPUT_QUANTITY _REC_A1AXS_1_MBSE_S2 655.35 CgkBooc_wkiDfEd_Czglhgc_fR_1a0o 12 -327.68 327.67 FORMAT "%9.2" DEPOSIT ABSOLUTE /end AXIS_PTS
/begin AXIS_PTS AXY_KF_EDA_ANZ_SPORT_MD_EM1_IST "KF_EDA_ANZ_SPORT_MD_EM1_IST" 0x8070C7FE NO_INPUT_QUANTITY _REC_A1AXS_1_MBSE_S2 65535 caoddzd_oAjpfzb_cAcEEha_1nR_oa0 6 -32768 32767 FORMAT "%5.0" DEPOSIT ABSOLUTE /end AXIS_PTS
/begin AXIS_PTS AXY_KF_FDZW_DYN1 "AXY_KF_FDZW_DYN1" 0x80747672 Dzw_annm _REC_A1AXS_1_MBSE_S2 110 BMW_q0p1_deg 4 -50 60 FORMAT "%6.1" DEPOSIT ABSOLUTE /end AXIS_PTS
/begin AXIS_PTS AXY_KF_FDZW_DYN2 "AXY_KF_FDZW_DYN2" 0x8074766A V _REC_A1AXS_1_MBSE_U2 360 AFeDmkb_cAbjmcc_kAkskhd_k__0oa0 4 0 360 FORMAT "%5.0" DEPOSIT ABSOLUTE /end AXIS_PTS
/begin AXIS_PTS AXY_KF_FDZW_DYN3 "AXY_KF_FDZW_DYN3" 0x80747662 Dzw_annm _REC_A1AXS_1_MBSE_S2 110 BMW_q0p1_deg 4 -50 60 FORMAT "%6.1" DEPOSIT ABSOLUTE /end AXIS_PTS
/begin AXIS_PTS AXY_KF_FDZW_DYN4 "AXY_KF_FDZW_DYN4" 0x8074765A V _REC_A1AXS_1_MBSE_U2 360 AFeDmkb_cAbjmcc_kAkskhd_k__0oa0 4 0 360 FORMAT "%5.0" DEPOSIT ABSOLUTE /end AXIS_PTS
/begin AXIS_PTS AXY_KF_FDZWT_BEST_PF1 "Factor temperature correction ZW-Best path 1" 0x80733F7C Tans _REC_A1AXS_1_MBSE_S2 6553.5 BMW_q0p1_degC 6 -3276.8 3276.7 FORMAT "%6.1" DEPOSIT ABSOLUTE /end AXIS_PTS
/begin AXIS_PTS AXY_KF_FDZWT_BEST_PF2 "Factor temperature correction ZW-Best path 2" 0x80733F70 Tans _REC_A1AXS_1_MBSE_S2 6553.5 BMW_q0p1_degC 6 -3276.8 3276.7 FORMAT "%6.1" DEPOSIT ABSOLUTE /end AXIS_PTS
/begin AXIS_PTS AXY_KF_FDZWT_PF1 "AXY_KF_FDZWT_PF1" 0x8073403C Tans _REC_A1AXS_1_MBSE_S2 6553.5 BMW_q0p1_degC 6 -3276.8 3276.7 FORMAT "%6.1" DEPOSIT ABSOLUTE /end AXIS_PTS
/begin AXIS_PTS AXY_KF_FDZWT_PF2 "AXY_KF_FDZWT_PF2" 0x80734030 Tans _REC_A1AXS_1_MBSE_S2 6553.5 BMW_q0p1_degC 6 -3276.8 3276.7 FORMAT "%6.1" DEPOSIT ABSOLUTE /end AXIS_PTS
/begin AXIS_PTS AXY_KF_FRKKORRF_1 "AXY_KF_FRKKORRF_1" 0x80713AAE Rf _REC_A1AXS_1_MBSE_S2 655.35 CgkBooc_wkiDfEd_Czglhgc_fR_1a0o 16 -327.68 327.67 FORMAT "%7.2" DEPOSIT ABSOLUTE /end AXIS_PTS
/begin AXIS_PTS AXY_KF_KOEFF_B_LA "AXY_KF_KOEFF_B_LA" 0x80734358 NO_INPUT_QUANTITY _REC_A1AXS_1_MBSE_S2 655.35 CgkBooc_wkiDfEd_Czglhgc_fR_1a0o 6 -327.68 327.67 FORMAT "%9.2" DEPOSIT ABSOLUTE /end AXIS_PTS
/begin AXIS_PTS AXY_KF_LA_BEZ "AXY_KF_LA_BEZ" 0x80734348 NO_INPUT_QUANTITY _REC_A1AXS_1_MBSE_S2 655.35 CgkBooc_wkiDfEd_Czglhgc_fR_1a0o 8 -327.68 327.67 FORMAT "%9.2" DEPOSIT ABSOLUTE /end AXIS_PTS
/begin AXIS_PTS AXY_KF_LAMIN_H "AXY_KF_LAMIN_H" 0x8071C122 Rf _REC_A1AXS_1_MBSE_S2 655.35 CgkBooc_wkiDfEd_Czglhgc_fR_1a0o 6 -327.68 327.67 FORMAT "%7.2" DEPOSIT ABSOLUTE /end AXIS_PTS
/begin AXIS_PTS AXY_KF_MD_RES_NST_KEY "AXY_KF_MD_RES_NST_KEY" 0x8072E036 Tmot _REC_A1AXS_1_MBSE_S2 655.35 DchEpAd_DBCFgoa_Ckhahgc_q__aoa0 4 -327.68 327.67 FORMAT "%7.2" DEPOSIT ABSOLUTE /end AXIS_PTS
/begin AXIS_PTS AXY_KF_MDIOP_1_TQE "Speed / rpm commercial vehicle" 0x8072A318 NO_INPUT_QUANTITY _REC_A1AXS_1_MBSE_S2 65535 caoddzd_oAjpfzb_cAcEEha_1nR_oa0 20 -32768 32767 FORMAT "%5.0" DEPOSIT ABSOLUTE /end AXIS_PTS
/begin AXIS_PTS AXY_KF_MDK_MAX_GANG_NKW "x-axis (NKW_plaus) for KF_MDK_MAX_GANG_NKW" 0x8074332C Nkw_plaus _REC_A1AXS_1_MBSE_S2 65535 caoddzd_oAjpfzb_cAcEEha_1nR_oa0 8 -32768 32767 FORMAT "%6.0" DEPOSIT ABSOLUTE /end AXIS_PTS
/begin AXIS_PTS AXY_KF_NEWP_LLK_TANS "AXY_KF_NEWP_LLK_TANS" 0x80747226 Tumg_wm _REC_A1AXS_1_MBSE_S2 6553.5 BMW_q0p1_degC 6 -3276.8 3276.7 DEPOSIT ABSOLUTE /end AXIS_PTS
/begin AXIS_PTS AXY_KF_PHA_H_E1 "AXY_KF_PHA_H_E1" 0x80716D2A NO_INPUT_QUANTITY _REC_A1AXS_1_MBSE_S2 3199.951171875 zyyxBpb_rEsnvtc_gktukCa_fR_5a0o 8 -1600 1599.951171875 DEPOSIT ABSOLUTE /end AXIS_PTS
/begin AXIS_PTS AXY_KF_PRAIL_H "AXY_KF_PRAIL_H" 0x80722EC8 BMWrailco_rat_VabHom_sw _REC_A1AXS_1_MBSE_S2 3199.951171875 zyyxBpb_rEsnvtc_gktukCa_fR_5a0o 8 -1600 1599.951171875 FORMAT "%8.3" DEPOSIT ABSOLUTE /end AXIS_PTS
/begin AXIS_PTS AXY_KF_PRAIL_H_K "AXY_KF_PRAIL_H_K" 0x80722E88 BMWrailco_rat_VabHom_sw _REC_A1AXS_1_MBSE_S2 3199.951171875 zyyxBpb_rEsnvtc_gktukCa_fR_5a0o 8 -1600 1599.951171875 FORMAT "%8.3" DEPOSIT ABSOLUTE /end AXIS_PTS
/begin AXIS_PTS AXY_KF_PRAIL_HGD "axis" 0x80722EA8 BMWrailco_rat_VabHom_sw _REC_A1AXS_1_MBSE_S2 3199.951171875 zyyxBpb_rEsnvtc_gktukCa_fR_5a0o 8 -1600 1599.951171875 FORMAT "%8.3" DEPOSIT ABSOLUTE /end AXIS_PTS
/begin AXIS_PTS AXY_KF_PRAIL_HGD_K "axis" 0x80722E98 BMWrailco_rat_VabHom_sw _REC_A1AXS_1_MBSE_S2 3199.951171875 zyyxBpb_rEsnvtc_gktukCa_fR_5a0o 8 -1600 1599.951171875 FORMAT "%8.3" DEPOSIT ABSOLUTE /end AXIS_PTS
/begin AXIS_PTS AXY_KF_ST_RKBAS_GD "AXY_KF_ST_RKBAS_GD" 0x8074A3A0 BMWinj_t_Eng_sw _REC_A1AXS_1_MBSE_S2 655.35 DchEpAd_DBCFgoa_Ckhahgc_q__aoa0 10 -327.68 327.67 FORMAT "%7.2" DEPOSIT ABSOLUTE /end AXIS_PTS
/begin AXIS_PTS AXY_KF_ST_RKBAS_VVT "AXY_KF_ST_RKBAS_VVT" 0x8074A236 BMWinj_t_Eng_sw _REC_A1AXS_1_MBSE_S2 655.35 DchEpAd_DBCFgoa_Ckhahgc_q__aoa0 12 -327.68 327.67 FORMAT "%7.2" DEPOSIT ABSOLUTE /end AXIS_PTS
/begin AXIS_PTS AXY_KF_TA_ATLSOLL "AXY_KF_TA_ATLSOLL" 0x80717B1C Rf_atm _REC_A1AXS_1_MBSE_S2 655.35 CgkBooc_wkiDfEd_Czglhgc_fR_1a0o 4 -327.68 327.67 DEPOSIT ABSOLUTE /end AXIS_PTS
/begin AXIS_PTS AXY_KF_TA_IKSOLL "AXY_KF_EXIT" 0x80717B14 Rf_atm _REC_A1AXS_1_MBSE_S2 655.35 CgkBooc_wkiDfEd_Czglhgc_fR_1a0o 4 -327.68 327.67 DEPOSIT ABSOLUTE /end AXIS_PTS
/begin AXIS_PTS AXY_KF_TA_VKSOLL "AXY_KF_TA_VKSOLL" 0x80717B0C Rf_atm _REC_A1AXS_1_MBSE_S2 655.35 CgkBooc_wkiDfEd_Czglhgc_fR_1a0o 4 -327.68 327.67 DEPOSIT ABSOLUTE /end AXIS_PTS
/begin AXIS_PTS AXY_KF_TD_FETTDELAY_TABG "AXY_KF_TD_FETTDELAY_TABG" 0x80749460 Nkw _REC_A1AXS_1_MBSE_S2 6554 caoddzd_oAjpfzb_cAcEEha_1nR_oa0 4 -3277 3277 FORMAT "%5.0" DEPOSIT ABSOLUTE /end AXIS_PTS
/begin AXIS_PTS AXY_KF_ZW_PF1 "AXY_KF_ZW_PF1" 0x80733DC4 NO_INPUT_QUANTITY _REC_A1AXS_1_MBSE_S2 655.35 CgkBooc_wkiDfEd_Czglhgc_fR_1a0o 20 -327.68 327.67 FORMAT "%9.2" DEPOSIT ABSOLUTE /end AXIS_PTS
/begin AXIS_PTS AXY_KF_ZW_PF2 "AXY_KF_ZW_PF2" 0x80733D9C NO_INPUT_QUANTITY _REC_A1AXS_1_MBSE_S2 655.35 CgkBooc_wkiDfEd_Czglhgc_fR_1a0o 20 -327.68 327.67 FORMAT "%9.2" DEPOSIT ABSOLUTE /end AXIS_PTS
/begin AXIS_PTS AXY_KF_ZW_S_PF1 "AXY_KF_ZW_S_PF1" 0x80733D74 NO_INPUT_QUANTITY _REC_A1AXS_1_MBSE_S2 655.35 CgkBooc_wkiDfEd_Czglhgc_fR_1a0o 20 -327.68 327.67 FORMAT "%9.2" DEPOSIT ABSOLUTE /end AXIS_PTS
/begin AXIS_PTS AXY_KF_ZW_S_PF2 "AXY_KF_ZW_S_PF2" 0x80733D4C NO_INPUT_QUANTITY _REC_A1AXS_1_MBSE_S2 655.35 CgkBooc_wkiDfEd_Czglhgc_fR_1a0o 20 -327.68 327.67 FORMAT "%9.2" DEPOSIT ABSOLUTE /end AXIS_PTS
/begin AXIS_PTS AXY_KF_ZW_UESP_PF1 "AXY_KF_ZW_UESP_PF1" 0x80733D30 NO_INPUT_QUANTITY _REC_A1AXS_1_MBSE_S2 655.35 CgkBooc_wkiDfEd_Czglhgc_fR_1a0o 14 -327.68 327.67 FORMAT "%9.2" DEPOSIT ABSOLUTE /end AXIS_PTS
/begin AXIS_PTS AXY_KF_ZW_UESP_PF2 "AXY_KF_ZW_UESP_PF2" 0x80733D14 NO_INPUT_QUANTITY _REC_A1AXS_1_MBSE_S2 655.35 CgkBooc_wkiDfEd_Czglhgc_fR_1a0o 14 -327.68 327.67 FORMAT "%9.2" DEPOSIT ABSOLUTE /end AXIS_PTS
/begin AXIS_PTS AXY_KF_ZW_VP_PF1 "AXY_KF_ZW_VP_PF1" 0x8074728A Rf_zwv _REC_A1AXS_1_MBSE_S2 655.35 CgkBooc_wkiDfEd_Czglhgc_fR_1a0o 16 -327.68 327.67 FORMAT "%9.2" DEPOSIT ABSOLUTE /end AXIS_PTS
/begin AXIS_PTS AXY_KF_ZW_VP_PF2 "AXY_KF_ZW_VP_PF2" 0x8074726A Rf_zwv _REC_A1AXS_1_MBSE_S2 655.35 CgkBooc_wkiDfEd_Czglhgc_fR_1a0o 16 -327.68 327.67 FORMAT "%9.2" DEPOSIT ABSOLUTE /end AXIS_PTS
/begin AXIS_PTS AXY_KF_ZWMIN_KSOT "AXY_KF_ZWMIN_KSOT" 0x80734BF8 NO_INPUT_QUANTITY _REC_A1AXS_1_MBSE_S2 655.35 CgkBooc_wkiDfEd_Czglhgc_fR_1a0o 8 -327.68 327.67 FORMAT "%9.4" DEPOSIT ABSOLUTE /end AXIS_PTS
/begin AXIS_PTS AXY_KF_ZWMIN_WSOT "AXY_KF_ZWMIN_WSOT" 0x80734BE8 NO_INPUT_QUANTITY _REC_A1AXS_1_MBSE_S2 655.35 CgkBooc_wkiDfEd_Czglhgc_fR_1a0o 8 -327.68 327.67 FORMAT "%9.4" DEPOSIT ABSOLUTE /end AXIS_PTS
/begin AXIS_PTS BMWchas_p_RailInjMpl_Ax "Catalyst heating after start() pressure rail (rail, line; meant for common rail injection) injection multiple axis x direction (X-axis) " 0x80739514 Nkw _REC_A1AXS_1_MBSE_S2 65535 caoddzd_oAjpfzb_cAcEEha_1nR_oa0 6 -32768 32767 FORMAT "%5.0" DEPOSIT ABSOLUTE /end AXIS_PTS
/begin AXIS_PTS BMWchas_p_RailInjMpl_Ay "Catalyst heating after start() pressure(pressure) rail(rail, line; meant for the common rail injection) injection(injection) multiple(multiple) axis y direction (Y-axis) " 0x80739508 BMWrailco_rat_VabHom_sw _REC_A1AXS_1_MBSE_S2 3199.951171875 zyyxBpb_rEsnvtc_gktukCa_fR_5a0o 6 -1600 1599.951171875 FORMAT "%8.3" DEPOSIT ABSOLUTE /end AXIS_PTS
/begin AXIS_PTS BMWchas_p_RailInjSng_Ax "Catalyst heating after start() pressure rail (rail, line; meant for common rail injection) injection single axis x direction (X-axis) " 0x807394F8 Nkw _REC_A1AXS_1_MBSE_S2 65535 caoddzd_oAjpfzb_cAcEEha_1nR_oa0 8 -32768 32767 FORMAT "%5.0" DEPOSIT ABSOLUTE /end AXIS_PTS
/begin AXIS_PTS BMWchas_p_RailInjSng_Ay "Catalyst heating after start() pressure(pressure) rail(rail, line; meant for the common rail injection) injection(injection) single(single) axis y direction (Y-axis) " 0x807394E8 BMWrailco_rat_VabHom_sw _REC_A1AXS_1_MBSE_S2 3199.951171875 zyyxBpb_rEsnvtc_gktukCa_fR_5a0o 8 -1600 1599.951171875 FORMAT "%8.3" DEPOSIT ABSOLUTE /end AXIS_PTS
/begin AXIS_PTS BMWchas_st_OpmBasCatCold_Ax "axis for BMWchas_st_OpmBasCatCold_T" 0x807398D0 BMWchst_t_Eng_sw _REC_A1AXS_1_MBSE_S2 655.35 DchEpAd_DBCFgoa_Ckhahgc_q__aoa0 8 -327.68 327.67 FORMAT "%6.2" DEPOSIT ABSOLUTE /end AXIS_PTS
/begin AXIS_PTS BMWchas_st_OpmBasLiOff_Ax "axis for BMWchas_st_OpmBasLiOff_T" 0x807398C0 BMWchst_t_Eng_sw _REC_A1AXS_1_MBSE_S2 655.35 DchEpAd_DBCFgoa_Ckhahgc_q__aoa0 8 -327.68 327.67 FORMAT "%6.2" DEPOSIT ABSOLUTE /end AXIS_PTS
/begin AXIS_PTS BMWchas_tq_ResExhFlpClsd_Ax "Catalyst heating after start() torque result exhausted flap closed axis x direction" 0x8073921C Nkw _REC_A1AXS_1_MBSE_S2 65535 caoddzd_oAjpfzb_cAcEEha_1nR_oa0 8 -32768 32767 FORMAT "%5.0" DEPOSIT ABSOLUTE /end AXIS_PTS
/begin AXIS_PTS BMWext_lam_CptPronMinLeanTq_Ax "exhaust temperature model a/fratio (lambda)(Lambda) component protection minimum lean lean torque axis x direction" 0x807176E0 Nkw_atm _REC_A1AXS_1_MBSE_S2 65535 caoddzd_oAjpfzb_cAcEEha_1nR_oa0 8 -32768 32767 DEPOSIT ABSOLUTE /end AXIS_PTS
/begin AXIS_PTS BMWext_lam_CptPronMinLeanTq_Ay "exhaust temperature model(Exhaust temperature model) a/fratio (lambda)(Lambda) component(Component, Component) protection(Protection) minimum(Minimum, Min) lean(Lean, Tight) torque(Torque) axis y direction(Y-axis)" 0x807176D0 Rf_atm _REC_A1AXS_1_MBSE_S2 655.35 CgkBooc_wkiDfEd_Czglhgc_fR_1a0o 8 -327.68 327.67 DEPOSIT ABSOLUTE /end AXIS_PTS
/begin AXIS_PTS BMWgpfheat_p_RailInjMpl_Ax "Catalyst heating after start() pressure rail (rail, line; meant for common rail injection) injection multiple axis x direction (X-axis) " 0x8071A37E Nkw _REC_A1AXS_1_MBSE_S2 65535 caoddzd_oAjpfzb_cAcEEha_1nR_oa0 6 -32768 32767 FORMAT "%5.0" DEPOSIT ABSOLUTE /end AXIS_PTS
/begin AXIS_PTS BMWgpfheat_p_RailInjMpl_Ay "Catalyst heating after start() pressure(pressure) rail(rail, line; meant for the common rail injection) injection(injection) multiple(multiple) axis y direction (Y-axis) " 0x8071A34E BMWrailco_rat_VabHom_sw _REC_A1AXS_1_MBSE_S2 3199.951171875 zyyxBpb_rEsnvtc_gktukCa_fR_5a0o 6 -1600 1599.951171875 FORMAT "%8.3" DEPOSIT ABSOLUTE /end AXIS_PTS
/begin AXIS_PTS BMWgpfheat_p_RailInjSng_Ax "Catalyst heating after start() pressure rail (rail, line; meant for common rail injection) injection multiple axis x direction (X-axis) " 0x8071A372 Nkw _REC_A1AXS_1_MBSE_S2 65535 caoddzd_oAjpfzb_cAcEEha_1nR_oa0 6 -32768 32767 FORMAT "%5.0" DEPOSIT ABSOLUTE /end AXIS_PTS
/begin AXIS_PTS BMWgpfheat_p_RailInjSng_Ay "Catalyst heating after start() pressure(pressure) rail(rail, line; meant for the common rail injection) injection(injection) multiple(multiple) axis y direction (Y-axis) " 0x8071A342 BMWrailco_rat_VabHom_sw _REC_A1AXS_1_MBSE_S2 3199.951171875 zyyxBpb_rEsnvtc_gktukCa_fR_5a0o 6 -1600 1599.951171875 FORMAT "%8.3" DEPOSIT ABSOLUTE /end AXIS_PTS
/begin AXIS_PTS BMWgpfheat_tq_ResExhFlpClsd_Ax "Catalyst heating after start() torque result exhausted flap closed axis x direction" 0x8071AA1E Nkw _REC_A1AXS_1_MBSE_S2 65535 caoddzd_oAjpfzb_cAcEEha_1nR_oa0 8 -32768 32767 FORMAT "%5.0" DEPOSIT ABSOLUTE /end AXIS_PTS
/begin AXIS_PTS BMWinjafs_fac_RatAirMax_Ax "Characteristic curve axis upper limit Rf for L-stoich adaptation" 0x80713766 Nkw _REC_A1AXS_1_MBSE_S2 65535 caoddzd_oAjpfzb_cAcEEha_1nR_oa0 6 -32768 32767 FORMAT "%5.0" DEPOSIT ABSOLUTE /end AXIS_PTS
/begin AXIS_PTS BMWinjmon_fac_HppEff_Ax "Injection map factor efficiency high-pressure pump (X-axis)" 0x80714B3E Nkw_10ms _REC_A1AXS_1_MBSE_S2 65535 caoddzd_oAjpfzb_cAcEEha_1nR_oa0 8 -32768 32767 FORMAT "%5.0" DEPOSIT ABSOLUTE /end AXIS_PTS
/begin AXIS_PTS BMWinjmon_fac_HppEff_Ay "Injection map factor efficiency high-pressure pump (Y-axis)" 0x80714B36 BMWrail_p_RpsActVal _REC_A1AXS_1_MBSE_U2 131.07 bukAcFc_hypjrAa_CBhougc_MCRooa0 4 0 131.07 DEPOSIT ABSOLUTE /end AXIS_PTS
/begin AXIS_PTS BMWlpa_n_EfpEngStrtAmb_Ax "EKP Speed ??Default Start Environment X-Axis" 0x8071974C Tumg _REC_A1AXS_1_MBSE_S2 6553.5 BMW_q0p1_degC 4 -3276.8 3276.7 FORMAT "%6.1" DEPOSIT ABSOLUTE /end AXIS_PTS
/begin AXIS_PTS BMWlpa_n_EfpEngStrtAmb_Ay "EKP speed default start environment Y-axis" 0x80719744 Pumg _REC_A1AXS_1_MBSE_U2 8191.875 BMW_p_sw_q0p125_hPa 4 0 8191.875 FORMAT "%8.3" DEPOSIT ABSOLUTE /end AXIS_PTS
/begin AXIS_PTS BMWlpa_n_EfpEngStrtPRail_Ax "EKP speed default start rail pressure x-axis" 0x80719740 BMWlpi_p_HiPAbs _REC_A1AXS_1_MBSE_U2 131.07 bukAcFc_hypjrAa_CBhougc_MCRooa0 2 0 131.07 DEPOSIT ABSOLUTE /end AXIS_PTS
/begin AXIS_PTS BMWlpa_n_EfpModSafe_Ax "EKP speed setting safe mode X-axis" 0x8071975C BMWlpi_t_Fu_sw _REC_A1AXS_1_MBSE_S2 655.35 DchEpAd_DBCFgoa_Ckhahgc_q__aoa0 4 -327.68 327.67 FORMAT "%5.2" DEPOSIT ABSOLUTE /end AXIS_PTS
/begin AXIS_PTS BMWlpa_n_EfpModSafe_Ay "EKP speed setting safe mode Y-axis" 0x80719754 BMWlpi_volf_Fu_sw _REC_A1AXS_1_MBSE_S2 655.35 zBcBzad_vmoivka_mFzjCgc_lCRooa0 4 -327.68 327.67 FORMAT "%5.2" DEPOSIT ABSOLUTE /end AXIS_PTS
/begin AXIS_PTS BMWlpa_rat_EfpPwm_Ax "EKP control speed in PWM X-axis" 0x80719770 BMWlpa_n_Efp_uw _REC_A1AXS_1_MBSE_U2 65535 caoddzd_oAjpfzb_cAcEEha_1nR_oa0 6 0 65535 FORMAT "%5.0" DEPOSIT ABSOLUTE /end AXIS_PTS
/begin AXIS_PTS BMWlpa_volf_FuMaxBoosCtlr_Ax "LoPAsst fuel volume flow during boost tracking (X-axis)" 0x8073C382 BMWlpsc_p_DeSp_sw _REC_A1AXS_1_MBSE_S2 65.535 rgduxyd_mlihaBb_gsCghzb_bCRa0a0 6 -32.768 32.767 FORMAT "%5.3" DEPOSIT ABSOLUTE /end AXIS_PTS
/begin AXIS_PTS BMWlpsc_p_HppMax_Ax "axis" 0x8073C638 BMWlpi_volf_Fu_sw _REC_A1AXS_1_MBSE_S2 655.35 zBcBzad_vmoivka_mFzjCgc_lCRooa0 4 -327.68 327.67 FORMAT "%5.2" DEPOSIT ABSOLUTE /end AXIS_PTS
/begin AXIS_PTS BMWlpsc_volf_FuEjrPmp_Ax "axis" 0x80719E56 BMWlpsc_p_EfpSpCtld_uw _REC_A1AXS_1_MBSE_U2 65.535 rgduxyd_mlihaBb_gsCghzb_bCRa0a0 8 0 65.535 FORMAT "%5.3" DEPOSIT ABSOLUTE /end AXIS_PTS
/begin AXIS_PTS BMWlpsc_volf_FuEjrPmp_Ay "axis" 0x8074F7AF BMWlpsc_st_TankCod_ub _REC_A1AXS_1_MBSE_U1 255 raChrxc_kBtBrmb_FmDuEFa_n__aa0o 4 0 255 FORMAT "%3.0" DEPOSIT ABSOLUTE /end AXIS_PTS
/begin AXIS_PTS BMWlpsd_p_RailDifMax_Ax "axis" 0x80719F6A BMWlpi_p_HiPAbsSp _REC_A1AXS_1_MBSE_U2 131.07 bukAcFc_hypjrAa_CBhougc_MCRooa0 4 0 131.07 DEPOSIT ABSOLUTE /end AXIS_PTS
/begin AXIS_PTS BMWls_fac_rf_RednFuOctIntkT_Ax "Support points for filling reduction factor depending on fuel quality." 0x8074FE52 F_octan _REC_A1AXS_1_MBSE_U1 0.99609375 BMW_Powertrain_DxECompuMethods_Def_ub_b1_nounit 6 0 0.99609375 FORMAT "%6.1" DEPOSIT ABSOLUTE /end AXIS_PTS
/begin AXIS_PTS BMWls_fac_rf_RednFuOctIntkT_Ay "Support points for filling reduction factor depending on the intake air temperature." 0x8071E476 Tans _REC_A1AXS_1_MBSE_S2 6553.5 BMW_q0p1_degC 6 -3276.8 3276.7 FORMAT "%6.1" DEPOSIT ABSOLUTE /end AXIS_PTS
/begin AXIS_PTS BMWls_pct_FiMaxCondRisk_Ax "Axle for maximum filling above speed due to risk of condensate on the intercooler" 0x8071E4BE NO_INPUT_QUANTITY _REC_A1AXS_1_MBSE_S2 65535 caoddzd_oAjpfzb_cAcEEha_1nR_oa0 12 -32768 32767 FORMAT "%5.0" DEPOSIT ABSOLUTE /end AXIS_PTS
/begin AXIS_PTS BMWls_pct_FiMaxIgOfs_Gx "Filling limitation characteristic curve depending on ignition angle retard" 0x8071E4AA Nkw _REC_A1AXS_1_MBSE_S2 65535 caoddzd_oAjpfzb_cAcEEha_1nR_oa0 10 -32768 32767 FORMAT "%5.0" DEPOSIT ABSOLUTE /end AXIS_PTS
/begin AXIS_PTS BMWls_pct_FiMaxIgOfs_Gy "Filling limitation characteristic curve depending on ignition angle retard" 0x8071E466 Dzw_tot_kr _REC_A1AXS_1_MBSE_S2 6553.5 BMW_q0p1_deg 8 -3276.8 3276.7 FORMAT "%6.1" DEPOSIT ABSOLUTE /end AXIS_PTS
/begin AXIS_PTS BMWls_rf_MaxEgT_Ax "Nkw" 0x8071E49E Nkw _REC_A1AXS_1_MBSE_S2 65535 caoddzd_oAjpfzb_cAcEEha_1nR_oa0 6 -32768 32767 FORMAT "%5.0" DEPOSIT ABSOLUTE /end AXIS_PTS
/begin AXIS_PTS BMWls_rf_MaxEgT_Ay "Nkw" 0x8071E482 Frfmxbsld _REC_A1AXS_1_MBSE_U2 1.99996948242188 Bhvfwhc_bigEubd_BBEupBd_nR_3oa0 6 0 1.99996948242188 FORMAT "%14.5" DEPOSIT ABSOLUTE /end AXIS_PTS
/begin AXIS_PTS BMWls_rf_MaxFuOctIntkT_Gy "Group support point for filling reduction factor" 0x8071E456 BMWls_fac_rf_RedFil_uw _REC_A1AXS_1_MBSE_U2 0.999984741210938 FzbmlAa_gCtylrb_ckCqxAc_nR_6oa0 8 0 0.999984741210938 FORMAT "%7.5" DEPOSIT ABSOLUTE /end AXIS_PTS
/begin AXIS_PTS BMWtchctr_fac_pwr_CompLimPctl_Ax "AXX_KL_F_PTURBVST" 0x80742972 BMWtchsp_mf_CmprNorm_uw _REC_A1AXS_1_MBSE_U2 2047.96875 CByjozc_eCmpBAb_pljBAmd_k__0oa0 6 0 2047.96875 FORMAT "%10.3" DEPOSIT ABSOLUTE /end AXIS_PTS
/begin AXIS_PTS BMWtchctr_pwr_Dp_Ax "AXX_KF_PATLR_D" 0x80724616 BMWtchbas_p_Dif_sw _REC_A1AXS_1_MBSE_S2 8191.875 BMW_p_sw_q0p125_hPa 14 -4096 4095.875 FORMAT "%10.3" DEPOSIT ABSOLUTE /end AXIS_PTS
/begin AXIS_PTS BMWtchctr_pwr_Dp_Ay "AXY_KF_PATLR_D" 0x807245FA BMWtchbas_p_DifGra_sw _REC_A1AXS_1_MBSE_S2 8191.875 BMW_p_sw_q0p125_hPa 14 -4096 4095.875 FORMAT "%10.3" DEPOSIT ABSOLUTE /end AXIS_PTS
/begin AXIS_PTS BMWtchctr_rat_p_ComprLimPctl_Ax "AXX_KL_FPLDSVLD_MN_DIS" 0x8074295A BMWtchsp_mf_CmprNorm_uw _REC_A1AXS_1_MBSE_U2 2047.96875 CByjozc_eCmpBAb_pljBAmd_k__0oa0 12 0 2047.96875 FORMAT "%10.3" DEPOSIT ABSOLUTE /end AXIS_PTS
/begin AXIS_PTS BMWtchctr_t_ExGasMdl_Ax "AXX_KF_TABGATL" 0x80742822 Nkw _REC_A1AXS_1_MBSE_S2 65535 caoddzd_oAjpfzb_cAcEEha_1nR_oa0 6 -32768 32767 FORMAT "%5.0" DEPOSIT ABSOLUTE /end AXIS_PTS
/begin AXIS_PTS BMWtchctr_t_ExGasMdl_Ay "AXY_KF_TABGATL" 0x80742816 Rf _REC_A1AXS_1_MBSE_S2 655.35 CgkBooc_wkiDfEd_Czglhgc_fR_1a0o 6 -327.68 327.67 FORMAT "%7.2" DEPOSIT ABSOLUTE /end AXIS_PTS
/begin AXIS_PTS BMWtchctr_t_ExGasMdlScav_Ax "AXX_KF_TABGATL" 0x8074283A Nkw _REC_A1AXS_1_MBSE_S2 65535 caoddzd_oAjpfzb_cAcEEha_1nR_oa0 6 -32768 32767 FORMAT "%5.0" DEPOSIT ABSOLUTE /end AXIS_PTS
/begin AXIS_PTS BMWtchctr_t_ExGasMdlScav_Ay "AXY_KF_TABGATL" 0x8074282E Rf _REC_A1AXS_1_MBSE_S2 655.35 CgkBooc_wkiDfEd_Czglhgc_fR_1a0o 6 -327.68 327.67 FORMAT "%7.2" DEPOSIT ABSOLUTE /end AXIS_PTS
/begin AXIS_PTS BMWtchob_fac_tq_Delt_Ax "AXX_KL_FDMDMX_OB" 0x80724AEA Tans _REC_A1AXS_1_MBSE_S2 6553.5 BMW_q0p1_degC 4 -3276.8 3276.7 FORMAT "%6.1" DEPOSIT ABSOLUTE /end AXIS_PTS
/begin AXIS_PTS BMWtchsp_fac_FilPRatCmpr_Ax "AXX_KL_FK_PLDSVLD" 0x80724FC4 BMWtchsp_mf_CmprNorm_uw _REC_A1AXS_1_MBSE_U2 2047.96875 CByjozc_eCmpBAb_pljBAmd_k__0oa0 4 0 2047.96875 FORMAT "%10.3" DEPOSIT ABSOLUTE /end AXIS_PTS
/begin AXIS_PTS BMWtchsp_fac_mf_FilCmprNorm_Ax "AXX_KL_FK_MSSOLATL" 0x80725006 NO_INPUT_QUANTITY _REC_A1AXS_1_MBSE_U2 2047.96875 CByjozc_eCmpBAb_pljBAmd_k__0oa0 4 0 2047.96875 FORMAT "%10.3" DEPOSIT ABSOLUTE /end AXIS_PTS
/begin AXIS_PTS BMWtchsp_rat_p_CmprMax_Ax "AXX_KF_FPLDMAX" 0x80724F68 BMWtchsp_mf_CmprNorm_uw _REC_A1AXS_1_MBSE_U2 2047.96875 CByjozc_eCmpBAb_pljBAmd_k__0oa0 8 0 2047.96875 FORMAT "%10.3" DEPOSIT ABSOLUTE /end AXIS_PTS
/begin AXIS_PTS BMWtchsp_rat_p_CmprMax_Ay "AXY_KF_FPLDMAX" 0x80724F5C BMWtchtbc_t_BefCmpr_sw _REC_A1AXS_1_MBSE_S2 6553.5 BMW_q0p1_degC 6 -3276.8 3276.7 FORMAT "%6.1" DEPOSIT ABSOLUTE /end AXIS_PTS
/begin AXIS_PTS BMWtchsp_rat_p_CmprPmp_Ax "AXX_KL_FPLDPUMP" 0x80724F4C BMWtchsp_mf_CmprNorm_uw _REC_A1AXS_1_MBSE_U2 2047.96875 CByjozc_eCmpBAb_pljBAmd_k__0oa0 8 0 2047.96875 FORMAT "%10.3" DEPOSIT ABSOLUTE /end AXIS_PTS
/begin AXIS_PTS BMWtchsp_rf_Liho_Ax "AXX_KL_LAMX" 0x80724F40 NO_INPUT_QUANTITY _REC_A1AXS_1_MBSE_S2 65535 caoddzd_oAjpfzb_cAcEEha_1nR_oa0 6 -32768 32767 FORMAT "%5.0" DEPOSIT ABSOLUTE /end AXIS_PTS
/begin AXIS_PTS BMWtqe_st_SptDet4NoiseAcvn_Ax "Torque Engine(Torque combustion engine) status, state(Status, Condition, Bit bar) sport(Sport) detection(Detection) four(Four, 4) noise(Noise) activation(Activation) axis x direction(X-axis)" 0x80752D07 Status_usecase_antr _REC_A1AXS_1_MBSE_U1 11 raChrxc_kBtBrmb_FmDuEFa_n__aa0o 12 0 11 FORMAT "%6.0" DEPOSIT ABSOLUTE /end AXIS_PTS
/begin AXIS_PTS BMWtqe_st_SptDet4NoiseAcvn_Ay "Torque Engine(Torque combustion engine) status, state(Status, Condition, Bit bar) sport(Sport) detection(Detection) four(Four, 4) noise(Noise) activation(Activation) axis y direction(Y-axis)" 0x80752D03 St_dsc_can _REC_A1AXS_1_MBSE_U1 11 raChrxc_kBtBrmb_FmDuEFa_n__aa0o 4 0 11 FORMAT "%3.0" DEPOSIT ABSOLUTE /end AXIS_PTS
/begin AXIS_PTS BMWtqe_tqc_FlApplStg_Ax "Torque Engine torque crank shaft fulload application Stage axis x direction" 0x8072D80E Nkw_ref _REC_A1AXS_1_MBSE_S2 65535 caoddzd_oAjpfzb_cAcEEha_1nR_oa0 18 -32768 32767 DEPOSIT ABSOLUTE /end AXIS_PTS
/begin AXIS_PTS GXX_KF_LABAS "X axis groups for KF_LABASxxx and KF_LA_SK" 0x8074943C Nkw _REC_A1AXS_1_MBSE_S2 65535 caoddzd_oAjpfzb_cAcEEha_1nR_oa0 18 -32768 32767 FORMAT "%5.0" DEPOSIT ABSOLUTE /end AXIS_PTS
/begin AXIS_PTS GXX_KF_PHA_H_B1_BAS "GXX_KF_PHA_H_B1_BAS" 0x807153DE Nkw _REC_A1AXS_1_MBSE_S2 65535 caoddzd_oAjpfzb_cAcEEha_1nR_oa0 10 -32768 32767 FORMAT "%5.0" DEPOSIT ABSOLUTE /end AXIS_PTS
/begin AXIS_PTS GXY_KF_LABAS "Groups Y axis for KF_LABASxxx and KF_LA_SK" 0x8074941A Rf _REC_A1AXS_1_MBSE_S2 655.35 CgkBooc_wkiDfEd_Czglhgc_fR_1a0o 17 -327.68 327.67 FORMAT "%7.2" DEPOSIT ABSOLUTE /end AXIS_PTS
/begin AXIS_PTS GXY_KF_PHA_H_B1_BAS "GXY_KF_PHA_H_B1_BAS Input Rk_soll_h_xlb" 0x807153B6 NO_INPUT_QUANTITY _REC_A1AXS_1_MBSE_S2 3199.951171875 zyyxBpb_rEsnvtc_gktukCa_fR_5a0o 12 -1600 1599.951171875 FORMAT "%8.3" DEPOSIT ABSOLUTE /end AXIS_PTS
/begin AXIS_PTS IKCtl_LoadAdd04_X_AX "Support point distribution relative filling, 4 Sst." 0x807946A3 rl_msg Axis_Xu8 191.3 rel_ub_q0p75 4 0 191.3 FORMAT "%5.1" DEPOSIT ABSOLUTE /end AXIS_PTS
/begin AXIS_PTS IKCtl_nEngB16_X_AX "KR: Support point distribution speed of group B" 0x807946E4 Epm_nEng Axis_Xs16 32767.5 EngN 16 -16384 16383.5 FORMAT "%8.2" DEPOSIT ABSOLUTE /end AXIS_PTS
/begin AXIS_PTS SNM08HDUW "SST distribution for engine speed" 0x807A0606 NO_INPUT_QUANTITY Axis_Xu16 16383.75 nmot_sw_q0p25 8 0 16383.75 FORMAT "%8.2" DEPOSIT ABSOLUTE /end AXIS_PTS
/begin AXIS_PTS SPD06HDSW "SST distribution for control difference rail pressure" 0x80793F5E FuPHi_pHpRglnDeLoc Axis_Xs16 131.07 RBPtCel_p_0p002_1 6 -65.536 65.534 FORMAT "%8.5" DEPOSIT ABSOLUTE /end AXIS_PTS
/begin CHARACTERISTIC AKR_dmHFMThdMin_C "Minimum threshold for HFM value to close exhaust flap" VALUE 0x80785A1A KwUw 6553.5 asfzqDd_xfCuqha_hliBAmd_k__0oa0 0 6553.5 FORMAT "%8.3" /end CHARACTERISTIC
/begin CHARACTERISTIC AKR_stSpt_C "Status Sports mode" VALUE 0x80785F10 FklWUb 255 DEZ 0 255 FORMAT "%5.1" /end CHARACTERISTIC
/begin CHARACTERISTIC Antilag_ActivationDelay___MGF_CC_PF "Activation delay" VALUE 0x807C0000 KwUw 655.35 camcxxd_bxlpdsa_Cshlhgc_sR_1a0o 0 60 /end CHARACTERISTIC
/begin CHARACTERISTIC Antilag_CoolantTempMax___MGF_CC_PF "Maximum coolant temperature" VALUE 0x807C058A KwUw 255 DchEpAd_DBCFgoa_Ckhahgc_q__aoa0 -300 300 FORMAT "%7.0" PHYS_UNIT "-" /end CHARACTERISTIC
/begin CHARACTERISTIC Antilag_CoolantTempMin___MGF_CC_PF "Minimum coolant temperature" VALUE 0x807C058C KwUw 255 DchEpAd_DBCFgoa_Ckhahgc_q__aoa0 -300 300 FORMAT "%7.0" PHYS_UNIT "-" /end CHARACTERISTIC
/begin CHARACTERISTIC Antilag_CutMethod___MGF_CC_PF "Method used to hold engine speed: 0 = fuel cut (bit of stuttering but safe), 1 = ignition cut (flame mode, very aggressive), 3 = factory rpm limiter (default, smoothest and safest)" VALUE 0x807C4A3C FklWUb 255 ___MGF_CC_EngineSpeedCutMethodCompuMethod 0 3 FORMAT "%7.0" /end CHARACTERISTIC
/begin CHARACTERISTIC Antilag_EgtTempMax___MGF_CC_PF "Maximum exhaust gas temperature [EGT]" VALUE 0x807C058E KwUw 255 BMW_q0p1_degC -1000 2000 FORMAT "%7.0" PHYS_UNIT "-" /end CHARACTERISTIC
/begin CHARACTERISTIC Antilag_IatTempMax___MGF_CC_PF "Maximum intake air temperature [IAT]" VALUE 0x807C4A3D FklWUb 255 ___MGF_CC_TemperatureCelsius_x3_d4_s48 -300 300 FORMAT "%7.0" PHYS_UNIT "-" /end CHARACTERISTIC
/begin CHARACTERISTIC Antilag_MaxDuration___MGF_CC_PF "Maximum usage duration" VALUE 0x807C08B0 KwUw 655.35 camcxxd_bxlpdsa_Cshlhgc_sR_1a0o 0 5000 /end CHARACTERISTIC
/begin CHARACTERISTIC Antilag_OverBoostThreshold___MGF_CC_PF "Maximum over boost" VALUE 0x807C08B2 KwUw 255 BMW_p_sw_q0p125_hPa 0 5000 FORMAT "%7.0" PHYS_UNIT "-" /end CHARACTERISTIC
/begin CHARACTERISTIC Antilag_Pedal___MGF_CC_PF "Pedal threshold for activation" VALUE 0x807C4A3E FklWUb 255 ___MGF_CC_Pedal_x100_d256 0 100 FORMAT "%7.0" PHYS_UNIT "-" /end CHARACTERISTIC
/begin CHARACTERISTIC Antilag_RollingSpeedThreshold___MGF_CC_PF "Speed threshold to detect rolling" VALUE 0x807C08B4 KwUw 255 ___MGF_CC_Speedkmh_d64 0 300 FORMAT "%7.0" PHYS_UNIT "-" /end CHARACTERISTIC
/begin CHARACTERISTIC Antilag_RollRpmMax___MGF_CC_PF "RPM maximum engagement" VALUE 0x807C08B6 KwUw 32767.5 EngN 0 15000 FORMAT "%8.2" /end CHARACTERISTIC
/begin CHARACTERISTIC Antilag_RollRpmMin___MGF_CC_PF "RPM minimum engagement" VALUE 0x807C08B8 KwUw 32767.5 EngN 0 15000 FORMAT "%8.2" /end CHARACTERISTIC
/begin CHARACTERISTIC Antilag_RpmDelayUntilCutRoll___MGF_CC_PF "RPM delay until cut" VALUE 0x807C08BA KwUw 32767.5 EngN 0 20000 FORMAT "%8.2" /end CHARACTERISTIC
/begin CHARACTERISTIC Antilag_RpmDelayUntilCutStand___MGF_CC_PF "RPM delay until cut" VALUE 0x807C08BC KwUw 32767.5 EngN 0 20000 FORMAT "%8.2" /end CHARACTERISTIC
/begin CHARACTERISTIC Antilag_RpmSetpoint___MGF_CC_PF "RPM setpoint" VALUE 0x807C08BE CurG_Ws16 32767.5 EngN 0 15000 FORMAT "%8.2" /end CHARACTERISTIC
/begin CHARACTERISTIC Antilag_TargetBoostRoll___MGF_CC_PF "Boost pressure setpoint" VALUE 0x807C08E4 KwUw 255 BMW_p_sw_q0p125_hPa 0 3000 FORMAT "%7.0" PHYS_UNIT "-" /end CHARACTERISTIC
/begin CHARACTERISTIC Antilag_TargetBoostStand___MGF_CC_PF "Boost pressure setpoint" VALUE 0x807C08E6 KwUw 255 BMW_p_sw_q0p125_hPa 0 3000 FORMAT "%7.0" PHYS_UNIT "-" /end CHARACTERISTIC
/begin CHARACTERISTIC Antilag_TargetNumberOfCylindersToSuppress___MGF_CC_PF "Target number of cylinders to suppress during antilag" VALUE 0x807C2491 FklWUb 8 raChrxc_kBtBrmb_FmDuEFa_n__aa0o 0 8 FORMAT "%3.0" /end CHARACTERISTIC
/begin CHARACTERISTIC BMWchas_tq_ResExhFlpClsdHys_C "Hysteresis for closing the exhaust flap" VALUE 0x80738178 CurG_Ws16 6553.5 BMW_dm_sw_q0p1_Nm -3276.8 3276.7 FORMAT "%6.1" /end CHARACTERISTIC
/begin CHARACTERISTIC BMWchas_v_IdlGearAcvMin_C "threshold vehicle velocity for setting the gear engaged for manual transmission vehicles." VALUE 0x80738174 CurG_Ws16 1310.7 jgbhAma_smpAegb_hlEBAmd_k__0oa0 -655.36 655.34 FORMAT "%6.2" /end CHARACTERISTIC
/begin CHARACTERISTIC BMWchas_v_MaxExhFlpClsd_C "Maximum speed up to which the exhaust flap should remain closed." VALUE 0x80738172 CurG_Ws16 1310.7 jgbhAma_smpAegb_hlEBAmd_k__0oa0 -655.36 655.34 FORMAT "%6.2" /end CHARACTERISTIC
/begin CHARACTERISTIC BMWchst_t_CatMax_C "threshold cat temperatur for canceling catalyst heating" VALUE 0x80710C60 CurG_Ws16 6553.5 BMW_q0p1_degC -3276.8 3276.7 /end CHARACTERISTIC
/begin CHARACTERISTIC BMWgpfheat_p_RailTstrPcg_C "Rail pressure setpoint for preconditioning" VALUE 0x8071A29E KwUw 39.9993896484375 cxdjuna_xpuCged_ocEpdua_MCRa2a0 0 39.9993896484375 /end CHARACTERISTIC
/begin CHARACTERISTIC BMWgpfheat_tq_ResExhFlpClsdHys_C "Hysteresis for closing the exhaust flap" VALUE 0x8071A3BA CurG_Ws16 6553.5 BMW_dm_sw_q0p1_Nm -3276.8 3276.7 FORMAT "%6.1" /end CHARACTERISTIC
/begin CHARACTERISTIC BMWgpfp_swi_PclFil_C "Manual switch to activate the OPF functionality in the Gpf_Cluster. ATTENTION: The switch is only evaluated in the INI function. This means that changes to the switch must be flashed and the SG must go to sleep." VALUE 0x8074F92B FklWUb 1 fgjpsvb_fDqjECa_acgrbDd_n_dae__ 0 1 /end CHARACTERISTIC
/begin CHARACTERISTIC BMWinjmon_vol_HppCmpn_C "Injection delivery volume HDP for delivery performance calculation of the HDP" VALUE 0x80714AA2 KwUw 65535 kEEdlBb_gsrEhkd_rmDuAhc_uCRoa0o 0 65535 FORMAT "%6.1" /end CHARACTERISTIC
/begin CHARACTERISTIC BMWlpa_fac_AirLimOvrTMin_C "LoPAsst filling limitation due to EKP excess temperature factor minimum" VALUE 0x8073C354 KwUw 3.99993896484375 ilxsavd_hkzmBfc_lAzCpAb_nR_1oa0 0 3.99993896484375 /end CHARACTERISTIC
/begin CHARACTERISTIC BMWlpa_n_EfpModMax_C "EKP speed specification Max-Mode" VALUE 0x8071964E KwUw 65535 caoddzd_oAjpfzb_cAcEEha_1nR_oa0 0 65535 FORMAT "%5.0" /end CHARACTERISTIC
/begin CHARACTERISTIC BMWlpa_rat_AirLimGraNeg_C "Filling limitation due to EKP gradient limitation Negative" VALUE 0x8073C35A KwUw 655.35 CgkBooc_wkiDfEd_Czglhgc_fR_1a0o 0 655.35 /end CHARACTERISTIC
/begin CHARACTERISTIC BMWlpa_rat_AirLimMax_C "Filling limitation due to EKP maximum value" VALUE 0x8073C356 KwUw 655.35 CgkBooc_wkiDfEd_Czglhgc_fR_1a0o 0 655.35 /end CHARACTERISTIC
/begin CHARACTERISTIC BMWlpa_rat_AirLimMin_C "LoPAsst filling limitation due to EKP minimum value" VALUE 0x8073C364 CurG_Ws16 655.35 CgkBooc_wkiDfEd_Czglhgc_fR_1a0o -327.68 327.67 /end CHARACTERISTIC
/begin CHARACTERISTIC BMWlpa_volf_FuBoosRstOfs_C "LoPAsst fuel volume flow for boost reset offset" VALUE 0x8073C362 CurG_Ws16 655.35 zBcBzad_vmoivka_mFzjCgc_lCRooa0 -327.68 327.67 /end CHARACTERISTIC
/begin CHARACTERISTIC BMWlpa_volf_FuFpcOvrT_C "LoPAsst filling limitation due to EKP overtemperature, maximum volume flow" VALUE 0x8073C35E CurG_Ws16 655.35 zBcBzad_vmoivka_mFzjCgc_lCRooa0 -327.68 327.67 /end CHARACTERISTIC
/begin CHARACTERISTIC BMWtchbas_cw_Noise_C "Configuration wastegate opening for acoustic reasons" VALUE 0x80750819 FklWUb 255 raChrxc_kBtBrmb_FmDuEFa_n__aa0o 0 255 FORMAT "%5.0" /end CHARACTERISTIC
/begin CHARACTERISTIC BMWtchdiag_n_EngMin_C "Lower speed threshold for leakage detection" VALUE 0x80724750 CurG_Ws16 65535 caoddzd_oAjpfzb_cAcEEha_1nR_oa0 -32768 32767 FORMAT "%5.0" /end CHARACTERISTIC
/begin CHARACTERISTIC BMWtchdiag_rf_SpMin_C "Desired filling (from Rf_soll_md, limited between Rf_max and Rf_min)" VALUE 0x8072474C CurG_Ws16 655.35 CgkBooc_wkiDfEd_Czglhgc_fR_1a0o -327.68 327.67 FORMAT "%6.4" /end CHARACTERISTIC
/begin CHARACTERISTIC BMWtchob_p_DifEnd_C "Control difference for overboost end" VALUE 0x80724912 CurG_Ws16 8191.875 BMW_p_sw_q0p125_hPa -4096 4095.875 FORMAT "%10.3" /end CHARACTERISTIC
/begin CHARACTERISTIC BMWtchob_p_DifGraTrigMin_C "Gradient of the control difference to trigger overboost" VALUE 0x80724AFE CurG_Ws16 8191.875 BMW_p_sw_q0p125_hPa -4096 4095.875 FORMAT "%10.3" /end CHARACTERISTIC
/begin CHARACTERISTIC BMWtchsp_p_OfsMax_C "Offset on the Pld_soll_max. This is subtracted from Pld_soll_max. If the actual pressure Pvdkds rises above this threshold, the Rf_max_pldmax calculation is switched on (load is high enough so that Fups and Pirg can be used for an Rfmax calculation" VALUE 0x80724DBE KwUw 8191.875 BMW_p_sw_q0p125_hPa 0 8191.875 FORMAT "%10.3" /end CHARACTERISTIC
/begin CHARACTERISTIC BMWtchsp_p_ReqMax_C "Maximum target boost pressure due to boost pressure sensor diagnosis" VALUE 0x80724DBA KwUw 8191.875 BMW_p_sw_q0p125_hPa 0 8191.875 FORMAT "%10.3" /end CHARACTERISTIC
/begin CHARACTERISTIC BMWtqe_st_ProhCylOffGc_C "manual request to prohibit EZA during gear change (request to EGS) (0 = no prohibition, 1 = prohibition)" VALUE 0x807527BA FklWUb 255 raChrxc_kBtBrmb_FmDuEFa_n__aa0o 0 255 FORMAT "%3.0" /end CHARACTERISTIC
/begin CHARACTERISTIC BMWtqe_swi_NoiseWiDiDfco_C "Switch to enable the functionality of a boost bubble despite prohibition SA" VALUE 0x80752C87 FklWUb 1 fgjpsvb_fDqjECa_acgrbDd_n_dae__ 0 1 /end CHARACTERISTIC
/begin CHARACTERISTIC CcmEnterMenuDelay___MGF_CC_PF "Delay to enter Custom Code Menu, CCM" VALUE 0x807C2410 KwUw 655.35 camcxxd_bxlpdsa_Cshlhgc_sR_1a0o 0 5000 /end CHARACTERISTIC
/begin CHARACTERISTIC CcmTimeout___MGF_CC_PF "Timeout until automatic exit of Custom Code Menu, CCM" VALUE 0x807C2412 KwUw 655.35 camcxxd_bxlpdsa_Cshlhgc_sR_1a0o 0 5000 /end CHARACTERISTIC
/begin CHARACTERISTIC CoEng_ratChrgAirCylMaxDesLim_C "Upper limit for the filling value requested by the hybrid coordinator." VALUE 0x80783CEE KwUw 1535.977 rel_q0p0234 0 1535.977 FORMAT "%8.3" /end CHARACTERISTIC
/begin CHARACTERISTIC CustomCanBusCruiseControlIdMap___MGF_CC_PF "CAN bus ID for cruise control module (Default = 0x189)" VALUE 0x807C248C KwUw 255 raChrxc_kBtBrmb_FmDuEFa_n__aa0o 0 4095 FORMAT "%7.0" /end CHARACTERISTIC
/begin CHARACTERISTIC CustomCanBusEcaIdMap___MGF_CC_PF "CAN bus ID for Ethanol Content Analyzer (ECA) module (Commonly 0x0EC, 0x0EB, or 0x4CB)" VALUE 0x807D88F2 KwUw 255 raChrxc_kBtBrmb_FmDuEFa_n__aa0o 0 4095 FORMAT "%7.0" /end CHARACTERISTIC
/begin CHARACTERISTIC CustomCanBusMotivReflexOutputIdMap___MGF_CC_PF "CAN bus ID for Motiv's Re|Flex module (Commonly 0x0EC, 0x0EB, 0x4CB, or 0x334)" VALUE 0x807D88F6 KwUw 255 raChrxc_kBtBrmb_FmDuEFa_n__aa0o 0 4095 FORMAT "%7.0" /end CHARACTERISTIC
/begin CHARACTERISTIC CustomCanBusTurnSignalIdMap___MGF_CC_PF "CAN bus ID for turn signal module (Default = 0x1EE)" VALUE 0x807D88FA KwUw 255 raChrxc_kBtBrmb_FmDuEFa_n__aa0o 0 4095 FORMAT "%7.0" /end CHARACTERISTIC
/begin CHARACTERISTIC CW_Antilag___MGF_CC "Antilag Codeword: Set 1 (true) to enable function and 0 (false) to disable function" VALUE 0x807C4A3F FklWUb 1 B_TRUE 0 1 FORMAT "%13.11" /end CHARACTERISTIC
/begin CHARACTERISTIC CW_ATMOD "" VALUE 0x8074F500 FklWUb 1 B_TRUE 0 1 FORMAT "%13.11" /end CHARACTERISTIC
/begin CHARACTERISTIC CW_BurblesOnTheFly___MGF_CC "Burbles On-The-Fly Codeword: Set 1 (true) to enable function and 0 (false) to disable function" VALUE 0x807C4A40 FklWUb 1 B_TRUE 0 1 FORMAT "%13.11" /end CHARACTERISTIC
/begin CHARACTERISTIC CW_CruiseControlConfig___MGF_CC "Cruise Control Config Codeword: Set 1 (true) if using RockerCombo and 0 (false) if using UniRocker" VALUE 0x807C2467 FklWUb 1 B_TRUE 0 1 FORMAT "%13.11" /end CHARACTERISTIC
/begin CHARACTERISTIC CW_CustomCodeMenu___MGF_CC "Custom Code Menu Codeword: Set 1 (true) to enable function and 0 (false) to disable function" VALUE 0x807C2466 FklWUb 1 B_TRUE 0 1 FORMAT "%13.11" /end CHARACTERISTIC
/begin CHARACTERISTIC CW_ExhaustFlapOnTheFly___MGF_CC "Exhaust Flap On-The-Fly Codeword: Set 1 (true) to enable function and 0 (false) to disable function" VALUE 0x807C2468 FklWUb 1 B_TRUE 0 1 FORMAT "%13.11" /end CHARACTERISTIC
/begin CHARACTERISTIC CW_FlexFuel___MGF_CC "Flex Fuel Codeword: Set 1 (true) to enable function and 0 (false) to disable function" VALUE 0x807C2469 FklWUb 1 B_TRUE 0 1 FORMAT "%13.11" /end CHARACTERISTIC
/begin CHARACTERISTIC CW_FlexFuelBlending___MGF_CC "Flex Fuel Blending Codeword: Set 1 (true) to enable function and 0 (false) to disable function" VALUE 0x807C246A FklWUb 1 B_TRUE 0 1 FORMAT "%13.11" /end CHARACTERISTIC
/begin CHARACTERISTIC CW_LowPressureFuelPressureSensorInstalled___MGF_CC "Low Pressure Fuel Pressure Sensor Installed Codeword: Set 1 (true) if (Motiv or Fuel-It) low pressure fuel pressure sensor is installed and 0 (false) if not installed" VALUE 0x807C2484 FklWUb 1 B_TRUE 0 1 FORMAT "%13.11" /end CHARACTERISTIC
/begin CHARACTERISTIC CW_MgfLimpModeProtectionEnabled___MGF_CC "Mgf Limp Mode Protection Enabled Codeword: Set 1 (true) if MG Flasher's protective limp mode should be enabled and 0 (false) if disabled" VALUE 0x807C2487 FklWUb 1 B_TRUE 0 1 FORMAT "%13.11" /end CHARACTERISTIC
/begin CHARACTERISTIC CW_MotivReflexInstalled___MGF_CC "Motiv Reflex Installed Codeword: Set 1 (true) if Motiv Re|Flex is installed and 0 (false) if not installed" VALUE 0x807C2488 FklWUb 1 B_TRUE 0 1 FORMAT "%13.11" /end CHARACTERISTIC
/begin CHARACTERISTIC CW_SensorEthanol___MGF_CC "Sensor Ethanol Codeword: Set 1 (true) if flex fuel sensor is installed on PT-CAN2 and 0 (false) if not installed " VALUE 0x807C246C FklWUb 1 B_TRUE 0 1 FORMAT "%13.11" /end CHARACTERISTIC
/begin CHARACTERISTIC CW_SOUND "CW_SOUND" VALUE 0x80752CB1 FklWUb 255 raChrxc_kBtBrmb_FmDuEFa_n__aa0o 0 255 FORMAT "%7.0" /end CHARACTERISTIC
/begin CHARACTERISTIC CW_UseAllCruiseControlCanBusData___MGF_CC "Use All Cruise Control Can Bus Data Codeword: Set 1 (true) to use all cruise control CAN bus data and 0 (false) to use only Rocker data" VALUE 0x807C246D FklWUb 1 B_TRUE 0 1 FORMAT "%13.11" /end CHARACTERISTIC
/begin CHARACTERISTIC CWAKR "Code word for exhaust flap control" VALUE 0x80785F55 FklWUb 255 DEZ 0 255 FORMAT "%5.1" /end CHARACTERISTIC
/begin CHARACTERISTIC CWSTEGSPROGAKR "Code word for exhaust flap control via stegsprog" VALUE 0x80785F59 FklWUb 255 DEZ 0 255 FORMAT "%5.1" /end CHARACTERISTIC
/begin CHARACTERISTIC CWVMAXCOD "Codeword VMAX coding active" VALUE 0x807A0441 FklWUb 255 DEZ 0 255 FORMAT "%5.1" /end CHARACTERISTIC
/begin CHARACTERISTIC Exh_swtSensCfgPPFlt_C "Switch for configuring/adjusting the pressure sensor" VALUE 0x807A66B8 FklWUb 255 BMW_ba_poel__ 0 255 FORMAT "%5.1" /end CHARACTERISTIC
/begin CHARACTERISTIC ExhaustFlapClosedMaxLoad___MGF_CC_PF "Maximum load before overriding user selection and opening exhaust flaps" VALUE 0x807C2414 CurG_Ws16 255 CgkBooc_wkiDfEd_Czglhgc_fR_1a0o -327 327 FORMAT "%7.0" PHYS_UNIT "-" /end CHARACTERISTIC
/begin CHARACTERISTIC FlexFuelEthanolDisplayActivationDelay___MGF_CC_PF "Delay to display flex fuel ethanol content on the dash" VALUE 0x807C2416 KwUw 655.35 camcxxd_bxlpdsa_Cshlhgc_sR_1a0o 0 5000 /end CHARACTERISTIC
/begin CHARACTERISTIC K_BS_MN "Lambda minimum value for component protection" VALUE 0x80717714 KwUw 15.999755859375 BumqDkc_mryszAa_EcglxAc_nR_4oa0 0 15.999755859375 /end CHARACTERISTIC
/begin CHARACTERISTIC K_EDA_MD_ANZ_BS_SCAL_CODE0 "Base scaling per area in the display" VALUE 0x8074E8E1 FklWUb 255 raChrxc_kBtBrmb_FmDuEFa_n__aa0o 0 255 /end CHARACTERISTIC
/begin CHARACTERISTIC K_EDA_MD_ANZ_BS_SCAL_CODE1 "Base scaling per area in the display" VALUE 0x8074E8E0 FklWUb 255 raChrxc_kBtBrmb_FmDuEFa_n__aa0o 0 255 /end CHARACTERISTIC
/begin CHARACTERISTIC K_EDA_MD_ANZ_BS_SCAL_CODE2 "Base scaling per area in the display" VALUE 0x8074E8DF FklWUb 255 raChrxc_kBtBrmb_FmDuEFa_n__aa0o 0 255 /end CHARACTERISTIC
/begin CHARACTERISTIC K_EDA_MD_ANZ_BS_SCAL_CODE3 "Base scaling per area in the display" VALUE 0x8074E8DE FklWUb 255 raChrxc_kBtBrmb_FmDuEFa_n__aa0o 0 255 /end CHARACTERISTIC
/begin CHARACTERISTIC K_EDA_MD_ANZ_BS_SCAL_CODE4 "Base scaling per area in the display" VALUE 0x8074E8DD FklWUb 255 raChrxc_kBtBrmb_FmDuEFa_n__aa0o 0 255 /end CHARACTERISTIC
/begin CHARACTERISTIC K_EDA_P_ANZ_SPORT_BS_SCAL_CODE0 "Base scaling per area in the display" VALUE 0x8074E8DC FklWUb 255 raChrxc_kBtBrmb_FmDuEFa_n__aa0o 0 255 /end CHARACTERISTIC
/begin CHARACTERISTIC K_EDA_P_ANZ_SPORT_BS_SCAL_CODE1 "Base scaling per area in the display" VALUE 0x8074E8DB FklWUb 255 raChrxc_kBtBrmb_FmDuEFa_n__aa0o 0 255 /end CHARACTERISTIC
/begin CHARACTERISTIC K_EDA_P_ANZ_SPORT_BS_SCAL_CODE2 "Base scaling per area in the display" VALUE 0x8074E8DA FklWUb 255 raChrxc_kBtBrmb_FmDuEFa_n__aa0o 0 255 /end CHARACTERISTIC
/begin CHARACTERISTIC K_EDA_P_ANZ_SPORT_BS_SCAL_CODE3 "Base scaling per area in the display" VALUE 0x8074E8D9 FklWUb 255 raChrxc_kBtBrmb_FmDuEFa_n__aa0o 0 255 /end CHARACTERISTIC
/begin CHARACTERISTIC K_F_SOT_RUECKBLICK_RS "Offset for factor for thrust bubbling when downshifting" VALUE 0x8074DFD1 FklWUb 0.99609375 BMW_Powertrain_DxECompuMethods_Def_ub_b1_nounit 0 0.99609375 FORMAT "%6.4" /end CHARACTERISTIC
/begin CHARACTERISTIC K_F_SOT_RUECKBLICK_STAND "Factor for thrust bubbling when stationary" VALUE 0x8074DFD0 FklWUb 0.99609375 BMW_Powertrain_DxECompuMethods_Def_ub_b1_nounit 0 0.99609375 FORMAT "%6.4" /end CHARACTERISTIC
/begin CHARACTERISTIC K_FRFMXBS_MN "Limiting factor filling intervention at BS at grease running limit" VALUE 0x80717784 KwUw 1.99996948242188 Bhvfwhc_bigEubd_BBEupBd_nR_3oa0 0 1.99996948242188 FORMAT "%14.5" /end CHARACTERISTIC
/begin CHARACTERISTIC K_LA_FETTDELAY "Lambda threshold from which a rich request from KF_LABAS_XXX is suppressed" VALUE 0x80748CD4 KwUw 15.999755859375 BumqDkc_mryszAa_EcglxAc_nR_4oa0 0 15.999755859375 FORMAT "%9.4" /end CHARACTERISTIC
/begin CHARACTERISTIC K_MAX_PSSOLBER "Maximum Ps_soll_offs (when calculating Ps_soll_sm_nl)" VALUE 0x8071C6B6 CurG_Ws16 8191.875 BMW_p_sw_q0p125_hPa -4096 4095.875 FORMAT "%8.3" /end CHARACTERISTIC
/begin CHARACTERISTIC K_MSVANST_DIFFPRAIL "Constant monitoring HDP activation minimum rail pressure undershoot" VALUE 0x80714AA0 KwUw 39.9993896484375 cxdjuna_xpuCged_ocEpdua_MCRa2a0 0 39.9993896484375 FORMAT "%6.2" /end CHARACTERISTIC
/begin CHARACTERISTIC K_PAK_MX "Maximum exhaust manifold pressure" VALUE 0x80710728 KwUw 8191.875 BMW_p_sw_q0p125_hPa 0 8191.875 FORMAT "%7.1" /end CHARACTERISTIC
/begin CHARACTERISTIC K_PRAIL_ST_MAX "Maximum rail pressure setpoint for engine start" VALUE 0x80741A8A KwUw 39.9761962890625 cxdjuna_xpuCged_ocEpdua_MCRa2a0 0 39.9761962890625 FORMAT "%9.4" /end CHARACTERISTIC
/begin CHARACTERISTIC K_RFVIST_MX "MAX limit Rfv_ist from NN" VALUE 0x807123E8 CurG_Ws16 655.35 CgkBooc_wkiDfEd_Czglhgc_fR_1a0o -327.68 327.67 FORMAT "%7.2" /end CHARACTERISTIC
/begin CHARACTERISTIC K_T_FETTDELAY_SPERR "Time during which a renewed suppression of enrichment is blocked" VALUE 0x8075D08D FklWUb 255 hcpywvc_dcqzDlc_FmDugua_s__aa0o 0 255 FORMAT "%5.2" /end CHARACTERISTIC
/begin CHARACTERISTIC K_T_NK_SOUND_MX "K_T_NK_SOUND_MX" VALUE 0x8072AD24 CurG_Ws16 6553.5 BMW_q0p1_degC -3276.8 3276.7 /end CHARACTERISTIC
/begin CHARACTERISTIC K_T_SOUND_MN "K_T_SOUND_MN" VALUE 0x8072AD22 CurG_Ws16 655.35 DchEpAd_DBCFgoa_Ckhahgc_q__aoa0 -327.68 327.67 /end CHARACTERISTIC
/begin CHARACTERISTIC K_T_VL_SOUND_MX "K_T_VL_SOUND_MX" VALUE 0x8072AD20 CurG_Ws16 6553.5 BMW_q0p1_degC -3276.8 3276.7 /end CHARACTERISTIC
/begin CHARACTERISTIC K_TKW_MX "Coolant set temperature in MAX mode" VALUE 0x80733C98 CurG_Ws16 655.35 DchEpAd_DBCFgoa_Ckhahgc_q__aoa0 -327.68 327.67 /end CHARACTERISTIC
/begin CHARACTERISTIC K_TKW_WA "Target coolant temperature in warm-up mode" VALUE 0x80733C94 CurG_Ws16 655.35 DchEpAd_DBCFgoa_Ckhahgc_q__aoa0 -327.68 327.67 /end CHARACTERISTIC
/begin CHARACTERISTIC K_V_SOT_MN "Min. driving speed for thrust bubbling" VALUE 0x8070B9FC CurG_Ws16 1310.7 Asyaixa_wdvtenb_FCefaCb_n__aa0o -655.36 655.34 FORMAT "%7.1" /end CHARACTERISTIC
/begin CHARACTERISTIC K_V_SOUND_MN "K_V_SOUND_MN" VALUE 0x8072AD1E KwUw 1310.7 jgbhAma_smpAegb_hlEBAmd_k__0oa0 0 1310.7 /end CHARACTERISTIC
/begin CHARACTERISTIC K_V_SOUND_MX "K_V_SOUND_MX" VALUE 0x8072AD1C KwUw 1310.7 jgbhAma_smpAegb_hlEBAmd_k__0oa0 0 1310.7 /end CHARACTERISTIC
/begin CHARACTERISTIC NMXHDR "RPM limit on HDR error" VALUE 0x80797428 CurG_Ws16 16383.5 n_sw_q0p5 0 16383.5 FORMAT "%8.2" /end CHARACTERISTIC
/begin CHARACTERISTIC PFlt_stActv_C "Activation of the particle filter functionality" VALUE 0x8079BE84 FklWUb 255 BMW_ba_poel__ 0 255 FORMAT "%5.1" /end CHARACTERISTIC
/begin CHARACTERISTIC PFlt_stPfilTyp_C "Bit coded type of particle filter" VALUE 0x8079BE85 FklWUb 255 BMW_ba_poel__ 0 255 FORMAT "%5.1" /end CHARACTERISTIC
/begin CHARACTERISTIC PVDMX "Upper pressure threshold for range check" VALUE 0x8078C25A KwUw 5119.922 p_uw_q0p078 0 5119.922 FORMAT "%8.3" /end CHARACTERISTIC
/begin CHARACTERISTIC S_AUSWAHL_FETTDELAY "Switch for switching the lambda setpoint during enrichment suppression. Either Lamda=1 or max selection between La_main and K_LA_FETTDELAY is output." VALUE 0x8075D08C FklWUb 1 raChrxc_kBtBrmb_FmDuEFa_n__aa0o 0 1 FORMAT "%3.0" /end CHARACTERISTIC
/begin CHARACTERISTIC S_BSRFMX "Filling limitation switch for component protection at the rich running limit" VALUE 0x8074F4CE FklWUb 1 raChrxc_kBtBrmb_FmDuEFa_n__aa0o 0 1 FORMAT "%3.0" /end CHARACTERISTIC
/begin CHARACTERISTIC S_PRAIL_GL_LA1 "Switch for activating the target rail pressure from the basic map in CILCN operating mode " VALUE 0x807504F2 FklWUb 255 raChrxc_kBtBrmb_FmDuEFa_n__aa0o 0 255 FORMAT "%3.0" /end CHARACTERISTIC
/begin CHARACTERISTIC TMOTAKR "Temperature threshold for engine temperature-dependent exhaust flap control" VALUE 0x80785F60 FklWUb 191.3 temp_ub_q0p75_o48 -48 143.3 FORMAT "%5.1" /end CHARACTERISTIC
/begin CHARACTERISTIC TVSTAKR "Delay time for triggering the exhaust flap after start" VALUE 0x80785F62 KwUw 655.35 t10msxs_ub_b2p55 0 655.35 FORMAT "%8.4" /end CHARACTERISTIC
/begin CHARACTERISTIC UniRockerEnterDetectionDelay___MGF_CC_PF "Delay for 'enter' button detection with UniRocker button configuration in Custom Code Menu, CCM" VALUE 0x807C2418 KwUw 655.35 camcxxd_bxlpdsa_Cshlhgc_sR_1a0o 0 5000 /end CHARACTERISTIC
/begin CHARACTERISTIC VMAXOVC "Vmax limit value, variant coded" VALUE 0x807A04BC KwUw 511.9922 vfzg_sw_q0p00781 0 511.9922 FORMAT "%8.4" /end CHARACTERISTIC
/begin CHARACTERISTIC VMINAKR "minimum vehicle speed for pulse output" VALUE 0x80785F64 FklWUb 318.8 vfzg_ub_q1p25 0 318.8 FORMAT "%5.1" /end CHARACTERISTIC
/begin CHARACTERISTIC VROHMAX "maximum allowed raw speed for signal range check" VALUE 0x8078C8BA KwUw 511.9922 vfzg_uw_b512 0 511.9922 FORMAT "%8.4" /end CHARACTERISTIC
/begin CHARACTERISTIC BMWext_lam_MinCptPronInit_Ca "Minimal lambda component protection in Init; vector element 0 = VorATL, 1=VorKat, 2=InKat" VAL_BLK 0x80717646 KwUw 15.999755859375 BumqDkc_mryszAa_EcglxAc_nR_4oa0 0 15.999755859375 NUMBER 3 MATRIX_DIM 3 1 1 /end CHARACTERISTIC
/begin CHARACTERISTIC Antilag_BMWtqe_gra_NMaxEngLimdDwn_T___MGF_CC_PF "Lower gradient limit for the max. permitted speed VM (1/min/10ms) (X-Axis does not switch, )" CURVE 0x807C2470 _REC_A1CUR_1_MBSE_U2_S1 65535 raChrxc_kBtBrmb_FmDuEFa_n__aa0o 0 60000 FORMAT "%5.0" MATRIX_DIM 10 1 1
 /begin AXIS_DESCR COM_AXIS BMWtqe_idx_SpdMaxLimr_ub raChrxc_kBtBrmb_FmDuEFa_n__aa0o 10 0 255 AXIS_PTS_REF Antilag_BMWtqe_gra_NMaxEngLimd_Ax___MGF_CC_PF FORMAT "%3.0" MONOTONY STRICT_INCREASE DEPOSIT ABSOLUTE /end AXIS_DESCR
/end CHARACTERISTIC
/begin CHARACTERISTIC Antilag_SafetyTorqueCap___MGF_CC_PF "Target torque during antilag safety shutdown" CURVE 0x807C08C0 _REC_A1CUR_1_MBSE_S2_S1 6553.5 BMW_dm_sw_q0p1_Nm -3000 3000 FORMAT "%6.1" MATRIX_DIM 18 1 1
 /begin AXIS_DESCR COM_AXIS Nkw_ref caoddzd_oAjpfzb_cAcEEha_1nR_oa0 18 -32768 32767 AXIS_PTS_REF BMWtqe_tqc_FlApplStg_Ax MONOTONY STRICT_INCREASE DEPOSIT ABSOLUTE /end AXIS_DESCR
/end CHARACTERISTIC
/begin CHARACTERISTIC BMWchas_st_OpmBasCatCold_T "Basic catalyst heating mode wish while catalyst is cold" CURVE 0x807588E4 _REC_A1CUR_1_MBSE_U1_S1 3 wDvwtyd_Bhgozed_DCekdfb_nsttFSS 0 3
 /begin AXIS_DESCR COM_AXIS BMWchst_t_Eng_sw DchEpAd_DBCFgoa_Ckhahgc_q__aoa0 8 -327.68 327.67 AXIS_PTS_REF BMWchas_st_OpmBasCatCold_Ax FORMAT "%6.2" MONOTONY MON_INCREASE DEPOSIT ABSOLUTE /end AXIS_DESCR
/end CHARACTERISTIC
/begin CHARACTERISTIC BMWchas_st_OpmBasLiOff_T "Basic catalyst heating mode wish after catalyst light-off has been reached" CURVE 0x807588DC _REC_A1CUR_1_MBSE_U1_S1 3 wDvwtyd_Bhgozed_DCekdfb_nsttFSS 0 3
 /begin AXIS_DESCR COM_AXIS BMWchst_t_Eng_sw DchEpAd_DBCFgoa_Ckhahgc_q__aoa0 8 -327.68 327.67 AXIS_PTS_REF BMWchas_st_OpmBasLiOff_Ax FORMAT "%6.2" MONOTONY MON_INCREASE DEPOSIT ABSOLUTE /end AXIS_DESCR
/end CHARACTERISTIC
/begin CHARACTERISTIC BMWchas_tq_ResExhFlpClsd_T "Torque reserve from which the exhaust flap should be closed for acoustic reasons." CURVE 0x807391C0 _REC_A1CUR_1_MBSE_S2_S1 6553.5 BMW_dm_sw_q0p1_Nm -3276.8 3276.7 FORMAT "%6.1"
 /begin AXIS_DESCR COM_AXIS Nkw caoddzd_oAjpfzb_cAcEEha_1nR_oa0 8 -32768 32767 AXIS_PTS_REF BMWchas_tq_ResExhFlpClsd_Ax FORMAT "%5.0" MONOTONY STRICT_INCREASE DEPOSIT ABSOLUTE /end AXIS_DESCR
/end CHARACTERISTIC
/begin CHARACTERISTIC BMWgpfheat_tq_ResExhFlpClsd_T "Torque reserve from which the exhaust flap should be closed for acoustic reasons." CURVE 0x8071A93C _REC_A1CUR_1_MBSE_S2_S1 6553.5 BMW_dm_sw_q0p1_Nm -3276.8 3276.7 FORMAT "%6.1"
 /begin AXIS_DESCR COM_AXIS Nkw caoddzd_oAjpfzb_cAcEEha_1nR_oa0 8 -32768 32767 AXIS_PTS_REF BMWgpfheat_tq_ResExhFlpClsd_Ax FORMAT "%5.0" MONOTONY STRICT_INCREASE DEPOSIT ABSOLUTE /end AXIS_DESCR
/end CHARACTERISTIC
/begin CHARACTERISTIC BMWinjafs_fac_RatAirMax_T "Characteristic curve upper limit Rf for L-stoich adaptation" CURVE 0x8071374E _REC_A1CUR_1_MBSE_S2_S1 655.35 ubqeuic_jteCkzd_CDglhgc_nR_1a0o -327.68 327.67
 /begin AXIS_DESCR COM_AXIS Nkw caoddzd_oAjpfzb_cAcEEha_1nR_oa0 6 -32768 32767 AXIS_PTS_REF BMWinjafs_fac_RatAirMax_Ax FORMAT "%5.0" MONOTONY STRICT_INCREASE DEPOSIT ABSOLUTE /end AXIS_DESCR
/end CHARACTERISTIC
/begin CHARACTERISTIC BMWlpa_n_EfpEngStrtPRail_T "EKP speed specification start rail pressure" CURVE 0x80719718 _REC_A1CUR_1_MBSE_U2_S1 65535 caoddzd_oAjpfzb_cAcEEha_1nR_oa0 0 65535 FORMAT "%5.0"
 /begin AXIS_DESCR COM_AXIS BMWlpi_p_HiPAbs bukAcFc_hypjrAa_CBhougc_MCRooa0 2 0 131.07 AXIS_PTS_REF BMWlpa_n_EfpEngStrtPRail_Ax MONOTONY STRICT_INCREASE DEPOSIT ABSOLUTE /end AXIS_DESCR
/end CHARACTERISTIC
/begin CHARACTERISTIC BMWlpa_rat_EfpPwm_T "EKP speed control in PWM" CURVE 0x8071965C _REC_A1CUR_1_MBSE_S2_S1 655.35 ubqeuic_jteCkzd_CDglhgc_nR_1a0o -327.68 327.67 FORMAT "%5.2"
 /begin AXIS_DESCR COM_AXIS BMWlpa_n_Efp_uw caoddzd_oAjpfzb_cAcEEha_1nR_oa0 6 0 65535 AXIS_PTS_REF BMWlpa_rat_EfpPwm_Ax FORMAT "%5.0" MONOTONY STRICT_INCREASE DEPOSIT ABSOLUTE /end AXIS_DESCR
/end CHARACTERISTIC
/begin CHARACTERISTIC BMWlpa_volf_FuMaxBoosCtlr_T "LoPAsst fuel volume flow during boost tracking (characteristic curve)" CURVE 0x8073C36E _REC_A1CUR_1_MBSE_S2_S1 655.35 zBcBzad_vmoivka_mFzjCgc_lCRooa0 -327.68 327.67
 /begin AXIS_DESCR COM_AXIS BMWlpsc_p_DeSp_sw rgduxyd_mlihaBb_gsCghzb_bCRa0a0 6 -32.768 32.767 AXIS_PTS_REF BMWlpa_volf_FuMaxBoosCtlr_Ax FORMAT "%5.3" MONOTONY STRICT_INCREASE DEPOSIT ABSOLUTE /end AXIS_DESCR
/end CHARACTERISTIC
/begin CHARACTERISTIC BMWlpsc_p_HppMax_T "Characteristic curve Maximum pressure before HDP depending on flow" CURVE 0x8073C628 _REC_A1CUR_1_MBSE_U2_S1 65.535 rgduxyd_mlihaBb_gsCghzb_bCRa0a0 0 65.535 FORMAT "%5.3"
 /begin AXIS_DESCR COM_AXIS BMWlpi_volf_Fu_sw zBcBzad_vmoivka_mFzjCgc_lCRooa0 4 -327.68 327.67 AXIS_PTS_REF BMWlpsc_p_HppMax_Ax FORMAT "%5.2" MONOTONY STRICT_INCREASE DEPOSIT ABSOLUTE /end AXIS_DESCR
/end CHARACTERISTIC
/begin CHARACTERISTIC BMWlpsd_p_RailDifMax_T "Rail pressure deviation threshold" CURVE 0x80719F62 _REC_A1CUR_1_MBSE_U2_S1 131.07 bukAcFc_hypjrAa_CBhougc_MCRooa0 0 131.07
 /begin AXIS_DESCR COM_AXIS BMWlpi_p_HiPAbsSp bukAcFc_hypjrAa_CBhougc_MCRooa0 4 0 131.07 AXIS_PTS_REF BMWlpsd_p_RailDifMax_Ax MONOTONY STRICT_INCREASE DEPOSIT ABSOLUTE /end AXIS_DESCR
/end CHARACTERISTIC
/begin CHARACTERISTIC BMWls_pct_FiMaxCondRisk_T "Maximum filling above speed due to risk of condensate on the intercooler" CURVE 0x8071E43E _REC_A1CUR_1_MBSE_S2_S1 655.35 CgkBooc_wkiDfEd_Czglhgc_fR_1a0o -327.68 327.67 FORMAT "%7.2"
 /begin AXIS_DESCR COM_AXIS NO_INPUT_QUANTITY caoddzd_oAjpfzb_cAcEEha_1nR_oa0 12 -32768 32767 AXIS_PTS_REF BMWls_pct_FiMaxCondRisk_Ax FORMAT "%5.0" MONOTONY MON_INCREASE DEPOSIT ABSOLUTE /end AXIS_DESCR
/end CHARACTERISTIC
/begin CHARACTERISTIC BMWtchctr_fac_pwr_CompLimPctl_T "Factor for pre-control up to which the controller with the P and D component can increase the compressor output during operation via pre-control" CURVE 0x8074294E _REC_A1CUR_1_MBSE_U2_S1 1.99996948242188 Bhvfwhc_bigEubd_BBEupBd_nR_3oa0 0 1.99996948242188 FORMAT "%11.4"
 /begin AXIS_DESCR COM_AXIS BMWtchsp_mf_CmprNorm_uw CByjozc_eCmpBAb_pljBAmd_k__0oa0 6 0 2047.96875 AXIS_PTS_REF BMWtchctr_fac_pwr_CompLimPctl_Ax FORMAT "%10.3" MONOTONY STRICT_INCREASE DEPOSIT ABSOLUTE /end AXIS_DESCR
/end CHARACTERISTIC
/begin CHARACTERISTIC BMWtchctr_rat_p_ComprLimPctl_T "Minimum limit of the target boost factor for aborting boost pressure control when the target pressure setting drops" CURVE 0x80742936 _REC_A1CUR_1_MBSE_U2_S1 7.9998779296875 acriqBc_tfkBqod_ocgjxzc_nR_8oa0 0 7.9998779296875 FORMAT "%10.3"
 /begin AXIS_DESCR COM_AXIS BMWtchsp_mf_CmprNorm_uw CByjozc_eCmpBAb_pljBAmd_k__0oa0 12 0 2047.96875 AXIS_PTS_REF BMWtchctr_rat_p_ComprLimPctl_Ax FORMAT "%10.3" MONOTONY STRICT_INCREASE DEPOSIT ABSOLUTE /end AXIS_DESCR
/end CHARACTERISTIC
/begin CHARACTERISTIC BMWtchob_fac_tq_Delt_T "Reduction factor overboost torque via TANS" CURVE 0x80724A7C _REC_A1CUR_1_MBSE_U2_S1 0.999984741210938 FzbmlAa_gCtylrb_ckCqxAc_nR_6oa0 0 0.999984741210938 FORMAT "%6.4"
 /begin AXIS_DESCR COM_AXIS Tans BMW_q0p1_degC 4 -3276.8 3276.7 AXIS_PTS_REF BMWtchob_fac_tq_Delt_Ax FORMAT "%6.1" MONOTONY STRICT_INCREASE DEPOSIT ABSOLUTE /end AXIS_DESCR
/end CHARACTERISTIC
/begin CHARACTERISTIC BMWtchsp_fac_FilPRatCmpr_T "Filter constant for target pressure ratio" CURVE 0x80724F1C _REC_A1CUR_1_MBSE_U2_S1 0.999984741210938 FzbmlAa_gCtylrb_ckCqxAc_nR_6oa0 0 0.999984741210938 FORMAT "%14.5"
 /begin AXIS_DESCR COM_AXIS BMWtchsp_mf_CmprNorm_uw CByjozc_eCmpBAb_pljBAmd_k__0oa0 4 0 2047.96875 AXIS_PTS_REF BMWtchsp_fac_FilPRatCmpr_Ax FORMAT "%10.3" MONOTONY STRICT_INCREASE DEPOSIT ABSOLUTE /end AXIS_DESCR
/end CHARACTERISTIC
/begin CHARACTERISTIC BMWtchsp_fac_mf_FilCmprNorm_T "Filter constant for corrected target mass flow" CURVE 0x80724FEE _REC_A1CUR_1_MBSE_U2_S1 0.999984741210938 FzbmlAa_gCtylrb_ckCqxAc_nR_6oa0 0 0.999984741210938 FORMAT "%14.5"
 /begin AXIS_DESCR COM_AXIS NO_INPUT_QUANTITY CByjozc_eCmpBAb_pljBAmd_k__0oa0 4 0 2047.96875 AXIS_PTS_REF BMWtchsp_fac_mf_FilCmprNorm_Ax FORMAT "%10.3" MONOTONY STRICT_INCREASE DEPOSIT ABSOLUTE /end AXIS_DESCR
/end CHARACTERISTIC
/begin CHARACTERISTIC BMWtchsp_rat_p_CmprPmp_T "KL_FPLDPUMP" CURVE 0x80724EDC _REC_A1CUR_1_MBSE_U2_S1 3.99993896484375 ilxsavd_hkzmBfc_lAzCpAb_nR_1oa0 0 3.99993896484375
 /begin AXIS_DESCR COM_AXIS BMWtchsp_mf_CmprNorm_uw CByjozc_eCmpBAb_pljBAmd_k__0oa0 8 0 2047.96875 AXIS_PTS_REF BMWtchsp_rat_p_CmprPmp_Ax FORMAT "%10.3" MONOTONY STRICT_INCREASE DEPOSIT ABSOLUTE /end AXIS_DESCR
/end CHARACTERISTIC
/begin CHARACTERISTIC BMWtchsp_rf_Liho_T "Limitation Rf for Atl variants in case of error (b_atlerr_md)" CURVE 0x80724ED0 _REC_A1CUR_1_MBSE_S2_S1 655.35 CgkBooc_wkiDfEd_Czglhgc_fR_1a0o -327.68 327.67
 /begin AXIS_DESCR COM_AXIS NO_INPUT_QUANTITY caoddzd_oAjpfzb_cAcEEha_1nR_oa0 6 -32768 32767 AXIS_PTS_REF BMWtchsp_rf_Liho_Ax FORMAT "%5.0" MONOTONY STRICT_INCREASE DEPOSIT ABSOLUTE /end AXIS_DESCR
/end CHARACTERISTIC
/begin CHARACTERISTIC BMWtqe_b_Clu4NoiseDeac_T "Map for deactivation of B_sound_hs depending on Status_usecase_antr" CURVE 0x80752CF7 _REC_A1CUR_1_MBSE_U1_S1 1 fgjpsvb_fDqjECa_acgrbDd_n_dae__ 0 1
 /begin AXIS_DESCR COM_AXIS Status_usecase_antr raChrxc_kBtBrmb_FmDuEFa_n__aa0o 12 0 11 AXIS_PTS_REF BMWtqe_st_SptDet4NoiseAcvn_Ax FORMAT "%6.0" MONOTONY STRICT_INCREASE DEPOSIT ABSOLUTE /end AXIS_DESCR
/end CHARACTERISTIC
/begin CHARACTERISTIC FuPHi_FlmMaxpl_T "Characteristic curve maximum relative fuel mass for plausibility of the high pressure system" CURVE 0x8078BF46 RB_Curve_S16_U16_Static 3071.953 rel_q0p046875 0 3071.953 FORMAT "%8.3"
 /begin AXIS_DESCR STD_AXIS Epm_nEng EngN 4 -16384 16383.5 FORMAT "%8.2" DEPOSIT ABSOLUTE /end AXIS_DESCR
/end CHARACTERISTIC
/begin CHARACTERISTIC FWIHDR "Weighting factor PI controller parameter HDR; I-part" CURVE 0x80793F26 Cur_Xu8Wu8 1.992188 fak_ub_b2 0 1.992188 FORMAT "%8.6"
 /begin AXIS_DESCR STD_AXIS FupHi_nEngLResHDR nmot_q40 8 0 10200 FORMAT "%5.0" DEPOSIT ABSOLUTE /end AXIS_DESCR
/end CHARACTERISTIC
/begin CHARACTERISTIC KL_FLD_KKS "Requirement to switch the KKS as a function of the filtered mean value of the throttle valve pressure" CURVE 0x8075B83C _REC_A1CUR_1_MBSE_U1_S1 10 raChrxc_kBtBrmb_FmDuEFa_n__aa0o 0 10
 /begin AXIS_DESCR COM_AXIS F_pld_wm_f acriqBc_tfkBqod_ocgjxzc_nR_8oa0 6 0 7.9998779296875 AXIS_PTS_REF AXX_KL_FLD_KKS MONOTONY STRICT_INCREASE DEPOSIT ABSOLUTE /end AXIS_DESCR
/end CHARACTERISTIC
/begin CHARACTERISTIC KL_FRFMXBS "Characteristic curve factor filling intervention at BS at grease running limit" CURVE 0x807177EC _REC_A1CUR_1_MBSE_U2_S1 1.99996948242188 Bhvfwhc_bigEubd_BBEupBd_nR_3oa0 0 1.99996948242188 FORMAT "%14.5"
 /begin AXIS_DESCR COM_AXIS NO_INPUT_QUANTITY Bhvfwhc_bigEubd_BBEupBd_nR_3oa0 4 0 1.99996948242188 AXIS_PTS_REF AXX_KL_FRFMXBS FORMAT "%14.5" MONOTONY STRICT_INCREASE DEPOSIT ABSOLUTE /end AXIS_DESCR
/end CHARACTERISTIC
/begin CHARACTERISTIC KL_LA_SBL "Characteristic Lambda specification thrust bubbling" CURVE 0x80748CD6 _REC_A1CUR_1_MBSE_U2_S1 15.999755859375 BumqDkc_mryszAa_EcglxAc_nR_4oa0 0 15.999755859375 FORMAT "%9.4"
 /begin AXIS_DESCR COM_AXIS Nkw caoddzd_oAjpfzb_cAcEEha_1nR_oa0 6 -32768 32767 AXIS_PTS_REF AXX_KL_LA_SBL FORMAT "%5.0" MONOTONY STRICT_INCREASE DEPOSIT ABSOLUTE /end AXIS_DESCR
/end CHARACTERISTIC
/begin CHARACTERISTIC KL_LAMX "maximum relative filling" CURVE 0x8071E506 _REC_A1CUR_1_MBSE_S2_S1 327.67 CgkBooc_wkiDfEd_Czglhgc_fR_1a0o 0 327.67 FORMAT "%7.2"
 /begin AXIS_DESCR COM_AXIS NO_INPUT_QUANTITY caoddzd_oAjpfzb_cAcEEha_1nR_oa0 18 -32768 32767 AXIS_PTS_REF AXX_KL_LAMX FORMAT "%5.0" MONOTONY MON_INCREASE DEPOSIT ABSOLUTE /end AXIS_DESCR
/end CHARACTERISTIC
/begin CHARACTERISTIC KL_NEL_TMOT "E-fan speed requirement by the motor temperature" CURVE 0x8075B5DA _REC_A1CUR_1_MBSE_U1_S1 99.609375 BMW_q0p3906_PERC 0 99.609375
 /begin AXIS_DESCR COM_AXIS Dtmot_tkwsoll_f DchEpAd_DBCFgoa_Ckhahgc_q__aoa0 12 -327.68 327.67 AXIS_PTS_REF AXX_KL_NEL_TMOT FORMAT "%6.2" MONOTONY STRICT_INCREASE DEPOSIT ABSOLUTE /end AXIS_DESCR
/end CHARACTERISTIC
/begin CHARACTERISTIC KL_NKW_SOUND_MN "Min. speed threshold for activating BMWtqe_b_NoisePre_bo depending on the gear" CURVE 0x8072AD44 _REC_A1CUR_1_MBSE_S2_S1 65535 caoddzd_oAjpfzb_cAcEEha_1nR_oa0 -32768 32767
 /begin AXIS_DESCR COM_AXIS Gangi raChrxc_kBtBrmb_FmDuEFa_n__aa0o 8 0 255 AXIS_PTS_REF AXX_KL_NKW_SOUND_MNMX FORMAT "%3.0" MONOTONY STRICT_INCREASE DEPOSIT ABSOLUTE /end AXIS_DESCR
/end CHARACTERISTIC
/begin CHARACTERISTIC KL_NKW_SOUND_MX "Max. speed threshold for activating BMWtqe_b_NoisePre_bo depending on the gear" CURVE 0x8072AD34 _REC_A1CUR_1_MBSE_S2_S1 65535 caoddzd_oAjpfzb_cAcEEha_1nR_oa0 -32768 32767
 /begin AXIS_DESCR COM_AXIS Gangi raChrxc_kBtBrmb_FmDuEFa_n__aa0o 8 0 255 AXIS_PTS_REF AXX_KL_NKW_SOUND_MNMX FORMAT "%3.0" MONOTONY STRICT_INCREASE DEPOSIT ABSOLUTE /end AXIS_DESCR
/end CHARACTERISTIC
/begin CHARACTERISTIC KL_RF_MAX "Characteristic maximum permissible filling over speed" CURVE 0x8071E05E _REC_A1CUR_1_MBSE_S2_S1 655.35 CgkBooc_wkiDfEd_Czglhgc_fR_1a0o -327.68 327.67 FORMAT "%7.2"
 /begin AXIS_DESCR COM_AXIS NO_INPUT_QUANTITY caoddzd_oAjpfzb_cAcEEha_1nR_oa0 12 -32768 32767 AXIS_PTS_REF AXX_KL_RF_MAX FORMAT "%5.0" MONOTONY MON_INCREASE DEPOSIT ABSOLUTE /end AXIS_DESCR
/end CHARACTERISTIC
/begin CHARACTERISTIC KL_RF_MAX_UESP "Characteristic of the maximum permissible filling over the speed when flushing" CURVE 0x8071E046 _REC_A1CUR_1_MBSE_S2_S1 655.35 CgkBooc_wkiDfEd_Czglhgc_fR_1a0o -327.68 327.67 FORMAT "%7.2"
 /begin AXIS_DESCR COM_AXIS NO_INPUT_QUANTITY caoddzd_oAjpfzb_cAcEEha_1nR_oa0 12 -32768 32767 AXIS_PTS_REF AXX_KL_RF_MAX_UESP FORMAT "%5.0" MONOTONY MON_INCREASE DEPOSIT ABSOLUTE /end AXIS_DESCR
/end CHARACTERISTIC
/begin CHARACTERISTIC KL_RFMIN_KRSTSYS "Minimum charge for charge limitation from injection monitoring" CURVE 0x8073ABC4 _REC_A1CUR_1_MBSE_S2_S1 655.35 CgkBooc_wkiDfEd_Czglhgc_fR_1a0o -327.68 327.67 FORMAT "%6.2"
 /begin AXIS_DESCR COM_AXIS Nkw caoddzd_oAjpfzb_cAcEEha_1nR_oa0 8 -32768 32767 AXIS_PTS_REF AXX_KL_RFMIN_KRSTSYS FORMAT "%5.0" MONOTONY STRICT_INCREASE DEPOSIT ABSOLUTE /end AXIS_DESCR
/end CHARACTERISTIC
/begin CHARACTERISTIC KL_RFTNLMX "Maximum nonlinear Drf when calculating Ps_soll_sm_nl" CURVE 0x8071C804 _REC_A1CUR_1_MBSE_S2_S1 327.67 CgkBooc_wkiDfEd_Czglhgc_fR_1a0o 0 327.67 FORMAT "%7.2"
 /begin AXIS_DESCR COM_AXIS NO_INPUT_QUANTITY caoddzd_oAjpfzb_cAcEEha_1nR_oa0 10 0 32767 AXIS_PTS_REF AXX_KL_RFTNLMX FORMAT "%5.0" MONOTONY MON_INCREASE DEPOSIT ABSOLUTE /end AXIS_DESCR
/end CHARACTERISTIC
/begin CHARACTERISTIC KL_RFVHUBDYNKOR "Characteristic curve Rfv_hub specification at F_rfv_dyn=0" CURVE 0x8071C90E _REC_A1CUR_1_MBSE_S2_S1 327.67 CgkBooc_wkiDfEd_Czglhgc_fR_1a0o 0 327.67 FORMAT "%7.2"
 /begin AXIS_DESCR COM_AXIS NO_INPUT_QUANTITY caoddzd_oAjpfzb_cAcEEha_1nR_oa0 20 -32768 32767 AXIS_PTS_REF AXX_KL_RFVHUBDYNKOR FORMAT "%5.0" MONOTONY MON_INCREASE DEPOSIT ABSOLUTE /end AXIS_DESCR
/end CHARACTERISTIC
/begin CHARACTERISTIC KL_T_IKAT_SOUND_MX "Temperature threshold cat for thrust bubble release " CURVE 0x8072AD2C _REC_A1CUR_1_MBSE_S2_S1 6553.5 BMW_q0p1_degC -3276.8 3276.7
 /begin AXIS_DESCR COM_AXIS Anz_b_sound raChrxc_kBtBrmb_FmDuEFa_n__aa0o 4 0 255 AXIS_PTS_REF AXX_KL_T_IKAT_SOUND_MX FORMAT "%5.0" MONOTONY STRICT_INCREASE DEPOSIT ABSOLUTE /end AXIS_DESCR
/end CHARACTERISTIC
/begin CHARACTERISTIC KL_TD_SOUND_MX "KL_TD_SOUND_MX" CURVE 0x8072AD6E _REC_A1CUR_1_MBSE_U2_S1 655.35 camcxxd_bxlpdsa_Cshlhgc_sR_1a0o 0 655.35
 /begin AXIS_DESCR COM_AXIS V_fzg_plaus jgbhAma_smpAegb_hlEBAmd_k__0oa0 4 -655.36 655.34 AXIS_PTS_REF AXX_KL_TD_SOUND_MX FORMAT "%6.2" MONOTONY STRICT_INCREASE DEPOSIT ABSOLUTE /end AXIS_DESCR
/end CHARACTERISTIC
/begin CHARACTERISTIC KL_TD_SOUND_MX_FREI "Sound duration freely applicable" CURVE 0x8072AD66 _REC_A1CUR_1_MBSE_U2_S1 655.35 camcxxd_bxlpdsa_Cshlhgc_sR_1a0o 0 655.35
 /begin AXIS_DESCR COM_AXIS V_fzg_plaus jgbhAma_smpAegb_hlEBAmd_k__0oa0 4 -655.36 655.34 AXIS_PTS_REF AXX_KL_TD_SOUND_MX_FREI FORMAT "%6.2" MONOTONY STRICT_INCREASE DEPOSIT ABSOLUTE /end AXIS_DESCR
/end CHARACTERISTIC
/begin CHARACTERISTIC KL_TD_SOUND_MX_SPORT "KL_TD_SOUND_MX_SPORT" CURVE 0x8072AD5E _REC_A1CUR_1_MBSE_U2_S1 655.35 camcxxd_bxlpdsa_Cshlhgc_sR_1a0o 0 655.35
 /begin AXIS_DESCR COM_AXIS V_fzg_plaus jgbhAma_smpAegb_hlEBAmd_k__0oa0 4 -655.36 655.34 AXIS_PTS_REF AXX_KL_TD_SOUND_MX_SPORT FORMAT "%6.2" MONOTONY STRICT_INCREASE DEPOSIT ABSOLUTE /end AXIS_DESCR
/end CHARACTERISTIC
/begin CHARACTERISTIC KL_TKW_HI "Coolant target temperature in High operating mode depending on the ambient temperature" CURVE 0x80733CAA _REC_A1CUR_1_MBSE_S2_S1 655.35 DchEpAd_DBCFgoa_Ckhahgc_q__aoa0 -327.68 327.67
 /begin AXIS_DESCR COM_AXIS Tumg_wm BMW_q0p1_degC 4 -3276.8 3276.7 AXIS_PTS_REF AXX_KL_TKW_HI MONOTONY STRICT_INCREASE DEPOSIT ABSOLUTE /end AXIS_DESCR
/end CHARACTERISTIC
/begin CHARACTERISTIC KL_TKW_NO "Target coolant temperature in normal operating mode depending on the ambient temperature" CURVE 0x80733CA2 _REC_A1CUR_1_MBSE_S2_S1 655.35 DchEpAd_DBCFgoa_Ckhahgc_q__aoa0 -327.68 327.67
 /begin AXIS_DESCR COM_AXIS Tumg_wm BMW_q0p1_degC 4 -3276.8 3276.7 AXIS_PTS_REF AXX_KL_TKW_NO MONOTONY STRICT_INCREASE DEPOSIT ABSOLUTE /end AXIS_DESCR
/end CHARACTERISTIC
/begin CHARACTERISTIC KLFVSTOTF "Offset correction of the pre-control MSV depending on fuel temperature" CURVE 0x807A05EB Cur_Xu8Wu8 1.992188 fak_ub_b2 0 1.992188 FORMAT "%8.6"
 /begin AXIS_DESCR STD_AXIS tfuelsq_msg temp_ub_q0p75_o48 3 -48 143.3 FORMAT "%5.1" DEPOSIT ABSOLUTE /end AXIS_DESCR
/end CHARACTERISTIC
/begin CHARACTERISTIC KLIHDR "I-component of the rail pressure regulator" CURVE 0x80793F3C KwUw 7.999878 fak_sw_b4 0 7.999878 FORMAT "%8.6"
 /begin AXIS_DESCR COM_AXIS FuPHi_pHpRglnDeLoc RBPtCel_p_0p002_1 6 -65.536 65.534 AXIS_PTS_REF SPD06HDSW FORMAT "%8.5" DEPOSIT ABSOLUTE /end AXIS_DESCR
/end CHARACTERISTIC
/begin CHARACTERISTIC KLPHDR "P-component of the rail pressure regulator" CURVE 0x80793F48 KwUw 7.999878 fak_sw_b4 0 7.999878 FORMAT "%8.6"
 /begin AXIS_DESCR COM_AXIS FuPHi_pHpRglnDeLoc RBPtCel_p_0p002_1 6 -65.536 65.534 AXIS_PTS_REF SPD06HDSW FORMAT "%8.5" DEPOSIT ABSOLUTE /end AXIS_DESCR
/end CHARACTERISTIC
/begin CHARACTERISTIC KLPHDRTF "Factor P-component HDR as a function of temperature" CURVE 0x80793F54 Cur_Xu8Wu8 1.992188 fak_ub_b2 0 1.992188 FORMAT "%8.6"
 /begin AXIS_DESCR STD_AXIS tfuelsq_msg temp_ub_q0p75_o48 4 -48 143.3 FORMAT "%5.1" DEPOSIT ABSOLUTE /end AXIS_DESCR
/end CHARACTERISTIC
/begin CHARACTERISTIC KLVSTMSVG "Gain factor feedforward control MSV" CURVE 0x807A05F2 KwUw 3.999939 fak_q6p1035Em5 0 3.999939 FORMAT "%8.6"
 /begin AXIS_DESCR COM_AXIS NO_INPUT_QUANTITY nmot_sw_q0p25 8 0 16383.75 AXIS_PTS_REF SNM08HDUW FORMAT "%8.2" DEPOSIT ABSOLUTE /end AXIS_DESCR
/end CHARACTERISTIC
/begin CHARACTERISTIC VSEKPMXN "Characteristic curve of fuel target volume flow at full load depending on the speed" CURVE 0x80788785 Cur_Xu8Wu8 255 RBPtCel_vol_1p0_1 0 255 FORMAT "%5.1"
 /begin AXIS_DESCR STD_AXIS NO_INPUT_QUANTITY nmot_q40 5 0 10200 FORMAT "%5.0" DEPOSIT ABSOLUTE /end AXIS_DESCR
/end CHARACTERISTIC
/begin CHARACTERISTIC AKRGRCC "Characteristic map for exhaust flap control depending on the gangsist and nmot, with the convertible top closed" MAP 0x807847FA Map_Xs16Ys16Ws16 400 ___MGF_CC_Pedal_x100_d256 -200 200 FORMAT "%8.4"
 /begin AXIS_DESCR STD_AXIS gangakr DEZ 10 0 127 FORMAT "%8.4" DEPOSIT ABSOLUTE /end AXIS_DESCR
 /begin AXIS_DESCR STD_AXIS Epm_nEngLRes nmot_q40 12 0 10200 FORMAT "%8.2" DEPOSIT ABSOLUTE /end AXIS_DESCR
/end CHARACTERISTIC
/begin CHARACTERISTIC AKRGRCC_VAR1 "Map for exhaust flap control depending on the gangsist and nmot, with the convertible top closed and the sports button activated" MAP 0x807851D2 Map_Xs16Ys16Ws16 400 ___MGF_CC_Pedal_x100_d256 -200 200 FORMAT "%8.4"
 /begin AXIS_DESCR STD_AXIS gangakr DEZ 6 0 127 FORMAT "%8.4" DEPOSIT ABSOLUTE /end AXIS_DESCR
 /begin AXIS_DESCR STD_AXIS Epm_nEngLRes nmot_q40 8 0 10200 FORMAT "%8.2" DEPOSIT ABSOLUTE /end AXIS_DESCR
/end CHARACTERISTIC
/begin CHARACTERISTIC AKRGRCC_VAR2 "Map for exhaust flap control depending on the gangsist and nmot, with the convertible top closed and the sports button activated" MAP 0x80785252 Map_Xs16Ys16Ws16 400 ___MGF_CC_Pedal_x100_d256 -200 200 FORMAT "%8.4"
 /begin AXIS_DESCR STD_AXIS gangakr DEZ 6 0 127 FORMAT "%8.4" DEPOSIT ABSOLUTE /end AXIS_DESCR
 /begin AXIS_DESCR STD_AXIS Epm_nEngLRes nmot_q40 8 0 10200 FORMAT "%8.2" DEPOSIT ABSOLUTE /end AXIS_DESCR
/end CHARACTERISTIC
/begin CHARACTERISTIC AKRGRCC_VAR3 "Map for exhaust flap control depending on the gangsist and nmot, with the convertible top closed and the sports button activated" MAP 0x807852D2 Map_Xs16Ys16Ws16 400 ___MGF_CC_Pedal_x100_d256 -200 200 FORMAT "%8.4"
 /begin AXIS_DESCR STD_AXIS gangakr DEZ 6 0 127 FORMAT "%8.4" DEPOSIT ABSOLUTE /end AXIS_DESCR
 /begin AXIS_DESCR STD_AXIS Epm_nEngLRes nmot_q40 8 0 10200 FORMAT "%8.2" DEPOSIT ABSOLUTE /end AXIS_DESCR
/end CHARACTERISTIC
/begin CHARACTERISTIC AKRGRCCAT "Characteristic map for exhaust flap control depending on the gangsist and nmot (DKG or AT transmission), with the convertible top closed" MAP 0x8078491A Map_Xs16Ys16Ws16 400 ___MGF_CC_Pedal_x100_d256 -200 200 FORMAT "%8.4"
 /begin AXIS_DESCR STD_AXIS gangakr DEZ 10 0 127 FORMAT "%8.4" DEPOSIT ABSOLUTE /end AXIS_DESCR
 /begin AXIS_DESCR STD_AXIS Epm_nEngLRes nmot_q40 12 0 10200 FORMAT "%8.2" DEPOSIT ABSOLUTE /end AXIS_DESCR
/end CHARACTERISTIC
/begin CHARACTERISTIC AKRGRCCAT_VAR1 "Characteristic map for exhaust flap control depending on the gangsist and nmot (DKG or AT transmission), with the convertible top closed" MAP 0x80784D46 Map_Xs16Ys16Ws16 400 ___MGF_CC_Pedal_x100_d256 -200 200 FORMAT "%8.4"
 /begin AXIS_DESCR STD_AXIS gangakr DEZ 8 0 127 FORMAT "%8.4" DEPOSIT ABSOLUTE /end AXIS_DESCR
 /begin AXIS_DESCR STD_AXIS Epm_nEngLRes nmot_q40 8 0 10200 FORMAT "%8.2" DEPOSIT ABSOLUTE /end AXIS_DESCR
/end CHARACTERISTIC
/begin CHARACTERISTIC AKRGRCCAT_VAR2 "Characteristic map for exhaust flap control depending on the gangsist and nmot (DKG or AT transmission), with the convertible top closed" MAP 0x80784DEA Map_Xs16Ys16Ws16 400 ___MGF_CC_Pedal_x100_d256 -200 200 FORMAT "%8.4"
 /begin AXIS_DESCR STD_AXIS gangakr DEZ 8 0 127 FORMAT "%8.4" DEPOSIT ABSOLUTE /end AXIS_DESCR
 /begin AXIS_DESCR STD_AXIS Epm_nEngLRes nmot_q40 8 0 10200 FORMAT "%8.2" DEPOSIT ABSOLUTE /end AXIS_DESCR
/end CHARACTERISTIC
/begin CHARACTERISTIC AKRGRCCAT_VAR3 "Characteristic map for exhaust flap control depending on the gangsist and nmot (DKG or AT transmission), with the convertible top closed" MAP 0x80784E8E Map_Xs16Ys16Ws16 400 ___MGF_CC_Pedal_x100_d256 -200 200 FORMAT "%8.4"
 /begin AXIS_DESCR STD_AXIS gangakr DEZ 8 0 127 FORMAT "%8.4" DEPOSIT ABSOLUTE /end AXIS_DESCR
 /begin AXIS_DESCR STD_AXIS Epm_nEngLRes nmot_q40 8 0 10200 FORMAT "%8.2" DEPOSIT ABSOLUTE /end AXIS_DESCR
/end CHARACTERISTIC
/begin CHARACTERISTIC AKRGRCCATM "Map for exhaust flap control depending on the gangsist and nmot (DKG or AT transmission), with the convertible top closed and the sports button activated" MAP 0x80784A3A Map_Xs16Ys16Ws16 400 ___MGF_CC_Pedal_x100_d256 -200 200 FORMAT "%8.4"
 /begin AXIS_DESCR STD_AXIS gangakr DEZ 10 0 127 FORMAT "%8.4" DEPOSIT ABSOLUTE /end AXIS_DESCR
 /begin AXIS_DESCR STD_AXIS Epm_nEngLRes nmot_q40 12 0 10200 FORMAT "%8.2" DEPOSIT ABSOLUTE /end AXIS_DESCR
/end CHARACTERISTIC
/begin CHARACTERISTIC AKRGRCCATM_VAR1 "Map for exhaust flap control depending on the gangsist and nmot (DKG or AT transmission), with the convertible top closed and the sports button activated" MAP 0x80784B5A Map_Xs16Ys16Ws16 400 ___MGF_CC_Pedal_x100_d256 -200 200 FORMAT "%8.4"
 /begin AXIS_DESCR STD_AXIS gangakr DEZ 8 0 127 FORMAT "%8.4" DEPOSIT ABSOLUTE /end AXIS_DESCR
 /begin AXIS_DESCR STD_AXIS Epm_nEngLRes nmot_q40 8 0 10200 FORMAT "%8.2" DEPOSIT ABSOLUTE /end AXIS_DESCR
/end CHARACTERISTIC
/begin CHARACTERISTIC AKRGRCCATM_VAR2 "Map for exhaust flap control depending on the gangsist and nmot (DKG or AT transmission), with the convertible top closed and the sports button activated" MAP 0x80784BFE Map_Xs16Ys16Ws16 400 ___MGF_CC_Pedal_x100_d256 -200 200 FORMAT "%8.4"
 /begin AXIS_DESCR STD_AXIS gangakr DEZ 8 0 127 FORMAT "%8.4" DEPOSIT ABSOLUTE /end AXIS_DESCR
 /begin AXIS_DESCR STD_AXIS Epm_nEngLRes nmot_q40 8 0 10200 FORMAT "%8.2" DEPOSIT ABSOLUTE /end AXIS_DESCR
/end CHARACTERISTIC
/begin CHARACTERISTIC AKRGRCCATM_VAR3 "Map for exhaust flap control depending on the gangsist and nmot (DKG or AT transmission), with the convertible top closed and the sports button activated" MAP 0x80784CA2 Map_Xs16Ys16Ws16 400 ___MGF_CC_Pedal_x100_d256 -200 200 FORMAT "%8.4"
 /begin AXIS_DESCR STD_AXIS gangakr DEZ 8 0 127 FORMAT "%8.4" DEPOSIT ABSOLUTE /end AXIS_DESCR
 /begin AXIS_DESCR STD_AXIS Epm_nEngLRes nmot_q40 8 0 10200 FORMAT "%8.2" DEPOSIT ABSOLUTE /end AXIS_DESCR
/end CHARACTERISTIC
/begin CHARACTERISTIC AKRGRCCM "Map for exhaust flap control depending on the gangsist and nmot, with the convertible top closed and the sports button activated" MAP 0x80784F32 Map_Xs16Ys16Ws16 400 ___MGF_CC_Pedal_x100_d256 -200 200 FORMAT "%8.4"
 /begin AXIS_DESCR STD_AXIS gangakr DEZ 10 0 127 FORMAT "%8.4" DEPOSIT ABSOLUTE /end AXIS_DESCR
 /begin AXIS_DESCR STD_AXIS Epm_nEngLRes nmot_q40 12 0 10200 FORMAT "%8.2" DEPOSIT ABSOLUTE /end AXIS_DESCR
/end CHARACTERISTIC
/begin CHARACTERISTIC AKRGRCCM_VAR1 "Map for exhaust flap control depending on the gangsist and nmot, with the convertible top closed and the sports button activated" MAP 0x80785052 Map_Xs16Ys16Ws16 400 ___MGF_CC_Pedal_x100_d256 -200 200 FORMAT "%8.4"
 /begin AXIS_DESCR STD_AXIS gangakr DEZ 6 0 127 FORMAT "%8.4" DEPOSIT ABSOLUTE /end AXIS_DESCR
 /begin AXIS_DESCR STD_AXIS Epm_nEngLRes nmot_q40 8 0 10200 FORMAT "%8.2" DEPOSIT ABSOLUTE /end AXIS_DESCR
/end CHARACTERISTIC
/begin CHARACTERISTIC AKRGRCCM_VAR2 "Map for exhaust flap control depending on the gangsist and nmot, with the convertible top closed and the sports button activated" MAP 0x807850D2 Map_Xs16Ys16Ws16 400 ___MGF_CC_Pedal_x100_d256 -200 200 FORMAT "%8.4"
 /begin AXIS_DESCR STD_AXIS gangakr DEZ 6 0 127 FORMAT "%8.4" DEPOSIT ABSOLUTE /end AXIS_DESCR
 /begin AXIS_DESCR STD_AXIS Epm_nEngLRes nmot_q40 8 0 10200 FORMAT "%8.2" DEPOSIT ABSOLUTE /end AXIS_DESCR
/end CHARACTERISTIC
/begin CHARACTERISTIC AKRGRCCM_VAR3 "Map for exhaust flap control depending on the gangsist and nmot, with the convertible top closed and the sports button activated" MAP 0x80785152 Map_Xs16Ys16Ws16 400 ___MGF_CC_Pedal_x100_d256 -200 200 FORMAT "%8.4"
 /begin AXIS_DESCR STD_AXIS gangakr DEZ 6 0 127 FORMAT "%8.4" DEPOSIT ABSOLUTE /end AXIS_DESCR
 /begin AXIS_DESCR STD_AXIS Epm_nEngLRes nmot_q40 8 0 10200 FORMAT "%8.2" DEPOSIT ABSOLUTE /end AXIS_DESCR
/end CHARACTERISTIC
/begin CHARACTERISTIC AKRGRCO "Characteristic map for exhaust flap control depending on the gangsist and nmot, with the convertible top open" MAP 0x80785352 Map_Xs16Ys16Ws16 400 ___MGF_CC_Pedal_x100_d256 -200 200 FORMAT "%8.4"
 /begin AXIS_DESCR STD_AXIS gangakr DEZ 10 0 127 FORMAT "%8.4" DEPOSIT ABSOLUTE /end AXIS_DESCR
 /begin AXIS_DESCR STD_AXIS Epm_nEngLRes nmot_q40 12 0 10200 FORMAT "%8.2" DEPOSIT ABSOLUTE /end AXIS_DESCR
/end CHARACTERISTIC
/begin CHARACTERISTIC AKRGRCO_VAR1 "Characteristic map for exhaust flap control depending on the gangsist and nmot, with the convertible top open" MAP 0x8078599A Map_Xs16Ys16Ws16 400 ___MGF_CC_Pedal_x100_d256 -200 200 FORMAT "%8.4"
 /begin AXIS_DESCR STD_AXIS gangakr DEZ 6 0 127 FORMAT "%8.4" DEPOSIT ABSOLUTE /end AXIS_DESCR
 /begin AXIS_DESCR STD_AXIS Epm_nEngLRes nmot_q40 8 0 10200 FORMAT "%8.2" DEPOSIT ABSOLUTE /end AXIS_DESCR
/end CHARACTERISTIC
/begin CHARACTERISTIC AKRGRCOAT "Characteristic map for exhaust flap control depending on the gangsist and nmot (DKG or AT transmission), with the convertible top open" MAP 0x80785472 Map_Xs16Ys16Ws16 400 ___MGF_CC_Pedal_x100_d256 -200 200 FORMAT "%8.4"
 /begin AXIS_DESCR STD_AXIS gangakr DEZ 10 0 127 FORMAT "%8.4" DEPOSIT ABSOLUTE /end AXIS_DESCR
 /begin AXIS_DESCR STD_AXIS Epm_nEngLRes nmot_q40 12 0 10200 FORMAT "%8.2" DEPOSIT ABSOLUTE /end AXIS_DESCR
/end CHARACTERISTIC
/begin CHARACTERISTIC AKRGRCOAT_VAR1 "Characteristic map for exhaust flap control depending on the gangsist and nmot (DKG or AT transmission), with the convertible top open" MAP 0x80785756 Map_Xs16Ys16Ws16 400 ___MGF_CC_Pedal_x100_d256 -200 200 FORMAT "%8.4"
 /begin AXIS_DESCR STD_AXIS gangakr DEZ 8 0 127 FORMAT "%8.4" DEPOSIT ABSOLUTE /end AXIS_DESCR
 /begin AXIS_DESCR STD_AXIS Epm_nEngLRes nmot_q40 8 0 10200 FORMAT "%8.2" DEPOSIT ABSOLUTE /end AXIS_DESCR
/end CHARACTERISTIC
/begin CHARACTERISTIC AKRGRCOATM "Characteristic map for exhaust flap control depending on the gangsist and nmot (DKG or AT transmission), with the convertible top open and the sport button activated and the sport button activated" MAP 0x80785592 Map_Xs16Ys16Ws16 400 ___MGF_CC_Pedal_x100_d256 -200 200 FORMAT "%8.4"
 /begin AXIS_DESCR STD_AXIS gangakr DEZ 10 0 127 FORMAT "%8.4" DEPOSIT ABSOLUTE /end AXIS_DESCR
 /begin AXIS_DESCR STD_AXIS Epm_nEngLRes nmot_q40 12 0 10200 FORMAT "%8.2" DEPOSIT ABSOLUTE /end AXIS_DESCR
/end CHARACTERISTIC
/begin CHARACTERISTIC AKRGRCOATM_VAR1 "Characteristic map for exhaust flap control depending on the gangsist and nmot (DKG or AT transmission), with the convertible top open and the sport button activated and the sport button activated" MAP 0x807856B2 Map_Xs16Ys16Ws16 400 ___MGF_CC_Pedal_x100_d256 -200 200 FORMAT "%8.4"
 /begin AXIS_DESCR STD_AXIS gangakr DEZ 8 0 127 FORMAT "%8.4" DEPOSIT ABSOLUTE /end AXIS_DESCR
 /begin AXIS_DESCR STD_AXIS Epm_nEngLRes nmot_q40 8 0 10200 FORMAT "%8.2" DEPOSIT ABSOLUTE /end AXIS_DESCR
/end CHARACTERISTIC
/begin CHARACTERISTIC AKRGRCOM "Map for exhaust flap control depending on the gangsist and nmot, with the convertible top open and the sports button activated" MAP 0x807857FA Map_Xs16Ys16Ws16 400 ___MGF_CC_Pedal_x100_d256 -200 200 FORMAT "%8.4"
 /begin AXIS_DESCR STD_AXIS gangakr DEZ 10 0 127 FORMAT "%8.4" DEPOSIT ABSOLUTE /end AXIS_DESCR
 /begin AXIS_DESCR STD_AXIS Epm_nEngLRes nmot_q40 12 0 10200 FORMAT "%8.2" DEPOSIT ABSOLUTE /end AXIS_DESCR
/end CHARACTERISTIC
/begin CHARACTERISTIC AKRGRCOM_VAR1 "Map for exhaust flap control depending on the gangsist and nmot, with the convertible top open and the sports button activated" MAP 0x8078591A Map_Xs16Ys16Ws16 400 ___MGF_CC_Pedal_x100_d256 -200 200 FORMAT "%8.4"
 /begin AXIS_DESCR STD_AXIS gangakr DEZ 6 0 127 FORMAT "%8.4" DEPOSIT ABSOLUTE /end AXIS_DESCR
 /begin AXIS_DESCR STD_AXIS Epm_nEngLRes nmot_q40 8 0 10200 FORMAT "%8.2" DEPOSIT ABSOLUTE /end AXIS_DESCR
/end CHARACTERISTIC
/begin CHARACTERISTIC Antilag_BMWtchctr_p_DifCrtnPp_M___MGF_CC_PF "Correction of pressure difference f. P-part of the performance-based boost pressure controller (X-Axis does not switch, )" MAP 0x807C000E _REC_A1CUR_1_MBSE_S2_S1 8191.875 BMW_p_sw_q0p125_hPa -4096 4095.875 FORMAT "%10.3"
 /begin AXIS_DESCR COM_AXIS BMWtchbas_p_Dif_sw BMW_p_sw_q0p125_hPa 12 -4096 4095.875 AXIS_PTS_REF Antilag_BMWtchctr_p_DifCrtnPp_Ax___MGF_CC_PF FORMAT "%10.3" MONOTONY MON_INCREASE DEPOSIT ABSOLUTE /end AXIS_DESCR
 /begin AXIS_DESCR COM_AXIS BMWtchsp_mf_Ex_uw CByjozc_eCmpBAb_pljBAmd_k__0oa0 6 0 2047.96875 AXIS_PTS_REF Antilag_BMWtchctr_p_DifCrtnPp_Ay___MGF_CC_PF FORMAT "%10.3" MONOTONY STRICT_INCREASE DEPOSIT ABSOLUTE /end AXIS_DESCR
/end CHARACTERISTIC
/begin CHARACTERISTIC Antilag_BMWtchctr_p_DifCrtnPpDyn_M___MGF_CC_PF "Correction of pressure difference f. P-part of the performance-based boost pressure controller (X-Axis does not switch, )" MAP 0x807C00AA _REC_A1CUR_1_MBSE_S2_S1 8191.875 BMW_p_sw_q0p125_hPa -4096 4095.875 FORMAT "%10.3"
 /begin AXIS_DESCR COM_AXIS BMWtchbas_p_Dif_sw BMW_p_sw_q0p125_hPa 12 -4096 4095.875 AXIS_PTS_REF Antilag_BMWtchctr_p_DifCrtnPpDyn_Ax___MGF_CC_PF FORMAT "%10.3" MONOTONY MON_INCREASE DEPOSIT ABSOLUTE /end AXIS_DESCR
 /begin AXIS_DESCR COM_AXIS BMWtchsp_mf_Ex_uw CByjozc_eCmpBAb_pljBAmd_k__0oa0 6 0 2047.96875 AXIS_PTS_REF Antilag_BMWtchctr_p_DifCrtnPpDyn_Ay___MGF_CC_PF FORMAT "%10.3" MONOTONY STRICT_INCREASE DEPOSIT ABSOLUTE /end AXIS_DESCR
/end CHARACTERISTIC
/begin CHARACTERISTIC Antilag_BMWtchctr_pwr_Dp_M___MGF_CC_PF "D part of the performance-based boost pressure controller (X-Axis and Y-Axis do not switch)" MAP 0x807C013A _REC_A1CUR_1_MBSE_S2_S1 127.998046875 jucyrzb_bpFgwfd_uqrfhgc_k__aoa0 -64 63.998046875 FORMAT "%10.3"
 /begin AXIS_DESCR COM_AXIS BMWtchbas_p_Dif_sw BMW_p_sw_q0p125_hPa 14 -4096 4095.875 AXIS_PTS_REF BMWtchctr_pwr_Dp_Ax FORMAT "%10.3" MONOTONY STRICT_INCREASE DEPOSIT ABSOLUTE /end AXIS_DESCR
 /begin AXIS_DESCR COM_AXIS BMWtchbas_p_DifGra_sw BMW_p_sw_q0p125_hPa 14 -4096 4095.875 AXIS_PTS_REF BMWtchctr_pwr_Dp_Ay FORMAT "%10.3" MONOTONY STRICT_INCREASE DEPOSIT ABSOLUTE /end AXIS_DESCR
/end CHARACTERISTIC
/begin CHARACTERISTIC Antilag_BMWtchctr_pwr_Pctl_M___MGF_CC_PF "Compressor map with required compressor / turbine performance ()" MAP 0x807C030A _REC_A1CUR_1_MBSE_U2_S1 127.998046875 jucyrzb_bpFgwfd_uqrfhgc_k__aoa0 0 127.998046875 FORMAT "%11.4"
 /begin AXIS_DESCR COM_AXIS BMWtchsp_rat_p_CmprLim_uw acriqBc_tfkBqod_ocgjxzc_nR_8oa0 20 0 7.9998779296875 AXIS_PTS_REF Antilag_BMWtchctr_pwr_Pctl_Ax___MGF_CC_PF FORMAT "%11.4" MONOTONY MON_INCREASE DEPOSIT ABSOLUTE /end AXIS_DESCR
 /begin AXIS_DESCR COM_AXIS BMWtchsp_mf_CmprNorm_uw CByjozc_eCmpBAb_pljBAmd_k__0oa0 16 0 2047.96875 AXIS_PTS_REF Antilag_BMWtchctr_pwr_Pctl_Ay___MGF_CC_PF FORMAT "%10.3" MONOTONY STRICT_INCREASE DEPOSIT ABSOLUTE /end AXIS_DESCR
/end CHARACTERISTIC
/begin CHARACTERISTIC Antilag_IgnRoll___MGF_CC_PF "Ignition setpoint: Engine speed [Nkw] vs Boost actual [Ps]" MAP 0x807C0590 CurG_Ws16 0 ___MGF_CC_IgnitionTiming_d10 -100 100 MATRIX_DIM 10 10 1
 /begin AXIS_DESCR COM_AXIS Nkw caoddzd_oAjpfzb_cAcEEha_1nR_oa0 10 0 15000 AXIS_PTS_REF Antilag_IgnRoll_X_Axis___MGF_CC_PF DEPOSIT ABSOLUTE /end AXIS_DESCR
 /begin AXIS_DESCR COM_AXIS Ps BMW_p_sw_q0p125_hPa 10 -3000 3000 AXIS_PTS_REF Antilag_IgnRoll_Y_Axis___MGF_CC_PF DEPOSIT ABSOLUTE /end AXIS_DESCR
/end CHARACTERISTIC
/begin CHARACTERISTIC Antilag_IgnStand___MGF_CC_PF "Ignition setpoint: Engine speed [Nkw] vs Boost actual [Ps]" MAP 0x807C0658 CurG_Ws16 0 ___MGF_CC_IgnitionTiming_d10 -100 100 MATRIX_DIM 10 10 1
 /begin AXIS_DESCR COM_AXIS Nkw caoddzd_oAjpfzb_cAcEEha_1nR_oa0 10 0 15000 AXIS_PTS_REF Antilag_IgnStand_X_Axis___MGF_CC_PF DEPOSIT ABSOLUTE /end AXIS_DESCR
 /begin AXIS_DESCR COM_AXIS Ps BMW_p_sw_q0p125_hPa 10 -3000 3000 AXIS_PTS_REF Antilag_IgnStand_Y_Axis___MGF_CC_PF DEPOSIT ABSOLUTE /end AXIS_DESCR
/end CHARACTERISTIC
/begin CHARACTERISTIC Antilag_LambdaRoll___MGF_CC_PF "Fueling setpoint: Engine speed [Nkw] vs Exhaust Gas Temperature [EGT] before turbine [Tabg_vl_xab]" MAP 0x807C0720 KwUw 0 ___MGF_CC_Fueling_d10 0 2 MATRIX_DIM 10 10 1
 /begin AXIS_DESCR COM_AXIS Nkw caoddzd_oAjpfzb_cAcEEha_1nR_oa0 10 0 15000 AXIS_PTS_REF Antilag_LambdaRoll_X_Axis___MGF_CC_PF DEPOSIT ABSOLUTE /end AXIS_DESCR
 /begin AXIS_DESCR COM_AXIS Tabg_vl_xab BMW_q0p1_degC 10 -3000 3000 AXIS_PTS_REF Antilag_LambdaRoll_Y_Axis___MGF_CC_PF DEPOSIT ABSOLUTE /end AXIS_DESCR
/end CHARACTERISTIC
/begin CHARACTERISTIC Antilag_LambdaStand___MGF_CC_PF "Fueling setpoint: Engine speed [Nkw] vs Exhaust Gas Temperature [EGT] before turbine [Tabg_vl_xab]" MAP 0x807C07E8 KwUw 0 ___MGF_CC_Fueling_d10 0 2 MATRIX_DIM 10 10 1
 /begin AXIS_DESCR COM_AXIS Nkw caoddzd_oAjpfzb_cAcEEha_1nR_oa0 10 0 15000 AXIS_PTS_REF Antilag_LambdaStand_X_Axis___MGF_CC_PF DEPOSIT ABSOLUTE /end AXIS_DESCR
 /begin AXIS_DESCR COM_AXIS Tabg_vl_xab BMW_q0p1_degC 10 -3000 3000 AXIS_PTS_REF Antilag_LambdaStand_Y_Axis___MGF_CC_PF DEPOSIT ABSOLUTE /end AXIS_DESCR
/end CHARACTERISTIC
/begin CHARACTERISTIC BMWchas_p_RailInjMpl_M "Rail pressure setpoint for multiple injection" MAP 0x80738BEC _REC_A1CUR_1_MBSE_U2_S1 39.9993896484375 cxdjuna_xpuCged_ocEpdua_MCRa2a0 0 39.9993896484375
 /begin AXIS_DESCR COM_AXIS Nkw caoddzd_oAjpfzb_cAcEEha_1nR_oa0 6 -32768 32767 AXIS_PTS_REF BMWchas_p_RailInjMpl_Ax FORMAT "%5.0" MONOTONY STRICT_INCREASE DEPOSIT ABSOLUTE /end AXIS_DESCR
 /begin AXIS_DESCR COM_AXIS BMWrailco_rat_VabHom_sw zyyxBpb_rEsnvtc_gktukCa_fR_5a0o 6 -1600 1599.951171875 AXIS_PTS_REF BMWchas_p_RailInjMpl_Ay FORMAT "%8.3" MONOTONY STRICT_INCREASE DEPOSIT ABSOLUTE /end AXIS_DESCR
/end CHARACTERISTIC
/begin CHARACTERISTIC BMWchas_p_RailInjSng_M "Rail pressure setpoint for single injection" MAP 0x80738B6C _REC_A1CUR_1_MBSE_U2_S1 39.9993896484375 cxdjuna_xpuCged_ocEpdua_MCRa2a0 0 39.9993896484375
 /begin AXIS_DESCR COM_AXIS Nkw caoddzd_oAjpfzb_cAcEEha_1nR_oa0 8 -32768 32767 AXIS_PTS_REF BMWchas_p_RailInjSng_Ax FORMAT "%5.0" MONOTONY STRICT_INCREASE DEPOSIT ABSOLUTE /end AXIS_DESCR
 /begin AXIS_DESCR COM_AXIS BMWrailco_rat_VabHom_sw zyyxBpb_rEsnvtc_gktukCa_fR_5a0o 8 -1600 1599.951171875 AXIS_PTS_REF BMWchas_p_RailInjSng_Ay FORMAT "%8.3" MONOTONY STRICT_INCREASE DEPOSIT ABSOLUTE /end AXIS_DESCR
/end CHARACTERISTIC
/begin CHARACTERISTIC BMWext_lam_CptPronMinLeanTq_M "Lambda Lean Best Torque for limiting the component protection lambda" MAP 0x80717650 _REC_A1CUR_1_MBSE_U2_S1 15.999755859375 BumqDkc_mryszAa_EcglxAc_nR_4oa0 0 15.999755859375
 /begin AXIS_DESCR COM_AXIS Nkw_atm caoddzd_oAjpfzb_cAcEEha_1nR_oa0 8 -32768 32767 AXIS_PTS_REF BMWext_lam_CptPronMinLeanTq_Ax MONOTONY STRICT_INCREASE DEPOSIT ABSOLUTE /end AXIS_DESCR
 /begin AXIS_DESCR COM_AXIS Rf_atm CgkBooc_wkiDfEd_Czglhgc_fR_1a0o 8 -327.68 327.67 AXIS_PTS_REF BMWext_lam_CptPronMinLeanTq_Ay MONOTONY STRICT_INCREASE DEPOSIT ABSOLUTE /end AXIS_DESCR
/end CHARACTERISTIC
/begin CHARACTERISTIC BMWgpfheat_p_RailInjMpl_M "Rail pressure setpoint for multiple injection" MAP 0x8071A2FA _REC_A1CUR_1_MBSE_U2_S1 39.9993896484375 cxdjuna_xpuCged_ocEpdua_MCRa2a0 0 39.9993896484375
 /begin AXIS_DESCR COM_AXIS Nkw caoddzd_oAjpfzb_cAcEEha_1nR_oa0 6 -32768 32767 AXIS_PTS_REF BMWgpfheat_p_RailInjMpl_Ax FORMAT "%5.0" MONOTONY STRICT_INCREASE DEPOSIT ABSOLUTE /end AXIS_DESCR
 /begin AXIS_DESCR COM_AXIS BMWrailco_rat_VabHom_sw zyyxBpb_rEsnvtc_gktukCa_fR_5a0o 6 -1600 1599.951171875 AXIS_PTS_REF BMWgpfheat_p_RailInjMpl_Ay FORMAT "%8.3" MONOTONY STRICT_INCREASE DEPOSIT ABSOLUTE /end AXIS_DESCR
/end CHARACTERISTIC
/begin CHARACTERISTIC BMWgpfheat_p_RailInjSng_M "Rail pressure setpoint for multiple injection" MAP 0x8071A2B2 _REC_A1CUR_1_MBSE_U2_S1 39.9993896484375 cxdjuna_xpuCged_ocEpdua_MCRa2a0 0 39.9993896484375
 /begin AXIS_DESCR COM_AXIS Nkw caoddzd_oAjpfzb_cAcEEha_1nR_oa0 6 -32768 32767 AXIS_PTS_REF BMWgpfheat_p_RailInjSng_Ax FORMAT "%5.0" MONOTONY STRICT_INCREASE DEPOSIT ABSOLUTE /end AXIS_DESCR
 /begin AXIS_DESCR COM_AXIS BMWrailco_rat_VabHom_sw zyyxBpb_rEsnvtc_gktukCa_fR_5a0o 6 -1600 1599.951171875 AXIS_PTS_REF BMWgpfheat_p_RailInjSng_Ay FORMAT "%8.3" MONOTONY STRICT_INCREASE DEPOSIT ABSOLUTE /end AXIS_DESCR
/end CHARACTERISTIC
/begin CHARACTERISTIC BMWinjmon_fac_HppEff_M "Injection map factor efficiency high pressure pump" MAP 0x80714AC6 _REC_A1CUR_1_MBSE_U2_S1 1.99996948242188 Bhvfwhc_bigEubd_BBEupBd_nR_3oa0 0 1.99996948242188 FORMAT "%6.2"
 /begin AXIS_DESCR COM_AXIS Nkw_10ms caoddzd_oAjpfzb_cAcEEha_1nR_oa0 8 -32768 32767 AXIS_PTS_REF BMWinjmon_fac_HppEff_Ax FORMAT "%5.0" MONOTONY STRICT_INCREASE DEPOSIT ABSOLUTE /end AXIS_DESCR
 /begin AXIS_DESCR COM_AXIS BMWrail_p_RpsActVal bukAcFc_hypjrAa_CBhougc_MCRooa0 4 0 131.07 AXIS_PTS_REF BMWinjmon_fac_HppEff_Ay MONOTONY STRICT_INCREASE DEPOSIT ABSOLUTE /end AXIS_DESCR
/end CHARACTERISTIC
/begin CHARACTERISTIC BMWlpa_n_EfpEngStrtAmb_M "EKP speed specification start environment" MAP 0x80719720 _REC_A1CUR_1_MBSE_U2_S1 65535 caoddzd_oAjpfzb_cAcEEha_1nR_oa0 0 65535 FORMAT "%5.0"
 /begin AXIS_DESCR COM_AXIS Tumg BMW_q0p1_degC 4 -3276.8 3276.7 AXIS_PTS_REF BMWlpa_n_EfpEngStrtAmb_Ax FORMAT "%6.1" MONOTONY STRICT_INCREASE DEPOSIT ABSOLUTE /end AXIS_DESCR
 /begin AXIS_DESCR COM_AXIS Pumg BMW_p_sw_q0p125_hPa 4 0 8191.875 AXIS_PTS_REF BMWlpa_n_EfpEngStrtAmb_Ay FORMAT "%8.3" MONOTONY STRICT_INCREASE DEPOSIT ABSOLUTE /end AXIS_DESCR
/end CHARACTERISTIC
/begin CHARACTERISTIC BMWlpa_n_EfpModSafe_M "EKP speed specification safe mode" MAP 0x80719668 _REC_A1CUR_1_MBSE_U2_S1 65535 caoddzd_oAjpfzb_cAcEEha_1nR_oa0 0 65535 FORMAT "%5.0"
 /begin AXIS_DESCR COM_AXIS BMWlpi_t_Fu_sw DchEpAd_DBCFgoa_Ckhahgc_q__aoa0 4 -327.68 327.67 AXIS_PTS_REF BMWlpa_n_EfpModSafe_Ax FORMAT "%5.2" MONOTONY STRICT_INCREASE DEPOSIT ABSOLUTE /end AXIS_DESCR
 /begin AXIS_DESCR COM_AXIS BMWlpi_volf_Fu_sw zBcBzad_vmoivka_mFzjCgc_lCRooa0 4 -327.68 327.67 AXIS_PTS_REF BMWlpa_n_EfpModSafe_Ay FORMAT "%5.2" MONOTONY STRICT_INCREASE DEPOSIT ABSOLUTE /end AXIS_DESCR
/end CHARACTERISTIC
/begin CHARACTERISTIC BMWlpsc_volf_FuEjrPmp_M "Flow rate map" MAP 0x80719B62 _REC_A1CUR_1_MBSE_S2_S1 655.35 zBcBzad_vmoivka_mFzjCgc_lCRooa0 -327.68 327.67 FORMAT "%5.2"
 /begin AXIS_DESCR COM_AXIS BMWlpsc_p_EfpSpCtld_uw rgduxyd_mlihaBb_gsCghzb_bCRa0a0 8 0 65.535 AXIS_PTS_REF BMWlpsc_volf_FuEjrPmp_Ax FORMAT "%5.3" MONOTONY STRICT_INCREASE DEPOSIT ABSOLUTE /end AXIS_DESCR
 /begin AXIS_DESCR COM_AXIS BMWlpsc_st_TankCod_ub raChrxc_kBtBrmb_FmDuEFa_n__aa0o 4 0 255 AXIS_PTS_REF BMWlpsc_volf_FuEjrPmp_Ay FORMAT "%3.0" MONOTONY STRICT_INCREASE DEPOSIT ABSOLUTE /end AXIS_DESCR
/end CHARACTERISTIC
/begin CHARACTERISTIC BMWls_fac_rf_RednFuOctIntkT_M "Base value for the filling reduction factor depending on fuel quality and intake air temperature." MAP 0x8074FE00 _REC_A1CUR_1_MBSE_U1_S1 1 ggDviCc_uydFbsa_CDgnhgc_nR_2a0o 0 1 FORMAT "%6.4"
 /begin AXIS_DESCR COM_AXIS F_octan BMW_Powertrain_DxECompuMethods_Def_ub_b1_nounit 6 0 0.99609375 AXIS_PTS_REF BMWls_fac_rf_RednFuOctIntkT_Ax FORMAT "%6.1" MONOTONY STRICT_INCREASE DEPOSIT ABSOLUTE /end AXIS_DESCR
 /begin AXIS_DESCR COM_AXIS Tans BMW_q0p1_degC 6 -3276.8 3276.7 AXIS_PTS_REF BMWls_fac_rf_RednFuOctIntkT_Ay FORMAT "%6.1" MONOTONY STRICT_INCREASE DEPOSIT ABSOLUTE /end AXIS_DESCR
/end CHARACTERISTIC
/begin CHARACTERISTIC BMWls_pct_FiMaxIgOfs_M "Filling limitation characteristic curve depending on ignition angle retard" MAP 0x8071E2FE _REC_A1CUR_1_MBSE_S2_S1 655.35 CgkBooc_wkiDfEd_Czglhgc_fR_1a0o -327.68 327.67 FORMAT "%7.2"
 /begin AXIS_DESCR COM_AXIS Nkw caoddzd_oAjpfzb_cAcEEha_1nR_oa0 10 -32768 32767 AXIS_PTS_REF BMWls_pct_FiMaxIgOfs_Gx FORMAT "%5.0" MONOTONY STRICT_INCREASE DEPOSIT ABSOLUTE /end AXIS_DESCR
 /begin AXIS_DESCR COM_AXIS Dzw_tot_kr BMW_q0p1_deg 8 -3276.8 3276.7 AXIS_PTS_REF BMWls_pct_FiMaxIgOfs_Gy FORMAT "%6.1" MONOTONY STRICT_INCREASE DEPOSIT ABSOLUTE /end AXIS_DESCR
/end CHARACTERISTIC
/begin CHARACTERISTIC BMWls_pct_FiMaxIgOfsSpt_M "Characteristic filling limitation depending on ignition angle retardation in sport mode" MAP 0x8071E39E _REC_A1CUR_1_MBSE_S2_S1 655.35 CgkBooc_wkiDfEd_Czglhgc_fR_1a0o -327.68 327.67 FORMAT "%7.2"
 /begin AXIS_DESCR COM_AXIS Nkw caoddzd_oAjpfzb_cAcEEha_1nR_oa0 10 -32768 32767 AXIS_PTS_REF BMWls_pct_FiMaxIgOfs_Gx FORMAT "%5.0" MONOTONY STRICT_INCREASE DEPOSIT ABSOLUTE /end AXIS_DESCR
 /begin AXIS_DESCR COM_AXIS Dzw_tot_kr BMW_q0p1_deg 8 -3276.8 3276.7 AXIS_PTS_REF BMWls_pct_FiMaxIgOfs_Gy FORMAT "%6.1" MONOTONY STRICT_INCREASE DEPOSIT ABSOLUTE /end AXIS_DESCR
/end CHARACTERISTIC
/begin CHARACTERISTIC BMWls_rf_MaxEgT_M "Maximum filling when limited by the component protection controller" MAP 0x8071E2B6 _REC_A1CUR_1_MBSE_S2_S1 655.35 ubqeuic_jteCkzd_CDglhgc_nR_1a0o -327.68 327.67 FORMAT "%7.2"
 /begin AXIS_DESCR COM_AXIS Nkw caoddzd_oAjpfzb_cAcEEha_1nR_oa0 6 -32768 32767 AXIS_PTS_REF BMWls_rf_MaxEgT_Ax FORMAT "%5.0" MONOTONY STRICT_INCREASE DEPOSIT ABSOLUTE /end AXIS_DESCR
 /begin AXIS_DESCR COM_AXIS Frfmxbsld Bhvfwhc_bigEubd_BBEupBd_nR_3oa0 6 0 1.99996948242188 AXIS_PTS_REF BMWls_rf_MaxEgT_Ay FORMAT "%14.5" MONOTONY STRICT_INCREASE DEPOSIT ABSOLUTE /end AXIS_DESCR
/end CHARACTERISTIC
/begin CHARACTERISTIC BMWls_rf_MaxFuOctIntkT_M "Maximum filling depending on the speed and the filling reduction factor at late center of gravity positions due to poor fuel and high collector temperatures." MAP 0x8071E176 _REC_A1CUR_1_MBSE_S2_S1 655.35 CgkBooc_wkiDfEd_Czglhgc_fR_1a0o -327.68 327.67 FORMAT "%7.2"
 /begin AXIS_DESCR COM_AXIS Nkw caoddzd_oAjpfzb_cAcEEha_1nR_oa0 10 -32768 32767 AXIS_PTS_REF BMWls_pct_FiMaxIgOfs_Gx FORMAT "%5.0" MONOTONY STRICT_INCREASE DEPOSIT ABSOLUTE /end AXIS_DESCR
 /begin AXIS_DESCR COM_AXIS BMWls_fac_rf_RedFil_uw FzbmlAa_gCtylrb_ckCqxAc_nR_6oa0 8 0 0.999984741210938 AXIS_PTS_REF BMWls_rf_MaxFuOctIntkT_Gy FORMAT "%7.5" MONOTONY STRICT_INCREASE DEPOSIT ABSOLUTE /end AXIS_DESCR
/end CHARACTERISTIC
/begin CHARACTERISTIC BMWls_rf_MaxFuOctIntkTSpt_M "Maximum filling depending on the speed and the filling reduction factor at late center of gravity positions due to poor fuel and high collector temperatures in sport mode." MAP 0x8071E216 _REC_A1CUR_1_MBSE_S2_S1 655.35 CgkBooc_wkiDfEd_Czglhgc_fR_1a0o -327.68 327.67 FORMAT "%7.2"
 /begin AXIS_DESCR COM_AXIS Nkw caoddzd_oAjpfzb_cAcEEha_1nR_oa0 10 -32768 32767 AXIS_PTS_REF BMWls_pct_FiMaxIgOfs_Gx FORMAT "%5.0" MONOTONY STRICT_INCREASE DEPOSIT ABSOLUTE /end AXIS_DESCR
 /begin AXIS_DESCR COM_AXIS BMWls_fac_rf_RedFil_uw FzbmlAa_gCtylrb_ckCqxAc_nR_6oa0 8 0 0.999984741210938 AXIS_PTS_REF BMWls_rf_MaxFuOctIntkT_Gy FORMAT "%7.5" MONOTONY STRICT_INCREASE DEPOSIT ABSOLUTE /end AXIS_DESCR
/end CHARACTERISTIC
/begin CHARACTERISTIC BMWls_rf_MaxModEng_M "Filling cap for temporary limitation at the start of the race." MAP 0x8071E076 _REC_A1CUR_1_MBSE_S2_S1 655.35 CgkBooc_wkiDfEd_Czglhgc_fR_1a0o -327.68 327.67 FORMAT "%7.2"
 /begin AXIS_DESCR COM_AXIS Nkw caoddzd_oAjpfzb_cAcEEha_1nR_oa0 10 -32768 32767 AXIS_PTS_REF BMWls_pct_FiMaxIgOfs_Gx FORMAT "%5.0" MONOTONY STRICT_INCREASE DEPOSIT ABSOLUTE /end AXIS_DESCR
 /begin AXIS_DESCR COM_AXIS Dzw_tot_kr BMW_q0p1_deg 8 -3276.8 3276.7 AXIS_PTS_REF BMWls_pct_FiMaxIgOfs_Gy FORMAT "%6.1" MONOTONY STRICT_INCREASE DEPOSIT ABSOLUTE /end AXIS_DESCR
/end CHARACTERISTIC
/begin CHARACTERISTIC BMWtchctr_t_ExGasMdl_M "Exhaust gas temperature during dynamic load changes for the physical ATL pilot control" MAP 0x80742486 _REC_A1CUR_1_MBSE_S2_S1 6553.5 BMW_q0p1_degC -3276.8 3276.7 FORMAT "%7.1"
 /begin AXIS_DESCR COM_AXIS Nkw caoddzd_oAjpfzb_cAcEEha_1nR_oa0 6 -32768 32767 AXIS_PTS_REF BMWtchctr_t_ExGasMdl_Ax FORMAT "%5.0" MONOTONY STRICT_INCREASE DEPOSIT ABSOLUTE /end AXIS_DESCR
 /begin AXIS_DESCR COM_AXIS Rf CgkBooc_wkiDfEd_Czglhgc_fR_1a0o 6 -327.68 327.67 AXIS_PTS_REF BMWtchctr_t_ExGasMdl_Ay FORMAT "%7.2" MONOTONY STRICT_INCREASE DEPOSIT ABSOLUTE /end AXIS_DESCR
/end CHARACTERISTIC
/begin CHARACTERISTIC BMWtchctr_t_ExGasMdlScav_M "Exhaust gas temperature during dynamic load changes for the physical ATL pilot control" MAP 0x807424CE _REC_A1CUR_1_MBSE_S2_S1 6553.5 BMW_q0p1_degC -3276.8 3276.7 FORMAT "%7.1"
 /begin AXIS_DESCR COM_AXIS Nkw caoddzd_oAjpfzb_cAcEEha_1nR_oa0 6 -32768 32767 AXIS_PTS_REF BMWtchctr_t_ExGasMdlScav_Ax FORMAT "%5.0" MONOTONY STRICT_INCREASE DEPOSIT ABSOLUTE /end AXIS_DESCR
 /begin AXIS_DESCR COM_AXIS Rf CgkBooc_wkiDfEd_Czglhgc_fR_1a0o 6 -327.68 327.67 AXIS_PTS_REF BMWtchctr_t_ExGasMdlScav_Ay FORMAT "%7.2" MONOTONY STRICT_INCREASE DEPOSIT ABSOLUTE /end AXIS_DESCR
/end CHARACTERISTIC
/begin CHARACTERISTIC BMWtchsp_rat_p_CmprMax_M "KF_FPLDMAX" MAP 0x80724DD0 _REC_A1CUR_1_MBSE_U2_S1 3.99993896484375 ilxsavd_hkzmBfc_lAzCpAb_nR_1oa0 0 3.99993896484375
 /begin AXIS_DESCR COM_AXIS BMWtchsp_mf_CmprNorm_uw CByjozc_eCmpBAb_pljBAmd_k__0oa0 8 0 2047.96875 AXIS_PTS_REF BMWtchsp_rat_p_CmprMax_Ax FORMAT "%10.3" MONOTONY STRICT_INCREASE DEPOSIT ABSOLUTE /end AXIS_DESCR
 /begin AXIS_DESCR COM_AXIS BMWtchtbc_t_BefCmpr_sw BMW_q0p1_degC 6 -3276.8 3276.7 AXIS_PTS_REF BMWtchsp_rat_p_CmprMax_Ay FORMAT "%6.1" MONOTONY STRICT_INCREASE DEPOSIT ABSOLUTE /end AXIS_DESCR
/end CHARACTERISTIC
/begin CHARACTERISTIC BMWtqe_st_SptDet4NoiseAcvn_M "Torque Engine(Torque combustion engine) status, state(Status, Condition, Bit bar) sport(Sport) detection(Detection) four(Four, 4) noise(Noise) activation(Activation) map(Characteristic map)" MAP 0x80752CBF _REC_A1CUR_1_MBSE_U1_S1 255 raChrxc_kBtBrmb_FmDuEFa_n__aa0o 0 255 FORMAT "%3.0"
 /begin AXIS_DESCR COM_AXIS Status_usecase_antr raChrxc_kBtBrmb_FmDuEFa_n__aa0o 12 0 11 AXIS_PTS_REF BMWtqe_st_SptDet4NoiseAcvn_Ax FORMAT "%6.0" MONOTONY STRICT_INCREASE DEPOSIT ABSOLUTE /end AXIS_DESCR
 /begin AXIS_DESCR COM_AXIS St_dsc_can raChrxc_kBtBrmb_FmDuEFa_n__aa0o 4 0 11 AXIS_PTS_REF BMWtqe_st_SptDet4NoiseAcvn_Ay FORMAT "%3.0" MONOTONY STRICT_INCREASE DEPOSIT ABSOLUTE /end AXIS_DESCR
/end CHARACTERISTIC
/begin CHARACTERISTIC IKCtl_facKnkRtdtCyl0_M "Retardation per knock event for cylinder 0" MAP 0x80795EB2 RB_Map_S16U8_S8 6 kw_q0p75 -6 0 FORMAT "%5.3"
 /begin AXIS_DESCR STD_AXIS Epm_nEng EngN 8 -16384 16383.5 FORMAT "%8.2" DEPOSIT ABSOLUTE /end AXIS_DESCR
 /begin AXIS_DESCR STD_AXIS IKCtl_facKnkInten_u8 fak_ub_b16 4 0 15.94 FORMAT "%5.2" DEPOSIT ABSOLUTE /end AXIS_DESCR
/end CHARACTERISTIC
/begin CHARACTERISTIC IKCtl_facKnkRtdtCyl1_M "Retardation per knock event for cylinder 1" MAP 0x80795EEA RB_Map_S16U8_S8 6 kw_q0p75 -6 0 FORMAT "%5.3"
 /begin AXIS_DESCR STD_AXIS Epm_nEng EngN 8 -16384 16383.5 FORMAT "%8.2" DEPOSIT ABSOLUTE /end AXIS_DESCR
 /begin AXIS_DESCR STD_AXIS IKCtl_facKnkInten_u8 fak_ub_b16 4 0 15.94 FORMAT "%5.2" DEPOSIT ABSOLUTE /end AXIS_DESCR
/end CHARACTERISTIC
/begin CHARACTERISTIC IKCtl_facKnkRtdtCyl2_M "Retardation per knock event for cylinder 2" MAP 0x80795F22 RB_Map_S16U8_S8 6 kw_q0p75 -6 0 FORMAT "%5.3"
 /begin AXIS_DESCR STD_AXIS Epm_nEng EngN 8 -16384 16383.5 FORMAT "%8.2" DEPOSIT ABSOLUTE /end AXIS_DESCR
 /begin AXIS_DESCR STD_AXIS IKCtl_facKnkInten_u8 fak_ub_b16 4 0 15.94 FORMAT "%5.2" DEPOSIT ABSOLUTE /end AXIS_DESCR
/end CHARACTERISTIC
/begin CHARACTERISTIC IKCtl_facKnkRtdtCyl3_M "Retarding per knock event for cylinder 3" MAP 0x80795F5A RB_Map_S16U8_S8 6 kw_q0p75 -6 0 FORMAT "%5.3"
 /begin AXIS_DESCR STD_AXIS Epm_nEng EngN 8 -16384 16383.5 FORMAT "%8.2" DEPOSIT ABSOLUTE /end AXIS_DESCR
 /begin AXIS_DESCR STD_AXIS IKCtl_facKnkInten_u8 fak_ub_b16 4 0 15.94 FORMAT "%5.2" DEPOSIT ABSOLUTE /end AXIS_DESCR
/end CHARACTERISTIC
/begin CHARACTERISTIC IKCtl_facKnkRtdtCyl4_M "Retardation per knock event for cylinder 4" MAP 0x80795F92 RB_Map_S16U8_S8 6 kw_q0p75 -6 0 FORMAT "%5.3"
 /begin AXIS_DESCR STD_AXIS Epm_nEng EngN 8 -16384 16383.5 FORMAT "%8.2" DEPOSIT ABSOLUTE /end AXIS_DESCR
 /begin AXIS_DESCR STD_AXIS IKCtl_facKnkInten_u8 fak_ub_b16 4 0 15.94 FORMAT "%5.2" DEPOSIT ABSOLUTE /end AXIS_DESCR
/end CHARACTERISTIC
/begin CHARACTERISTIC IKCtl_facKnkRtdtCyl5_M "Retardation per knock event for cylinder 5" MAP 0x80795FCA RB_Map_S16U8_S8 6 kw_q0p75 -6 0 FORMAT "%5.3"
 /begin AXIS_DESCR STD_AXIS Epm_nEng EngN 8 -16384 16383.5 FORMAT "%8.2" DEPOSIT ABSOLUTE /end AXIS_DESCR
 /begin AXIS_DESCR STD_AXIS IKCtl_facKnkInten_u8 fak_ub_b16 4 0 15.94 FORMAT "%5.2" DEPOSIT ABSOLUTE /end AXIS_DESCR
/end CHARACTERISTIC
/begin CHARACTERISTIC IKCtl_FacKnockDetThd0_GM "Knock detection factor map cylinder counter 0" MAP 0x807956F6 FklWUb 3.438 fak_ub_b16 0.0625 3.5 FORMAT "%5.3"
 /begin AXIS_DESCR COM_AXIS Epm_nEng EngN 16 -16384 16383.5 AXIS_PTS_REF IKCtl_nEngB16_X_AX FORMAT "%8.2" DEPOSIT ABSOLUTE /end AXIS_DESCR
 /begin AXIS_DESCR COM_AXIS rl_msg rel_ub_q0p75 4 0 191.3 AXIS_PTS_REF IKCtl_LoadAdd04_X_AX FORMAT "%5.1" DEPOSIT ABSOLUTE /end AXIS_DESCR
/end CHARACTERISTIC
/begin CHARACTERISTIC IKCtl_FacKnockDetThd1_GM "Knock detection factor map cylinder counter 1" MAP 0x80795736 FklWUb 3.438 fak_ub_b16 0.0625 3.5 FORMAT "%5.3"
 /begin AXIS_DESCR COM_AXIS Epm_nEng EngN 16 -16384 16383.5 AXIS_PTS_REF IKCtl_nEngB16_X_AX FORMAT "%8.2" DEPOSIT ABSOLUTE /end AXIS_DESCR
 /begin AXIS_DESCR COM_AXIS rl_msg rel_ub_q0p75 4 0 191.3 AXIS_PTS_REF IKCtl_LoadAdd04_X_AX FORMAT "%5.1" DEPOSIT ABSOLUTE /end AXIS_DESCR
/end CHARACTERISTIC
/begin CHARACTERISTIC IKCtl_FacKnockDetThd2_GM "Knock detection factor map cylinder counter 2" MAP 0x80795776 FklWUb 3.438 fak_ub_b16 0.0625 3.5 FORMAT "%5.3"
 /begin AXIS_DESCR COM_AXIS Epm_nEng EngN 16 -16384 16383.5 AXIS_PTS_REF IKCtl_nEngB16_X_AX FORMAT "%8.2" DEPOSIT ABSOLUTE /end AXIS_DESCR
 /begin AXIS_DESCR COM_AXIS rl_msg rel_ub_q0p75 4 0 191.3 AXIS_PTS_REF IKCtl_LoadAdd04_X_AX FORMAT "%5.1" DEPOSIT ABSOLUTE /end AXIS_DESCR
/end CHARACTERISTIC
/begin CHARACTERISTIC IKCtl_FacKnockDetThd3_GM "Knock detection factor map cylinder counter 3" MAP 0x807957B6 FklWUb 3.438 fak_ub_b16 0.0625 3.5 FORMAT "%5.3"
 /begin AXIS_DESCR COM_AXIS Epm_nEng EngN 16 -16384 16383.5 AXIS_PTS_REF IKCtl_nEngB16_X_AX FORMAT "%8.2" DEPOSIT ABSOLUTE /end AXIS_DESCR
 /begin AXIS_DESCR COM_AXIS rl_msg rel_ub_q0p75 4 0 191.3 AXIS_PTS_REF IKCtl_LoadAdd04_X_AX FORMAT "%5.1" DEPOSIT ABSOLUTE /end AXIS_DESCR
/end CHARACTERISTIC
/begin CHARACTERISTIC IKCtl_FacKnockDetThd4_GM "Knock detection factor map cylinder counter 4" MAP 0x807957F6 FklWUb 3.438 fak_ub_b16 0.0625 3.5 FORMAT "%5.3"
 /begin AXIS_DESCR COM_AXIS Epm_nEng EngN 16 -16384 16383.5 AXIS_PTS_REF IKCtl_nEngB16_X_AX FORMAT "%8.2" DEPOSIT ABSOLUTE /end AXIS_DESCR
 /begin AXIS_DESCR COM_AXIS rl_msg rel_ub_q0p75 4 0 191.3 AXIS_PTS_REF IKCtl_LoadAdd04_X_AX FORMAT "%5.1" DEPOSIT ABSOLUTE /end AXIS_DESCR
/end CHARACTERISTIC
/begin CHARACTERISTIC IKCtl_FacKnockDetThd5_GM "Knock detection factor map cylinder counter 5" MAP 0x80795836 FklWUb 3.438 fak_ub_b16 0.0625 3.5 FORMAT "%5.3"
 /begin AXIS_DESCR COM_AXIS Epm_nEng EngN 16 -16384 16383.5 AXIS_PTS_REF IKCtl_nEngB16_X_AX FORMAT "%8.2" DEPOSIT ABSOLUTE /end AXIS_DESCR
 /begin AXIS_DESCR COM_AXIS rl_msg rel_ub_q0p75 4 0 191.3 AXIS_PTS_REF IKCtl_LoadAdd04_X_AX FORMAT "%5.1" DEPOSIT ABSOLUTE /end AXIS_DESCR
/end CHARACTERISTIC
/begin CHARACTERISTIC KF_BSLGF "Lambda grease limit for component protection filling intervention" MAP 0x8071779A _REC_A1CUR_1_MBSE_U2_S1 15.999755859375 BumqDkc_mryszAa_EcglxAc_nR_4oa0 0 15.999755859375
 /begin AXIS_DESCR COM_AXIS Nkw_atm caoddzd_oAjpfzb_cAcEEha_1nR_oa0 4 -32768 32767 AXIS_PTS_REF AXX_KF_BSLGF MONOTONY STRICT_INCREASE DEPOSIT ABSOLUTE /end AXIS_DESCR
 /begin AXIS_DESCR COM_AXIS Rf_atm CgkBooc_wkiDfEd_Czglhgc_fR_1a0o 4 -327.68 327.67 AXIS_PTS_REF AXY_KF_BSLGF MONOTONY STRICT_INCREASE DEPOSIT ABSOLUTE /end AXIS_DESCR
/end CHARACTERISTIC
/begin CHARACTERISTIC KF_DLAMBSVST_TABG "Deltalambda for pre-control component protection exhaust gas temperature branch" MAP 0x807179E0 _REC_A1CUR_1_MBSE_S2_S1 8 BumqDkc_mryszAa_EcglxAc_nR_4oa0 -8 0 FORMAT "%7.4"
 /begin AXIS_DESCR COM_AXIS Nkw_atm caoddzd_oAjpfzb_cAcEEha_1nR_oa0 8 -32768 32767 AXIS_PTS_REF AXX_KF_DLAMBSVST_TABG MONOTONY STRICT_INCREASE DEPOSIT ABSOLUTE /end AXIS_DESCR
 /begin AXIS_DESCR COM_AXIS Rf_atm CgkBooc_wkiDfEd_Czglhgc_fR_1a0o 8 -327.68 327.67 AXIS_PTS_REF AXY_KF_DLAMBSVST_TABG MONOTONY STRICT_INCREASE DEPOSIT ABSOLUTE /end AXIS_DESCR
/end CHARACTERISTIC
/begin CHARACTERISTIC KF_DPLDS_PRED "Offset setpoint boost pressure as f(engine speed, dynamic Rf_setpoint damping)" MAP 0x807418E4 _REC_A1CUR_1_MBSE_U2_S1 8191.875 rAdkuaa_wDllxja_BnDuEFa_n__aa0o 0 8191.875
 /begin AXIS_DESCR COM_AXIS Nkw caoddzd_oAjpfzb_cAcEEha_1nR_oa0 6 0 32767 AXIS_PTS_REF AXX_KF_DPLDS_PRED FORMAT "%5.0" MONOTONY MON_INCREASE DEPOSIT ABSOLUTE /end AXIS_DESCR
 /begin AXIS_DESCR COM_AXIS Drf_s2spred CgkBooc_wkiDfEd_Czglhgc_fR_1a0o 6 0 655.35 AXIS_PTS_REF AXY_KF_DPLDS_PRED MONOTONY MON_INCREASE DEPOSIT ABSOLUTE /end AXIS_DESCR
/end CHARACTERISTIC
/begin CHARACTERISTIC KF_DPLDSOLL_SPORT "Map boost pressure offset to the target boost pressure (in sport mode)" MAP 0x807208FA _REC_A1CUR_1_MBSE_U2_S1 8191.875 BMW_p_sw_q0p125_hPa 0 8191.875 FORMAT "%8.3"
 /begin AXIS_DESCR COM_AXIS NO_INPUT_QUANTITY caoddzd_oAjpfzb_cAcEEha_1nR_oa0 6 0 32767 AXIS_PTS_REF AXX_KF_DPLDSOLL_SPORT FORMAT "%5.0" MONOTONY MON_INCREASE DEPOSIT ABSOLUTE /end AXIS_DESCR
 /begin AXIS_DESCR COM_AXIS NO_INPUT_QUANTITY acriqBc_tfkBqod_ocgjxzc_nR_8oa0 6 0 7.9998779296875 AXIS_PTS_REF AXY_KF_DPLDSOLL_SPORT FORMAT "%7.5" MONOTONY MON_INCREASE DEPOSIT ABSOLUTE /end AXIS_DESCR
/end CHARACTERISTIC
/begin CHARACTERISTIC KF_DZW_DYN "Delta ignition angle dynamic correction" MAP 0x8075665F _REC_A1CUR_1_MBSE_S1_S1 127.5 aAwkuzc_BFpgCmb_tmDukma_q__aa0o -64 63.5 FORMAT "%4.1"
 /begin AXIS_DESCR COM_AXIS Nkw caoddzd_oAjpfzb_cAcEEha_1nR_oa0 4 -32768 32767 AXIS_PTS_REF AXX_KF_DZW_DYN FORMAT "%5.0" MONOTONY STRICT_INCREASE DEPOSIT ABSOLUTE /end AXIS_DESCR
 /begin AXIS_DESCR COM_AXIS NO_INPUT_QUANTITY CgkBooc_wkiDfEd_Czglhgc_fR_1a0o 4 -327.68 327.67 AXIS_PTS_REF AXY_KF_DZW_DYN FORMAT "%9.2" MONOTONY STRICT_INCREASE DEPOSIT ABSOLUTE /end AXIS_DESCR
/end CHARACTERISTIC
/begin CHARACTERISTIC KF_DZWMIN_NORMAL_SOT "Ignition angle intervention for sound tuning" MAP 0x80757DE8 _REC_A1CUR_1_MBSE_S1_S1 127.5 aAwkuzc_BFpgCmb_tmDukma_q__aa0o -64 63.5
 /begin AXIS_DESCR COM_AXIS Nkw caoddzd_oAjpfzb_cAcEEha_1nR_oa0 6 -32768 32767 AXIS_PTS_REF AXX_KF_DZWMIN_NORMAL_SOT FORMAT "%5.0" MONOTONY STRICT_INCREASE DEPOSIT ABSOLUTE /end AXIS_DESCR
 /begin AXIS_DESCR COM_AXIS V AFeDmkb_cAbjmcc_kAkskhd_k__0oa0 4 0 65535 AXIS_PTS_REF AXY_KF_DZWMIN_NORMAL_SOT FORMAT "%5.0" MONOTONY STRICT_INCREASE DEPOSIT ABSOLUTE /end AXIS_DESCR
/end CHARACTERISTIC
/begin CHARACTERISTIC KF_DZWMIN_SPORT_SOT "Ignition angle intervention for sound tuning at B_sport" MAP 0x80757D90 _REC_A1CUR_1_MBSE_S1_S1 127.5 aAwkuzc_BFpgCmb_tmDukma_q__aa0o -64 63.5
 /begin AXIS_DESCR COM_AXIS Nkw caoddzd_oAjpfzb_cAcEEha_1nR_oa0 6 -32768 32767 AXIS_PTS_REF AXX_KF_DZWMIN_SPORT_SOT FORMAT "%5.0" MONOTONY STRICT_INCREASE DEPOSIT ABSOLUTE /end AXIS_DESCR
 /begin AXIS_DESCR COM_AXIS V AFeDmkb_cAbjmcc_kAkskhd_k__0oa0 4 0 65535 AXIS_PTS_REF AXY_KF_DZWMIN_SPORT_SOT FORMAT "%5.0" MONOTONY STRICT_INCREASE DEPOSIT ABSOLUTE /end AXIS_DESCR
/end CHARACTERISTIC
/begin CHARACTERISTIC KF_DZWT_PF1 "Temperature correction ZW knock limit path 1" MAP 0x80756C81 _REC_A1CUR_1_MBSE_S1_S1 127.5 aAwkuzc_BFpgCmb_tmDukma_q__aa0o -64 63.5 FORMAT "%4.1"
 /begin AXIS_DESCR COM_AXIS Nkw caoddzd_oAjpfzb_cAcEEha_1nR_oa0 20 -32768 32767 AXIS_PTS_REF AXX_KF_DZWT_PF1 FORMAT "%5.0" MONOTONY MON_INCREASE DEPOSIT ABSOLUTE /end AXIS_DESCR
 /begin AXIS_DESCR COM_AXIS NO_INPUT_QUANTITY CgkBooc_wkiDfEd_Czglhgc_fR_1a0o 16 -327.68 327.67 AXIS_PTS_REF AXY_KF_DZWT_PF1 FORMAT "%9.2" MONOTONY MON_INCREASE DEPOSIT ABSOLUTE /end AXIS_DESCR
/end CHARACTERISTIC
/begin CHARACTERISTIC KF_DZWT_PF2 "Temperature correction ZW knock limit path 2" MAP 0x80756B41 _REC_A1CUR_1_MBSE_S1_S1 127.5 aAwkuzc_BFpgCmb_tmDukma_q__aa0o -64 63.5 FORMAT "%4.1"
 /begin AXIS_DESCR COM_AXIS Nkw caoddzd_oAjpfzb_cAcEEha_1nR_oa0 20 -32768 32767 AXIS_PTS_REF AXX_KF_DZWT_PF2 FORMAT "%5.0" MONOTONY MON_INCREASE DEPOSIT ABSOLUTE /end AXIS_DESCR
 /begin AXIS_DESCR COM_AXIS NO_INPUT_QUANTITY CgkBooc_wkiDfEd_Czglhgc_fR_1a0o 16 -327.68 327.67 AXIS_PTS_REF AXY_KF_DZWT_PF2 FORMAT "%9.2" MONOTONY MON_INCREASE DEPOSIT ABSOLUTE /end AXIS_DESCR
/end CHARACTERISTIC
/begin CHARACTERISTIC KF_DZWT_UESP_PF1 "Temperature correction ZW knock limit path 1 flush" MAP 0x80756AC9 _REC_A1CUR_1_MBSE_S1_S1 127.5 aAwkuzc_BFpgCmb_tmDukma_q__aa0o -64 63.5 FORMAT "%4.1"
 /begin AXIS_DESCR COM_AXIS Nkw caoddzd_oAjpfzb_cAcEEha_1nR_oa0 10 -32768 32767 AXIS_PTS_REF AXX_KF_DZWT_UESP_PF1 FORMAT "%5.0" MONOTONY STRICT_INCREASE DEPOSIT ABSOLUTE /end AXIS_DESCR
 /begin AXIS_DESCR COM_AXIS NO_INPUT_QUANTITY CgkBooc_wkiDfEd_Czglhgc_fR_1a0o 12 -327.68 327.67 AXIS_PTS_REF AXY_KF_DZWT_UESP_PF1 FORMAT "%9.2" MONOTONY STRICT_INCREASE DEPOSIT ABSOLUTE /end AXIS_DESCR
/end CHARACTERISTIC
/begin CHARACTERISTIC KF_DZWT_UESP_PF2 "Temperature correction ZW knock limit path 2 flush" MAP 0x80756A51 _REC_A1CUR_1_MBSE_S1_S1 127.5 aAwkuzc_BFpgCmb_tmDukma_q__aa0o -64 63.5 FORMAT "%4.1"
 /begin AXIS_DESCR COM_AXIS Nkw caoddzd_oAjpfzb_cAcEEha_1nR_oa0 10 -32768 32767 AXIS_PTS_REF AXX_KF_DZWT_UESP_PF2 FORMAT "%5.0" MONOTONY STRICT_INCREASE DEPOSIT ABSOLUTE /end AXIS_DESCR
 /begin AXIS_DESCR COM_AXIS NO_INPUT_QUANTITY CgkBooc_wkiDfEd_Czglhgc_fR_1a0o 12 -327.68 327.67 AXIS_PTS_REF AXY_KF_DZWT_UESP_PF2 FORMAT "%9.2" MONOTONY STRICT_INCREASE DEPOSIT ABSOLUTE /end AXIS_DESCR
/end CHARACTERISTIC
/begin CHARACTERISTIC KF_EDA_ANZ_SPORT_MD_EM1_IST "Adjustment of the moment for the performance display" MAP 0x8070C732 _REC_A1CUR_1_MBSE_S2_S1 6553.5 BMW_dm_sw_q0p1_Nm -3276.8 3276.7 FORMAT "%7.2"
 /begin AXIS_DESCR COM_AXIS NO_INPUT_QUANTITY BMW_dm_sw_q0p1_Nm 6 -3276.8 3276.7 AXIS_PTS_REF AXX_KF_EDA_ANZ_SPORT_MD_EM1_IST FORMAT "%7.2" MONOTONY STRICT_INCREASE DEPOSIT ABSOLUTE /end AXIS_DESCR
 /begin AXIS_DESCR COM_AXIS NO_INPUT_QUANTITY caoddzd_oAjpfzb_cAcEEha_1nR_oa0 6 -32768 32767 AXIS_PTS_REF AXY_KF_EDA_ANZ_SPORT_MD_EM1_IST FORMAT "%5.0" MONOTONY STRICT_INCREASE DEPOSIT ABSOLUTE /end AXIS_DESCR
/end CHARACTERISTIC
/begin CHARACTERISTIC KF_FDZW_DYN1 "Weighting factor dynamic correction via Tans and Dzw_annm for manual transmissions" MAP 0x8075CB6C _REC_A1CUR_1_MBSE_U1_S1 0.99609375 BMW_Powertrain_DxECompuMethods_Def_ub_b1_nounit 0 0.99609375
 /begin AXIS_DESCR COM_AXIS Tans BMW_q0p1_degC 4 -3276.8 3276.7 AXIS_PTS_REF AXX_KF_FDZW_DYN1 FORMAT "%6.1" MONOTONY STRICT_INCREASE DEPOSIT ABSOLUTE /end AXIS_DESCR
 /begin AXIS_DESCR COM_AXIS Dzw_annm BMW_q0p1_deg 4 -50 60 AXIS_PTS_REF AXY_KF_FDZW_DYN1 FORMAT "%6.1" MONOTONY STRICT_INCREASE DEPOSIT ABSOLUTE /end AXIS_DESCR
/end CHARACTERISTIC
/begin CHARACTERISTIC KF_FDZW_DYN2 "Weighting factor dynamic correction via V and gears for manual transmission" MAP 0x8075CB44 _REC_A1CUR_1_MBSE_U1_S1 0.99609375 BMW_Powertrain_DxECompuMethods_Def_ub_b1_nounit 0 0.99609375
 /begin AXIS_DESCR COM_AXIS Gangi raChrxc_kBtBrmb_FmDuEFa_n__aa0o 10 0 255 AXIS_PTS_REF AXX_KF_FDZW_DYN2 FORMAT "%3.0" MONOTONY MON_INCREASE DEPOSIT ABSOLUTE /end AXIS_DESCR
 /begin AXIS_DESCR COM_AXIS V AFeDmkb_cAbjmcc_kAkskhd_k__0oa0 4 0 360 AXIS_PTS_REF AXY_KF_FDZW_DYN2 FORMAT "%5.0" MONOTONY STRICT_INCREASE DEPOSIT ABSOLUTE /end AXIS_DESCR
/end CHARACTERISTIC
/begin CHARACTERISTIC KF_FDZW_DYN3 "Weighting factor dynamic correction via Tans and Dzw_annm for automatic transmission" MAP 0x8075CB34 _REC_A1CUR_1_MBSE_U1_S1 0.99609375 BMW_Powertrain_DxECompuMethods_Def_ub_b1_nounit 0 0.99609375
 /begin AXIS_DESCR COM_AXIS Tans BMW_q0p1_degC 4 -3276.8 3276.7 AXIS_PTS_REF AXX_KF_FDZW_DYN3 FORMAT "%6.1" MONOTONY STRICT_INCREASE DEPOSIT ABSOLUTE /end AXIS_DESCR
 /begin AXIS_DESCR COM_AXIS Dzw_annm BMW_q0p1_deg 4 -50 60 AXIS_PTS_REF AXY_KF_FDZW_DYN3 FORMAT "%6.1" MONOTONY STRICT_INCREASE DEPOSIT ABSOLUTE /end AXIS_DESCR
/end CHARACTERISTIC
/begin CHARACTERISTIC KF_FDZW_DYN4 "Weighting factor dynamic correction via V and Gangi for automatic transmissions" MAP 0x8075CB0C _REC_A1CUR_1_MBSE_U1_S1 0.99609375 BMW_Powertrain_DxECompuMethods_Def_ub_b1_nounit 0 0.99609375
 /begin AXIS_DESCR COM_AXIS Gangi raChrxc_kBtBrmb_FmDuEFa_n__aa0o 10 0 255 AXIS_PTS_REF AXX_KF_FDZW_DYN4 FORMAT "%3.0" MONOTONY MON_INCREASE DEPOSIT ABSOLUTE /end AXIS_DESCR
 /begin AXIS_DESCR COM_AXIS V AFeDmkb_cAbjmcc_kAkskhd_k__0oa0 4 0 360 AXIS_PTS_REF AXY_KF_FDZW_DYN4 FORMAT "%5.0" MONOTONY STRICT_INCREASE DEPOSIT ABSOLUTE /end AXIS_DESCR
/end CHARACTERISTIC
/begin CHARACTERISTIC KF_FDZWT_BEST_PF1 "Factor temperature correction ZW-Best path 1" MAP 0x80733F28 _REC_A1CUR_1_MBSE_S2_S1 3.99993896484375 ilxsavd_hkzmBfc_lAzCpAb_nR_1oa0 -2 1.99993896484375 FORMAT "%14.5"
 /begin AXIS_DESCR COM_AXIS Tmot DchEpAd_DBCFgoa_Ckhahgc_q__aoa0 6 -327.68 327.67 AXIS_PTS_REF AXX_KF_FDZWT_BEST_PF1 FORMAT "%7.2" MONOTONY STRICT_INCREASE DEPOSIT ABSOLUTE /end AXIS_DESCR
 /begin AXIS_DESCR COM_AXIS Tans BMW_q0p1_degC 6 -3276.8 3276.7 AXIS_PTS_REF AXY_KF_FDZWT_BEST_PF1 FORMAT "%6.1" MONOTONY STRICT_INCREASE DEPOSIT ABSOLUTE /end AXIS_DESCR
/end CHARACTERISTIC
/begin CHARACTERISTIC KF_FDZWT_BEST_PF2 "Factor temperature correction ZW-Best path 2" MAP 0x80733EE0 _REC_A1CUR_1_MBSE_S2_S1 3.99993896484375 ilxsavd_hkzmBfc_lAzCpAb_nR_1oa0 -2 1.99993896484375 FORMAT "%14.5"
 /begin AXIS_DESCR COM_AXIS Tmot DchEpAd_DBCFgoa_Ckhahgc_q__aoa0 6 -327.68 327.67 AXIS_PTS_REF AXX_KF_FDZWT_BEST_PF2 FORMAT "%7.2" MONOTONY STRICT_INCREASE DEPOSIT ABSOLUTE /end AXIS_DESCR
 /begin AXIS_DESCR COM_AXIS Tans BMW_q0p1_degC 6 -3276.8 3276.7 AXIS_PTS_REF AXY_KF_FDZWT_BEST_PF2 FORMAT "%6.1" MONOTONY STRICT_INCREASE DEPOSIT ABSOLUTE /end AXIS_DESCR
/end CHARACTERISTIC
/begin CHARACTERISTIC KF_FDZWT_PF1 "Factor temperature correction ZW knock limit path 1" MAP 0x80733FE8 _REC_A1CUR_1_MBSE_S2_S1 3.9998779296875 ilxsavd_hkzmBfc_lAzCpAb_nR_1oa0 -2 1.9998779296875 FORMAT "%14.5"
 /begin AXIS_DESCR COM_AXIS Tmot DchEpAd_DBCFgoa_Ckhahgc_q__aoa0 6 -327.68 327.67 AXIS_PTS_REF AXX_KF_FDZWT_PF1 FORMAT "%7.2" MONOTONY STRICT_INCREASE DEPOSIT ABSOLUTE /end AXIS_DESCR
 /begin AXIS_DESCR COM_AXIS Tans BMW_q0p1_degC 6 -3276.8 3276.7 AXIS_PTS_REF AXY_KF_FDZWT_PF1 FORMAT "%6.1" MONOTONY STRICT_INCREASE DEPOSIT ABSOLUTE /end AXIS_DESCR
/end CHARACTERISTIC
/begin CHARACTERISTIC KF_FDZWT_PF2 "Factor temperature correction ZW knock limit path 2" MAP 0x80733FA0 _REC_A1CUR_1_MBSE_S2_S1 3.9998779296875 ilxsavd_hkzmBfc_lAzCpAb_nR_1oa0 -2 1.9998779296875 FORMAT "%14.5"
 /begin AXIS_DESCR COM_AXIS Tmot DchEpAd_DBCFgoa_Ckhahgc_q__aoa0 6 -327.68 327.67 AXIS_PTS_REF AXX_KF_FDZWT_PF2 FORMAT "%7.2" MONOTONY STRICT_INCREASE DEPOSIT ABSOLUTE /end AXIS_DESCR
 /begin AXIS_DESCR COM_AXIS Tans BMW_q0p1_degC 6 -3276.8 3276.7 AXIS_PTS_REF AXY_KF_FDZWT_PF2 FORMAT "%6.1" MONOTONY STRICT_INCREASE DEPOSIT ABSOLUTE /end AXIS_DESCR
/end CHARACTERISTIC
/begin CHARACTERISTIC KF_FRKKORRF_1 "Map pre-control correction bank 1" MAP 0x807138AE _REC_A1CUR_1_MBSE_U2_S1 1.99996948242188 Bhvfwhc_bigEubd_BBEupBd_nR_3oa0 0 1.99996948242188 FORMAT "%14.5"
 /begin AXIS_DESCR COM_AXIS Nkw caoddzd_oAjpfzb_cAcEEha_1nR_oa0 16 -32768 32767 AXIS_PTS_REF AXX_KF_FRKKORRF_1 FORMAT "%5.0" MONOTONY STRICT_INCREASE DEPOSIT ABSOLUTE /end AXIS_DESCR
 /begin AXIS_DESCR COM_AXIS Rf CgkBooc_wkiDfEd_Czglhgc_fR_1a0o 16 -327.68 327.67 AXIS_PTS_REF AXY_KF_FRKKORRF_1 FORMAT "%7.2" MONOTONY STRICT_INCREASE DEPOSIT ABSOLUTE /end AXIS_DESCR
/end CHARACTERISTIC
/begin CHARACTERISTIC KF_KOEFF_B_LA "Coefficient B for lambda correction ZW knock limit" MAP 0x80734228 _REC_A1CUR_1_MBSE_U2_S1 15.999755859375 BumqDkc_mryszAa_EcglxAc_nR_4oa0 0 15.999755859375 FORMAT "%9.4"
 /begin AXIS_DESCR COM_AXIS Nkw caoddzd_oAjpfzb_cAcEEha_1nR_oa0 6 -32768 32767 AXIS_PTS_REF AXX_KF_KOEFF_B_LA FORMAT "%5.0" MONOTONY STRICT_INCREASE DEPOSIT ABSOLUTE /end AXIS_DESCR
 /begin AXIS_DESCR COM_AXIS NO_INPUT_QUANTITY CgkBooc_wkiDfEd_Czglhgc_fR_1a0o 6 -327.68 327.67 AXIS_PTS_REF AXY_KF_KOEFF_B_LA FORMAT "%9.2" MONOTONY STRICT_INCREASE DEPOSIT ABSOLUTE /end AXIS_DESCR
/end CHARACTERISTIC
/begin CHARACTERISTIC KF_LA_BEZ "Reference lambda for lambda correction ZW knock limit" MAP 0x807341C8 _REC_A1CUR_1_MBSE_U2_S1 15.999755859375 BumqDkc_mryszAa_EcglxAc_nR_4oa0 0 15.999755859375 FORMAT "%9.4"
 /begin AXIS_DESCR COM_AXIS Nkw caoddzd_oAjpfzb_cAcEEha_1nR_oa0 6 -32768 32767 AXIS_PTS_REF AXX_KF_LA_BEZ FORMAT "%5.0" MONOTONY STRICT_INCREASE DEPOSIT ABSOLUTE /end AXIS_DESCR
 /begin AXIS_DESCR COM_AXIS NO_INPUT_QUANTITY CgkBooc_wkiDfEd_Czglhgc_fR_1a0o 8 -327.68 327.67 AXIS_PTS_REF AXY_KF_LA_BEZ FORMAT "%9.2" MONOTONY MON_INCREASE DEPOSIT ABSOLUTE /end AXIS_DESCR
/end CHARACTERISTIC
/begin CHARACTERISTIC KF_LA_SK "Base lambda in homogeneous with super knocker" MAP 0x80748CE2 _REC_A1CUR_1_MBSE_U2_S1 15.999755859375 BumqDkc_mryszAa_EcglxAc_nR_4oa0 0 15.999755859375 FORMAT "%9.4"
 /begin AXIS_DESCR COM_AXIS Nkw caoddzd_oAjpfzb_cAcEEha_1nR_oa0 18 -32768 32767 AXIS_PTS_REF GXX_KF_LABAS FORMAT "%5.0" MONOTONY STRICT_INCREASE DEPOSIT ABSOLUTE /end AXIS_DESCR
 /begin AXIS_DESCR COM_AXIS Rf CgkBooc_wkiDfEd_Czglhgc_fR_1a0o 17 -327.68 327.67 AXIS_PTS_REF GXY_KF_LABAS FORMAT "%7.2" MONOTONY STRICT_INCREASE DEPOSIT ABSOLUTE /end AXIS_DESCR
/end CHARACTERISTIC
/begin CHARACTERISTIC KF_LABAS_1 "Base lambda in the homogeneous bank 1" MAP 0x807491AA _REC_A1CUR_1_MBSE_U2_S1 15.999755859375 BumqDkc_mryszAa_EcglxAc_nR_4oa0 0 15.999755859375 FORMAT "%9.4"
 /begin AXIS_DESCR COM_AXIS Nkw caoddzd_oAjpfzb_cAcEEha_1nR_oa0 18 -32768 32767 AXIS_PTS_REF GXX_KF_LABAS FORMAT "%5.0" MONOTONY STRICT_INCREASE DEPOSIT ABSOLUTE /end AXIS_DESCR
 /begin AXIS_DESCR COM_AXIS Rf CgkBooc_wkiDfEd_Czglhgc_fR_1a0o 17 -327.68 327.67 AXIS_PTS_REF GXY_KF_LABAS FORMAT "%7.2" MONOTONY STRICT_INCREASE DEPOSIT ABSOLUTE /end AXIS_DESCR
/end CHARACTERISTIC
/begin CHARACTERISTIC KF_LABAS_2 "Base lambda in the homogeneous bank 2" MAP 0x80748F46 _REC_A1CUR_1_MBSE_U2_S1 15.999755859375 BumqDkc_mryszAa_EcglxAc_nR_4oa0 0 15.999755859375 FORMAT "%9.4"
 /begin AXIS_DESCR COM_AXIS Nkw caoddzd_oAjpfzb_cAcEEha_1nR_oa0 18 -32768 32767 AXIS_PTS_REF GXX_KF_LABAS FORMAT "%5.0" MONOTONY STRICT_INCREASE DEPOSIT ABSOLUTE /end AXIS_DESCR
 /begin AXIS_DESCR COM_AXIS Rf CgkBooc_wkiDfEd_Czglhgc_fR_1a0o 17 -327.68 327.67 AXIS_PTS_REF GXY_KF_LABAS FORMAT "%7.2" MONOTONY STRICT_INCREASE DEPOSIT ABSOLUTE /end AXIS_DESCR
/end CHARACTERISTIC
/begin CHARACTERISTIC KF_LAMIN_H "Lamda burning limits bold" MAP 0x8071C0DA _REC_A1CUR_1_MBSE_U2_S1 15.999755859375 BumqDkc_mryszAa_EcglxAc_nR_4oa0 0 15.999755859375 FORMAT "%9.4"
 /begin AXIS_DESCR COM_AXIS Nkw caoddzd_oAjpfzb_cAcEEha_1nR_oa0 6 -32768 32767 AXIS_PTS_REF AXX_KF_LAMIN_H FORMAT "%5.0" MONOTONY STRICT_INCREASE DEPOSIT ABSOLUTE /end AXIS_DESCR
 /begin AXIS_DESCR COM_AXIS Rf CgkBooc_wkiDfEd_Czglhgc_fR_1a0o 6 -327.68 327.67 AXIS_PTS_REF AXY_KF_LAMIN_H FORMAT "%7.2" MONOTONY STRICT_INCREASE DEPOSIT ABSOLUTE /end AXIS_DESCR
/end CHARACTERISTIC
/begin CHARACTERISTIC KF_MD_RES_NST_KEY "Momentum reserve in the post-start" MAP 0x8072DF2A _REC_A1CUR_1_MBSE_S2_S1 6553.5 BMW_dm_sw_q0p1_Nm -3276.8 3276.7 FORMAT "%6.1"
 /begin AXIS_DESCR COM_AXIS Tn_start_10 camcxxd_bxlpdsa_Cshlhgc_sR_1a0o 4 0 655.35 AXIS_PTS_REF AXX_KF_MD_RES_NST_KEY FORMAT "%7.2" MONOTONY STRICT_INCREASE DEPOSIT ABSOLUTE /end AXIS_DESCR
 /begin AXIS_DESCR COM_AXIS Tmot DchEpAd_DBCFgoa_Ckhahgc_q__aoa0 4 -327.68 327.67 AXIS_PTS_REF AXY_KF_MD_RES_NST_KEY FORMAT "%7.2" MONOTONY STRICT_INCREASE DEPOSIT ABSOLUTE /end AXIS_DESCR
/end CHARACTERISTIC
/begin CHARACTERISTIC KF_MDIOP_1_TQE "optimal reference torque from filling and speed" MAP 0x8072A048 _REC_A1CUR_1_MBSE_S2_S1 6553.5 BMW_dm_sw_q0p1_Nm -3276.8 3276.7
 /begin AXIS_DESCR COM_AXIS NO_INPUT_QUANTITY CgkBooc_wkiDfEd_Czglhgc_fR_1a0o 18 -327.68 327.67 AXIS_PTS_REF AXX_KF_MDIOP_1_TQE FORMAT "%6.2" MONOTONY STRICT_INCREASE DEPOSIT ABSOLUTE /end AXIS_DESCR
 /begin AXIS_DESCR COM_AXIS NO_INPUT_QUANTITY caoddzd_oAjpfzb_cAcEEha_1nR_oa0 20 -32768 32767 AXIS_PTS_REF AXY_KF_MDIOP_1_TQE FORMAT "%5.0" MONOTONY STRICT_INCREASE DEPOSIT ABSOLUTE /end AXIS_DESCR
/end CHARACTERISTIC
/begin CHARACTERISTIC KF_MDK_MAX_GANG_NKW "KF_MDK_MAX_GANG_NKW" MAP 0x8074328C _REC_A1CUR_1_MBSE_S2_S1 6553.5 BMW_dm_sw_q0p1_Nm -3276.8 3276.7 FORMAT "%6.2"
 /begin AXIS_DESCR COM_AXIS Gang_gb1_ist raChrxc_kBtBrmb_FmDuEFa_n__aa0o 10 -128 127 AXIS_PTS_REF AXX_KF_MDK_MAX_GANG_NKW FORMAT "%6.0" MONOTONY STRICT_INCREASE DEPOSIT ABSOLUTE /end AXIS_DESCR
 /begin AXIS_DESCR COM_AXIS Nkw_plaus caoddzd_oAjpfzb_cAcEEha_1nR_oa0 8 -32768 32767 AXIS_PTS_REF AXY_KF_MDK_MAX_GANG_NKW FORMAT "%6.0" MONOTONY STRICT_INCREASE DEPOSIT ABSOLUTE /end AXIS_DESCR
/end CHARACTERISTIC
/begin CHARACTERISTIC KF_NEWP_LLK_TANS "Request of the EW_LLK depending on the intake air temperature and the difference between intake air temperature and ambient temperature" MAP 0x8075BB48 _REC_A1CUR_1_MBSE_U1_S1 100 nnxvdDd_vDnjvqd_FmDuEEa_f__aa0o 0 100
 /begin AXIS_DESCR COM_AXIS Dtans_tumg_wm BMW_q0p1_degC 6 -3276.8 3276.7 AXIS_PTS_REF AXX_KF_NEWP_LLK_TANS MONOTONY STRICT_INCREASE DEPOSIT ABSOLUTE /end AXIS_DESCR
 /begin AXIS_DESCR COM_AXIS Tumg_wm BMW_q0p1_degC 6 -3276.8 3276.7 AXIS_PTS_REF AXY_KF_NEWP_LLK_TANS MONOTONY STRICT_INCREASE DEPOSIT ABSOLUTE /end AXIS_DESCR
/end CHARACTERISTIC
/begin CHARACTERISTIC KF_PHA_H_B1_SK_PRE "Characteristic map starting angle ES1 Preventive super knocking." MAP 0x80714E76 _REC_A1CUR_1_MBSE_S2_S1 1535.9765625 aEmoCzd_erpwvfb_msfkhgc_qR_1a0o -768 767.9765625
 /begin AXIS_DESCR COM_AXIS Nkw caoddzd_oAjpfzb_cAcEEha_1nR_oa0 10 -32768 32767 AXIS_PTS_REF GXX_KF_PHA_H_B1_BAS FORMAT "%5.0" MONOTONY STRICT_INCREASE DEPOSIT ABSOLUTE /end AXIS_DESCR
 /begin AXIS_DESCR COM_AXIS NO_INPUT_QUANTITY zyyxBpb_rEsnvtc_gktukCa_fR_5a0o 12 -1600 1599.951171875 AXIS_PTS_REF GXY_KF_PHA_H_B1_BAS FORMAT "%8.3" MONOTONY STRICT_INCREASE DEPOSIT ABSOLUTE /end AXIS_DESCR
/end CHARACTERISTIC
/begin CHARACTERISTIC KF_PHA_H_B1_W "Kennfeld Beginnwinkel ES1 Warm" MAP 0x80714D06 _REC_A1CUR_1_MBSE_S2_S1 1535.9765625 aEmoCzd_erpwvfb_msfkhgc_qR_1a0o -768 767.9765625
 /begin AXIS_DESCR COM_AXIS Nkw caoddzd_oAjpfzb_cAcEEha_1nR_oa0 10 -32768 32767 AXIS_PTS_REF GXX_KF_PHA_H_B1_BAS FORMAT "%5.0" MONOTONY STRICT_INCREASE DEPOSIT ABSOLUTE /end AXIS_DESCR
 /begin AXIS_DESCR COM_AXIS NO_INPUT_QUANTITY zyyxBpb_rEsnvtc_gktukCa_fR_5a0o 12 -1600 1599.951171875 AXIS_PTS_REF GXY_KF_PHA_H_B1_BAS FORMAT "%8.3" MONOTONY STRICT_INCREASE DEPOSIT ABSOLUTE /end AXIS_DESCR
/end CHARACTERISTIC
/begin CHARACTERISTIC KF_PHA_H_E1 "KF_PHA_H_E1" MAP 0x807163CA _REC_A1CUR_1_MBSE_S2_S1 1535.9765625 ridxkCa_Dxvxtdc_CChkhgc_nR_1a0o -768 767.9765625
 /begin AXIS_DESCR COM_AXIS Nkw caoddzd_oAjpfzb_cAcEEha_1nR_oa0 8 -32768 32767 AXIS_PTS_REF AXX_KF_PHA_H_E1 FORMAT "%5.0" MONOTONY STRICT_INCREASE DEPOSIT ABSOLUTE /end AXIS_DESCR
 /begin AXIS_DESCR COM_AXIS NO_INPUT_QUANTITY zyyxBpb_rEsnvtc_gktukCa_fR_5a0o 8 -1600 1599.951171875 AXIS_PTS_REF AXY_KF_PHA_H_E1 MONOTONY STRICT_INCREASE DEPOSIT ABSOLUTE /end AXIS_DESCR
/end CHARACTERISTIC
/begin CHARACTERISTIC KF_PRAIL_H "Map RAIL PRESSURE HOMOGENOUS -- with active VVT" MAP 0x80722DE0 _REC_A1CUR_1_MBSE_U2_S1 39.9993896484375 cxdjuna_xpuCged_ocEpdua_MCRa2a0 0 39.9993896484375 FORMAT "%9.4"
 /begin AXIS_DESCR COM_AXIS Nkw caoddzd_oAjpfzb_cAcEEha_1nR_oa0 8 -32768 32767 AXIS_PTS_REF AXX_KF_PRAIL_H FORMAT "%5.0" MONOTONY STRICT_INCREASE DEPOSIT ABSOLUTE /end AXIS_DESCR
 /begin AXIS_DESCR COM_AXIS BMWrailco_rat_VabHom_sw zyyxBpb_rEsnvtc_gktukCa_fR_5a0o 8 -1600 1599.951171875 AXIS_PTS_REF AXY_KF_PRAIL_H FORMAT "%8.3" MONOTONY STRICT_INCREASE DEPOSIT ABSOLUTE /end AXIS_DESCR
/end CHARACTERISTIC
/begin CHARACTERISTIC KF_PRAIL_H_K "Map RAIL PRESSURE HOMOGENEOUS COLD -- with active VVT" MAP 0x80722B60 _REC_A1CUR_1_MBSE_U2_S1 39.9993896484375 cxdjuna_xpuCged_ocEpdua_MCRa2a0 0 39.9993896484375 FORMAT "%9.4"
 /begin AXIS_DESCR COM_AXIS Nkw caoddzd_oAjpfzb_cAcEEha_1nR_oa0 8 -32768 32767 AXIS_PTS_REF AXX_KF_PRAIL_H_K FORMAT "%5.0" MONOTONY STRICT_INCREASE DEPOSIT ABSOLUTE /end AXIS_DESCR
 /begin AXIS_DESCR COM_AXIS BMWrailco_rat_VabHom_sw zyyxBpb_rEsnvtc_gktukCa_fR_5a0o 8 -1600 1599.951171875 AXIS_PTS_REF AXY_KF_PRAIL_H_K FORMAT "%8.3" MONOTONY STRICT_INCREASE DEPOSIT ABSOLUTE /end AXIS_DESCR
/end CHARACTERISTIC
/begin CHARACTERISTIC KF_PRAIL_HGD "Map RAIL PRESSURE HOMOGENOUS -- with deactivated VVT (GD)" MAP 0x80722C60 _REC_A1CUR_1_MBSE_U2_S1 39.9993896484375 cxdjuna_xpuCged_ocEpdua_MCRa2a0 0 39.9993896484375 FORMAT "%9.4"
 /begin AXIS_DESCR COM_AXIS Nkw caoddzd_oAjpfzb_cAcEEha_1nR_oa0 8 -32768 32767 AXIS_PTS_REF AXX_KF_PRAIL_HGD FORMAT "%5.0" MONOTONY STRICT_INCREASE DEPOSIT ABSOLUTE /end AXIS_DESCR
 /begin AXIS_DESCR COM_AXIS BMWrailco_rat_VabHom_sw zyyxBpb_rEsnvtc_gktukCa_fR_5a0o 8 -1600 1599.951171875 AXIS_PTS_REF AXY_KF_PRAIL_HGD FORMAT "%8.3" MONOTONY STRICT_INCREASE DEPOSIT ABSOLUTE /end AXIS_DESCR
/end CHARACTERISTIC
/begin CHARACTERISTIC KF_PRAIL_HGD_K "Map RAIL PRESSURE HOMOGENEOUS COLD -- with deactivated VVT (GD)" MAP 0x80722BE0 _REC_A1CUR_1_MBSE_U2_S1 39.9993896484375 cxdjuna_xpuCged_ocEpdua_MCRa2a0 0 39.9993896484375 FORMAT "%9.4"
 /begin AXIS_DESCR COM_AXIS Nkw caoddzd_oAjpfzb_cAcEEha_1nR_oa0 8 -32768 32767 AXIS_PTS_REF AXX_KF_PRAIL_HGD_K FORMAT "%5.0" MONOTONY STRICT_INCREASE DEPOSIT ABSOLUTE /end AXIS_DESCR
 /begin AXIS_DESCR COM_AXIS BMWrailco_rat_VabHom_sw zyyxBpb_rEsnvtc_gktukCa_fR_5a0o 8 -1600 1599.951171875 AXIS_PTS_REF AXY_KF_PRAIL_HGD_K FORMAT "%8.3" MONOTONY STRICT_INCREASE DEPOSIT ABSOLUTE /end AXIS_DESCR
/end CHARACTERISTIC
/begin CHARACTERISTIC KF_ST_RKBAS_GD "Map Basic Rk Quantity throttled operation" MAP 0x8074A2A8 _REC_A1CUR_1_MBSE_S2_S1 3199.951171875 zyyxBpb_rEsnvtc_gktukCa_fR_5a0o -1600 1599.951171875
 /begin AXIS_DESCR COM_AXIS Nkw caoddzd_oAjpfzb_cAcEEha_1nR_oa0 10 -32768 32767 AXIS_PTS_REF AXX_KF_ST_RKBAS_GD FORMAT "%5.0" MONOTONY STRICT_INCREASE DEPOSIT ABSOLUTE /end AXIS_DESCR
 /begin AXIS_DESCR COM_AXIS BMWinj_t_Eng_sw DchEpAd_DBCFgoa_Ckhahgc_q__aoa0 10 -327.68 327.67 AXIS_PTS_REF AXY_KF_ST_RKBAS_GD FORMAT "%7.2" MONOTONY STRICT_INCREASE DEPOSIT ABSOLUTE /end AXIS_DESCR
/end CHARACTERISTIC
/begin CHARACTERISTIC KF_ST_RKBAS_VVT "Map Base-Rk Quantity VVT Operation" MAP 0x8074A116 _REC_A1CUR_1_MBSE_S2_S1 3199.951171875 zyyxBpb_rEsnvtc_gktukCa_fR_5a0o -1600 1599.951171875
 /begin AXIS_DESCR COM_AXIS Nkw caoddzd_oAjpfzb_cAcEEha_1nR_oa0 12 -32768 32767 AXIS_PTS_REF AXX_KF_ST_RKBAS_VVT FORMAT "%5.0" MONOTONY STRICT_INCREASE DEPOSIT ABSOLUTE /end AXIS_DESCR
 /begin AXIS_DESCR COM_AXIS BMWinj_t_Eng_sw DchEpAd_DBCFgoa_Ckhahgc_q__aoa0 12 -327.68 327.67 AXIS_PTS_REF AXY_KF_ST_RKBAS_VVT FORMAT "%7.2" MONOTONY STRICT_INCREASE DEPOSIT ABSOLUTE /end AXIS_DESCR
/end CHARACTERISTIC
/begin CHARACTERISTIC KF_TA_ATLSOLL "Target temperature for exhaust gas temperature ATL" MAP 0x80717940 _REC_A1CUR_1_MBSE_S2_S1 6553.5 BMW_q0p1_degC -3276.8 3276.7 FORMAT "%6.1"
 /begin AXIS_DESCR COM_AXIS Nkw_atm caoddzd_oAjpfzb_cAcEEha_1nR_oa0 4 -32768 32767 AXIS_PTS_REF AXX_KF_TA_ATLSOLL MONOTONY STRICT_INCREASE DEPOSIT ABSOLUTE /end AXIS_DESCR
 /begin AXIS_DESCR COM_AXIS Rf_atm CgkBooc_wkiDfEd_Czglhgc_fR_1a0o 4 -327.68 327.67 AXIS_PTS_REF AXY_KF_TA_ATLSOLL MONOTONY STRICT_INCREASE DEPOSIT ABSOLUTE /end AXIS_DESCR
/end CHARACTERISTIC
/begin CHARACTERISTIC KF_TA_IKSOLL "Target temperature for exhaust gas temperature in cat" MAP 0x80717920 _REC_A1CUR_1_MBSE_S2_S1 6553.5 BMW_q0p1_degC -3276.8 3276.7 FORMAT "%6.1"
 /begin AXIS_DESCR COM_AXIS Nkw_atm caoddzd_oAjpfzb_cAcEEha_1nR_oa0 4 -32768 32767 AXIS_PTS_REF AXX_KF_TA_IKSOLL MONOTONY STRICT_INCREASE DEPOSIT ABSOLUTE /end AXIS_DESCR
 /begin AXIS_DESCR COM_AXIS Rf_atm CgkBooc_wkiDfEd_Czglhgc_fR_1a0o 4 -327.68 327.67 AXIS_PTS_REF AXY_KF_TA_IKSOLL MONOTONY STRICT_INCREASE DEPOSIT ABSOLUTE /end AXIS_DESCR
/end CHARACTERISTIC
/begin CHARACTERISTIC KF_TA_VKSOLL "Target temperature for exhaust gas temperature mixing section" MAP 0x80717900 _REC_A1CUR_1_MBSE_S2_S1 6553.5 BMW_q0p1_degC -3276.8 3276.7 FORMAT "%6.1"
 /begin AXIS_DESCR COM_AXIS Nkw_atm caoddzd_oAjpfzb_cAcEEha_1nR_oa0 4 -32768 32767 AXIS_PTS_REF AXX_KF_TA_VKSOLL MONOTONY STRICT_INCREASE DEPOSIT ABSOLUTE /end AXIS_DESCR
 /begin AXIS_DESCR COM_AXIS Rf_atm CgkBooc_wkiDfEd_Czglhgc_fR_1a0o 4 -327.68 327.67 AXIS_PTS_REF AXY_KF_TA_VKSOLL MONOTONY STRICT_INCREASE DEPOSIT ABSOLUTE /end AXIS_DESCR
/end CHARACTERISTIC
/begin CHARACTERISTIC KF_TD_FETTDELAY_TABG "Duration of enrichment suppression from KF_LABAS_XXX. This time depends on the pipe wall temperature Tw_r1." MAP 0x8075D08E _REC_A1CUR_1_MBSE_U1_S1 51 BMW_q0p2_s 0 51
 /begin AXIS_DESCR COM_AXIS Tw_r1 BMW_q0p1_degC 6 -3276.8 3276.7 AXIS_PTS_REF AXX_KF_TD_FETTDELAY_TABG FORMAT "%6.1" MONOTONY STRICT_INCREASE DEPOSIT ABSOLUTE /end AXIS_DESCR
 /begin AXIS_DESCR COM_AXIS Nkw caoddzd_oAjpfzb_cAcEEha_1nR_oa0 4 -3277 3277 AXIS_PTS_REF AXY_KF_TD_FETTDELAY_TABG FORMAT "%5.0" MONOTONY STRICT_INCREASE DEPOSIT ABSOLUTE /end AXIS_DESCR
/end CHARACTERISTIC
/begin CHARACTERISTIC KF_ZW_PF1 "Basic firing angle path 1" MAP 0x807564C3 _REC_A1CUR_1_MBSE_S1_S1 127.5 aAwkuzc_BFpgCmb_tmDukma_q__aa0o -64 63.5 FORMAT "%4.1"
 /begin AXIS_DESCR COM_AXIS Nkw caoddzd_oAjpfzb_cAcEEha_1nR_oa0 20 -32768 32767 AXIS_PTS_REF AXX_KF_ZW_PF1 FORMAT "%5.0" MONOTONY STRICT_INCREASE DEPOSIT ABSOLUTE /end AXIS_DESCR
 /begin AXIS_DESCR COM_AXIS NO_INPUT_QUANTITY CgkBooc_wkiDfEd_Czglhgc_fR_1a0o 20 -327.68 327.67 AXIS_PTS_REF AXY_KF_ZW_PF1 FORMAT "%9.2" MONOTONY STRICT_INCREASE DEPOSIT ABSOLUTE /end AXIS_DESCR
/end CHARACTERISTIC
/begin CHARACTERISTIC KF_ZW_PF2 "Basic firing angle path 2" MAP 0x80756333 _REC_A1CUR_1_MBSE_S1_S1 127.5 aAwkuzc_BFpgCmb_tmDukma_q__aa0o -64 63.5 FORMAT "%4.1"
 /begin AXIS_DESCR COM_AXIS Nkw caoddzd_oAjpfzb_cAcEEha_1nR_oa0 20 -32768 32767 AXIS_PTS_REF AXX_KF_ZW_PF2 FORMAT "%5.0" MONOTONY STRICT_INCREASE DEPOSIT ABSOLUTE /end AXIS_DESCR
 /begin AXIS_DESCR COM_AXIS NO_INPUT_QUANTITY CgkBooc_wkiDfEd_Czglhgc_fR_1a0o 20 -327.68 327.67 AXIS_PTS_REF AXY_KF_ZW_PF2 FORMAT "%9.2" MONOTONY STRICT_INCREASE DEPOSIT ABSOLUTE /end AXIS_DESCR
/end CHARACTERISTIC
/begin CHARACTERISTIC KF_ZW_S_PF1 "Basic ignition angle path 1 safe" MAP 0x807561A3 _REC_A1CUR_1_MBSE_S1_S1 127.5 aAwkuzc_BFpgCmb_tmDukma_q__aa0o -64 63.5 FORMAT "%4.1"
 /begin AXIS_DESCR COM_AXIS Nkw caoddzd_oAjpfzb_cAcEEha_1nR_oa0 20 -32768 32767 AXIS_PTS_REF AXX_KF_ZW_S_PF1 FORMAT "%5.0" MONOTONY STRICT_INCREASE DEPOSIT ABSOLUTE /end AXIS_DESCR
 /begin AXIS_DESCR COM_AXIS NO_INPUT_QUANTITY CgkBooc_wkiDfEd_Czglhgc_fR_1a0o 20 -327.68 327.67 AXIS_PTS_REF AXY_KF_ZW_S_PF1 FORMAT "%9.2" MONOTONY STRICT_INCREASE DEPOSIT ABSOLUTE /end AXIS_DESCR
/end CHARACTERISTIC
/begin CHARACTERISTIC KF_ZW_S_PF2 "Basic ignition angle path 2 safe" MAP 0x80756013 _REC_A1CUR_1_MBSE_S1_S1 127.5 aAwkuzc_BFpgCmb_tmDukma_q__aa0o -64 63.5 FORMAT "%4.1"
 /begin AXIS_DESCR COM_AXIS Nkw caoddzd_oAjpfzb_cAcEEha_1nR_oa0 20 -32768 32767 AXIS_PTS_REF AXX_KF_ZW_S_PF2 FORMAT "%5.0" MONOTONY STRICT_INCREASE DEPOSIT ABSOLUTE /end AXIS_DESCR
 /begin AXIS_DESCR COM_AXIS NO_INPUT_QUANTITY CgkBooc_wkiDfEd_Czglhgc_fR_1a0o 20 -327.68 327.67 AXIS_PTS_REF AXY_KF_ZW_S_PF2 FORMAT "%9.2" MONOTONY STRICT_INCREASE DEPOSIT ABSOLUTE /end AXIS_DESCR
/end CHARACTERISTIC
/begin CHARACTERISTIC KF_ZW_UESP_PF1 "Basic ignition angle overflush path 1" MAP 0x80755F87 _REC_A1CUR_1_MBSE_S1_S1 127.5 aAwkuzc_BFpgCmb_tmDukma_q__aa0o -64 63.5 FORMAT "%4.1"
 /begin AXIS_DESCR COM_AXIS Nkw caoddzd_oAjpfzb_cAcEEha_1nR_oa0 10 -32768 32767 AXIS_PTS_REF AXX_KF_ZW_UESP_PF1 FORMAT "%5.0" MONOTONY STRICT_INCREASE DEPOSIT ABSOLUTE /end AXIS_DESCR
 /begin AXIS_DESCR COM_AXIS NO_INPUT_QUANTITY CgkBooc_wkiDfEd_Czglhgc_fR_1a0o 14 -327.68 327.67 AXIS_PTS_REF AXY_KF_ZW_UESP_PF1 FORMAT "%9.2" MONOTONY STRICT_INCREASE DEPOSIT ABSOLUTE /end AXIS_DESCR
/end CHARACTERISTIC
/begin CHARACTERISTIC KF_ZW_UESP_PF2 "Basic ignition angle over-scavenging path 2" MAP 0x80755EFB _REC_A1CUR_1_MBSE_S1_S1 127.5 aAwkuzc_BFpgCmb_tmDukma_q__aa0o -64 63.5 FORMAT "%4.1"
 /begin AXIS_DESCR COM_AXIS Nkw caoddzd_oAjpfzb_cAcEEha_1nR_oa0 10 -32768 32767 AXIS_PTS_REF AXX_KF_ZW_UESP_PF2 FORMAT "%5.0" MONOTONY STRICT_INCREASE DEPOSIT ABSOLUTE /end AXIS_DESCR
 /begin AXIS_DESCR COM_AXIS NO_INPUT_QUANTITY CgkBooc_wkiDfEd_Czglhgc_fR_1a0o 14 -327.68 327.67 AXIS_PTS_REF AXY_KF_ZW_UESP_PF2 FORMAT "%9.2" MONOTONY STRICT_INCREASE DEPOSIT ABSOLUTE /end AXIS_DESCR
/end CHARACTERISTIC
/begin CHARACTERISTIC KF_ZW_VP_PF1 "Map for ignition angle vanos in stop F_basis=1 path 1" MAP 0x8075BCAC _REC_A1CUR_1_MBSE_S1_S1 127.5 aAwkuzc_BFpgCmb_tmDukma_q__aa0o -64 63.5 FORMAT "%4.1"
 /begin AXIS_DESCR COM_AXIS Nkw caoddzd_oAjpfzb_cAcEEha_1nR_oa0 20 -32768 32767 AXIS_PTS_REF AXX_KF_ZW_VP_PF1 FORMAT "%5.0" MONOTONY STRICT_INCREASE DEPOSIT ABSOLUTE /end AXIS_DESCR
 /begin AXIS_DESCR COM_AXIS Rf_zwv CgkBooc_wkiDfEd_Czglhgc_fR_1a0o 16 -327.68 327.67 AXIS_PTS_REF AXY_KF_ZW_VP_PF1 FORMAT "%9.2" MONOTONY STRICT_INCREASE DEPOSIT ABSOLUTE /end AXIS_DESCR
/end CHARACTERISTIC
/begin CHARACTERISTIC KF_ZW_VP_PF2 "Map for ignition angle vanos in stop F_basis=1 path 2" MAP 0x8075BB6C _REC_A1CUR_1_MBSE_S1_S1 127.5 aAwkuzc_BFpgCmb_tmDukma_q__aa0o -64 63.5 FORMAT "%4.1"
 /begin AXIS_DESCR COM_AXIS Nkw caoddzd_oAjpfzb_cAcEEha_1nR_oa0 20 -32768 32767 AXIS_PTS_REF AXX_KF_ZW_VP_PF2 FORMAT "%5.0" MONOTONY STRICT_INCREASE DEPOSIT ABSOLUTE /end AXIS_DESCR
 /begin AXIS_DESCR COM_AXIS Rf_zwv CgkBooc_wkiDfEd_Czglhgc_fR_1a0o 16 -327.68 327.67 AXIS_PTS_REF AXY_KF_ZW_VP_PF2 FORMAT "%9.2" MONOTONY STRICT_INCREASE DEPOSIT ABSOLUTE /end AXIS_DESCR
/end CHARACTERISTIC
/begin CHARACTERISTIC KF_ZWMIN_KSOT "Zwmin for sound tuning cold" MAP 0x80757D50 _REC_A1CUR_1_MBSE_S1_S1 127.5 aAwkuzc_BFpgCmb_tmDukma_q__aa0o -64 63.5
 /begin AXIS_DESCR COM_AXIS Nkw caoddzd_oAjpfzb_cAcEEha_1nR_oa0 8 -32768 32767 AXIS_PTS_REF AXX_KF_ZWMIN_KSOT FORMAT "%5.0" MONOTONY STRICT_INCREASE DEPOSIT ABSOLUTE /end AXIS_DESCR
 /begin AXIS_DESCR COM_AXIS NO_INPUT_QUANTITY CgkBooc_wkiDfEd_Czglhgc_fR_1a0o 8 -327.68 327.67 AXIS_PTS_REF AXY_KF_ZWMIN_KSOT FORMAT "%9.4" MONOTONY STRICT_INCREASE DEPOSIT ABSOLUTE /end AXIS_DESCR
/end CHARACTERISTIC
/begin CHARACTERISTIC KF_ZWMIN_KSOT___MGF_CC_PF_Slot0 "Zwmin for sound tuning cold (Slot 0, at 0 RPM, X-Axis and Y-Axis do not switch, OEM Address)" MAP 0x80757D50 _REC_A1CUR_1_MBSE_S1_S1 127.5 aAwkuzc_BFpgCmb_tmDukma_q__aa0o -64 63.5
 /begin AXIS_DESCR COM_AXIS Nkw caoddzd_oAjpfzb_cAcEEha_1nR_oa0 8 -32768 32767 AXIS_PTS_REF AXX_KF_ZWMIN_KSOT FORMAT "%5.0" MONOTONY STRICT_INCREASE DEPOSIT ABSOLUTE /end AXIS_DESCR
 /begin AXIS_DESCR COM_AXIS NO_INPUT_QUANTITY CgkBooc_wkiDfEd_Czglhgc_fR_1a0o 8 -327.68 327.67 AXIS_PTS_REF AXY_KF_ZWMIN_KSOT FORMAT "%9.4" MONOTONY STRICT_INCREASE DEPOSIT ABSOLUTE /end AXIS_DESCR
/end CHARACTERISTIC
/begin CHARACTERISTIC KF_ZWMIN_KSOT___MGF_CC_PF_Slot1 "Zwmin for sound tuning cold (Slot 1, at 1000 RPM, X-Axis and Y-Axis do not switch, Pump Fuel)" MAP 0x807C77A6 _REC_A1CUR_1_MBSE_S1_S1 127.5 aAwkuzc_BFpgCmb_tmDukma_q__aa0o -64 63.5
 /begin AXIS_DESCR COM_AXIS Nkw caoddzd_oAjpfzb_cAcEEha_1nR_oa0 8 -32768 32767 AXIS_PTS_REF AXX_KF_ZWMIN_KSOT FORMAT "%5.0" MONOTONY STRICT_INCREASE DEPOSIT ABSOLUTE /end AXIS_DESCR
 /begin AXIS_DESCR COM_AXIS NO_INPUT_QUANTITY CgkBooc_wkiDfEd_Czglhgc_fR_1a0o 8 -327.68 327.67 AXIS_PTS_REF AXY_KF_ZWMIN_KSOT FORMAT "%9.4" MONOTONY STRICT_INCREASE DEPOSIT ABSOLUTE /end AXIS_DESCR
/end CHARACTERISTIC
/begin CHARACTERISTIC KF_ZWMIN_KSOT___MGF_CC_PF_Slot2 "Zwmin for sound tuning cold (Slot 2, at 2000 RPM, X-Axis and Y-Axis do not switch, Pump Fuel)" MAP 0x807C77E6 _REC_A1CUR_1_MBSE_S1_S1 127.5 aAwkuzc_BFpgCmb_tmDukma_q__aa0o -64 63.5
 /begin AXIS_DESCR COM_AXIS Nkw caoddzd_oAjpfzb_cAcEEha_1nR_oa0 8 -32768 32767 AXIS_PTS_REF AXX_KF_ZWMIN_KSOT FORMAT "%5.0" MONOTONY STRICT_INCREASE DEPOSIT ABSOLUTE /end AXIS_DESCR
 /begin AXIS_DESCR COM_AXIS NO_INPUT_QUANTITY CgkBooc_wkiDfEd_Czglhgc_fR_1a0o 8 -327.68 327.67 AXIS_PTS_REF AXY_KF_ZWMIN_KSOT FORMAT "%9.4" MONOTONY STRICT_INCREASE DEPOSIT ABSOLUTE /end AXIS_DESCR
/end CHARACTERISTIC
/begin CHARACTERISTIC KF_ZWMIN_KSOT___MGF_CC_PF_Slot3 "Zwmin for sound tuning cold (Slot 3, at 3000 RPM, X-Axis and Y-Axis do not switch, Pump Fuel)" MAP 0x807C7826 _REC_A1CUR_1_MBSE_S1_S1 127.5 aAwkuzc_BFpgCmb_tmDukma_q__aa0o -64 63.5
 /begin AXIS_DESCR COM_AXIS Nkw caoddzd_oAjpfzb_cAcEEha_1nR_oa0 8 -32768 32767 AXIS_PTS_REF AXX_KF_ZWMIN_KSOT FORMAT "%5.0" MONOTONY STRICT_INCREASE DEPOSIT ABSOLUTE /end AXIS_DESCR
 /begin AXIS_DESCR COM_AXIS NO_INPUT_QUANTITY CgkBooc_wkiDfEd_Czglhgc_fR_1a0o 8 -327.68 327.67 AXIS_PTS_REF AXY_KF_ZWMIN_KSOT FORMAT "%9.4" MONOTONY STRICT_INCREASE DEPOSIT ABSOLUTE /end AXIS_DESCR
/end CHARACTERISTIC
/begin CHARACTERISTIC KF_ZWMIN_KSOT___MGF_CC_PF_Slot4 "Zwmin for sound tuning cold (Slot 4, at 4000 RPM, X-Axis and Y-Axis do not switch, Pump Fuel)" MAP 0x807C7866 _REC_A1CUR_1_MBSE_S1_S1 127.5 aAwkuzc_BFpgCmb_tmDukma_q__aa0o -64 63.5
 /begin AXIS_DESCR COM_AXIS Nkw caoddzd_oAjpfzb_cAcEEha_1nR_oa0 8 -32768 32767 AXIS_PTS_REF AXX_KF_ZWMIN_KSOT FORMAT "%5.0" MONOTONY STRICT_INCREASE DEPOSIT ABSOLUTE /end AXIS_DESCR
 /begin AXIS_DESCR COM_AXIS NO_INPUT_QUANTITY CgkBooc_wkiDfEd_Czglhgc_fR_1a0o 8 -327.68 327.67 AXIS_PTS_REF AXY_KF_ZWMIN_KSOT FORMAT "%9.4" MONOTONY STRICT_INCREASE DEPOSIT ABSOLUTE /end AXIS_DESCR
/end CHARACTERISTIC
/begin CHARACTERISTIC KF_ZWMIN_KSOT___MGF_CC_PF_Slot5 "Zwmin for sound tuning cold (Slot 5, at 5000 RPM, X-Axis and Y-Axis do not switch, Pump Fuel)" MAP 0x807C78A6 _REC_A1CUR_1_MBSE_S1_S1 127.5 aAwkuzc_BFpgCmb_tmDukma_q__aa0o -64 63.5
 /begin AXIS_DESCR COM_AXIS Nkw caoddzd_oAjpfzb_cAcEEha_1nR_oa0 8 -32768 32767 AXIS_PTS_REF AXX_KF_ZWMIN_KSOT FORMAT "%5.0" MONOTONY STRICT_INCREASE DEPOSIT ABSOLUTE /end AXIS_DESCR
 /begin AXIS_DESCR COM_AXIS NO_INPUT_QUANTITY CgkBooc_wkiDfEd_Czglhgc_fR_1a0o 8 -327.68 327.67 AXIS_PTS_REF AXY_KF_ZWMIN_KSOT FORMAT "%9.4" MONOTONY STRICT_INCREASE DEPOSIT ABSOLUTE /end AXIS_DESCR
/end CHARACTERISTIC
/begin CHARACTERISTIC KF_ZWMIN_WSOT "Zwmin for sound tuning warm" MAP 0x80757D10 _REC_A1CUR_1_MBSE_S1_S1 127.5 aAwkuzc_BFpgCmb_tmDukma_q__aa0o -64 63.5
 /begin AXIS_DESCR COM_AXIS Nkw caoddzd_oAjpfzb_cAcEEha_1nR_oa0 8 -32768 32767 AXIS_PTS_REF AXX_KF_ZWMIN_WSOT FORMAT "%5.0" MONOTONY STRICT_INCREASE DEPOSIT ABSOLUTE /end AXIS_DESCR
 /begin AXIS_DESCR COM_AXIS NO_INPUT_QUANTITY CgkBooc_wkiDfEd_Czglhgc_fR_1a0o 8 -327.68 327.67 AXIS_PTS_REF AXY_KF_ZWMIN_WSOT FORMAT "%9.4" MONOTONY STRICT_INCREASE DEPOSIT ABSOLUTE /end AXIS_DESCR
/end CHARACTERISTIC
/begin CHARACTERISTIC KF_ZWMIN_WSOT___MGF_CC_PF_Slot0 "Zwmin for sound tuning warm (Slot 0, at 0 RPM, X-Axis and Y-Axis do not switch, OEM Address)" MAP 0x80757D10 _REC_A1CUR_1_MBSE_S1_S1 127.5 aAwkuzc_BFpgCmb_tmDukma_q__aa0o -64 63.5
 /begin AXIS_DESCR COM_AXIS Nkw caoddzd_oAjpfzb_cAcEEha_1nR_oa0 8 -32768 32767 AXIS_PTS_REF AXX_KF_ZWMIN_WSOT FORMAT "%5.0" MONOTONY STRICT_INCREASE DEPOSIT ABSOLUTE /end AXIS_DESCR
 /begin AXIS_DESCR COM_AXIS NO_INPUT_QUANTITY CgkBooc_wkiDfEd_Czglhgc_fR_1a0o 8 -327.68 327.67 AXIS_PTS_REF AXY_KF_ZWMIN_WSOT FORMAT "%9.4" MONOTONY STRICT_INCREASE DEPOSIT ABSOLUTE /end AXIS_DESCR
/end CHARACTERISTIC
/begin CHARACTERISTIC KF_ZWMIN_WSOT___MGF_CC_PF_Slot1 "Zwmin for sound tuning warm (Slot 1, at 1000 RPM, X-Axis and Y-Axis do not switch, Pump Fuel)" MAP 0x807C78E6 _REC_A1CUR_1_MBSE_S1_S1 127.5 aAwkuzc_BFpgCmb_tmDukma_q__aa0o -64 63.5
 /begin AXIS_DESCR COM_AXIS Nkw caoddzd_oAjpfzb_cAcEEha_1nR_oa0 8 -32768 32767 AXIS_PTS_REF AXX_KF_ZWMIN_WSOT FORMAT "%5.0" MONOTONY STRICT_INCREASE DEPOSIT ABSOLUTE /end AXIS_DESCR
 /begin AXIS_DESCR COM_AXIS NO_INPUT_QUANTITY CgkBooc_wkiDfEd_Czglhgc_fR_1a0o 8 -327.68 327.67 AXIS_PTS_REF AXY_KF_ZWMIN_WSOT FORMAT "%9.4" MONOTONY STRICT_INCREASE DEPOSIT ABSOLUTE /end AXIS_DESCR
/end CHARACTERISTIC
/begin CHARACTERISTIC KF_ZWMIN_WSOT___MGF_CC_PF_Slot2 "Zwmin for sound tuning warm (Slot 2, at 2000 RPM, X-Axis and Y-Axis do not switch, Pump Fuel)" MAP 0x807C7926 _REC_A1CUR_1_MBSE_S1_S1 127.5 aAwkuzc_BFpgCmb_tmDukma_q__aa0o -64 63.5
 /begin AXIS_DESCR COM_AXIS Nkw caoddzd_oAjpfzb_cAcEEha_1nR_oa0 8 -32768 32767 AXIS_PTS_REF AXX_KF_ZWMIN_WSOT FORMAT "%5.0" MONOTONY STRICT_INCREASE DEPOSIT ABSOLUTE /end AXIS_DESCR
 /begin AXIS_DESCR COM_AXIS NO_INPUT_QUANTITY CgkBooc_wkiDfEd_Czglhgc_fR_1a0o 8 -327.68 327.67 AXIS_PTS_REF AXY_KF_ZWMIN_WSOT FORMAT "%9.4" MONOTONY STRICT_INCREASE DEPOSIT ABSOLUTE /end AXIS_DESCR
/end CHARACTERISTIC
/begin CHARACTERISTIC KF_ZWMIN_WSOT___MGF_CC_PF_Slot3 "Zwmin for sound tuning warm (Slot 3, at 3000 RPM, X-Axis and Y-Axis do not switch, Pump Fuel)" MAP 0x807C7966 _REC_A1CUR_1_MBSE_S1_S1 127.5 aAwkuzc_BFpgCmb_tmDukma_q__aa0o -64 63.5
 /begin AXIS_DESCR COM_AXIS Nkw caoddzd_oAjpfzb_cAcEEha_1nR_oa0 8 -32768 32767 AXIS_PTS_REF AXX_KF_ZWMIN_WSOT FORMAT "%5.0" MONOTONY STRICT_INCREASE DEPOSIT ABSOLUTE /end AXIS_DESCR
 /begin AXIS_DESCR COM_AXIS NO_INPUT_QUANTITY CgkBooc_wkiDfEd_Czglhgc_fR_1a0o 8 -327.68 327.67 AXIS_PTS_REF AXY_KF_ZWMIN_WSOT FORMAT "%9.4" MONOTONY STRICT_INCREASE DEPOSIT ABSOLUTE /end AXIS_DESCR
/end CHARACTERISTIC
/begin CHARACTERISTIC KF_ZWMIN_WSOT___MGF_CC_PF_Slot4 "Zwmin for sound tuning warm (Slot 4, at 4000 RPM, X-Axis and Y-Axis do not switch, Pump Fuel)" MAP 0x807C79A6 _REC_A1CUR_1_MBSE_S1_S1 127.5 aAwkuzc_BFpgCmb_tmDukma_q__aa0o -64 63.5
 /begin AXIS_DESCR COM_AXIS Nkw caoddzd_oAjpfzb_cAcEEha_1nR_oa0 8 -32768 32767 AXIS_PTS_REF AXX_KF_ZWMIN_WSOT FORMAT "%5.0" MONOTONY STRICT_INCREASE DEPOSIT ABSOLUTE /end AXIS_DESCR
 /begin AXIS_DESCR COM_AXIS NO_INPUT_QUANTITY CgkBooc_wkiDfEd_Czglhgc_fR_1a0o 8 -327.68 327.67 AXIS_PTS_REF AXY_KF_ZWMIN_WSOT FORMAT "%9.4" MONOTONY STRICT_INCREASE DEPOSIT ABSOLUTE /end AXIS_DESCR
/end CHARACTERISTIC
/begin CHARACTERISTIC KF_ZWMIN_WSOT___MGF_CC_PF_Slot5 "Zwmin for sound tuning warm (Slot 5, at 5000 RPM, X-Axis and Y-Axis do not switch, Pump Fuel)" MAP 0x807C79E6 _REC_A1CUR_1_MBSE_S1_S1 127.5 aAwkuzc_BFpgCmb_tmDukma_q__aa0o -64 63.5
 /begin AXIS_DESCR COM_AXIS Nkw caoddzd_oAjpfzb_cAcEEha_1nR_oa0 8 -32768 32767 AXIS_PTS_REF AXX_KF_ZWMIN_WSOT FORMAT "%5.0" MONOTONY STRICT_INCREASE DEPOSIT ABSOLUTE /end AXIS_DESCR
 /begin AXIS_DESCR COM_AXIS NO_INPUT_QUANTITY CgkBooc_wkiDfEd_Czglhgc_fR_1a0o 8 -327.68 327.67 AXIS_PTS_REF AXY_KF_ZWMIN_WSOT FORMAT "%9.4" MONOTONY STRICT_INCREASE DEPOSIT ABSOLUTE /end AXIS_DESCR
/end CHARACTERISTIC
/begin FUNCTION Antilag "Build boost before accelerating"
 /begin DEF_CHARACTERISTIC Antilag_Pedal___MGF_CC_PF Antilag_CutMethod___MGF_CC_PF Antilag_ActivationDelay___MGF_CC_PF Antilag_TargetNumberOfCylindersToSuppress___MGF_CC_PF Antilag_BMWtqe_gra_NMaxEngLimdDwn_T___MGF_CC_PF /end DEF_CHARACTERISTIC
 /begin SUB_FUNCTION Antilag_Codewords Antilag_PIDs Antilag_Rolling Antilag_Safety Antilag_Standing /end SUB_FUNCTION
/end FUNCTION
/begin FUNCTION Antilag_Codewords "" /begin DEF_CHARACTERISTIC CW_Antilag___MGF_CC /end DEF_CHARACTERISTIC /end FUNCTION
/begin FUNCTION Antilag_PIDs ""
 /begin DEF_CHARACTERISTIC Antilag_BMWtchctr_pwr_Pctl_M___MGF_CC_PF Antilag_BMWtchctr_p_DifCrtnPp_M___MGF_CC_PF Antilag_BMWtchctr_p_DifCrtnPpDyn_M___MGF_CC_PF Antilag_BMWtchctr_pwr_Dp_M___MGF_CC_PF /end DEF_CHARACTERISTIC
/end FUNCTION
/begin FUNCTION Antilag_Rolling ""
 /begin DEF_CHARACTERISTIC Antilag_RpmDelayUntilCutRoll___MGF_CC_PF Antilag_RollingSpeedThreshold___MGF_CC_PF Antilag_RollRpmMax___MGF_CC_PF Antilag_RollRpmMin___MGF_CC_PF Antilag_IgnRoll___MGF_CC_PF Antilag_LambdaRoll___MGF_CC_PF Antilag_TargetBoostRoll___MGF_CC_PF /end DEF_CHARACTERISTIC
/end FUNCTION
/begin FUNCTION Antilag_Safety ""
 /begin DEF_CHARACTERISTIC Antilag_CoolantTempMin___MGF_CC_PF Antilag_CoolantTempMax___MGF_CC_PF Antilag_EgtTempMax___MGF_CC_PF Antilag_OverBoostThreshold___MGF_CC_PF Antilag_IatTempMax___MGF_CC_PF Antilag_SafetyTorqueCap___MGF_CC_PF Antilag_MaxDuration___MGF_CC_PF /end DEF_CHARACTERISTIC
/end FUNCTION
/begin FUNCTION Antilag_Standing ""
 /begin DEF_CHARACTERISTIC Antilag_RpmSetpoint___MGF_CC_PF Antilag_RpmDelayUntilCutStand___MGF_CC_PF Antilag_IgnStand___MGF_CC_PF Antilag_LambdaStand___MGF_CC_PF Antilag_TargetBoostStand___MGF_CC_PF /end DEF_CHARACTERISTIC
/end FUNCTION
/begin FUNCTION Boost "Intake/exhaust pressure targets/limits"
 /begin DEF_CHARACTERISTIC K_PAK_MX BMWlpa_n_EfpEngStrtAmb_M K_MAX_PSSOLBER KL_RFTNLMX KF_DPLDSOLL_SPORT BMWtchdiag_n_EngMin_C BMWtchob_p_DifEnd_C BMWtchob_fac_tq_Delt_T BMWtchob_p_DifGraTrigMin_C BMWtchsp_p_ReqMax_C BMWtchsp_p_OfsMax_C BMWtchsp_rat_p_CmprMax_M BMWtchsp_rat_p_CmprPmp_T BMWtchsp_fac_FilPRatCmpr_T BMWtchsp_fac_mf_FilCmprNorm_T KF_DPLDS_PRED BMWtchctr_rat_p_ComprLimPctl_T BMWtchctr_fac_pwr_CompLimPctl_T KF_NEWP_LLK_TANS PVDMX /end DEF_CHARACTERISTIC
/end FUNCTION
/begin FUNCTION BoostByGear "" /begin SUB_FUNCTION BoostByGear_Codewords /end SUB_FUNCTION /end FUNCTION
/begin FUNCTION BoostByGear_Codewords "" /end FUNCTION
/begin FUNCTION Burbles "Pops and bangs"
 /begin SUB_FUNCTION Burbles_Codewords Burbles_Slot0 Burbles_Slot1 Burbles_Slot2 Burbles_Slot3 Burbles_Slot4 Burbles_Slot5 /end SUB_FUNCTION
/end FUNCTION
/begin FUNCTION Burbles_Codewords "" /begin DEF_CHARACTERISTIC CW_BurblesOnTheFly___MGF_CC /end DEF_CHARACTERISTIC /end FUNCTION
/begin FUNCTION Burbles_Slot0 ""
 /begin DEF_CHARACTERISTIC KF_ZWMIN_WSOT___MGF_CC_PF_Slot0 KF_ZWMIN_KSOT___MGF_CC_PF_Slot0 /end DEF_CHARACTERISTIC
/end FUNCTION
/begin FUNCTION Burbles_Slot1 ""
 /begin DEF_CHARACTERISTIC KF_ZWMIN_WSOT___MGF_CC_PF_Slot1 KF_ZWMIN_KSOT___MGF_CC_PF_Slot1 /end DEF_CHARACTERISTIC
/end FUNCTION
/begin FUNCTION Burbles_Slot2 ""
 /begin DEF_CHARACTERISTIC KF_ZWMIN_WSOT___MGF_CC_PF_Slot2 KF_ZWMIN_KSOT___MGF_CC_PF_Slot2 /end DEF_CHARACTERISTIC
/end FUNCTION
/begin FUNCTION Burbles_Slot3 ""
 /begin DEF_CHARACTERISTIC KF_ZWMIN_WSOT___MGF_CC_PF_Slot3 KF_ZWMIN_KSOT___MGF_CC_PF_Slot3 /end DEF_CHARACTERISTIC
/end FUNCTION
/begin FUNCTION Burbles_Slot4 ""
 /begin DEF_CHARACTERISTIC KF_ZWMIN_WSOT___MGF_CC_PF_Slot4 KF_ZWMIN_KSOT___MGF_CC_PF_Slot4 /end DEF_CHARACTERISTIC
/end FUNCTION
/begin FUNCTION Burbles_Slot5 ""
 /begin DEF_CHARACTERISTIC KF_ZWMIN_WSOT___MGF_CC_PF_Slot5 KF_ZWMIN_KSOT___MGF_CC_PF_Slot5 /end DEF_CHARACTERISTIC
/end FUNCTION
/begin FUNCTION Cooling "Engine cooling"
 /begin DEF_CHARACTERISTIC K_TKW_WA K_TKW_MX KL_TKW_NO KL_TKW_HI KL_NEL_TMOT KL_FLD_KKS /end DEF_CHARACTERISTIC
/end FUNCTION
/begin FUNCTION CustomCode ""
 /begin SUB_FUNCTION Antilag BoostByGear Burbles CustomCodeMenu ExhaustFlap FlexFuel MaxCooling RadiatorFlap SwitchableMaps TcuTorqueLimiter Valet /end SUB_FUNCTION
/end FUNCTION
/begin FUNCTION CustomCodeMenu "On-The-Fly access to custom features"
 /begin DEF_CHARACTERISTIC CcmEnterMenuDelay___MGF_CC_PF CcmTimeout___MGF_CC_PF UniRockerEnterDetectionDelay___MGF_CC_PF /end DEF_CHARACTERISTIC
 /begin SUB_FUNCTION CustomCodeMenu_Codewords CustomCodeMenu_CanBusIds /end SUB_FUNCTION
/end FUNCTION
/begin FUNCTION CustomCodeMenu_CanBusIds ""
 /begin DEF_CHARACTERISTIC CustomCanBusCruiseControlIdMap___MGF_CC_PF CustomCanBusEcaIdMap___MGF_CC_PF CustomCanBusMotivReflexOutputIdMap___MGF_CC_PF CustomCanBusTurnSignalIdMap___MGF_CC_PF /end DEF_CHARACTERISTIC
/end FUNCTION
/begin FUNCTION CustomCodeMenu_Codewords ""
 /begin DEF_CHARACTERISTIC CW_CustomCodeMenu___MGF_CC CW_CruiseControlConfig___MGF_CC CW_UseAllCruiseControlCanBusData___MGF_CC CW_LowPressureFuelPressureSensorInstalled___MGF_CC CW_MgfLimpModeProtectionEnabled___MGF_CC CW_MotivReflexInstalled___MGF_CC /end DEF_CHARACTERISTIC
/end FUNCTION
/begin FUNCTION DisplayCalibration "Sport gauge scales for power and torque"
 /begin DEF_CHARACTERISTIC K_EDA_P_ANZ_SPORT_BS_SCAL_CODE3 K_EDA_P_ANZ_SPORT_BS_SCAL_CODE2 K_EDA_P_ANZ_SPORT_BS_SCAL_CODE1 K_EDA_P_ANZ_SPORT_BS_SCAL_CODE0 K_EDA_MD_ANZ_BS_SCAL_CODE4 K_EDA_MD_ANZ_BS_SCAL_CODE3 K_EDA_MD_ANZ_BS_SCAL_CODE2 K_EDA_MD_ANZ_BS_SCAL_CODE1 K_EDA_MD_ANZ_BS_SCAL_CODE0 /end DEF_CHARACTERISTIC
/end FUNCTION
/begin FUNCTION Exhaust "Exhaust flap, burbles and noise"
 /begin DEF_CHARACTERISTIC K_V_SOT_MN BMWchst_t_CatMax_C BMWgpfheat_p_RailTstrPcg_C BMWgpfheat_p_RailInjSng_M BMWgpfheat_p_RailInjMpl_M BMWgpfheat_tq_ResExhFlpClsdHys_C BMWgpfheat_tq_ResExhFlpClsd_T K_V_SOUND_MX K_V_SOUND_MN K_T_VL_SOUND_MX K_T_SOUND_MN K_T_NK_SOUND_MX KL_T_IKAT_SOUND_MX KL_NKW_SOUND_MX KL_NKW_SOUND_MN KL_TD_SOUND_MX_SPORT KL_TD_SOUND_MX_FREI KL_TD_SOUND_MX KF_MD_RES_NST_KEY BMWchas_v_MaxExhFlpClsd_C BMWchas_v_IdlGearAcvMin_C BMWchas_tq_ResExhFlpClsdHys_C BMWchas_tq_ResExhFlpClsd_T K_F_SOT_RUECKBLICK_STAND K_F_SOT_RUECKBLICK_RS BMWgpfp_swi_PclFil_C BMWtchbas_cw_Noise_C BMWtqe_st_ProhCylOffGc_C BMWtqe_swi_NoiseWiDiDfco_C CW_SOUND BMWtqe_st_SptDet4NoiseAcvn_M BMWtqe_b_Clu4NoiseDeac_T KF_ZWMIN_WSOT KF_ZWMIN_KSOT KF_DZWMIN_SPORT_SOT KF_DZWMIN_NORMAL_SOT BMWchas_st_OpmBasLiOff_T BMWchas_st_OpmBasCatCold_T AKRGRCC AKRGRCCAT AKRGRCCATM AKRGRCCATM_VAR1 AKRGRCCATM_VAR2 AKRGRCCATM_VAR3 AKRGRCCAT_VAR1 AKRGRCCAT_VAR2 AKRGRCCAT_VAR3 AKRGRCCM AKRGRCCM_VAR1 AKRGRCCM_VAR2 AKRGRCCM_VAR3 AKRGRCC_VAR1 AKRGRCC_VAR2 AKRGRCC_VAR3 AKRGRCO AKRGRCOAT AKRGRCOATM AKRGRCOATM_VAR1 AKRGRCOAT_VAR1 AKRGRCOM AKRGRCOM_VAR1 AKRGRCO_VAR1 AKR_dmHFMThdMin_C AKR_stSpt_C CWAKR CWSTEGSPROGAKR TMOTAKR TVSTAKR VMINAKR PFlt_stActv_C PFlt_stPfilTyp_C CWVMAXCOD VMAXOVC Exh_swtSensCfgPPFlt_C /end DEF_CHARACTERISTIC
/end FUNCTION
/begin FUNCTION ExhaustFlap "Force exhaust flap controls" /begin DEF_CHARACTERISTIC ExhaustFlapClosedMaxLoad___MGF_CC_PF /end DEF_CHARACTERISTIC /begin SUB_FUNCTION ExhaustFlap_Codewords /end SUB_FUNCTION /end FUNCTION
/begin FUNCTION ExhaustFlap_Codewords "" /begin DEF_CHARACTERISTIC CW_ExhaustFlapOnTheFly___MGF_CC /end DEF_CHARACTERISTIC /end FUNCTION
/begin FUNCTION ExhaustGasTemperature "Target EGT"
 /begin DEF_CHARACTERISTIC KF_TA_VKSOLL KF_TA_IKSOLL KF_TA_ATLSOLL BMWtchctr_t_ExGasMdl_M BMWtchctr_t_ExGasMdlScav_M /end DEF_CHARACTERISTIC
/end FUNCTION
/begin FUNCTION FlexFuel "Blend fuel maps with an ECA or hard-coded E%" /begin DEF_CHARACTERISTIC FlexFuelEthanolDisplayActivationDelay___MGF_CC_PF /end DEF_CHARACTERISTIC
 /begin SUB_FUNCTION FlexFuel_Codewords FlexFuel_Slot0 FlexFuel_Slot1 FlexFuel_Slot2 FlexFuel_Slot3 FlexFuel_Slot4 /end SUB_FUNCTION
/end FUNCTION
/begin FUNCTION FlexFuel_Codewords ""
 /begin DEF_CHARACTERISTIC CW_FlexFuelBlending___MGF_CC CW_FlexFuel___MGF_CC CW_SensorEthanol___MGF_CC /end DEF_CHARACTERISTIC
/end FUNCTION
/begin FUNCTION FlexFuel_Slot0 "Used for all slots if CW_UseMultipleFlexFuelSlots is disabled"
 /begin SUB_FUNCTION FlexFuel_Slot0_Codewords FlexFuel_Slot0_Blenders FlexFuel_Slot0_SensorlessValues /end SUB_FUNCTION
/end FUNCTION
/begin FUNCTION FlexFuel_Slot0_Blenders "" /end FUNCTION
/begin FUNCTION FlexFuel_Slot0_Codewords "" /end FUNCTION
/begin FUNCTION FlexFuel_Slot0_SensorlessValues "E% without sensor (ECA)" /end FUNCTION
/begin FUNCTION FlexFuel_Slot1 "Only used if CW_UseMultipleFlexFuelSlots is enabled"
 /begin SUB_FUNCTION FlexFuel_Slot1_Codewords FlexFuel_Slot1_Blenders FlexFuel_Slot1_SensorlessValues /end SUB_FUNCTION
/end FUNCTION
/begin FUNCTION FlexFuel_Slot1_Blenders "" /end FUNCTION
/begin FUNCTION FlexFuel_Slot1_Codewords "" /end FUNCTION
/begin FUNCTION FlexFuel_Slot1_SensorlessValues "E% without sensor (ECA)" /end FUNCTION
/begin FUNCTION FlexFuel_Slot2 "Only used if CW_UseMultipleFlexFuelSlots is enabled"
 /begin SUB_FUNCTION FlexFuel_Slot2_Codewords FlexFuel_Slot2_Blenders FlexFuel_Slot2_SensorlessValues /end SUB_FUNCTION
/end FUNCTION
/begin FUNCTION FlexFuel_Slot2_Blenders "" /end FUNCTION
/begin FUNCTION FlexFuel_Slot2_Codewords "" /end FUNCTION
/begin FUNCTION FlexFuel_Slot2_SensorlessValues "E% without sensor (ECA)" /end FUNCTION
/begin FUNCTION FlexFuel_Slot3 "Only used if CW_UseMultipleFlexFuelSlots is enabled"
 /begin SUB_FUNCTION FlexFuel_Slot3_Codewords FlexFuel_Slot3_Blenders FlexFuel_Slot3_SensorlessValues /end SUB_FUNCTION
/end FUNCTION
/begin FUNCTION FlexFuel_Slot3_Blenders "" /end FUNCTION
/begin FUNCTION FlexFuel_Slot3_Codewords "" /end FUNCTION
/begin FUNCTION FlexFuel_Slot3_SensorlessValues "E% without sensor (ECA)" /end FUNCTION
/begin FUNCTION FlexFuel_Slot4 "Only used if CW_UseMultipleFlexFuelSlots is enabled"
 /begin SUB_FUNCTION FlexFuel_Slot4_Codewords FlexFuel_Slot4_Blenders FlexFuel_Slot4_SensorlessValues /end SUB_FUNCTION
/end FUNCTION
/begin FUNCTION FlexFuel_Slot4_Blenders "" /end FUNCTION
/begin FUNCTION FlexFuel_Slot4_Codewords "" /end FUNCTION
/begin FUNCTION FlexFuel_Slot4_SensorlessValues "E% without sensor (ECA)" /end FUNCTION
/begin FUNCTION FuelCorrection "Lambda modifiers" /begin DEF_CHARACTERISTIC KF_FRKKORRF_1 KF_PHA_H_B1_W KF_PHA_H_E1 /end DEF_CHARACTERISTIC /end FUNCTION
/begin FUNCTION FuelLimits "Lambda limits" /begin DEF_CHARACTERISTIC K_BS_MN K_FRFMXBS_MN KF_BSLGF KL_LA_SBL /end DEF_CHARACTERISTIC /end FUNCTION
/begin FUNCTION FuelTargets "Lambda targets"
 /begin DEF_CHARACTERISTIC KF_LABAS_1 K_MSVANST_DIFFPRAIL BMWinjmon_fac_HppEff_M KF_PHA_H_B1_SK_PRE BMWext_lam_MinCptPronInit_Ca KF_DLAMBSVST_TABG BMWlpa_n_EfpModMax_C BMWlpa_n_EfpModSafe_M BMWlpa_n_EfpEngStrtPRail_T BMWlpsc_volf_FuEjrPmp_M BMWlpsd_p_RailDifMax_T KF_LAMIN_H KF_PRAIL_H_K KF_PRAIL_HGD_K KF_PRAIL_HGD KF_PRAIL_H KF_LA_BEZ KF_KOEFF_B_LA BMWchas_p_RailInjSng_M BMWchas_p_RailInjMpl_M BMWlpa_volf_FuFpcOvrT_C BMWlpa_volf_FuBoosRstOfs_C BMWlpa_volf_FuMaxBoosCtlr_T BMWlpsc_p_HppMax_T K_PRAIL_ST_MAX K_LA_FETTDELAY KF_LA_SK KF_LABAS_2 KF_ST_RKBAS_VVT KF_ST_RKBAS_GD CW_ATMOD S_PRAIL_GL_LA1 S_AUSWAHL_FETTDELAY K_T_FETTDELAY_SPERR KF_TD_FETTDELAY_TABG VSEKPMXN FuPHi_FlmMaxpl_T FWIHDR KLIHDR KLPHDR KLPHDRTF NMXHDR KLFVSTOTF KLVSTMSVG /end DEF_CHARACTERISTIC
/end FUNCTION
/begin FUNCTION GenericCharacteristics "OEM Maps"
 /begin SUB_FUNCTION FuelTargets Exhaust TorqueLimiters LoadControl Boost FuelCorrection Limits FuelLimits ExhaustGasTemperature LowPressureFuelPump Vanos WastegateControl ThrottleControl Cooling Ignition Knock MAFSensor DisplayCalibration TorqueMonitoring /end SUB_FUNCTION
/end FUNCTION
/begin FUNCTION Ignition "Timing targets"
 /begin DEF_CHARACTERISTIC KF_FDZWT_BEST_PF2 KF_FDZWT_BEST_PF1 KF_ZW_UESP_PF2 KF_ZW_UESP_PF1 KF_ZW_S_PF2 KF_ZW_S_PF1 KF_ZW_PF2 KF_ZW_PF1 KF_DZW_DYN KF_DZWT_UESP_PF2 KF_DZWT_UESP_PF1 KF_DZWT_PF2 KF_DZWT_PF1 KF_ZW_VP_PF2 KF_ZW_VP_PF1 KF_FDZW_DYN4 KF_FDZW_DYN3 KF_FDZW_DYN2 KF_FDZW_DYN1 /end DEF_CHARACTERISTIC
/end FUNCTION
/begin FUNCTION Knock "Knock factors and corrections"
 /begin DEF_CHARACTERISTIC KF_FDZWT_PF2 KF_FDZWT_PF1 IKCtl_FacKnockDetThd0_GM IKCtl_FacKnockDetThd1_GM IKCtl_FacKnockDetThd2_GM IKCtl_FacKnockDetThd3_GM IKCtl_FacKnockDetThd4_GM IKCtl_FacKnockDetThd5_GM IKCtl_facKnkRtdtCyl0_M IKCtl_facKnkRtdtCyl1_M IKCtl_facKnkRtdtCyl2_M IKCtl_facKnkRtdtCyl3_M IKCtl_facKnkRtdtCyl4_M IKCtl_facKnkRtdtCyl5_M /end DEF_CHARACTERISTIC
/end FUNCTION
/begin FUNCTION Limits "General limiters" /begin DEF_CHARACTERISTIC BMWinjmon_vol_HppCmpn_C KF_MDK_MAX_GANG_NKW VROHMAX /end DEF_CHARACTERISTIC /end FUNCTION
/begin FUNCTION LoadControl "Load targets and limiters"
 /begin DEF_CHARACTERISTIC KF_EDA_ANZ_SPORT_MD_EM1_IST K_RFVIST_MX BMWinjafs_fac_RatAirMax_T BMWext_lam_CptPronMinLeanTq_M KL_FRFMXBS KL_RFVHUBDYNKOR KL_RF_MAX_UESP KL_RF_MAX BMWls_rf_MaxModEng_M BMWls_rf_MaxFuOctIntkT_M BMWls_rf_MaxFuOctIntkTSpt_M BMWls_rf_MaxEgT_M BMWls_pct_FiMaxIgOfs_M BMWls_pct_FiMaxIgOfsSpt_M BMWls_pct_FiMaxCondRisk_T KL_LAMX BMWtchdiag_rf_SpMin_C BMWtchsp_rf_Liho_T KF_MDIOP_1_TQE KL_RFMIN_KRSTSYS S_BSRFMX BMWls_fac_rf_RednFuOctIntkT_M CoEng_ratChrgAirCylMaxDesLim_C /end DEF_CHARACTERISTIC
/end FUNCTION
/begin FUNCTION LowPressureFuelPump "LPFP targets and limiters"
 /begin DEF_CHARACTERISTIC BMWlpa_rat_EfpPwm_T BMWlpa_fac_AirLimOvrTMin_C BMWlpa_rat_AirLimMax_C BMWlpa_rat_AirLimGraNeg_C BMWlpa_rat_AirLimMin_C /end DEF_CHARACTERISTIC
/end FUNCTION
/begin COMPU_METHOD ___MGF_CC_EngineSpeedCutMethodCompuMethod "default compuMethod" TAB_VERB "%6.3" "-" COMPU_TAB_REF ___MGF_CC_EngineSpeedCutMethodCompuVTab /end COMPU_METHOD
/begin COMPU_METHOD ___MGF_CC_Fueling_d10 "default compuMethod" RAT_FUNC "%8.3" "�" COEFFS 0 4096 0 0 0 1 /end COMPU_METHOD
/begin COMPU_METHOD ___MGF_CC_IgnitionTiming_d10 "default compuMethod" RAT_FUNC "%8.3" "�" COEFFS 0 10 0 0 0 1 /end COMPU_METHOD
/begin COMPU_METHOD ___MGF_CC_Pedal_x100_d256 "default compuMethod" RAT_FUNC "%6.3" "%" COEFFS 0 256 0 0 0 100 /end COMPU_METHOD
/begin COMPU_METHOD ___MGF_CC_Speedkmh_d64 "default compuMethod" RAT_FUNC "%6.4" "km/h" COEFFS 0 64 0 0 0 1 /end COMPU_METHOD
/begin COMPU_METHOD ___MGF_CC_TemperatureCelsius_x3_d4_s48 "default compuMethod" RAT_FUNC "%6.2" "�C" COEFFS 0 1 48 0 0 0.75 /end COMPU_METHOD
/begin COMPU_METHOD aAwkuzc_BFpgCmb_tmDukma_q__aa0o "aAwkuzc_BFpgCmb_tmDukma_q__aa0o" RAT_FUNC "%6.3" "�" COEFFS 0 2 0 0 0 1 /end COMPU_METHOD
/begin COMPU_METHOD acriqBc_tfkBqod_ocgjxzc_nR_8oa0 "acriqBc_tfkBqod_ocgjxzc_nR_8oa0" RAT_FUNC "%6.3" "-" COEFFS 0 8192 0 0 0 1 /end COMPU_METHOD
/begin COMPU_METHOD aEmoCzd_erpwvfb_msfkhgc_qR_1a0o "aEmoCzd_erpwvfb_msfkhgc_qR_1a0o" RAT_FUNC "%6.3" "�" COEFFS 0 128 0 0 0 3 /end COMPU_METHOD
/begin COMPU_METHOD AFeDmkb_cAbjmcc_kAkskhd_k__0oa0 "AFeDmkb_cAbjmcc_kAkskhd_k__0oa0" RAT_FUNC "%6.3" "km/h" COEFFS 0 1 0 0 0 1 /end COMPU_METHOD
/begin COMPU_METHOD asfzqDd_xfCuqha_hliBAmd_k__0oa0 "asfzqDd_xfCuqha_hliBAmd_k__0oa0" RAT_FUNC "%6.3" "kg/h" COEFFS 0 10 0 0 0 1 /end COMPU_METHOD
/begin COMPU_METHOD Asyaixa_wdvtenb_FCefaCb_n__aa0o "Asyaixa_wdvtenb_FCefaCb_n__aa0o" RAT_FUNC "%6.3" "-" COEFFS 0 50 0 0 0 1 /end COMPU_METHOD
/begin COMPU_METHOD B_TRUE "" TAB_VERB "%6.3" "" COMPU_TAB_REF ACCMPR_CODAVL_SY_Compu /end COMPU_METHOD
/begin COMPU_METHOD Bhvfwhc_bigEubd_BBEupBd_nR_3oa0 "Bhvfwhc_bigEubd_BBEupBd_nR_3oa0" RAT_FUNC "%6.3" "-" COEFFS 0 32768 0 0 0 1 /end COMPU_METHOD
/begin COMPU_METHOD BMW_ba_poel__ "" RAT_FUNC "%6.2" "-" COEFFS 0 1 0 0 0 1 /end COMPU_METHOD
/begin COMPU_METHOD BMW_dm_sw_q0p1_Nm "" RAT_FUNC "%6.3" "Nm" COEFFS 0 10 0 0 0 1 /end COMPU_METHOD
/begin COMPU_METHOD BMW_p_sw_q0p125_hPa "" RAT_FUNC "%6.3" "hPa" COEFFS 0 8 0 0 0 1 /end COMPU_METHOD
/begin COMPU_METHOD BMW_Powertrain_DxECompuMethods_Def_ub_b1_nounit "Def_ub_b1" RAT_FUNC "%6.3" "-" COEFFS 0 256 0 0 0 1 /end COMPU_METHOD
/begin COMPU_METHOD BMW_q0p1_deg "" RAT_FUNC "%6.3" "�" COEFFS 0 10 0 0 0 1 /end COMPU_METHOD
/begin COMPU_METHOD BMW_q0p1_degC "" RAT_FUNC "%6.3" "�C" COEFFS 0 10 0 0 0 1 /end COMPU_METHOD
/begin COMPU_METHOD BMW_q0p2_s "" RAT_FUNC "%6.3" "s" COEFFS 0 5 0 0 0 1 /end COMPU_METHOD
/begin COMPU_METHOD BMW_q0p3906_PERC "" RAT_FUNC "%6.3" "%" COEFFS 0 64 0 0 0 25 /end COMPU_METHOD
/begin COMPU_METHOD bukAcFc_hypjrAa_CBhougc_MCRooa0 "bukAcFc_hypjrAa_CBhougc_MCRooa0" RAT_FUNC "%6.3" "MPa" COEFFS 0 500 0 0 0 1 /end COMPU_METHOD
/begin COMPU_METHOD BumqDkc_mryszAa_EcglxAc_nR_4oa0 "BumqDkc_mryszAa_EcglxAc_nR_4oa0" RAT_FUNC "%6.3" "-" COEFFS 0 4096 0 0 0 1 /end COMPU_METHOD
/begin COMPU_METHOD camcxxd_bxlpdsa_Cshlhgc_sR_1a0o "Def_q0p01" RAT_FUNC "%6.3" "s" COEFFS 0 100 0 0 0 1 /end COMPU_METHOD
/begin COMPU_METHOD caoddzd_oAjpfzb_cAcEEha_1nR_oa0 "Def_q1" RAT_FUNC "%6.3" "1/min" COEFFS 0 1 0 0 0 1 /end COMPU_METHOD
/begin COMPU_METHOD CByjozc_eCmpBAb_pljBAmd_k__0oa0 "CByjozc_eCmpBAb_pljBAmd_k__0oa0" RAT_FUNC "%6.3" "kg/h" COEFFS 0 32 0 0 0 1 /end COMPU_METHOD
/begin COMPU_METHOD CgkBooc_wkiDfEd_Czglhgc_fR_1a0o "Def_q0p01" RAT_FUNC "%6.3" "%" COEFFS 0 100 0 0 0 1 /end COMPU_METHOD
/begin COMPU_METHOD cxdjuna_xpuCged_ocEpdua_MCRa2a0 "cxdjuna_xpuCged_ocEpdua_MCRa2a0" RAT_FUNC "%6.3" "MPa" COEFFS 0 8192 0 0 0 5 /end COMPU_METHOD
/begin COMPU_METHOD DchEpAd_DBCFgoa_Ckhahgc_q__aoa0 "DchEpAd_DBCFgoa_Ckhahgc_q__aoa0" RAT_FUNC "%6.3" "�C" COEFFS 0 100 0 0 0 1 /end COMPU_METHOD
/begin COMPU_METHOD DEZ "" RAT_FUNC "%6.2" "" COEFFS 0 1 0 0 0 1 /end COMPU_METHOD
/begin COMPU_METHOD EngN "" RAT_FUNC "%6.3" "rpm" COEFFS 0 2 0 0 0 1 /end COMPU_METHOD
/begin COMPU_METHOD fak_q6p1035Em5 "" RAT_FUNC "%7.6" "-" COEFFS 0 65536 0 0 0 4 /end COMPU_METHOD
/begin COMPU_METHOD fak_sw_b4 "" RAT_FUNC "%6.5" "-" COEFFS 0 65536 0 0 0 8 /end COMPU_METHOD
/begin COMPU_METHOD fak_ub_b16 "" RAT_FUNC "%6.4" "-" COEFFS 0 256 0 0 0 16 /end COMPU_METHOD
/begin COMPU_METHOD fak_ub_b2 "" RAT_FUNC "%8.5" "-" COEFFS 0 256 0 0 0 2 /end COMPU_METHOD
/begin COMPU_METHOD fgjpsvb_fDqjECa_acgrbDd_n_dae__ "Def_bool" TAB_VERB "%6.3" "-" COMPU_TAB_REF Cmxqxpb_zopwEwb_acgrjwd___dae__ /end COMPU_METHOD
/begin COMPU_METHOD FzbmlAa_gCtylrb_ckCqxAc_nR_6oa0 "FzbmlAa_gCtylrb_ckCqxAc_nR_6oa0" RAT_FUNC "%6.3" "-" COEFFS 0 65536 0 0 0 1 /end COMPU_METHOD
/begin COMPU_METHOD ggDviCc_uydFbsa_CDgnhgc_nR_2a0o "ggDviCc_uydFbsa_CDgnhgc_nR_2a0o" RAT_FUNC "%6.3" "-" COEFFS 0 200 0 0 0 1 /end COMPU_METHOD
/begin COMPU_METHOD hcpywvc_dcqzDlc_FmDugua_s__aa0o "Def_q1" RAT_FUNC "%6.3" "s" COEFFS 0 1 0 0 0 1 /end COMPU_METHOD
/begin COMPU_METHOD ilxsavd_hkzmBfc_lAzCpAb_nR_1oa0 "ilxsavd_hkzmBfc_lAzCpAb_nR_1oa0" RAT_FUNC "%6.3" "-" COEFFS 0 16384 0 0 0 1 /end COMPU_METHOD
/begin COMPU_METHOD jgbhAma_smpAegb_hlEBAmd_k__0oa0 "jgbhAma_smpAegb_hlEBAmd_k__0oa0" RAT_FUNC "%6.3" "km/h" COEFFS 0 50 0 0 0 1 /end COMPU_METHOD
/begin COMPU_METHOD jucyrzb_bpFgwfd_uqrfhgc_k__aoa0 "jucyrzb_bpFgwfd_uqrfhgc_k__aoa0" RAT_FUNC "%6.3" "kW" COEFFS 0 512 0 0 0 1 /end COMPU_METHOD
/begin COMPU_METHOD kEEdlBb_gsrEhkd_rmDuAhc_uCRoa0o "kEEdlBb_gsrEhkd_rmDuAhc_uCRoa0o" RAT_FUNC "%6.3" "ul" COEFFS 0 1 0 0 0 1 /end COMPU_METHOD
/begin COMPU_METHOD kw_q0p75 "" RAT_FUNC "%6.3" "Grad KW" COEFFS 0 4 0 0 0 3 /end COMPU_METHOD
/begin COMPU_METHOD n_sw_q0p5 "" RAT_FUNC "%6.3" "1/min" COEFFS 0 2 0 0 0 1 /end COMPU_METHOD
/begin COMPU_METHOD nmot_q40 "" RAT_FUNC "%6.1" "1/min" COEFFS 0 1 0 0 0 40 /end COMPU_METHOD
/begin COMPU_METHOD nmot_sw_q0p25 "" RAT_FUNC "%6.3" "1/min" COEFFS 0 1 0 0 0 0.25 /end COMPU_METHOD
/begin COMPU_METHOD nnxvdDd_vDnjvqd_FmDuEEa_f__aa0o "Def_q1" RAT_FUNC "%6.3" "%" COEFFS 0 1 0 0 0 1 /end COMPU_METHOD
/begin COMPU_METHOD p_uw_q0p078 "" RAT_FUNC "%6.4" "hPa" COEFFS 0 256 0 0 0 20 /end COMPU_METHOD
/begin COMPU_METHOD raChrxc_kBtBrmb_FmDuEFa_n__aa0o "Def_q1" RAT_FUNC "%6.3" "-" COEFFS 0 1 0 0 0 1 /end COMPU_METHOD
/begin COMPU_METHOD rAdkuaa_wDllxja_BnDuEFa_n__aa0o "rAdkuaa_wDllxja_BnDuEFa_n__aa0o" RAT_FUNC "%6.3" "-" COEFFS 0 8 0 0 0 1 /end COMPU_METHOD
/begin COMPU_METHOD RBPtCel_p_0p002_1 "" RAT_FUNC "%6.4" "MPa" COEFFS 0 1000 0 0 0 2 /end COMPU_METHOD
/begin COMPU_METHOD RBPtCel_vol_1p0_1 "" RAT_FUNC "%6.2" "l" COEFFS 0 1 0 0 0 1 /end COMPU_METHOD
/begin COMPU_METHOD rel_q0p0234 "" RAT_FUNC "%6.4" "%" COEFFS 0 128 0 0 0 3 /end COMPU_METHOD
/begin COMPU_METHOD rel_q0p046875 "" RAT_FUNC "%6.4" "%" COEFFS 0 65536 0 0 0 3072 /end COMPU_METHOD
/begin COMPU_METHOD rel_ub_q0p75 "" RAT_FUNC "%6.3" "%" COEFFS 0 1 0 0 0 0.75 /end COMPU_METHOD
/begin COMPU_METHOD rgduxyd_mlihaBb_gsCghzb_bCRa0a0 "rgduxyd_mlihaBb_gsCghzb_bCRa0a0" RAT_FUNC "%6.3" "bar" COEFFS 0 1000 0 0 0 1 /end COMPU_METHOD
/begin COMPU_METHOD ridxkCa_Dxvxtdc_CChkhgc_nR_1a0o "ridxkCa_Dxvxtdc_CChkhgc_nR_1a0o" RAT_FUNC "%6.3" "-" COEFFS 0 128 0 0 0 3 /end COMPU_METHOD
/begin COMPU_METHOD t10msxs_ub_b2p55 "" RAT_FUNC "%6.4" "s" COEFFS 0 1 0 0 0 0.01 /end COMPU_METHOD
/begin COMPU_METHOD temp_ub_q0p75_o48 "" RAT_FUNC "%6.2" "Grad C" COEFFS 0 1 48 0 0 0.75 /end COMPU_METHOD
/begin COMPU_METHOD ubqeuic_jteCkzd_CDglhgc_nR_1a0o "Def_q0p01" RAT_FUNC "%6.3" "-" COEFFS 0 100 0 0 0 1 /end COMPU_METHOD
/begin COMPU_METHOD vfzg_sw_q0p00781 "" RAT_FUNC "%6.4" "km/h" COEFFS 0 1 0 0 0 0.0078125 /end COMPU_METHOD
/begin COMPU_METHOD vfzg_ub_q1p25 "" RAT_FUNC "%6.2" "km/h" COEFFS 0 1 0 0 0 1.25 /end COMPU_METHOD
/begin COMPU_METHOD vfzg_uw_b512 "" RAT_FUNC "%6.4" "km/h" COEFFS 0 65536 0 0 0 512 /end COMPU_METHOD
/begin COMPU_METHOD wDvwtyd_Bhgozed_DCekdfb_nsttFSS "wDvwtyd_Bhgozed_DCekdfb_nsttFSS" TAB_VERB "%6.3" "-" COMPU_TAB_REF wDvwtyd_Bhgozed_DCekdfb_nsttFSS /end COMPU_METHOD
/begin COMPU_METHOD zBcBzad_vmoivka_mFzjCgc_lCRooa0 "zBcBzad_vmoivka_mFzjCgc_lCRooa0" RAT_FUNC "%6.3" "l/h" COEFFS 0 100 0 0 0 1 /end COMPU_METHOD
/begin COMPU_METHOD zyyxBpb_rEsnvtc_gktukCa_fR_5a0o "zyyxBpb_rEsnvtc_gktukCa_fR_5a0o" RAT_FUNC "%6.3" "%" COEFFS 0 512 0 0 0 25 /end COMPU_METHOD
/begin COMPU_VTAB ___MGF_CC_EngineSpeedCutMethodCompuVTab "" TAB_VERB 3 0 "Fuel" 1 "Ignition" 3 "Factory" DEFAULT_VALUE "Not Defined, unexpected results" /end COMPU_VTAB
/begin COMPU_VTAB ACCMPR_CODAVL_SY_Compu "" TAB_VERB 2 0 "FALSE" 1 "TRUE" /end COMPU_VTAB
/begin COMPU_VTAB Cmxqxpb_zopwEwb_acgrjwd___dae__ "Cmxqxpb_zopwEwb_acgrjwd___dae__" TAB_VERB 2 0 "false" 1 "true" DEFAULT_VALUE "Zustand nicht definiert" /end COMPU_VTAB
/begin COMPU_VTAB wDvwtyd_Bhgozed_DCekdfb_nsttFSS "wDvwtyd_Bhgozed_DCekdfb_nsttFSS" TAB_VERB 4 0 "CH_OFF" 1 "CH_1ES" 2 "CH_2ES" 3 "CH_3ES" DEFAULT_VALUE "Zustand nicht definiert" /end COMPU_VTAB
/begin RECORD_LAYOUT ___MGF_CC_Antilag_Ign_Roll_xAxis AXIS_PTS_X 0 SWORD INDEX_INCR PLONG /end RECORD_LAYOUT
/begin RECORD_LAYOUT _REC_A1AXS_1_MBSE_S1 ALIGNMENT_BYTE 1 ALIGNMENT_WORD 2 ALIGNMENT_LONG 4 ALIGNMENT_FLOAT32_IEEE 4 ALIGNMENT_FLOAT64_IEEE 4 AXIS_PTS_X 1 SBYTE INDEX_INCR DIRECT /end RECORD_LAYOUT
/begin RECORD_LAYOUT _REC_A1AXS_1_MBSE_S2 ALIGNMENT_BYTE 1 ALIGNMENT_WORD 2 ALIGNMENT_LONG 4 ALIGNMENT_FLOAT32_IEEE 4 ALIGNMENT_FLOAT64_IEEE 4 AXIS_PTS_X 1 SWORD INDEX_INCR DIRECT /end RECORD_LAYOUT
/begin RECORD_LAYOUT _REC_A1AXS_1_MBSE_U1 ALIGNMENT_BYTE 1 ALIGNMENT_WORD 2 ALIGNMENT_LONG 4 ALIGNMENT_FLOAT32_IEEE 4 ALIGNMENT_FLOAT64_IEEE 4 AXIS_PTS_X 1 UBYTE INDEX_INCR DIRECT /end RECORD_LAYOUT
/begin RECORD_LAYOUT _REC_A1AXS_1_MBSE_U2 ALIGNMENT_BYTE 1 ALIGNMENT_WORD 2 ALIGNMENT_LONG 4 ALIGNMENT_FLOAT32_IEEE 4 ALIGNMENT_FLOAT64_IEEE 4 AXIS_PTS_X 1 UWORD INDEX_INCR DIRECT /end RECORD_LAYOUT
/begin RECORD_LAYOUT _REC_A1CUR_1_MBSE_S1_S1 ALIGNMENT_BYTE 1 ALIGNMENT_WORD 2 ALIGNMENT_LONG 4 ALIGNMENT_FLOAT32_IEEE 4 ALIGNMENT_FLOAT64_IEEE 4 FNC_VALUES 1 SBYTE ROW_DIR DIRECT /end RECORD_LAYOUT
/begin RECORD_LAYOUT _REC_A1CUR_1_MBSE_S2_S1 ALIGNMENT_BYTE 1 ALIGNMENT_WORD 2 ALIGNMENT_LONG 4 ALIGNMENT_FLOAT32_IEEE 4 ALIGNMENT_FLOAT64_IEEE 4 FNC_VALUES 1 SWORD ROW_DIR DIRECT /end RECORD_LAYOUT
/begin RECORD_LAYOUT _REC_A1CUR_1_MBSE_U1_S1 ALIGNMENT_BYTE 1 ALIGNMENT_WORD 2 ALIGNMENT_LONG 4 ALIGNMENT_FLOAT32_IEEE 4 ALIGNMENT_FLOAT64_IEEE 4 FNC_VALUES 1 UBYTE ROW_DIR DIRECT /end RECORD_LAYOUT
/begin RECORD_LAYOUT _REC_A1CUR_1_MBSE_U2_S1 ALIGNMENT_BYTE 1 ALIGNMENT_WORD 2 ALIGNMENT_LONG 4 ALIGNMENT_FLOAT32_IEEE 4 ALIGNMENT_FLOAT64_IEEE 4 FNC_VALUES 1 UWORD ROW_DIR DIRECT /end RECORD_LAYOUT
/begin RECORD_LAYOUT Axis_Xs16 ALIGNMENT_BYTE 1 ALIGNMENT_WORD 2 ALIGNMENT_LONG 4 ALIGNMENT_FLOAT32_IEEE 4 ALIGNMENT_FLOAT64_IEEE 4 NO_AXIS_PTS_X 1 SWORD AXIS_PTS_X 2 SWORD INDEX_INCR DIRECT /end RECORD_LAYOUT
/begin RECORD_LAYOUT Axis_Xu16 ALIGNMENT_BYTE 1 ALIGNMENT_WORD 2 ALIGNMENT_LONG 4 ALIGNMENT_FLOAT32_IEEE 4 ALIGNMENT_FLOAT64_IEEE 4 NO_AXIS_PTS_X 1 UWORD AXIS_PTS_X 2 UWORD INDEX_INCR DIRECT /end RECORD_LAYOUT
/begin RECORD_LAYOUT Axis_Xu8 ALIGNMENT_BYTE 1 ALIGNMENT_WORD 2 ALIGNMENT_LONG 4 ALIGNMENT_FLOAT32_IEEE 4 ALIGNMENT_FLOAT64_IEEE 4 NO_AXIS_PTS_X 1 UBYTE AXIS_PTS_X 2 UBYTE INDEX_INCR DIRECT /end RECORD_LAYOUT
/begin RECORD_LAYOUT Cur_Xu8Wu8 ALIGNMENT_BYTE 1 ALIGNMENT_WORD 2 ALIGNMENT_LONG 4 ALIGNMENT_FLOAT32_IEEE 4 ALIGNMENT_FLOAT64_IEEE 4 NO_AXIS_PTS_X 1 UBYTE AXIS_PTS_X 2 UBYTE INDEX_INCR DIRECT FNC_VALUES 3 UBYTE COLUMN_DIR DIRECT /end RECORD_LAYOUT
/begin RECORD_LAYOUT CurG_Ws16 ALIGNMENT_BYTE 1 ALIGNMENT_WORD 2 ALIGNMENT_LONG 4 ALIGNMENT_FLOAT32_IEEE 4 ALIGNMENT_FLOAT64_IEEE 4 FNC_VALUES 1 SWORD COLUMN_DIR DIRECT /end RECORD_LAYOUT
/begin RECORD_LAYOUT FklWUb ALIGNMENT_BYTE 1 ALIGNMENT_WORD 2 ALIGNMENT_LONG 4 ALIGNMENT_FLOAT32_IEEE 4 ALIGNMENT_FLOAT64_IEEE 4 FNC_VALUES 1 UBYTE COLUMN_DIR DIRECT /end RECORD_LAYOUT
/begin RECORD_LAYOUT KwUw ALIGNMENT_BYTE 1 ALIGNMENT_WORD 2 ALIGNMENT_LONG 4 ALIGNMENT_FLOAT32_IEEE 4 ALIGNMENT_FLOAT64_IEEE 4 FNC_VALUES 1 UWORD COLUMN_DIR DIRECT /end RECORD_LAYOUT
/begin RECORD_LAYOUT Map_Xs16Ys16Ws16 ALIGNMENT_BYTE 1 ALIGNMENT_WORD 2 ALIGNMENT_LONG 4 ALIGNMENT_FLOAT32_IEEE 4 ALIGNMENT_FLOAT64_IEEE 4 NO_AXIS_PTS_X 1 SWORD NO_AXIS_PTS_Y 2 SWORD AXIS_PTS_X 3 SWORD INDEX_INCR DIRECT AXIS_PTS_Y 4 SWORD INDEX_INCR DIRECT FNC_VALUES 5 SWORD COLUMN_DIR DIRECT /end RECORD_LAYOUT
/begin RECORD_LAYOUT RB_Curve_S16_U16_Static ALIGNMENT_BYTE 1 ALIGNMENT_WORD 2 ALIGNMENT_LONG 4 ALIGNMENT_FLOAT32_IEEE 4 ALIGNMENT_FLOAT64_IEEE 4 NO_AXIS_PTS_X 1 SWORD AXIS_PTS_X 2 SWORD INDEX_INCR DIRECT FNC_VALUES 3 UWORD COLUMN_DIR DIRECT STATIC_RECORD_LAYOUT /end RECORD_LAYOUT
/begin RECORD_LAYOUT RB_Map_S16U8_S8 ALIGNMENT_BYTE 1 ALIGNMENT_WORD 2 ALIGNMENT_LONG 4 ALIGNMENT_FLOAT32_IEEE 4 ALIGNMENT_FLOAT64_IEEE 4 NO_AXIS_PTS_X 1 SWORD NO_AXIS_PTS_Y 2 SWORD AXIS_PTS_X 3 SWORD INDEX_INCR DIRECT AXIS_PTS_Y 4 UBYTE INDEX_INCR DIRECT FNC_VALUES 5 SBYTE COLUMN_DIR DIRECT /end RECORD_LAYOUT
/end MODULE
/end PROJECT
