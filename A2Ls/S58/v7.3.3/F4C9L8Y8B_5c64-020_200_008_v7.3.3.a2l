ASAP2_VERSION 1 60
/begin PROJECT MG1CS049_S58_F4C2L8Y8B "MG1CS049"
/begin HEADER "" VERSION "F4C2L8Y8B" PROJECT_NO MG1CS049_S58_F4C2L8Y8B /end HEADER
/begin MODULE DIM ""
/begin MOD_COMMON "" BYTE_ORDER MSB_LAST DEPOSIT ABSOLUTE ALIGNMENT_BYTE 1 ALIGNMENT_WORD 2 ALIGNMENT_LONG 4 ALIGNMENT_FLOAT32_IEEE 4 ALIGNMENT_FLOAT64_IEEE 4 /end MOD_COMMON
/begin AXIS_PTS AXX_KF_BSLGF "AXX_KF_BSLGF" 0x80719DEE Nkw_atm _REC_A1AXS_1_MBSE_S2 65535 caoddzd_oAjpfzb_cAcEEha_1nR_oa0 4 -32768 32767 DEPOSIT ABSOLUTE /end AXIS_PTS
/begin AXIS_PTS AXX_KF_DLAMBSVST_TABG "AXX_KF_DLAMBSVST_TABG" 0x8071A0FC Nkw_atm _REC_A1AXS_1_MBSE_S2 65535 caoddzd_oAjpfzb_cAcEEha_1nR_oa0 8 -32768 32767 DEPOSIT ABSOLUTE /end AXIS_PTS
/begin AXIS_PTS AXX_KF_DZW_DYN "AXX_KF_DZW_DYN" 0x807378AC Nkw _REC_A1AXS_1_MBSE_S2 65535 caoddzd_oAjpfzb_cAcEEha_1nR_oa0 4 -32768 32767 FORMAT "%5.0" DEPOSIT ABSOLUTE /end AXIS_PTS
/begin AXIS_PTS AXX_KF_DZWT_PF1 "AXX_KF_DZWT_PF1" 0x8074C41C Nkw _REC_A1AXS_1_MBSE_S2 65535 caoddzd_oAjpfzb_cAcEEha_1nR_oa0 20 -32768 32767 FORMAT "%5.0" DEPOSIT ABSOLUTE /end AXIS_PTS
/begin AXIS_PTS AXX_KF_DZWT_PF2 "AXX_KF_DZWT_PF2" 0x8074C3F4 Nkw _REC_A1AXS_1_MBSE_S2 65535 caoddzd_oAjpfzb_cAcEEha_1nR_oa0 20 -32768 32767 FORMAT "%5.0" DEPOSIT ABSOLUTE /end AXIS_PTS
/begin AXIS_PTS AXX_KF_DZWT_UESP_PF1 "AXX_KF_DZWT_UESP_PF1" 0x8074C3E0 Nkw _REC_A1AXS_1_MBSE_S2 65535 caoddzd_oAjpfzb_cAcEEha_1nR_oa0 10 -32768 32767 FORMAT "%5.0" DEPOSIT ABSOLUTE /end AXIS_PTS
/begin AXIS_PTS AXX_KF_DZWT_UESP_PF2 "AXX_KF_DZWT_UESP_PF2" 0x8074C3CC Nkw _REC_A1AXS_1_MBSE_S2 65535 caoddzd_oAjpfzb_cAcEEha_1nR_oa0 10 -32768 32767 FORMAT "%5.0" DEPOSIT ABSOLUTE /end AXIS_PTS
/begin AXIS_PTS AXX_KF_EDA_ANZ_SPORT_MD_EM1_IST "KF_EDA_ANZ_SPORT_MD_EM1_IST" 0x8070CE36 NO_INPUT_QUANTITY _REC_A1AXS_1_MBSE_S2 6553.5 BMW_dm_sw_q0p1_Nm 6 -3276.8 3276.7 FORMAT "%7.2" DEPOSIT ABSOLUTE /end AXIS_PTS
/begin AXIS_PTS AXX_KF_FDZW_DYN1 "AXX_KF_FDZW_DYN1" 0x8074C238 Tans _REC_A1AXS_1_MBSE_S2 6553.5 BMW_q0p1_degC 4 -3276.8 3276.7 FORMAT "%6.1" DEPOSIT ABSOLUTE /end AXIS_PTS
/begin AXIS_PTS AXX_KF_FDZW_DYN2 "AXX_KF_FDZW_DYN2" 0x80762EA1 Gangi _REC_A1AXS_1_MBSE_U1 255 raChrxc_kBtBrmb_FmDuEFa_n__aa0o 10 0 255 FORMAT "%3.0" DEPOSIT ABSOLUTE /end AXIS_PTS
/begin AXIS_PTS AXX_KF_FDZW_DYN3 "AXX_KF_FDZW_DYN3" 0x8074C230 Tans _REC_A1AXS_1_MBSE_S2 6553.5 BMW_q0p1_degC 4 -3276.8 3276.7 FORMAT "%6.1" DEPOSIT ABSOLUTE /end AXIS_PTS
/begin AXIS_PTS AXX_KF_FDZW_DYN4 "AXX_KF_FDZW_DYN4" 0x80762E97 Gangi _REC_A1AXS_1_MBSE_U1 255 raChrxc_kBtBrmb_FmDuEFa_n__aa0o 10 0 255 FORMAT "%3.0" DEPOSIT ABSOLUTE /end AXIS_PTS
/begin AXIS_PTS AXX_KF_FDZWT_BEST_PF1 "Temperature correction factor for best ignition angle path 1" 0x807376A0 Tmot _REC_A1AXS_1_MBSE_S2 655.35 DchEpAd_DBCFgoa_Ckhahgc_q__aoa0 6 -327.68 327.67 FORMAT "%7.2" DEPOSIT ABSOLUTE /end AXIS_PTS
/begin AXIS_PTS AXX_KF_FDZWT_BEST_PF2 "Temperature correction factor for best ignition angle path 2" 0x80737694 Tmot _REC_A1AXS_1_MBSE_S2 655.35 DchEpAd_DBCFgoa_Ckhahgc_q__aoa0 6 -327.68 327.67 FORMAT "%7.2" DEPOSIT ABSOLUTE /end AXIS_PTS
/begin AXIS_PTS AXX_KF_FDZWT_PF1 "AXX_KF_FDZWT_PF1" 0x80737760 Tmot _REC_A1AXS_1_MBSE_S2 655.35 DchEpAd_DBCFgoa_Ckhahgc_q__aoa0 6 -327.68 327.67 FORMAT "%7.2" DEPOSIT ABSOLUTE /end AXIS_PTS
/begin AXIS_PTS AXX_KF_FDZWT_PF2 "AXX_KF_FDZWT_PF2" 0x80737754 Tmot _REC_A1AXS_1_MBSE_S2 655.35 DchEpAd_DBCFgoa_Ckhahgc_q__aoa0 6 -327.68 327.67 FORMAT "%7.2" DEPOSIT ABSOLUTE /end AXIS_PTS
/begin AXIS_PTS AXX_KF_FMS_DKPSRPL_MN "Nkw_eisy" 0x80752246 NO_INPUT_QUANTITY _REC_A1AXS_1_MBSE_S2 32767 caoddzd_oAjpfzb_cAcEEha_1nR_oa0 6 0 32767 FORMAT "%5.0" DEPOSIT ABSOLUTE /end AXIS_PTS
/begin AXIS_PTS AXX_KF_FMS_DKPSRPL_MX "Nkw_eisy" 0x8075223A NO_INPUT_QUANTITY _REC_A1AXS_1_MBSE_S2 32767 caoddzd_oAjpfzb_cAcEEha_1nR_oa0 6 0 32767 FORMAT "%5.0" DEPOSIT ABSOLUTE /end AXIS_PTS
/begin AXIS_PTS AXX_KF_FMS_HFMPL_MN "Nkw_eisy" 0x8073DE4C NO_INPUT_QUANTITY _REC_A1AXS_1_MBSE_S2 65535 caoddzd_oAjpfzb_cAcEEha_1nR_oa0 6 -32768 32767 FORMAT "%5.0" DEPOSIT ABSOLUTE /end AXIS_PTS
/begin AXIS_PTS AXX_KF_FMS_HFMPL_MX "Nkw_eisy" 0x8073DE40 NO_INPUT_QUANTITY _REC_A1AXS_1_MBSE_S2 65535 caoddzd_oAjpfzb_cAcEEha_1nR_oa0 6 -32768 32767 FORMAT "%5.0" DEPOSIT ABSOLUTE /end AXIS_PTS
/begin AXIS_PTS AXX_KF_FRKKORRF_1 "AXX_KF_FRKKORRF_1" 0x80714FD0 Nkw _REC_A1AXS_1_MBSE_S2 65535 caoddzd_oAjpfzb_cAcEEha_1nR_oa0 16 -32768 32767 FORMAT "%5.0" DEPOSIT ABSOLUTE /end AXIS_PTS
/begin AXIS_PTS AXX_KF_KOEFF_B_LA "AXX_KF_KOEFF_B_LA" 0x80737AB8 Nkw _REC_A1AXS_1_MBSE_S2 65535 caoddzd_oAjpfzb_cAcEEha_1nR_oa0 6 -32768 32767 FORMAT "%5.0" DEPOSIT ABSOLUTE /end AXIS_PTS
/begin AXIS_PTS AXX_KF_LA_BEZ "AXX_KF_LA_BEZ" 0x80737AAC Nkw _REC_A1AXS_1_MBSE_S2 65535 caoddzd_oAjpfzb_cAcEEha_1nR_oa0 6 -32768 32767 FORMAT "%5.0" DEPOSIT ABSOLUTE /end AXIS_PTS
/begin AXIS_PTS AXX_KF_LAMIN_H "AXX_KF_LAMIN_H" 0x8071F352 Nkw _REC_A1AXS_1_MBSE_S2 65535 caoddzd_oAjpfzb_cAcEEha_1nR_oa0 6 -32768 32767 FORMAT "%5.0" DEPOSIT ABSOLUTE /end AXIS_PTS
/begin AXIS_PTS AXX_KF_MDIOP_1_TQE "AXX_KF_MDIOP_1_TQE" 0x8072DD84 NO_INPUT_QUANTITY _REC_A1AXS_1_MBSE_S2 655.35 CgkBooc_wkiDfEd_Czglhgc_fR_1a0o 18 -327.68 327.67 FORMAT "%6.2" DEPOSIT ABSOLUTE /end AXIS_PTS
/begin AXIS_PTS AXX_KF_MDK_MAX_GANG_NKW "X-axis (Gang_gb1_ist) for KF_MDK_MAX_GANG_NKW" 0x8075F8BE Gang_gb1_ist _REC_A1AXS_1_MBSE_S1 255 raChrxc_kBtBrmb_FmDuEFa_n__aa0o 10 -128 127 FORMAT "%6.0" DEPOSIT ABSOLUTE /end AXIS_PTS
/begin AXIS_PTS AXX_KF_PHA_H_E1 "AXX_KF_PHA_H_E1" 0x80718C14 Nkw _REC_A1AXS_1_MBSE_S2 65535 caoddzd_oAjpfzb_cAcEEha_1nR_oa0 8 -32768 32767 FORMAT "%5.0" DEPOSIT ABSOLUTE /end AXIS_PTS
/begin AXIS_PTS AXX_KF_PRAIL_H "AXX_KF_PRAIL_H" 0x807261EE Nkw _REC_A1AXS_1_MBSE_S2 65535 caoddzd_oAjpfzb_cAcEEha_1nR_oa0 8 -32768 32767 FORMAT "%5.0" DEPOSIT ABSOLUTE /end AXIS_PTS
/begin AXIS_PTS AXX_KF_PRAIL_H_K "AXX_KF_PRAIL_H_K" 0x807261AE Nkw _REC_A1AXS_1_MBSE_S2 65535 caoddzd_oAjpfzb_cAcEEha_1nR_oa0 8 -32768 32767 FORMAT "%5.0" DEPOSIT ABSOLUTE /end AXIS_PTS
/begin AXIS_PTS AXX_KF_PRAIL_HDPWARM "Achse" 0x807261DE Nkw _REC_A1AXS_1_MBSE_S2 65535 caoddzd_oAjpfzb_cAcEEha_1nR_oa0 8 -32768 32767 FORMAT "%5.0" DEPOSIT ABSOLUTE /end AXIS_PTS
/begin AXIS_PTS AXX_KF_PRAIL_HGD "Achse" 0x807261CE Nkw _REC_A1AXS_1_MBSE_S2 65535 caoddzd_oAjpfzb_cAcEEha_1nR_oa0 8 -32768 32767 FORMAT "%5.0" DEPOSIT ABSOLUTE /end AXIS_PTS
/begin AXIS_PTS AXX_KF_PRAIL_HGD_K "Achse" 0x807261BE Nkw _REC_A1AXS_1_MBSE_S2 65535 caoddzd_oAjpfzb_cAcEEha_1nR_oa0 8 -32768 32767 FORMAT "%5.0" DEPOSIT ABSOLUTE /end AXIS_PTS
/begin AXIS_PTS AXX_KF_ST_RKBAS_GD "AXX_KF_ST_RKBAS_GD" 0x8074FA94 Nkw _REC_A1AXS_1_MBSE_S2 65535 caoddzd_oAjpfzb_cAcEEha_1nR_oa0 10 -32768 32767 FORMAT "%5.0" DEPOSIT ABSOLUTE /end AXIS_PTS
/begin AXIS_PTS AXX_KF_ST_RKBAS_VVT "AXX_KF_ST_RKBAS_VVT" 0x8074F90A Nkw _REC_A1AXS_1_MBSE_S2 65535 caoddzd_oAjpfzb_cAcEEha_1nR_oa0 12 -32768 32767 FORMAT "%5.0" DEPOSIT ABSOLUTE /end AXIS_PTS
/begin AXIS_PTS AXX_KF_TD_FETTDELAY_TABG "AXX_KF_TD_FETTDELAY_TABG" 0x8074E5C8 Tw_r1 _REC_A1AXS_1_MBSE_S2 6553.5 BMW_q0p1_degC 6 -3276.8 3276.7 FORMAT "%6.1" DEPOSIT ABSOLUTE /end AXIS_PTS
/begin AXIS_PTS AXX_KF_ZW_PF1 "AXX_KF_ZW_PF1" 0x807375A2 Nkw _REC_A1AXS_1_MBSE_S2 65535 caoddzd_oAjpfzb_cAcEEha_1nR_oa0 20 -32768 32767 FORMAT "%5.0" DEPOSIT ABSOLUTE /end AXIS_PTS
/begin AXIS_PTS AXX_KF_ZW_PF2 "AXX_KF_ZW_PF2" 0x8073757A Nkw _REC_A1AXS_1_MBSE_S2 65535 caoddzd_oAjpfzb_cAcEEha_1nR_oa0 20 -32768 32767 FORMAT "%5.0" DEPOSIT ABSOLUTE /end AXIS_PTS
/begin AXIS_PTS AXX_KF_ZW_S_PF1 "AXX_KF_ZW_S_PF1" 0x80737552 Nkw _REC_A1AXS_1_MBSE_S2 65535 caoddzd_oAjpfzb_cAcEEha_1nR_oa0 20 -32768 32767 FORMAT "%5.0" DEPOSIT ABSOLUTE /end AXIS_PTS
/begin AXIS_PTS AXX_KF_ZW_S_PF2 "AXX_KF_ZW_S_PF2" 0x8073752A Nkw _REC_A1AXS_1_MBSE_S2 65535 caoddzd_oAjpfzb_cAcEEha_1nR_oa0 20 -32768 32767 FORMAT "%5.0" DEPOSIT ABSOLUTE /end AXIS_PTS
/begin AXIS_PTS AXX_KF_ZW_UESP_PF1 "AXX_KF_ZW_UESP_PF1" 0x80737516 Nkw _REC_A1AXS_1_MBSE_S2 65535 caoddzd_oAjpfzb_cAcEEha_1nR_oa0 10 -32768 32767 FORMAT "%5.0" DEPOSIT ABSOLUTE /end AXIS_PTS
/begin AXIS_PTS AXX_KF_ZW_UESP_PF2 "AXX_KF_ZW_UESP_PF2" 0x80737502 Nkw _REC_A1AXS_1_MBSE_S2 65535 caoddzd_oAjpfzb_cAcEEha_1nR_oa0 10 -32768 32767 FORMAT "%5.0" DEPOSIT ABSOLUTE /end AXIS_PTS
/begin AXIS_PTS AXX_KF_ZW_VP_PF1 "AXX_KF_ZW_VP_PF1" 0x8074F60A Nkw _REC_A1AXS_1_MBSE_S2 65535 caoddzd_oAjpfzb_cAcEEha_1nR_oa0 20 -32768 32767 FORMAT "%5.0" DEPOSIT ABSOLUTE /end AXIS_PTS
/begin AXIS_PTS AXX_KF_ZW_VP_PF2 "AXX_KF_ZW_VP_PF2" 0x8074F5E2 Nkw _REC_A1AXS_1_MBSE_S2 65535 caoddzd_oAjpfzb_cAcEEha_1nR_oa0 20 -32768 32767 FORMAT "%5.0" DEPOSIT ABSOLUTE /end AXIS_PTS
/begin AXIS_PTS AXX_KL_FRFMXBS "AXX_KL_FRFMXBS" 0x80719DE6 NO_INPUT_QUANTITY _REC_A1AXS_1_MBSE_U2 1.99996948242188 Bhvfwhc_bigEubd_BBEupBd_nR_3oa0 4 0 1.99996948242188 FORMAT "%14.5" DEPOSIT ABSOLUTE /end AXIS_PTS
/begin AXIS_PTS AXX_KL_LAMX "Nkw * kl_tasche_aus" 0x80721C74 NO_INPUT_QUANTITY _REC_A1AXS_1_MBSE_S2 65535 caoddzd_oAjpfzb_cAcEEha_1nR_oa0 18 -32768 32767 FORMAT "%5.0" DEPOSIT ABSOLUTE /end AXIS_PTS
/begin AXIS_PTS AXX_KL_RF_MAX "Nkw" 0x80721C38 NO_INPUT_QUANTITY _REC_A1AXS_1_MBSE_S2 65535 caoddzd_oAjpfzb_cAcEEha_1nR_oa0 12 -32768 32767 FORMAT "%5.0" DEPOSIT ABSOLUTE /end AXIS_PTS
/begin AXIS_PTS AXX_KL_RF_MAX_UESP "Nkw" 0x80721C20 NO_INPUT_QUANTITY _REC_A1AXS_1_MBSE_S2 65535 caoddzd_oAjpfzb_cAcEEha_1nR_oa0 12 -32768 32767 FORMAT "%5.0" DEPOSIT ABSOLUTE /end AXIS_PTS
/begin AXIS_PTS AXX_KL_RFMIN_KRSTSYS "X-axis for KL_RFMIN_KRSTSYS" 0x8073F5EA Nkw _REC_A1AXS_1_MBSE_S2 65535 caoddzd_oAjpfzb_cAcEEha_1nR_oa0 8 -32768 32767 FORMAT "%5.0" DEPOSIT ABSOLUTE /end AXIS_PTS
/begin AXIS_PTS AXX_KL_RFVHUBDYNKOR "Nkw" 0x8071FB8E NO_INPUT_QUANTITY _REC_A1AXS_1_MBSE_S2 65535 caoddzd_oAjpfzb_cAcEEha_1nR_oa0 20 -32768 32767 FORMAT "%5.0" DEPOSIT ABSOLUTE /end AXIS_PTS
/begin AXIS_PTS AXY_KF_BSLGF "AXY_KF_BSLGF" 0x80719DDE Rf_atm _REC_A1AXS_1_MBSE_S2 655.35 CgkBooc_wkiDfEd_Czglhgc_fR_1a0o 4 -327.68 327.67 DEPOSIT ABSOLUTE /end AXIS_PTS
/begin AXIS_PTS AXY_KF_DLAMBSVST_TABG "AXY_KF_DLAMBSVST_TABG" 0x8071A0A4 Rf_atm _REC_A1AXS_1_MBSE_S2 655.35 CgkBooc_wkiDfEd_Czglhgc_fR_1a0o 8 -327.68 327.67 DEPOSIT ABSOLUTE /end AXIS_PTS
/begin AXIS_PTS AXY_KF_DZW_DYN "AXY_KF_DZW_DYN" 0x8073784C NO_INPUT_QUANTITY _REC_A1AXS_1_MBSE_S2 655.35 CgkBooc_wkiDfEd_Czglhgc_fR_1a0o 4 -327.68 327.67 FORMAT "%9.2" DEPOSIT ABSOLUTE /end AXIS_PTS
/begin AXIS_PTS AXY_KF_DZWT_PF1 "AXY_KF_DZWT_PF1" 0x8074C354 NO_INPUT_QUANTITY _REC_A1AXS_1_MBSE_S2 655.35 CgkBooc_wkiDfEd_Czglhgc_fR_1a0o 16 -327.68 327.67 FORMAT "%9.2" DEPOSIT ABSOLUTE /end AXIS_PTS
/begin AXIS_PTS AXY_KF_DZWT_PF2 "AXY_KF_DZWT_PF2" 0x8074C334 NO_INPUT_QUANTITY _REC_A1AXS_1_MBSE_S2 655.35 CgkBooc_wkiDfEd_Czglhgc_fR_1a0o 16 -327.68 327.67 FORMAT "%9.2" DEPOSIT ABSOLUTE /end AXIS_PTS
/begin AXIS_PTS AXY_KF_DZWT_UESP_PF1 "AXY_KF_DZWT_UESP_PF1" 0x8074C31C NO_INPUT_QUANTITY _REC_A1AXS_1_MBSE_S2 655.35 CgkBooc_wkiDfEd_Czglhgc_fR_1a0o 12 -327.68 327.67 FORMAT "%9.2" DEPOSIT ABSOLUTE /end AXIS_PTS
/begin AXIS_PTS AXY_KF_DZWT_UESP_PF2 "AXY_KF_DZWT_UESP_PF2" 0x8074C304 NO_INPUT_QUANTITY _REC_A1AXS_1_MBSE_S2 655.35 CgkBooc_wkiDfEd_Czglhgc_fR_1a0o 12 -327.68 327.67 FORMAT "%9.2" DEPOSIT ABSOLUTE /end AXIS_PTS
/begin AXIS_PTS AXY_KF_EDA_ANZ_SPORT_MD_EM1_IST "KF_EDA_ANZ_SPORT_MD_EM1_IST" 0x8070CE66 NO_INPUT_QUANTITY _REC_A1AXS_1_MBSE_S2 65535 caoddzd_oAjpfzb_cAcEEha_1nR_oa0 6 -32768 32767 FORMAT "%5.0" DEPOSIT ABSOLUTE /end AXIS_PTS
/begin AXIS_PTS AXY_KF_FDZW_DYN1 "AXY_KF_FDZW_DYN1" 0x8074C228 Dzw_annm _REC_A1AXS_1_MBSE_S2 110 BMW_q0p1_deg 4 -50 60 FORMAT "%6.1" DEPOSIT ABSOLUTE /end AXIS_PTS
/begin AXIS_PTS AXY_KF_FDZW_DYN2 "AXY_KF_FDZW_DYN2" 0x8074C220 V _REC_A1AXS_1_MBSE_U2 360 AFeDmkb_cAbjmcc_kAkskhd_k__0oa0 4 0 360 FORMAT "%5.0" DEPOSIT ABSOLUTE /end AXIS_PTS
/begin AXIS_PTS AXY_KF_FDZW_DYN3 "AXY_KF_FDZW_DYN3" 0x8074C218 Dzw_annm _REC_A1AXS_1_MBSE_S2 110 BMW_q0p1_deg 4 -50 60 FORMAT "%6.1" DEPOSIT ABSOLUTE /end AXIS_PTS
/begin AXIS_PTS AXY_KF_FDZW_DYN4 "AXY_KF_FDZW_DYN4" 0x8074C210 V _REC_A1AXS_1_MBSE_U2 360 AFeDmkb_cAbjmcc_kAkskhd_k__0oa0 4 0 360 FORMAT "%5.0" DEPOSIT ABSOLUTE /end AXIS_PTS
/begin AXIS_PTS AXY_KF_FDZWT_BEST_PF1 "Temperature correction factor for best ignition angle path 1" 0x80737688 Tans _REC_A1AXS_1_MBSE_S2 6553.5 BMW_q0p1_degC 6 -3276.8 3276.7 FORMAT "%6.1" DEPOSIT ABSOLUTE /end AXIS_PTS
/begin AXIS_PTS AXY_KF_FDZWT_BEST_PF2 "Temperature correction factor for best ignition angle path 2" 0x8073767C Tans _REC_A1AXS_1_MBSE_S2 6553.5 BMW_q0p1_degC 6 -3276.8 3276.7 FORMAT "%6.1" DEPOSIT ABSOLUTE /end AXIS_PTS
/begin AXIS_PTS AXY_KF_FDZWT_PF1 "AXY_KF_FDZWT_PF1" 0x80737748 Tans _REC_A1AXS_1_MBSE_S2 6553.5 BMW_q0p1_degC 6 -3276.8 3276.7 FORMAT "%6.1" DEPOSIT ABSOLUTE /end AXIS_PTS
/begin AXIS_PTS AXY_KF_FDZWT_PF2 "AXY_KF_FDZWT_PF2" 0x8073773C Tans _REC_A1AXS_1_MBSE_S2 6553.5 BMW_q0p1_degC 6 -3276.8 3276.7 FORMAT "%6.1" DEPOSIT ABSOLUTE /end AXIS_PTS
/begin AXIS_PTS AXY_KF_FMS_DKPSRPL_MN "Rf_soll" 0x80752222 NO_INPUT_QUANTITY _REC_A1AXS_1_MBSE_S2 327.67 CgkBooc_wkiDfEd_Czglhgc_fR_1a0o 6 0 327.67 FORMAT "%7.2" DEPOSIT ABSOLUTE /end AXIS_PTS
/begin AXIS_PTS AXY_KF_FMS_DKPSRPL_MX "Rf_soll" 0x80752216 NO_INPUT_QUANTITY _REC_A1AXS_1_MBSE_S2 327.67 CgkBooc_wkiDfEd_Czglhgc_fR_1a0o 6 0 327.67 FORMAT "%7.2" DEPOSIT ABSOLUTE /end AXIS_PTS
/begin AXIS_PTS AXY_KF_FMS_HFMPL_MN "Rf_soll" 0x8073DE34 NO_INPUT_QUANTITY _REC_A1AXS_1_MBSE_S2 655.35 CgkBooc_wkiDfEd_Czglhgc_fR_1a0o 6 -327.68 327.67 FORMAT "%7.2" DEPOSIT ABSOLUTE /end AXIS_PTS
/begin AXIS_PTS AXY_KF_FMS_HFMPL_MX "Rf_soll" 0x8073DE28 NO_INPUT_QUANTITY _REC_A1AXS_1_MBSE_S2 655.35 CgkBooc_wkiDfEd_Czglhgc_fR_1a0o 6 -327.68 327.67 FORMAT "%7.2" DEPOSIT ABSOLUTE /end AXIS_PTS
/begin AXIS_PTS AXY_KF_FRKKORRF_1 "AXY_KF_FRKKORRF_1" 0x80714F98 Rf _REC_A1AXS_1_MBSE_S2 655.35 CgkBooc_wkiDfEd_Czglhgc_fR_1a0o 16 -327.68 327.67 FORMAT "%7.2" DEPOSIT ABSOLUTE /end AXIS_PTS
/begin AXIS_PTS AXY_KF_KOEFF_B_LA "AXY_KF_KOEFF_B_LA" 0x80737A64 NO_INPUT_QUANTITY _REC_A1AXS_1_MBSE_S2 655.35 CgkBooc_wkiDfEd_Czglhgc_fR_1a0o 6 -327.68 327.67 FORMAT "%9.2" DEPOSIT ABSOLUTE /end AXIS_PTS
/begin AXIS_PTS AXY_KF_LA_BEZ "AXY_KF_LA_BEZ" 0x80737A54 NO_INPUT_QUANTITY _REC_A1AXS_1_MBSE_S2 655.35 CgkBooc_wkiDfEd_Czglhgc_fR_1a0o 8 -327.68 327.67 FORMAT "%9.2" DEPOSIT ABSOLUTE /end AXIS_PTS
/begin AXIS_PTS AXY_KF_LAMIN_H "AXY_KF_LAMIN_H" 0x8071F346 Rf _REC_A1AXS_1_MBSE_S2 655.35 CgkBooc_wkiDfEd_Czglhgc_fR_1a0o 6 -327.68 327.67 FORMAT "%7.2" DEPOSIT ABSOLUTE /end AXIS_PTS
/begin AXIS_PTS AXY_KF_MDIOP_1_TQE "AXY_KF_MDIOP_1_TQE" 0x8072DD5C NO_INPUT_QUANTITY _REC_A1AXS_1_MBSE_S2 65535 caoddzd_oAjpfzb_cAcEEha_1nR_oa0 20 -32768 32767 FORMAT "%5.0" DEPOSIT ABSOLUTE /end AXIS_PTS
/begin AXIS_PTS AXY_KF_MDK_MAX_GANG_NKW "X-axis (NKW_plaus) for KF_MDK_MAX_GANG_NKW" 0x8074844E Nkw_plaus _REC_A1AXS_1_MBSE_S2 65535 caoddzd_oAjpfzb_cAcEEha_1nR_oa0 8 -32768 32767 FORMAT "%6.0" DEPOSIT ABSOLUTE /end AXIS_PTS
/begin AXIS_PTS AXY_KF_PHA_H_E1 "AXY_KF_PHA_H_E1" 0x80718B8C NO_INPUT_QUANTITY _REC_A1AXS_1_MBSE_S2 3199.951171875 zyyxBpb_rEsnvtc_gktukCa_fR_5a0o 8 -1600 1599.951171875 DEPOSIT ABSOLUTE /end AXIS_PTS
/begin AXIS_PTS AXY_KF_PRAIL_H "AXY_KF_PRAIL_H" 0x80726196 BMWrailco_rat_VabHom_sw _REC_A1AXS_1_MBSE_S2 3199.951171875 zyyxBpb_rEsnvtc_gktukCa_fR_5a0o 8 -1600 1599.951171875 FORMAT "%8.3" DEPOSIT ABSOLUTE /end AXIS_PTS
/begin AXIS_PTS AXY_KF_PRAIL_H_K "AXY_KF_PRAIL_H_K" 0x80726156 BMWrailco_rat_VabHom_sw _REC_A1AXS_1_MBSE_S2 3199.951171875 zyyxBpb_rEsnvtc_gktukCa_fR_5a0o 8 -1600 1599.951171875 FORMAT "%8.3" DEPOSIT ABSOLUTE /end AXIS_PTS
/begin AXIS_PTS AXY_KF_PRAIL_HDPWARM "Achse" 0x80726186 BMWrailco_rat_VabHom_sw _REC_A1AXS_1_MBSE_S2 3199.951171875 zyyxBpb_rEsnvtc_gktukCa_fR_5a0o 8 -1600 1599.951171875 FORMAT "%8.3" DEPOSIT ABSOLUTE /end AXIS_PTS
/begin AXIS_PTS AXY_KF_PRAIL_HGD "Achse" 0x80726176 BMWrailco_rat_VabHom_sw _REC_A1AXS_1_MBSE_S2 3199.951171875 zyyxBpb_rEsnvtc_gktukCa_fR_5a0o 8 -1600 1599.951171875 FORMAT "%8.3" DEPOSIT ABSOLUTE /end AXIS_PTS
/begin AXIS_PTS AXY_KF_PRAIL_HGD_K "Achse" 0x80726166 BMWrailco_rat_VabHom_sw _REC_A1AXS_1_MBSE_S2 3199.951171875 zyyxBpb_rEsnvtc_gktukCa_fR_5a0o 8 -1600 1599.951171875 FORMAT "%8.3" DEPOSIT ABSOLUTE /end AXIS_PTS
/begin AXIS_PTS AXY_KF_ST_RKBAS_GD "AXY_KF_ST_RKBAS_GD" 0x8074FA2C BMWinj_t_Eng_sw _REC_A1AXS_1_MBSE_S2 655.35 DchEpAd_DBCFgoa_Ckhahgc_q__aoa0 10 -327.68 327.67 FORMAT "%7.2" DEPOSIT ABSOLUTE /end AXIS_PTS
/begin AXIS_PTS AXY_KF_ST_RKBAS_VVT "AXY_KF_ST_RKBAS_VVT" 0x8074F8C2 BMWinj_t_Eng_sw _REC_A1AXS_1_MBSE_S2 655.35 DchEpAd_DBCFgoa_Ckhahgc_q__aoa0 12 -327.68 327.67 FORMAT "%7.2" DEPOSIT ABSOLUTE /end AXIS_PTS
/begin AXIS_PTS AXY_KF_TD_FETTDELAY_TABG "AXY_KF_TD_FETTDELAY_TABG" 0x8074E5C0 Nkw _REC_A1AXS_1_MBSE_S2 6554 caoddzd_oAjpfzb_cAcEEha_1nR_oa0 4 -3277 3277 FORMAT "%5.0" DEPOSIT ABSOLUTE /end AXIS_PTS
/begin AXIS_PTS AXY_KF_ZW_PF1 "AXY_KF_ZW_PF1" 0x807374DA NO_INPUT_QUANTITY _REC_A1AXS_1_MBSE_S2 655.35 CgkBooc_wkiDfEd_Czglhgc_fR_1a0o 20 -327.68 327.67 FORMAT "%9.2" DEPOSIT ABSOLUTE /end AXIS_PTS
/begin AXIS_PTS AXY_KF_ZW_PF2 "AXY_KF_ZW_PF2" 0x807374B2 NO_INPUT_QUANTITY _REC_A1AXS_1_MBSE_S2 655.35 CgkBooc_wkiDfEd_Czglhgc_fR_1a0o 20 -327.68 327.67 FORMAT "%9.2" DEPOSIT ABSOLUTE /end AXIS_PTS
/begin AXIS_PTS AXY_KF_ZW_S_PF1 "AXY_KF_ZW_S_PF1" 0x8073748A NO_INPUT_QUANTITY _REC_A1AXS_1_MBSE_S2 655.35 CgkBooc_wkiDfEd_Czglhgc_fR_1a0o 20 -327.68 327.67 FORMAT "%9.2" DEPOSIT ABSOLUTE /end AXIS_PTS
/begin AXIS_PTS AXY_KF_ZW_S_PF2 "AXY_KF_ZW_S_PF2" 0x80737462 NO_INPUT_QUANTITY _REC_A1AXS_1_MBSE_S2 655.35 CgkBooc_wkiDfEd_Czglhgc_fR_1a0o 20 -327.68 327.67 FORMAT "%9.2" DEPOSIT ABSOLUTE /end AXIS_PTS
/begin AXIS_PTS AXY_KF_ZW_UESP_PF1 "AXY_KF_ZW_UESP_PF1" 0x80737446 NO_INPUT_QUANTITY _REC_A1AXS_1_MBSE_S2 655.35 CgkBooc_wkiDfEd_Czglhgc_fR_1a0o 14 -327.68 327.67 FORMAT "%9.2" DEPOSIT ABSOLUTE /end AXIS_PTS
/begin AXIS_PTS AXY_KF_ZW_UESP_PF2 "AXY_KF_ZW_UESP_PF2" 0x8073742A NO_INPUT_QUANTITY _REC_A1AXS_1_MBSE_S2 655.35 CgkBooc_wkiDfEd_Czglhgc_fR_1a0o 14 -327.68 327.67 FORMAT "%9.2" DEPOSIT ABSOLUTE /end AXIS_PTS
/begin AXIS_PTS AXY_KF_ZW_VP_PF1 "AXY_KF_ZW_VP_PF1" 0x8074F5C2 Rf_zwv _REC_A1AXS_1_MBSE_S2 655.35 CgkBooc_wkiDfEd_Czglhgc_fR_1a0o 16 -327.68 327.67 FORMAT "%9.2" DEPOSIT ABSOLUTE /end AXIS_PTS
/begin AXIS_PTS AXY_KF_ZW_VP_PF2 "AXY_KF_ZW_VP_PF2" 0x8074F5A2 Rf_zwv _REC_A1AXS_1_MBSE_S2 655.35 CgkBooc_wkiDfEd_Czglhgc_fR_1a0o 16 -327.68 327.67 FORMAT "%9.2" DEPOSIT ABSOLUTE /end AXIS_PTS
/begin AXIS_PTS BMWchas_p_RailInjMpl_Ax "Catalyst heating after start, rail pressure injection multiple X-axis" 0x8073D220 Nkw _REC_A1AXS_1_MBSE_S2 65535 caoddzd_oAjpfzb_cAcEEha_1nR_oa0 6 -32768 32767 FORMAT "%5.0" DEPOSIT ABSOLUTE /end AXIS_PTS
/begin AXIS_PTS BMWchas_p_RailInjMpl_Ay "Catalyst heating after start, rail pressure injection multiple Y-axis" 0x8073D214 BMWrailco_rat_VabHom_sw _REC_A1AXS_1_MBSE_S2 3199.951171875 zyyxBpb_rEsnvtc_gktukCa_fR_5a0o 6 -1600 1599.951171875 FORMAT "%8.3" DEPOSIT ABSOLUTE /end AXIS_PTS
/begin AXIS_PTS BMWchas_p_RailInjSng_Ax "Catalyst heating after start, rail pressure injection single X-axis" 0x8073D204 Nkw _REC_A1AXS_1_MBSE_S2 65535 caoddzd_oAjpfzb_cAcEEha_1nR_oa0 8 -32768 32767 FORMAT "%5.0" DEPOSIT ABSOLUTE /end AXIS_PTS
/begin AXIS_PTS BMWchas_p_RailInjSng_Ay "Catalyst heating after start, rail pressure injection single Y-axis" 0x8073D1F4 BMWrailco_rat_VabHom_sw _REC_A1AXS_1_MBSE_S2 3199.951171875 zyyxBpb_rEsnvtc_gktukCa_fR_5a0o 8 -1600 1599.951171875 FORMAT "%8.3" DEPOSIT ABSOLUTE /end AXIS_PTS
/begin AXIS_PTS BMWext_lam_CptPronDfco_Ax "Exhaust temperature model, lambda component protection deceleration fuel cutoff X-axis" 0x80719C5A NO_INPUT_QUANTITY _REC_A1AXS_1_MBSE_S2 65535 caoddzd_oAjpfzb_cAcEEha_1nR_oa0 6 -32768 32767 FORMAT "%5.0" DEPOSIT ABSOLUTE /end AXIS_PTS
/begin AXIS_PTS BMWext_lam_CptPronMinLeanTq_Ax "Exhaust temperature model, lambda component protection minimum lean torque X-axis" 0x80719B90 Nkw_atm _REC_A1AXS_1_MBSE_S2 65535 caoddzd_oAjpfzb_cAcEEha_1nR_oa0 8 -32768 32767 DEPOSIT ABSOLUTE /end AXIS_PTS
/begin AXIS_PTS BMWext_lam_CptPronMinLeanTq_Ay "Exhaust temperature model, lambda component protection minimum lean torque Y-axis" 0x80719B80 Rf_atm _REC_A1AXS_1_MBSE_S2 655.35 CgkBooc_wkiDfEd_Czglhgc_fR_1a0o 8 -327.68 327.67 DEPOSIT ABSOLUTE /end AXIS_PTS
/begin AXIS_PTS BMWgpfdiag_rf_LimPclFilMin_Ax "GPF diagnostics, relative filling limit particle filter minimum X-axis" 0x8074128E Nkw _REC_A1AXS_1_MBSE_S2 65535 caoddzd_oAjpfzb_cAcEEha_1nR_oa0 4 -32768 32767 FORMAT "%5.0" DEPOSIT ABSOLUTE /end AXIS_PTS
/begin AXIS_PTS BMWinjafs_fac_RatAirMax_Ax "Curve axis upper limit Rf for stoichiometric lambda adaptation" 0x80714CBA Nkw _REC_A1AXS_1_MBSE_S2 65535 caoddzd_oAjpfzb_cAcEEha_1nR_oa0 6 -32768 32767 FORMAT "%5.0" DEPOSIT ABSOLUTE /end AXIS_PTS
/begin AXIS_PTS BMWinjmon_fac_HppEff_Ax "Injection map factor for high-pressure pump efficiency (X-axis)" 0x807162F8 Nkw_10ms _REC_A1AXS_1_MBSE_S2 65535 caoddzd_oAjpfzb_cAcEEha_1nR_oa0 8 -32768 32767 FORMAT "%5.0" DEPOSIT ABSOLUTE /end AXIS_PTS
/begin AXIS_PTS BMWinjmon_fac_HppEff_Ay "Injection map factor for high-pressure pump efficiency (Y-axis)" 0x807162F0 BMWrail_p_RpsActVal _REC_A1AXS_1_MBSE_U2 131.07 bukAcFc_hypjrAa_CBhougc_MCRooa0 4 0 131.07 DEPOSIT ABSOLUTE /end AXIS_PTS
/begin AXIS_PTS BMWlpa_n_EfpEngStrtPRail_Ax "Electric fuel pump speed setpoint for start rail pressure X-axis" 0x8071C768 BMWlpi_p_HiPAbs _REC_A1AXS_1_MBSE_U2 131.07 bukAcFc_hypjrAa_CBhougc_MCRooa0 2 0 131.07 DEPOSIT ABSOLUTE /end AXIS_PTS
/begin AXIS_PTS BMWlpa_n_EfpModSafe_Ax "Electric fuel pump speed setpoint safe mode X-axis" 0x8071C784 BMWlpi_t_Fu_sw _REC_A1AXS_1_MBSE_S2 655.35 DchEpAd_DBCFgoa_Ckhahgc_q__aoa0 4 -327.68 327.67 FORMAT "%5.2" DEPOSIT ABSOLUTE /end AXIS_PTS
/begin AXIS_PTS BMWlpa_n_EfpModSafe_Ay "Electric fuel pump speed setpoint safe mode Y-axis" 0x8071C77C BMWlpi_volf_Fu_sw _REC_A1AXS_1_MBSE_S2 655.35 zBcBzad_vmoivka_mFzjCgc_lCRooa0 4 -327.68 327.67 FORMAT "%5.2" DEPOSIT ABSOLUTE /end AXIS_PTS
/begin AXIS_PTS BMWlpa_rat_EfpPwm_Ax "Electric fuel pump speed control via PWM X-axis" 0x8071C798 BMWlpa_n_Efp_uw _REC_A1AXS_1_MBSE_U2 65535 caoddzd_oAjpfzb_cAcEEha_1nR_oa0 6 0 65535 FORMAT "%5.0" DEPOSIT ABSOLUTE /end AXIS_PTS
/begin AXIS_PTS BMWlpa_volf_FuMaxBoosCtlr_Ax "LoPAsst fuel volume flow at boost tracking (X-axis)" 0x80740F5A BMWlpsc_p_DeSp_sw _REC_A1AXS_1_MBSE_S2 65.535 rgduxyd_mlihaBb_gsCghzb_bCRa0a0 6 -32.768 32.767 FORMAT "%5.3" DEPOSIT ABSOLUTE /end AXIS_PTS
/begin AXIS_PTS BMWlpsc_p_HppMax_Ax "Achse" 0x80741218 BMWlpi_volf_Fu_sw _REC_A1AXS_1_MBSE_S2 655.35 zBcBzad_vmoivka_mFzjCgc_lCRooa0 4 -327.68 327.67 FORMAT "%5.2" DEPOSIT ABSOLUTE /end AXIS_PTS
/begin AXIS_PTS BMWlpsc_volf_FuEjrPmp_Ax "Achse" 0x8071CD0C BMWlpsc_p_EfpSpCtld_uw _REC_A1AXS_1_MBSE_U2 65.535 rgduxyd_mlihaBb_gsCghzb_bCRa0a0 8 0 65.535 FORMAT "%5.3" DEPOSIT ABSOLUTE /end AXIS_PTS
/begin AXIS_PTS BMWlpsc_volf_FuEjrPmp_Ay "Achse" 0x80755FDD BMWlpsc_st_TankCod_ub _REC_A1AXS_1_MBSE_U1 255 raChrxc_kBtBrmb_FmDuEFa_n__aa0o 4 0 255 FORMAT "%3.0" DEPOSIT ABSOLUTE /end AXIS_PTS
/begin AXIS_PTS BMWlpsd_p_RailDifMax_Ax "Achse" 0x8071CE2A BMWlpi_p_HiPAbsSp _REC_A1AXS_1_MBSE_U2 131.07 bukAcFc_hypjrAa_CBhougc_MCRooa0 4 0 131.07 DEPOSIT ABSOLUTE /end AXIS_PTS
/begin AXIS_PTS BMWls_fac_rf_RednFuOctIntkT_Ax "Breakpoints for filling reduction factor depending on fuel quality" 0x807566A9 F_octan _REC_A1AXS_1_MBSE_U1 0.99609375 BMW_Powertrain_DxECompuMethods_Def_ub_b1_nounit 6 0 0.99609375 FORMAT "%6.1" DEPOSIT ABSOLUTE /end AXIS_PTS
/begin AXIS_PTS BMWls_fac_rf_RednFuOctIntkT_Ay "Breakpoints for filling reduction factor depending on intake air temperature" 0x80721BC0 Tans _REC_A1AXS_1_MBSE_S2 6553.5 BMW_q0p1_degC 6 -3276.8 3276.7 FORMAT "%6.1" DEPOSIT ABSOLUTE /end AXIS_PTS
/begin AXIS_PTS BMWls_pct_FiMaxCondRisk_Ax "Axis for maximum filling over RPM due to condensation risk at the charge air cooler" 0x80721C08 NO_INPUT_QUANTITY _REC_A1AXS_1_MBSE_S2 65535 caoddzd_oAjpfzb_cAcEEha_1nR_oa0 12 -32768 32767 FORMAT "%5.0" DEPOSIT ABSOLUTE /end AXIS_PTS
/begin AXIS_PTS BMWls_pct_FiMaxIgOfs_Gx "Curve filling limitation depending on ignition angle retard" 0x80721BF4 Nkw _REC_A1AXS_1_MBSE_S2 65535 caoddzd_oAjpfzb_cAcEEha_1nR_oa0 10 -32768 32767 FORMAT "%5.0" DEPOSIT ABSOLUTE /end AXIS_PTS
/begin AXIS_PTS BMWls_pct_FiMaxIgOfs_Gy "Curve filling limitation depending on ignition angle retard" 0x80721BB0 Dzw_tot_kr _REC_A1AXS_1_MBSE_S2 6553.5 BMW_q0p1_deg 8 -3276.8 3276.7 FORMAT "%6.1" DEPOSIT ABSOLUTE /end AXIS_PTS
/begin AXIS_PTS BMWls_rf_MaxEgT_Ax "Nkw" 0x80721BE8 Nkw _REC_A1AXS_1_MBSE_S2 65535 caoddzd_oAjpfzb_cAcEEha_1nR_oa0 6 -32768 32767 FORMAT "%5.0" DEPOSIT ABSOLUTE /end AXIS_PTS
/begin AXIS_PTS BMWls_rf_MaxEgT_Ay "Nkw" 0x80721BCC Frfmxbsld _REC_A1AXS_1_MBSE_U2 1.99996948242188 Bhvfwhc_bigEubd_BBEupBd_nR_3oa0 6 0 1.99996948242188 FORMAT "%14.5" DEPOSIT ABSOLUTE /end AXIS_PTS
/begin AXIS_PTS BMWls_rf_MaxFuOctIntkT_Gy "Group breakpoint for filling reduction factor" 0x80721BA0 BMWls_fac_rf_RedFil_uw _REC_A1AXS_1_MBSE_U2 0.999984741210938 FzbmlAa_gCtylrb_ckCqxAc_nR_6oa0 8 0 0.999984741210938 FORMAT "%7.5" DEPOSIT ABSOLUTE /end AXIS_PTS
/begin AXIS_PTS BMWtchctr_p_DifCrtnPp_Ax "AXX_KF_PDIFF_ATLR_P" 0x807278D4 BMWtchbas_p_Dif_sw _REC_A1AXS_1_MBSE_S2 8191.875 BMW_p_sw_q0p125_hPa 12 -4096 4095.875 FORMAT "%10.3" DEPOSIT ABSOLUTE /end AXIS_PTS
/begin AXIS_PTS BMWtchctr_p_DifCrtnPp_Ay___MGF_CC_FF2_Slot4 "AXY_KF_PDIFF_ATLR_P (Slot 4, Flex Fuel 2)" 0x807D0254 BMWtchsp_mf_Ex_uw _REC_A1AXS_1_MBSE_U2 2047.96875 CByjozc_eCmpBAb_pljBAmd_k__0oa0 6 0 2047.96875 FORMAT "%10.3" DEPOSIT ABSOLUTE /end AXIS_PTS
/begin AXIS_PTS BMWtchctr_p_DifCrtnPp_Ay___MGF_CC_PF_Slot0 "AXY_KF_PDIFF_ATLR_P (Slot 0, OEM Address)" 0x807278C8 BMWtchsp_mf_Ex_uw _REC_A1AXS_1_MBSE_U2 2047.96875 CByjozc_eCmpBAb_pljBAmd_k__0oa0 6 0 2047.96875 FORMAT "%10.3" DEPOSIT ABSOLUTE /end AXIS_PTS
/begin AXIS_PTS BMWtchctr_p_DifCrtnPp_Ay___MGF_CC_PF_Slot1 "AXY_KF_PDIFF_ATLR_P (Slot 1, Pump Fuel)" 0x807C0A18 BMWtchsp_mf_Ex_uw _REC_A1AXS_1_MBSE_U2 2047.96875 CByjozc_eCmpBAb_pljBAmd_k__0oa0 6 0 2047.96875 FORMAT "%10.3" DEPOSIT ABSOLUTE /end AXIS_PTS
/begin AXIS_PTS BMWtchctr_pct_WgBasc_Ax "AXX_KF_WGPOS_VST" 0x80747D14 NO_INPUT_QUANTITY _REC_A1AXS_1_MBSE_U2 3.99993896484375 ilxsavd_hkzmBfc_lAzCpAb_nR_1oa0 12 0 3.99993896484375 FORMAT "%14.5" DEPOSIT ABSOLUTE /end AXIS_PTS
/begin AXIS_PTS BMWtchctr_pct_WgBasc_Ay "AXY_KF_WGPOS_VST" 0x80747CFC NO_INPUT_QUANTITY _REC_A1AXS_1_MBSE_U2 2559.9609375 ECeoxdb_wFseCtb_mEytEnb_k__o8a0 12 0 2559.9609375 FORMAT "%10.3" DEPOSIT ABSOLUTE /end AXIS_PTS
/begin AXIS_PTS BMWtchctr_pwr_Dp_Ax "AXX_KF_PATLR_D" 0x8072787C BMWtchbas_p_Dif_sw _REC_A1AXS_1_MBSE_S2 8191.875 BMW_p_sw_q0p125_hPa 14 -4096 4095.875 FORMAT "%10.3" DEPOSIT ABSOLUTE /end AXIS_PTS
/begin AXIS_PTS BMWtchctr_pwr_Dp_Ay "AXY_KF_PATLR_D" 0x80727860 BMWtchbas_p_DifGra_sw _REC_A1AXS_1_MBSE_S2 8191.875 BMW_p_sw_q0p125_hPa 14 -4096 4095.875 FORMAT "%10.3" DEPOSIT ABSOLUTE /end AXIS_PTS
/begin AXIS_PTS BMWtchctr_pwr_Pctl_Ax___MGF_CC_FF2_Slot4 "AXX_KF_ATL_PVERD (Slot 4, Flex Fuel 2)" 0x807D1318 BMWtchsp_rat_p_CmprLim_uw _REC_A1AXS_1_MBSE_U2 7.9998779296875 acriqBc_tfkBqod_ocgjxzc_nR_8oa0 20 0 7.9998779296875 FORMAT "%11.4" DEPOSIT ABSOLUTE /end AXIS_PTS
/begin AXIS_PTS BMWtchctr_pwr_Pctl_Ax___MGF_CC_PF_Slot0 "AXX_KF_ATL_PVERD (Slot 0, OEM Address)" 0x80727818 BMWtchsp_rat_p_CmprLim_uw _REC_A1AXS_1_MBSE_U2 7.9998779296875 acriqBc_tfkBqod_ocgjxzc_nR_8oa0 20 0 7.9998779296875 FORMAT "%11.4" DEPOSIT ABSOLUTE /end AXIS_PTS
/begin AXIS_PTS BMWtchctr_pwr_Pctl_Ax___MGF_CC_PF_Slot1 "AXX_KF_ATL_PVERD (Slot 1, Pump Fuel)" 0x807C1728 BMWtchsp_rat_p_CmprLim_uw _REC_A1AXS_1_MBSE_U2 7.9998779296875 acriqBc_tfkBqod_ocgjxzc_nR_8oa0 20 0 7.9998779296875 FORMAT "%11.4" DEPOSIT ABSOLUTE /end AXIS_PTS
/begin AXIS_PTS BMWtchctr_pwr_PctlWideRng_Ay___MGF_CC_FF2_Slot4 "BMWtchctr_pwr_PctlWideRng_Ay (Slot 4, Flex Fuel 2)" 0x807D8C22 BMWtchsp_mf_CmprNormWideRng_uw _REC_A1AXS_1_MBSE_U2 4095.9375 wpxDCba_sgbvDxb_FliBAmd_k__0oa0 16 0 4095.9375 FORMAT "%10.3" DEPOSIT ABSOLUTE /end AXIS_PTS
/begin AXIS_PTS BMWtchctr_pwr_PctlWideRng_Ay___MGF_CC_PF_Slot0 "BMWtchctr_pwr_PctlWideRng_Ay (Slot 0, OEM Address)" 0x80727840 BMWtchsp_mf_CmprNormWideRng_uw _REC_A1AXS_1_MBSE_U2 4095.9375 wpxDCba_sgbvDxb_FliBAmd_k__0oa0 16 0 4095.9375 FORMAT "%10.3" DEPOSIT ABSOLUTE /end AXIS_PTS
/begin AXIS_PTS BMWtchctr_pwr_PctlWideRng_Ay___MGF_CC_PF_Slot1 "BMWtchctr_pwr_PctlWideRng_Ay (Slot 1, Pump Fuel)" 0x807D8CE2 BMWtchsp_mf_CmprNormWideRng_uw _REC_A1AXS_1_MBSE_U2 4095.9375 wpxDCba_sgbvDxb_FliBAmd_k__0oa0 16 0 4095.9375 FORMAT "%10.3" DEPOSIT ABSOLUTE /end AXIS_PTS
/begin AXIS_PTS BMWtchsp_rat_p_CmprMax_Ax "AXX_KF_FPLDMAX" 0x807284AC BMWtchsp_mf_CmprNorm_uw _REC_A1AXS_1_MBSE_U2 4095.9375 wpxDCba_sgbvDxb_FliBAmd_k__0oa0 8 0 4095.9375 FORMAT "%10.3" DEPOSIT ABSOLUTE /end AXIS_PTS
/begin AXIS_PTS BMWtchsp_rat_p_CmprMax_Ay "AXY_KF_FPLDMAX" 0x807284A0 BMWtchtbc_t_BefCmpr_sw _REC_A1AXS_1_MBSE_S2 6553.5 BMW_q0p1_degC 6 -3276.8 3276.7 FORMAT "%6.1" DEPOSIT ABSOLUTE /end AXIS_PTS
/begin AXIS_PTS BMWtchsp_rat_p_CmprPmp_Ax "AXX_KL_FPLDPUMP" 0x80728490 BMWtchsp_mf_CmprNorm_uw _REC_A1AXS_1_MBSE_U2 4095.9375 wpxDCba_sgbvDxb_FliBAmd_k__0oa0 8 0 4095.9375 FORMAT "%10.3" DEPOSIT ABSOLUTE /end AXIS_PTS
/begin AXIS_PTS BMWtchsp_rf_Liho_Ax "AXX_KL_LAMX" 0x80728484 NO_INPUT_QUANTITY _REC_A1AXS_1_MBSE_S2 65535 caoddzd_oAjpfzb_cAcEEha_1nR_oa0 6 -32768 32767 FORMAT "%5.0" DEPOSIT ABSOLUTE /end AXIS_PTS
/begin AXIS_PTS BMWtqe_tqc_FlApplStg_Ax "Torque engine, crankshaft torque full load application stage X-axis" 0x807314C0 Nkw_ref _REC_A1AXS_1_MBSE_S2 65535 caoddzd_oAjpfzb_cAcEEha_1nR_oa0 18 -32768 32767 DEPOSIT ABSOLUTE /end AXIS_PTS
/begin AXIS_PTS GXX_KF_LABAS "Group X-axis for KF_LABASxxx and KF_LA_SK" 0x8074E59C Nkw _REC_A1AXS_1_MBSE_S2 65535 caoddzd_oAjpfzb_cAcEEha_1nR_oa0 18 -32768 32767 FORMAT "%5.0" DEPOSIT ABSOLUTE /end AXIS_PTS
/begin AXIS_PTS GXX_KF_PHA_H_B1_BAS "GXX_KF_PHA_H_B1_BAS" 0x80716BA8 Nkw _REC_A1AXS_1_MBSE_S2 65535 caoddzd_oAjpfzb_cAcEEha_1nR_oa0 10 -32768 32767 FORMAT "%5.0" DEPOSIT ABSOLUTE /end AXIS_PTS
/begin AXIS_PTS GXY_KF_LABAS "Group Y-axis for KF_LABASxxx and KF_LA_SK" 0x8074E57A Rf _REC_A1AXS_1_MBSE_S2 655.35 CgkBooc_wkiDfEd_Czglhgc_fR_1a0o 17 -327.68 327.67 FORMAT "%7.2" DEPOSIT ABSOLUTE /end AXIS_PTS
/begin AXIS_PTS GXY_KF_PHA_H_B1_BAS "GXY_KF_PHA_H_B1_BAS input Rk_soll_h_xlb" 0x80716B80 NO_INPUT_QUANTITY _REC_A1AXS_1_MBSE_S2 3199.951171875 zyyxBpb_rEsnvtc_gktukCa_fR_5a0o 12 -1600 1599.951171875 FORMAT "%8.3" DEPOSIT ABSOLUTE /end AXIS_PTS
/begin AXIS_PTS IKCtl_nEngB16_X_AX "KR: Breakpoint distribution engine speed of group B" 0x807A0A74 Epm_nEng Axis_Xs16 32767.5 EngN 16 -16384 16383.5 FORMAT "%8.2" DEPOSIT ABSOLUTE /end AXIS_PTS
/begin AXIS_PTS IKCtl_ratLoadAddl04_X_AX "Support point distribution relative filling, 4 support points" 0x807A0AB2 AirMod_ratChrgAirCyl Axis_Xu16 1535.977 rel_q0p0234 4 0 1535.977 FORMAT "%8.3" DEPOSIT ABSOLUTE /end AXIS_PTS
/begin AXIS_PTS SNM08HDUW "Breakpoint distribution for engine speed" 0x807ADDD8 NO_INPUT_QUANTITY Axis_Xu16 16383.75 nmot_sw_q0p25 8 0 16383.75 FORMAT "%8.2" DEPOSIT ABSOLUTE /end AXIS_PTS
/begin AXIS_PTS SPD06HDSW "Breakpoint distribution for rail pressure control deviation" 0x807A00A2 FuPHi_pHpRglnDeLoc Axis_Xs16 131.07 RBPtCel_p_0p002_1 6 -65.536 65.534 FORMAT "%8.5" DEPOSIT ABSOLUTE /end AXIS_PTS
/begin CHARACTERISTIC BMW_swi_SpkPlugPronAcvn_C "Switch to activate the ignition system protection function" VALUE 0x80763804 FklWUb 1 fgjpsvb_fDqjECa_acgrbDd_n_dae__ 0 1 /end CHARACTERISTIC
/begin CHARACTERISTIC BMWinjmon_vol_HppCmpn_C "Injection delivery volume of high-pressure pump for delivery capacity calculation" VALUE 0x8071625C KwUw 65535 kEEdlBb_gsrEhkd_rmDuAhc_uCRoa0o 0 65535 FORMAT "%6.1" /end CHARACTERISTIC
/begin CHARACTERISTIC BMWlpa_fac_AirLimOvrTMin_C "LoPAsst filling limitation due to electric fuel pump over-temperature factor minimum" VALUE 0x80740F26 KwUw 3.99993896484375 ilxsavd_hkzmBfc_lAzCpAb_nR_1oa0 0 3.99993896484375 /end CHARACTERISTIC
/begin CHARACTERISTIC BMWlpa_fac_n_PwrMgrFild_C "Filter constant for electric fuel pump speed setpoint for fEPM" VALUE 0x807523F6 KwUw 0.999984741210938 FzbmlAa_gCtylrb_ckCqxAc_nR_6oa0 0 0.999984741210938 FORMAT "%6.4" /end CHARACTERISTIC
/begin CHARACTERISTIC BMWlpa_n_EfpModMax_C "Electric fuel pump speed setpoint max mode" VALUE 0x8071C676 KwUw 65535 caoddzd_oAjpfzb_cAcEEha_1nR_oa0 0 65535 FORMAT "%5.0" /end CHARACTERISTIC
/begin CHARACTERISTIC BMWlpa_rat_AirLimGraNeg_C "Filling limitation due to electric fuel pump negative gradient limitation" VALUE 0x80740F2E KwUw 655.35 CgkBooc_wkiDfEd_Czglhgc_fR_1a0o 0 655.35 /end CHARACTERISTIC
/begin CHARACTERISTIC BMWlpa_rat_AirLimMax_C "Filling limitation due to electric fuel pump maximum value" VALUE 0x80740F2A KwUw 655.35 CgkBooc_wkiDfEd_Czglhgc_fR_1a0o 0 655.35 /end CHARACTERISTIC
/begin CHARACTERISTIC BMWlpa_rat_AirLimMin_C "LoPAsst filling limitation due to electric fuel pump minimum value" VALUE 0x80740F3C CurG_Ws16 655.35 CgkBooc_wkiDfEd_Czglhgc_fR_1a0o -327.68 327.67 /end CHARACTERISTIC
/begin CHARACTERISTIC BMWlpa_volf_FuBoosRstOfs_C "LoPAsst fuel volume flow for boost reset offset" VALUE 0x80740F38 CurG_Ws16 655.35 zBcBzad_vmoivka_mFzjCgc_lCRooa0 -327.68 327.67 /end CHARACTERISTIC
/begin CHARACTERISTIC BMWlpa_volf_FuFpcOvrT_C "LoPAsst filling limitation due to electric fuel pump over-temperature maximum volume flow" VALUE 0x80740F34 CurG_Ws16 655.35 zBcBzad_vmoivka_mFzjCgc_lCRooa0 -327.68 327.67 /end CHARACTERISTIC
/begin CHARACTERISTIC BMWtchdiag_rf_SpMin_C "Target filling (from Rf_soll_md, limited between Rf_max and Rf_min)" VALUE 0x807279B2 CurG_Ws16 655.35 CgkBooc_wkiDfEd_Czglhgc_fR_1a0o -327.68 327.67 FORMAT "%6.4" /end CHARACTERISTIC
/begin CHARACTERISTIC BMWtchsp_p_ReqMax_C___MGF_CC_PF_Slot0 "Maximum target boost pressure due to boost pressure sensor diagnostics (Slot 0, OEM Address)" VALUE 0x807281DE KwUw 8191.875 BMW_p_sw_q0p125_hPa 0 8191.875 FORMAT "%10.3" /end CHARACTERISTIC
/begin CHARACTERISTIC BMWtchsp_p_ReqMax_C___MGF_CC_PF_Slot1 "Maximum target boost pressure due to boost pressure sensor diagnostics (Slot 1, Pump Fuel)" VALUE 0x807C2248 KwUw 8191.875 BMW_p_sw_q0p125_hPa 0 8191.875 FORMAT "%10.3" /end CHARACTERISTIC
/begin CHARACTERISTIC BMWtqe_n_LamStrdMax_C "Max permitted lambda in stratified operation" VALUE 0x80730ADA CurG_Ws16 65535 raChrxc_kBtBrmb_FmDuEFa_n__aa0o -32768 32767 FORMAT "%6.0" /end CHARACTERISTIC
/begin CHARACTERISTIC CW_ATMOD "" VALUE 0x80755CFB FklWUb 1 B_TRUE 0 1 FORMAT "%13.11" /end CHARACTERISTIC
/begin CHARACTERISTIC CW_MapSwitch_BMWtchctr_p_DifCrtnPp_M___MGF_CC "BMWtchctr_p_DifCrtnPp_M Codeword: Set 1 (true) to enable PumpFuel (PF) map switching of this map (allows slots 0-4) and 0 (false) to disable PF map switching of this map (in all slots, effectively, always reading PF from slot 0)" VALUE 0x807DB068 FklWUb 1 B_TRUE 0 1 FORMAT "%13.11" /end CHARACTERISTIC
/begin CHARACTERISTIC CW_MapSwitch_BMWtchctr_pct_WgBasc_M___MGF_CC "BMWtchctr_pct_WgBasc_M Codeword: Set 1 (true) to enable PumpFuel (PF) map switching of this map (allows slots 0-4) and 0 (false) to disable PF map switching of this map (in all slots, effectively, always reading PF from slot 0)" VALUE 0x807DB06A FklWUb 1 B_TRUE 0 1 FORMAT "%13.11" /end CHARACTERISTIC
/begin CHARACTERISTIC CW_MapSwitch_BMWtchctr_pwr_Dp_M___MGF_CC "BMWtchctr_pwr_Dp_M Codeword: Set 1 (true) to enable PumpFuel (PF) map switching of this map (allows slots 0-4) and 0 (false) to disable PF map switching of this map (in all slots, effectively, always reading PF from slot 0)" VALUE 0x807DB06B FklWUb 1 B_TRUE 0 1 FORMAT "%13.11" /end CHARACTERISTIC
/begin CHARACTERISTIC CW_MapSwitch_BMWtchctr_pwr_PctlWideRng_M___MGF_CC "BMWtchctr_pwr_PctlWideRng_M Codeword: Set 1 (true) to enable PumpFuel (PF) map switching of this map (allows slots 0-4) and 0 (false) to disable PF map switching of this map (in all slots, effectively, always reading PF from slot 0)" VALUE 0x807DB06D FklWUb 1 B_TRUE 0 1 FORMAT "%13.11" /end CHARACTERISTIC
/begin CHARACTERISTIC CW_MapSwitch_BMWtchsp_p_ReqMax_C___MGF_CC "BMWtchsp_p_ReqMax_C Codeword: Set 1 (true) to enable PumpFuel (PF) map switching of this map (allows slots 0-4) and 0 (false) to disable PF map switching of this map (in all slots, effectively, always reading PF from slot 0)" VALUE 0x807DB06E FklWUb 1 B_TRUE 0 1 FORMAT "%13.11" /end CHARACTERISTIC
/begin CHARACTERISTIC CW_MapSwitch_BMWtchsp_rat_p_CmprMax_M___MGF_CC "BMWtchsp_rat_p_CmprMax_M Codeword: Set 1 (true) to enable PumpFuel (PF) map switching of this map (allows slots 0-4) and 0 (false) to disable PF map switching of this map (in all slots, effectively, always reading PF from slot 0)" VALUE 0x807DB06F FklWUb 1 B_TRUE 0 1 FORMAT "%13.11" /end CHARACTERISTIC
/begin CHARACTERISTIC CW_MapSwitch_BMWtchsp_rat_p_CmprPmp_T___MGF_CC "BMWtchsp_rat_p_CmprPmp_T Codeword: Set 1 (true) to enable PumpFuel (PF) map switching of this map (allows slots 0-4) and 0 (false) to disable PF map switching of this map (in all slots, effectively, always reading PF from slot 0)" VALUE 0x807DB070 FklWUb 1 B_TRUE 0 1 FORMAT "%13.11" /end CHARACTERISTIC
/begin CHARACTERISTIC CW_MapSwitch_BMWtqe_tqc_FlApplBol_T___MGF_CC "BMWtqe_tqc_FlApplBol_T Codeword: Set 1 (true) to enable PumpFuel (PF) map switching of this map (allows slots 0-4) and 0 (false) to disable PF map switching of this map (in all slots, effectively, always reading PF from slot 0)" VALUE 0x807DB071 FklWUb 1 B_TRUE 0 1 FORMAT "%13.11" /end CHARACTERISTIC
/begin CHARACTERISTIC CW_MapSwitch_BMWtqe_tqc_FlApplStgNorm_T___MGF_CC "BMWtqe_tqc_FlApplStgNorm_T Codeword: Set 1 (true) to enable PumpFuel (PF) map switching of this map (allows slots 0-4) and 0 (false) to disable PF map switching of this map (in all slots, effectively, always reading PF from slot 0)" VALUE 0x807DB072 FklWUb 1 B_TRUE 0 1 FORMAT "%13.11" /end CHARACTERISTIC
/begin CHARACTERISTIC CW_MapSwitch_BMWtqe_tqc_FlApplStgPwr1_T___MGF_CC "BMWtqe_tqc_FlApplStgPwr1_T Codeword: Set 1 (true) to enable PumpFuel (PF) map switching of this map (allows slots 0-4) and 0 (false) to disable PF map switching of this map (in all slots, effectively, always reading PF from slot 0)" VALUE 0x807DB073 FklWUb 1 B_TRUE 0 1 FORMAT "%13.11" /end CHARACTERISTIC
/begin CHARACTERISTIC CW_MapSwitch_BMWtqe_tqc_FlApplStgPwr2_T___MGF_CC "BMWtqe_tqc_FlApplStgPwr2_T Codeword: Set 1 (true) to enable PumpFuel (PF) map switching of this map (allows slots 0-4) and 0 (false) to disable PF map switching of this map (in all slots, effectively, always reading PF from slot 0)" VALUE 0x807DB074 FklWUb 1 B_TRUE 0 1 FORMAT "%13.11" /end CHARACTERISTIC
/begin CHARACTERISTIC CW_MapSwitch_BMWtqe_tqc_FlApplStgPwrHi_T___MGF_CC "BMWtqe_tqc_FlApplStgPwrHi_T Codeword: Set 1 (true) to enable PumpFuel (PF) map switching of this map (allows slots 0-4) and 0 (false) to disable PF map switching of this map (in all slots, effectively, always reading PF from slot 0)" VALUE 0x807DB075 FklWUb 1 B_TRUE 0 1 FORMAT "%13.11" /end CHARACTERISTIC
/begin CHARACTERISTIC CW_MapSwitch_IKCtl_FacKnockDetThd0_GM___MGF_CC "IKCtl_FacKnockDetThd0_GM Codeword: Set 1 (true) to enable PumpFuel (PF) map switching of this map (allows slots 0-4) and 0 (false) to disable PF map switching of this map (in all slots, effectively, always reading PF from slot 0)" VALUE 0x807DB076 FklWUb 1 B_TRUE 0 1 FORMAT "%13.11" /end CHARACTERISTIC
/begin CHARACTERISTIC CW_MapSwitch_IKCtl_FacKnockDetThd1_GM___MGF_CC "IKCtl_FacKnockDetThd1_GM Codeword: Set 1 (true) to enable PumpFuel (PF) map switching of this map (allows slots 0-4) and 0 (false) to disable PF map switching of this map (in all slots, effectively, always reading PF from slot 0)" VALUE 0x807DB077 FklWUb 1 B_TRUE 0 1 FORMAT "%13.11" /end CHARACTERISTIC
/begin CHARACTERISTIC CW_MapSwitch_IKCtl_FacKnockDetThd2_GM___MGF_CC "IKCtl_FacKnockDetThd2_GM Codeword: Set 1 (true) to enable PumpFuel (PF) map switching of this map (allows slots 0-4) and 0 (false) to disable PF map switching of this map (in all slots, effectively, always reading PF from slot 0)" VALUE 0x807DB078 FklWUb 1 B_TRUE 0 1 FORMAT "%13.11" /end CHARACTERISTIC
/begin CHARACTERISTIC CW_MapSwitch_IKCtl_FacKnockDetThd3_GM___MGF_CC "IKCtl_FacKnockDetThd3_GM Codeword: Set 1 (true) to enable PumpFuel (PF) map switching of this map (allows slots 0-4) and 0 (false) to disable PF map switching of this map (in all slots, effectively, always reading PF from slot 0)" VALUE 0x807DB079 FklWUb 1 B_TRUE 0 1 FORMAT "%13.11" /end CHARACTERISTIC
/begin CHARACTERISTIC CW_MapSwitch_IKCtl_FacKnockDetThd4_GM___MGF_CC "IKCtl_FacKnockDetThd4_GM Codeword: Set 1 (true) to enable PumpFuel (PF) map switching of this map (allows slots 0-4) and 0 (false) to disable PF map switching of this map (in all slots, effectively, always reading PF from slot 0)" VALUE 0x807DB07A FklWUb 1 B_TRUE 0 1 FORMAT "%13.11" /end CHARACTERISTIC
/begin CHARACTERISTIC CW_MapSwitch_IKCtl_FacKnockDetThd5_GM___MGF_CC "IKCtl_FacKnockDetThd5_GM Codeword: Set 1 (true) to enable PumpFuel (PF) map switching of this map (allows slots 0-4) and 0 (false) to disable PF map switching of this map (in all slots, effectively, always reading PF from slot 0)" VALUE 0x807DB07B FklWUb 1 B_TRUE 0 1 FORMAT "%13.11" /end CHARACTERISTIC
/begin CHARACTERISTIC CW_MapSwitch_KF_FDZWT_PF1___MGF_CC "KF_FDZWT_PF1 Codeword: Set 1 (true) to enable PumpFuel (PF) map switching of this map (allows slots 0-4) and 0 (false) to disable PF map switching of this map (in all slots, effectively, always reading PF from slot 0)" VALUE 0x807DB07C FklWUb 1 B_TRUE 0 1 FORMAT "%13.11" /end CHARACTERISTIC
/begin CHARACTERISTIC CW_MapSwitch_KF_FDZWT_PF2___MGF_CC "KF_FDZWT_PF2 Codeword: Set 1 (true) to enable PumpFuel (PF) map switching of this map (allows slots 0-4) and 0 (false) to disable PF map switching of this map (in all slots, effectively, always reading PF from slot 0)" VALUE 0x807DB07D FklWUb 1 B_TRUE 0 1 FORMAT "%13.11" /end CHARACTERISTIC
/begin CHARACTERISTIC CW_MapSwitch_KF_FRKKORRF_1___MGF_CC "KF_FRKKORRF_1 Codeword: Set 1 (true) to enable PumpFuel (PF) map switching of this map (allows slots 0-4) and 0 (false) to disable PF map switching of this map (in all slots, effectively, always reading PF from slot 0)" VALUE 0x807DB07E FklWUb 1 B_TRUE 0 1 FORMAT "%13.11" /end CHARACTERISTIC
/begin CHARACTERISTIC CW_MapSwitch_KF_LABAS_1___MGF_CC "KF_LABAS_1 Codeword: Set 1 (true) to enable PumpFuel (PF) map switching of this map (allows slots 0-4) and 0 (false) to disable PF map switching of this map (in all slots, effectively, always reading PF from slot 0)" VALUE 0x807DB07F FklWUb 1 B_TRUE 0 1 FORMAT "%13.11" /end CHARACTERISTIC
/begin CHARACTERISTIC CW_MapSwitch_KF_LABAS_2___MGF_CC "KF_LABAS_2 Codeword: Set 1 (true) to enable PumpFuel (PF) map switching of this map (allows slots 0-4) and 0 (false) to disable PF map switching of this map (in all slots, effectively, always reading PF from slot 0)" VALUE 0x807DB080 FklWUb 1 B_TRUE 0 1 FORMAT "%13.11" /end CHARACTERISTIC
/begin CHARACTERISTIC CW_MapSwitch_KF_PHA_H_B1_W___MGF_CC "KF_PHA_H_B1_W Codeword: Set 1 (true) to enable PumpFuel (PF) map switching of this map (allows slots 0-4) and 0 (false) to disable PF map switching of this map (in all slots, effectively, always reading PF from slot 0)" VALUE 0x807DB082 FklWUb 1 B_TRUE 0 1 FORMAT "%13.11" /end CHARACTERISTIC
/begin CHARACTERISTIC CW_MapSwitch_KF_PHA_H_E1___MGF_CC "KF_PHA_H_E1 Codeword: Set 1 (true) to enable PumpFuel (PF) map switching of this map (allows slots 0-4) and 0 (false) to disable PF map switching of this map (in all slots, effectively, always reading PF from slot 0)" VALUE 0x807DB083 FklWUb 1 B_TRUE 0 1 FORMAT "%13.11" /end CHARACTERISTIC
/begin CHARACTERISTIC CW_MapSwitch_KF_ZW_PF1___MGF_CC "KF_ZW_PF1 Codeword: Set 1 (true) to enable PumpFuel (PF) map switching of this map (allows slots 0-4) and 0 (false) to disable PF map switching of this map (in all slots, effectively, always reading PF from slot 0)" VALUE 0x807DB084 FklWUb 1 B_TRUE 0 1 FORMAT "%13.11" /end CHARACTERISTIC
/begin CHARACTERISTIC CW_MapSwitch_KF_ZW_PF2___MGF_CC "KF_ZW_PF2 Codeword: Set 1 (true) to enable PumpFuel (PF) map switching of this map (allows slots 0-4) and 0 (false) to disable PF map switching of this map (in all slots, effectively, always reading PF from slot 0)" VALUE 0x807DB085 FklWUb 1 B_TRUE 0 1 FORMAT "%13.11" /end CHARACTERISTIC
/begin CHARACTERISTIC CW_MapSwitch_KF_ZW_S_PF1___MGF_CC "KF_ZW_S_PF1 Codeword: Set 1 (true) to enable PumpFuel (PF) map switching of this map (allows slots 0-4) and 0 (false) to disable PF map switching of this map (in all slots, effectively, always reading PF from slot 0)" VALUE 0x807DB086 FklWUb 1 B_TRUE 0 1 FORMAT "%13.11" /end CHARACTERISTIC
/begin CHARACTERISTIC CW_MapSwitch_KF_ZW_S_PF2___MGF_CC "KF_ZW_S_PF2 Codeword: Set 1 (true) to enable PumpFuel (PF) map switching of this map (allows slots 0-4) and 0 (false) to disable PF map switching of this map (in all slots, effectively, always reading PF from slot 0)" VALUE 0x807DB087 FklWUb 1 B_TRUE 0 1 FORMAT "%13.11" /end CHARACTERISTIC
/begin CHARACTERISTIC CW_MapSwitch_KF_ZW_UESP_PF1___MGF_CC "KF_ZW_UESP_PF1 Codeword: Set 1 (true) to enable PumpFuel (PF) map switching of this map (allows slots 0-4) and 0 (false) to disable PF map switching of this map (in all slots, effectively, always reading PF from slot 0)" VALUE 0x807DB088 FklWUb 1 B_TRUE 0 1 FORMAT "%13.11" /end CHARACTERISTIC
/begin CHARACTERISTIC CW_MapSwitch_KF_ZW_UESP_PF2___MGF_CC "KF_ZW_UESP_PF2 Codeword: Set 1 (true) to enable PumpFuel (PF) map switching of this map (allows slots 0-4) and 0 (false) to disable PF map switching of this map (in all slots, effectively, always reading PF from slot 0)" VALUE 0x807DB089 FklWUb 1 B_TRUE 0 1 FORMAT "%13.11" /end CHARACTERISTIC
/begin CHARACTERISTIC CW_MapSwitch_KF_ZW_VP_PF1___MGF_CC "KF_ZW_VP_PF1 Codeword: Set 1 (true) to enable PumpFuel (PF) map switching of this map (allows slots 0-4) and 0 (false) to disable PF map switching of this map (in all slots, effectively, always reading PF from slot 0)" VALUE 0x807DB08A FklWUb 1 B_TRUE 0 1 FORMAT "%13.11" /end CHARACTERISTIC
/begin CHARACTERISTIC CW_MapSwitch_KF_ZW_VP_PF2___MGF_CC "KF_ZW_VP_PF2 Codeword: Set 1 (true) to enable PumpFuel (PF) map switching of this map (allows slots 0-4) and 0 (false) to disable PF map switching of this map (in all slots, effectively, always reading PF from slot 0)" VALUE 0x807DB08B FklWUb 1 B_TRUE 0 1 FORMAT "%13.11" /end CHARACTERISTIC
/begin CHARACTERISTIC CW_MapSwitch_KL_MDKMX_VL_APPLZ___MGF_CC "KL_MDKMX_VL_APPLZ Codeword: Set 1 (true) to enable PumpFuel (PF) map switching of this map (allows slots 0-4) and 0 (false) to disable PF map switching of this map (in all slots, effectively, always reading PF from slot 0)" VALUE 0x807DB08C FklWUb 1 B_TRUE 0 1 FORMAT "%13.11" /end CHARACTERISTIC
/begin CHARACTERISTIC CW_MapSwitch_KL_RF_MAX___MGF_CC "KL_RF_MAX Codeword: Set 1 (true) to enable PumpFuel (PF) map switching of this map (allows slots 0-4) and 0 (false) to disable PF map switching of this map (in all slots, effectively, always reading PF from slot 0)" VALUE 0x807DB08D FklWUb 1 B_TRUE 0 1 FORMAT "%13.11" /end CHARACTERISTIC
/begin CHARACTERISTIC CW_MapSwitch_KL_RF_MAX_UESP___MGF_CC "KL_RF_MAX_UESP Codeword: Set 1 (true) to enable PumpFuel (PF) map switching of this map (allows slots 0-4) and 0 (false) to disable PF map switching of this map (in all slots, effectively, always reading PF from slot 0)" VALUE 0x807DB08E FklWUb 1 B_TRUE 0 1 FORMAT "%13.11" /end CHARACTERISTIC
/begin CHARACTERISTIC CW_MapSwitch_Slot1___MGF_CC "Map Switch  Slot 1 Codeword: Set 1 (true) to enable PumpFuel (PF) map switching of this slot (for all maps) and 0 (false) to disable PF map switching of this slot (for all maps, effectively PF, FF1 and FF2 will all use their slot 0 maps)" VALUE 0x807DB08F FklWUb 1 B_TRUE 0 1 FORMAT "%13.11" /end CHARACTERISTIC
/begin CHARACTERISTIC CW_MaxCooling___MGF_CC "Max Cooling Codeword: Set 1 (true) to enable function and 0 (false) to disable function" VALUE 0x807C4A42 FklWUb 1 B_TRUE 0 1 FORMAT "%13.11" /end CHARACTERISTIC
/begin CHARACTERISTIC CW_MaxCooling_FanSpeed___MGF_CC "Max Cooling  Fan Speed Codeword: Set 1 (true) to enable function and 0 (false) to disable function" VALUE 0x807DB064 FklWUb 1 B_TRUE 0 1 FORMAT "%13.11" /end CHARACTERISTIC
/begin CHARACTERISTIC CW_OctaneSwitch___MGF_CC "Octane Switch Codeword: Set 1 (true) to enable function and 0 (false) to disable function" VALUE 0x807C4A43 FklWUb 1 B_TRUE 0 1 FORMAT "%13.11" /end CHARACTERISTIC
/begin CHARACTERISTIC CW_RadiatorFlapOnTheFly___MGF_CC "Radiator Flap On-The-Fly Codeword: Set 1 (true) to enable function and 0 (false) to disable function" VALUE 0x807C2490 FklWUb 1 B_TRUE 0 1 FORMAT "%13.11" /end CHARACTERISTIC
/begin CHARACTERISTIC FlexFuelEthanolValue___MGF_CC_FF1_Slot4 "Ethanol content when no sensor is installed and not set to override (Slot 4) Flex Fuel 1" VALUE 0x807C25C2 KwUw 255 CgkBooc_wkiDfEd_Czglhgc_fR_1a0o 0 100 FORMAT "%7.0" PHYS_UNIT "-" /end CHARACTERISTIC
/begin CHARACTERISTIC K_BS_MN "Lambda minimum value for component protection" VALUE 0x80719BF0 KwUw 15.999755859375 BumqDkc_mryszAa_EcglxAc_nR_4oa0 0 15.999755859375 /end CHARACTERISTIC
/begin CHARACTERISTIC K_FRFMXBS_MN "Limitation factor for filling intervention at component protection rich running limit" VALUE 0x80719C78 KwUw 1.99996948242188 Bhvfwhc_bigEubd_BBEupBd_nR_3oa0 0 1.99996948242188 FORMAT "%14.5" /end CHARACTERISTIC
/begin CHARACTERISTIC K_HFMPLCD_NKW_MX "Mass flow diagnostics release for HFM during coast down, maximum engine speed threshold" VALUE 0x8073DD8A CurG_Ws16 32767 caoddzd_oAjpfzb_cAcEEha_1nR_oa0 0 32767 FORMAT "%5.0" /end CHARACTERISTIC
/begin CHARACTERISTIC K_LA_FETTDELAY "Lambda threshold above which an enrichment request from KF_LABAS_XXX is suppressed" VALUE 0x8074DE4C KwUw 15.999755859375 BumqDkc_mryszAa_EcglxAc_nR_4oa0 0 15.999755859375 FORMAT "%9.4" /end CHARACTERISTIC
/begin CHARACTERISTIC K_MSVANST_DIFFPRAIL "Constant monitoring of high-pressure pump actuation minimum rail pressure undershoot" VALUE 0x8071625A KwUw 39.9993896484375 cxdjuna_xpuCged_ocEpdua_MCRa2a0 0 39.9993896484375 FORMAT "%6.2" /end CHARACTERISTIC
/begin CHARACTERISTIC K_PRAIL_ST_MAX "Maximum rail pressure setpoint for engine start" VALUE 0x80746F2A KwUw 39.9761962890625 cxdjuna_xpuCged_ocEpdua_MCRa2a0 0 39.9761962890625 FORMAT "%9.4" /end CHARACTERISTIC
/begin CHARACTERISTIC K_RFMIN_KRSTSYS "Minimum filling limitation from fuel system monitoring" VALUE 0x8071634C CurG_Ws16 655.35 CgkBooc_wkiDfEd_Czglhgc_fR_1a0o -327.68 327.67 FORMAT "%6.2" /end CHARACTERISTIC
/begin CHARACTERISTIC K_RFVIST_MX "MAX limit Rfv_ist from N.N." VALUE 0x807138CE CurG_Ws16 655.35 CgkBooc_wkiDfEd_Czglhgc_fR_1a0o -327.68 327.67 FORMAT "%7.2" /end CHARACTERISTIC
/begin CHARACTERISTIC K_T_FETTDELAY_SPERR "Time during which a renewed enrichment suppression is blocked" VALUE 0x80763B4D FklWUb 255 hcpywvc_dcqzDlc_FmDugua_s__aa0o 0 255 FORMAT "%5.2" /end CHARACTERISTIC
/begin CHARACTERISTIC MaxCooling_TargetFanSpeed___MGF_CC "Target fan speed when Max Cooling is enabled" VALUE 0x807DB065 FklWUb 255 ___MGF_CC_Pedal_x100_d256 0 100 FORMAT "%7.0" PHYS_UNIT "-" /end CHARACTERISTIC
/begin CHARACTERISTIC MaxCooling_TargetTemperature___MGF_CC "Target temperature when Max Cooling is enabled" VALUE 0x807DB062 CurG_Ws16 255 DchEpAd_DBCFgoa_Ckhahgc_q__aoa0 -200 200 FORMAT "%7.0" PHYS_UNIT "-" /end CHARACTERISTIC
/begin CHARACTERISTIC MoFETC_tiAccExcddThd_C "Time threshold for exceeded acceleration" VALUE 0x8076BAD6 KwUw 65535 BMW_q1_millisecond 0 65535 FORMAT "%8.2" /end CHARACTERISTIC
/begin CHARACTERISTIC NMXHDR "RPM limit at high-pressure rail controller fault" VALUE 0x807A3A3E CurG_Ws16 16383.5 n_sw_q0p5 0 16383.5 FORMAT "%8.2" /end CHARACTERISTIC
/begin CHARACTERISTIC S_AUSWAHL_FETTDELAY "Switch for changing the lambda setpoint during enrichment suppression. Either lambda=1 or max selection between La_main and K_LA_FETTDELAY is output." VALUE 0x80763B4C FklWUb 1 raChrxc_kBtBrmb_FmDuEFa_n__aa0o 0 1 FORMAT "%3.0" /end CHARACTERISTIC
/begin CHARACTERISTIC S_BSRFMX "Switch for filling limitation at component protection rich running limit" VALUE 0x80755CC6 FklWUb 1 raChrxc_kBtBrmb_FmDuEFa_n__aa0o 0 1 FORMAT "%3.0" /end CHARACTERISTIC
/begin CHARACTERISTIC S_PRAIL_GL_LA1 "Schalter zur Aktivierung des Sollraildrucks aus Grundkennfeld im Betriebsmodus CILCN " VALUE 0x80756DA7 FklWUb 255 raChrxc_kBtBrmb_FmDuEFa_n__aa0o 0 255 FORMAT "%3.0" /end CHARACTERISTIC
/begin CHARACTERISTIC VROHMAX "Maximum permitted raw speed for signal range check" VALUE 0x80797DBA KwUw 511.9922 vfzg_uw_b512 0 511.9922 FORMAT "%8.4" /end CHARACTERISTIC
/begin CHARACTERISTIC BMWext_lam_MinCptPronInit_Ca "Minimum lambda component protection in Init; vector element 0 = pre-turbo, 1 = pre-catalyst, 2 = in-catalyst" VAL_BLK 0x80719AB2 KwUw 15.999755859375 BumqDkc_mryszAa_EcglxAc_nR_4oa0 0 15.999755859375 NUMBER 3 MATRIX_DIM 3 1 1 /end CHARACTERISTIC
/begin CHARACTERISTIC BMWext_lam_CptPronDfco_T "Lambda feedforward value after cylinder deactivation in component protection" CURVE 0x80719C42 _REC_A1CUR_1_MBSE_U2_S1 15.999755859375 BumqDkc_mryszAa_EcglxAc_nR_4oa0 0 15.999755859375 FORMAT "%9.4"
 /begin AXIS_DESCR COM_AXIS NO_INPUT_QUANTITY caoddzd_oAjpfzb_cAcEEha_1nR_oa0 6 -32768 32767 AXIS_PTS_REF BMWext_lam_CptPronDfco_Ax FORMAT "%5.0" MONOTONY STRICT_INCREASE DEPOSIT ABSOLUTE /end AXIS_DESCR
/end CHARACTERISTIC
/begin CHARACTERISTIC BMWgpfdiag_rf_LimPclFilMin_T "Lower safeguard for relative filling limit by the GPF. Even with a fully loaded GPF, the filling limit cannot drop below this value." CURVE 0x80741286 _REC_A1CUR_1_MBSE_S2_S1 655.35 CgkBooc_wkiDfEd_Czglhgc_fR_1a0o -327.68 327.67
 /begin AXIS_DESCR COM_AXIS Nkw caoddzd_oAjpfzb_cAcEEha_1nR_oa0 4 -32768 32767 AXIS_PTS_REF BMWgpfdiag_rf_LimPclFilMin_Ax FORMAT "%5.0" MONOTONY STRICT_INCREASE DEPOSIT ABSOLUTE /end AXIS_DESCR
/end CHARACTERISTIC
/begin CHARACTERISTIC BMWinjafs_fac_RatAirMax_T "Curve upper limit Rf for stoichiometric lambda adaptation" CURVE 0x80714CA2 _REC_A1CUR_1_MBSE_S2_S1 655.35 ubqeuic_jteCkzd_CDglhgc_nR_1a0o -327.68 327.67
 /begin AXIS_DESCR COM_AXIS Nkw caoddzd_oAjpfzb_cAcEEha_1nR_oa0 6 -32768 32767 AXIS_PTS_REF BMWinjafs_fac_RatAirMax_Ax FORMAT "%5.0" MONOTONY STRICT_INCREASE DEPOSIT ABSOLUTE /end AXIS_DESCR
/end CHARACTERISTIC
/begin CHARACTERISTIC BMWlpa_n_EfpEngStrtPRail_T "Electric fuel pump speed setpoint for start rail pressure" CURVE 0x8071C740 _REC_A1CUR_1_MBSE_U2_S1 65535 caoddzd_oAjpfzb_cAcEEha_1nR_oa0 0 65535 FORMAT "%5.0"
 /begin AXIS_DESCR COM_AXIS BMWlpi_p_HiPAbs bukAcFc_hypjrAa_CBhougc_MCRooa0 2 0 131.07 AXIS_PTS_REF BMWlpa_n_EfpEngStrtPRail_Ax MONOTONY STRICT_INCREASE DEPOSIT ABSOLUTE /end AXIS_DESCR
/end CHARACTERISTIC
/begin CHARACTERISTIC BMWlpa_rat_EfpPwm_T "Electric fuel pump speed control via PWM" CURVE 0x8071C684 _REC_A1CUR_1_MBSE_S2_S1 655.35 ubqeuic_jteCkzd_CDglhgc_nR_1a0o -327.68 327.67 FORMAT "%5.2"
 /begin AXIS_DESCR COM_AXIS BMWlpa_n_Efp_uw caoddzd_oAjpfzb_cAcEEha_1nR_oa0 6 0 65535 AXIS_PTS_REF BMWlpa_rat_EfpPwm_Ax FORMAT "%5.0" MONOTONY STRICT_INCREASE DEPOSIT ABSOLUTE /end AXIS_DESCR
/end CHARACTERISTIC
/begin CHARACTERISTIC BMWlpa_volf_FuMaxBoosCtlr_T "LoPAsst fuel volume flow at boost tracking (characteristic curve)" CURVE 0x80740F46 _REC_A1CUR_1_MBSE_S2_S1 655.35 zBcBzad_vmoivka_mFzjCgc_lCRooa0 -327.68 327.67
 /begin AXIS_DESCR COM_AXIS BMWlpsc_p_DeSp_sw rgduxyd_mlihaBb_gsCghzb_bCRa0a0 6 -32.768 32.767 AXIS_PTS_REF BMWlpa_volf_FuMaxBoosCtlr_Ax FORMAT "%5.3" MONOTONY STRICT_INCREASE DEPOSIT ABSOLUTE /end AXIS_DESCR
/end CHARACTERISTIC
/begin CHARACTERISTIC BMWlpsc_p_HppMax_T "Curve maximum pressure before high-pressure pump depending on flow rate" CURVE 0x80741208 _REC_A1CUR_1_MBSE_U2_S1 65.535 rgduxyd_mlihaBb_gsCghzb_bCRa0a0 0 65.535 FORMAT "%5.3"
 /begin AXIS_DESCR COM_AXIS BMWlpi_volf_Fu_sw zBcBzad_vmoivka_mFzjCgc_lCRooa0 4 -327.68 327.67 AXIS_PTS_REF BMWlpsc_p_HppMax_Ax FORMAT "%5.2" MONOTONY STRICT_INCREASE DEPOSIT ABSOLUTE /end AXIS_DESCR
/end CHARACTERISTIC
/begin CHARACTERISTIC BMWlpsd_p_RailDifMax_T "Rail pressure deviation threshold" CURVE 0x8071CE22 _REC_A1CUR_1_MBSE_U2_S1 131.07 bukAcFc_hypjrAa_CBhougc_MCRooa0 0 131.07
 /begin AXIS_DESCR COM_AXIS BMWlpi_p_HiPAbsSp bukAcFc_hypjrAa_CBhougc_MCRooa0 4 0 131.07 AXIS_PTS_REF BMWlpsd_p_RailDifMax_Ax MONOTONY STRICT_INCREASE DEPOSIT ABSOLUTE /end AXIS_DESCR
/end CHARACTERISTIC
/begin CHARACTERISTIC BMWls_pct_FiMaxCondRisk_T "Maximum filling over RPM due to condensation risk at the charge air cooler" CURVE 0x80721B88 _REC_A1CUR_1_MBSE_S2_S1 655.35 CgkBooc_wkiDfEd_Czglhgc_fR_1a0o -327.68 327.67 FORMAT "%7.2"
 /begin AXIS_DESCR COM_AXIS NO_INPUT_QUANTITY caoddzd_oAjpfzb_cAcEEha_1nR_oa0 12 -32768 32767 AXIS_PTS_REF BMWls_pct_FiMaxCondRisk_Ax FORMAT "%5.0" MONOTONY MON_INCREASE DEPOSIT ABSOLUTE /end AXIS_DESCR
/end CHARACTERISTIC
/begin CHARACTERISTIC BMWtchsp_rat_p_CmprPmp_T___MGF_CC_PF_Slot0 "KL_FPLDPUMP (Slot 0, OEM Address)" CURVE 0x80728420 _REC_A1CUR_1_MBSE_U2_S1 3.99993896484375 ilxsavd_hkzmBfc_lAzCpAb_nR_1oa0 0 3.99993896484375
 /begin AXIS_DESCR COM_AXIS BMWtchsp_mf_CmprNorm_uw wpxDCba_sgbvDxb_FliBAmd_k__0oa0 8 0 4095.9375 AXIS_PTS_REF BMWtchsp_rat_p_CmprPmp_Ax FORMAT "%10.3" MONOTONY STRICT_INCREASE DEPOSIT ABSOLUTE /end AXIS_DESCR
/end CHARACTERISTIC
/begin CHARACTERISTIC BMWtchsp_rat_p_CmprPmp_T___MGF_CC_PF_Slot1 "KL_FPLDPUMP (Slot 1, Pump Fuel)" CURVE 0x807C23D0 _REC_A1CUR_1_MBSE_U2_S1 3.99993896484375 ilxsavd_hkzmBfc_lAzCpAb_nR_1oa0 0 3.99993896484375
 /begin AXIS_DESCR COM_AXIS BMWtchsp_mf_CmprNorm_uw wpxDCba_sgbvDxb_FliBAmd_k__0oa0 8 0 4095.9375 AXIS_PTS_REF BMWtchsp_rat_p_CmprPmp_Ax FORMAT "%10.3" MONOTONY STRICT_INCREASE DEPOSIT ABSOLUTE /end AXIS_DESCR
/end CHARACTERISTIC
/begin CHARACTERISTIC BMWtchsp_rf_Liho_T "Relative filling limitation for turbocharger variants in fault condition (b_atlerr_md)" CURVE 0x80728414 _REC_A1CUR_1_MBSE_S2_S1 655.35 CgkBooc_wkiDfEd_Czglhgc_fR_1a0o -327.68 327.67
 /begin AXIS_DESCR COM_AXIS NO_INPUT_QUANTITY caoddzd_oAjpfzb_cAcEEha_1nR_oa0 6 -32768 32767 AXIS_PTS_REF BMWtchsp_rf_Liho_Ax FORMAT "%5.0" MONOTONY STRICT_INCREASE DEPOSIT ABSOLUTE /end AXIS_DESCR
/end CHARACTERISTIC
/begin CHARACTERISTIC BMWtqe_tqc_FlApplBol_T___MGF_CC_PF_Slot0 "Torque engine crankshaft torque full load application bottom limit characteristic curve (Slot 0, OEM Address)" CURVE 0x8073149C _REC_A1CUR_1_MBSE_S2_S1 6553.5 BMW_dm_sw_q0p1_Nm -3276.8 3276.7 FORMAT "%6.1"
 /begin AXIS_DESCR COM_AXIS Nkw_ref caoddzd_oAjpfzb_cAcEEha_1nR_oa0 18 -32768 32767 AXIS_PTS_REF BMWtqe_tqc_FlApplStg_Ax MONOTONY STRICT_INCREASE DEPOSIT ABSOLUTE /end AXIS_DESCR
/end CHARACTERISTIC
/begin CHARACTERISTIC BMWtqe_tqc_FlApplBol_T___MGF_CC_PF_Slot1 "Torque engine crankshaft torque full load application bottom limit characteristic curve (Slot 1, Pump Fuel)" CURVE 0x807C6CB6 _REC_A1CUR_1_MBSE_S2_S1 6553.5 BMW_dm_sw_q0p1_Nm -3276.8 3276.7 FORMAT "%6.1"
 /begin AXIS_DESCR COM_AXIS Nkw_ref caoddzd_oAjpfzb_cAcEEha_1nR_oa0 18 -32768 32767 AXIS_PTS_REF BMWtqe_tqc_FlApplStg_Ax MONOTONY STRICT_INCREASE DEPOSIT ABSOLUTE /end AXIS_DESCR
/end CHARACTERISTIC
/begin CHARACTERISTIC BMWtqe_tqc_FlApplStgNorm_T___MGF_CC_PF_Slot0 "Torque engine crankshaft full load application stage normal curve (Slot 0, OEM Address)" CURVE 0x80731478 _REC_A1CUR_1_MBSE_S2_S1 6553.5 BMW_dm_sw_q0p1_Nm -3276.8 3276.7 FORMAT "%6.1"
 /begin AXIS_DESCR COM_AXIS Nkw_ref caoddzd_oAjpfzb_cAcEEha_1nR_oa0 18 -32768 32767 AXIS_PTS_REF BMWtqe_tqc_FlApplStg_Ax MONOTONY STRICT_INCREASE DEPOSIT ABSOLUTE /end AXIS_DESCR
/end CHARACTERISTIC
/begin CHARACTERISTIC BMWtqe_tqc_FlApplStgNorm_T___MGF_CC_PF_Slot1 "Torque engine crankshaft full load application stage normal curve (Slot 1, Pump Fuel)" CURVE 0x807C49AC _REC_A1CUR_1_MBSE_S2_S1 6553.5 BMW_dm_sw_q0p1_Nm -3276.8 3276.7 FORMAT "%6.1"
 /begin AXIS_DESCR COM_AXIS Nkw_ref caoddzd_oAjpfzb_cAcEEha_1nR_oa0 18 -32768 32767 AXIS_PTS_REF BMWtqe_tqc_FlApplStg_Ax MONOTONY STRICT_INCREASE DEPOSIT ABSOLUTE /end AXIS_DESCR
/end CHARACTERISTIC
/begin CHARACTERISTIC BMWtqe_tqc_FlApplStgPwr1_T___MGF_CC_PF_Slot0 "Torque engine, crankshaft torque full load application stage power 1 curve (Slot 0, OEM Address)" CURVE 0x80731454 _REC_A1CUR_1_MBSE_S2_S1 6553.5 BMW_dm_sw_q0p1_Nm -3276.8 3276.7 FORMAT "%6.1"
 /begin AXIS_DESCR COM_AXIS Nkw_ref caoddzd_oAjpfzb_cAcEEha_1nR_oa0 18 -32768 32767 AXIS_PTS_REF BMWtqe_tqc_FlApplStg_Ax MONOTONY STRICT_INCREASE DEPOSIT ABSOLUTE /end AXIS_DESCR
/end CHARACTERISTIC
/begin CHARACTERISTIC BMWtqe_tqc_FlApplStgPwr1_T___MGF_CC_PF_Slot1 "Torque engine, crankshaft torque full load application stage power 1 curve (Slot 1, Pump Fuel)" CURVE 0x807C6D46 _REC_A1CUR_1_MBSE_S2_S1 6553.5 BMW_dm_sw_q0p1_Nm -3276.8 3276.7 FORMAT "%6.1"
 /begin AXIS_DESCR COM_AXIS Nkw_ref caoddzd_oAjpfzb_cAcEEha_1nR_oa0 18 -32768 32767 AXIS_PTS_REF BMWtqe_tqc_FlApplStg_Ax MONOTONY STRICT_INCREASE DEPOSIT ABSOLUTE /end AXIS_DESCR
/end CHARACTERISTIC
/begin CHARACTERISTIC BMWtqe_tqc_FlApplStgPwr2_T___MGF_CC_PF_Slot0 "Torque engine, crankshaft torque full load application stage power 2 curve (Slot 0, OEM Address)" CURVE 0x80731430 _REC_A1CUR_1_MBSE_S2_S1 6553.5 BMW_dm_sw_q0p1_Nm -3276.8 3276.7 FORMAT "%6.1"
 /begin AXIS_DESCR COM_AXIS Nkw_ref caoddzd_oAjpfzb_cAcEEha_1nR_oa0 18 -32768 32767 AXIS_PTS_REF BMWtqe_tqc_FlApplStg_Ax MONOTONY STRICT_INCREASE DEPOSIT ABSOLUTE /end AXIS_DESCR
/end CHARACTERISTIC
/begin CHARACTERISTIC BMWtqe_tqc_FlApplStgPwr2_T___MGF_CC_PF_Slot1 "Torque engine, crankshaft torque full load application stage power 2 curve (Slot 1, Pump Fuel)" CURVE 0x807C8876 _REC_A1CUR_1_MBSE_S2_S1 6553.5 BMW_dm_sw_q0p1_Nm -3276.8 3276.7 FORMAT "%6.1"
 /begin AXIS_DESCR COM_AXIS Nkw_ref caoddzd_oAjpfzb_cAcEEha_1nR_oa0 18 -32768 32767 AXIS_PTS_REF BMWtqe_tqc_FlApplStg_Ax MONOTONY STRICT_INCREASE DEPOSIT ABSOLUTE /end AXIS_DESCR
/end CHARACTERISTIC
/begin CHARACTERISTIC BMWtqe_tqc_FlApplStgPwrHi_T___MGF_CC_PF_Slot0 "Torque engine crankshaft torque full load application stage power high characteristic curve (Slot 0, OEM Address)" CURVE 0x8073140C _REC_A1CUR_1_MBSE_S2_S1 6553.5 BMW_dm_sw_q0p1_Nm -3276.8 3276.7 FORMAT "%6.1"
 /begin AXIS_DESCR COM_AXIS Nkw_ref caoddzd_oAjpfzb_cAcEEha_1nR_oa0 18 -32768 32767 AXIS_PTS_REF BMWtqe_tqc_FlApplStg_Ax MONOTONY STRICT_INCREASE DEPOSIT ABSOLUTE /end AXIS_DESCR
/end CHARACTERISTIC
/begin CHARACTERISTIC BMWtqe_tqc_FlApplStgPwrHi_T___MGF_CC_PF_Slot1 "Torque engine crankshaft torque full load application stage power high characteristic curve (Slot 1, Pump Fuel)" CURVE 0x807C8906 _REC_A1CUR_1_MBSE_S2_S1 6553.5 BMW_dm_sw_q0p1_Nm -3276.8 3276.7 FORMAT "%6.1"
 /begin AXIS_DESCR COM_AXIS Nkw_ref caoddzd_oAjpfzb_cAcEEha_1nR_oa0 18 -32768 32767 AXIS_PTS_REF BMWtqe_tqc_FlApplStg_Ax MONOTONY STRICT_INCREASE DEPOSIT ABSOLUTE /end AXIS_DESCR
/end CHARACTERISTIC
/begin CHARACTERISTIC FuPHi_FlmMaxpl_T "Characteristic curve maximum relative fuel mass for plausibility check of the high-pressure system" CURVE 0x80797450 RB_Curve_S16_U16_Static 3071.953 rel_q0p046875 0 3071.953 FORMAT "%8.3"
 /begin AXIS_DESCR STD_AXIS Epm_nEng EngN 4 -16384 16383.5 FORMAT "%8.2" DEPOSIT ABSOLUTE /end AXIS_DESCR
/end CHARACTERISTIC
/begin CHARACTERISTIC FWIHDR "Weighting factor PI controller parameter high-pressure rail; I-component" CURVE 0x807A006A Cur_Xu8Wu8 1.992188 fak_ub_b2 0 1.992188 FORMAT "%8.6"
 /begin AXIS_DESCR STD_AXIS FupHi_nEngLResHDR nmot_q40 8 0 10200 FORMAT "%5.0" DEPOSIT ABSOLUTE /end AXIS_DESCR
/end CHARACTERISTIC
/begin CHARACTERISTIC KL_FRFMXBS "Curve factor for filling intervention at component protection rich running limit" CURVE 0x80719CF4 _REC_A1CUR_1_MBSE_U2_S1 1.99996948242188 Bhvfwhc_bigEubd_BBEupBd_nR_3oa0 0 1.99996948242188 FORMAT "%14.5"
 /begin AXIS_DESCR COM_AXIS NO_INPUT_QUANTITY Bhvfwhc_bigEubd_BBEupBd_nR_3oa0 4 0 1.99996948242188 AXIS_PTS_REF AXX_KL_FRFMXBS FORMAT "%14.5" MONOTONY STRICT_INCREASE DEPOSIT ABSOLUTE /end AXIS_DESCR
/end CHARACTERISTIC
/begin CHARACTERISTIC KL_LAMX "Maximum relative filling" CURVE 0x80721C50 _REC_A1CUR_1_MBSE_S2_S1 327.67 CgkBooc_wkiDfEd_Czglhgc_fR_1a0o 0 327.67 FORMAT "%7.2"
 /begin AXIS_DESCR COM_AXIS NO_INPUT_QUANTITY caoddzd_oAjpfzb_cAcEEha_1nR_oa0 18 -32768 32767 AXIS_PTS_REF AXX_KL_LAMX FORMAT "%5.0" MONOTONY MON_INCREASE DEPOSIT ABSOLUTE /end AXIS_DESCR
/end CHARACTERISTIC
/begin CHARACTERISTIC KL_RF_MAX "Curve maximum permissible filling over engine speed" CURVE 0x807217A8 _REC_A1CUR_1_MBSE_S2_S1 655.35 CgkBooc_wkiDfEd_Czglhgc_fR_1a0o -327.68 327.67 FORMAT "%7.2"
 /begin AXIS_DESCR COM_AXIS NO_INPUT_QUANTITY caoddzd_oAjpfzb_cAcEEha_1nR_oa0 12 -32768 32767 AXIS_PTS_REF AXX_KL_RF_MAX FORMAT "%5.0" MONOTONY MON_INCREASE DEPOSIT ABSOLUTE /end AXIS_DESCR
/end CHARACTERISTIC
/begin CHARACTERISTIC KL_RF_MAX___MGF_CC_FF2_Slot4 "Curve maximum permissible filling over engine speed (Slot 4, Flex Fuel 2)" CURVE 0x807D4CB2 _REC_A1CUR_1_MBSE_S2_S1 655.35 CgkBooc_wkiDfEd_Czglhgc_fR_1a0o -327.68 327.67 FORMAT "%7.2"
 /begin AXIS_DESCR COM_AXIS NO_INPUT_QUANTITY caoddzd_oAjpfzb_cAcEEha_1nR_oa0 12 -32768 32767 AXIS_PTS_REF AXX_KL_RF_MAX FORMAT "%5.0" MONOTONY MON_INCREASE DEPOSIT ABSOLUTE /end AXIS_DESCR
/end CHARACTERISTIC
/begin CHARACTERISTIC KL_RF_MAX___MGF_CC_PF_Slot0 "Curve maximum permissible filling over engine speed (Slot 0, OEM Address)" CURVE 0x807217A8 _REC_A1CUR_1_MBSE_S2_S1 655.35 CgkBooc_wkiDfEd_Czglhgc_fR_1a0o -327.68 327.67 FORMAT "%7.2"
 /begin AXIS_DESCR COM_AXIS NO_INPUT_QUANTITY caoddzd_oAjpfzb_cAcEEha_1nR_oa0 12 -32768 32767 AXIS_PTS_REF AXX_KL_RF_MAX FORMAT "%5.0" MONOTONY MON_INCREASE DEPOSIT ABSOLUTE /end AXIS_DESCR
/end CHARACTERISTIC
/begin CHARACTERISTIC KL_RF_MAX___MGF_CC_PF_Slot1 "Curve maximum permissible filling over engine speed (Slot 1, Pump Fuel)" CURVE 0x807C48E8 _REC_A1CUR_1_MBSE_S2_S1 655.35 CgkBooc_wkiDfEd_Czglhgc_fR_1a0o -327.68 327.67 FORMAT "%7.2"
 /begin AXIS_DESCR COM_AXIS NO_INPUT_QUANTITY caoddzd_oAjpfzb_cAcEEha_1nR_oa0 12 -32768 32767 AXIS_PTS_REF AXX_KL_RF_MAX FORMAT "%5.0" MONOTONY MON_INCREASE DEPOSIT ABSOLUTE /end AXIS_DESCR
/end CHARACTERISTIC
/begin CHARACTERISTIC KL_RF_MAX_UESP "Curve maximum permissible filling over engine speed during scavenging" CURVE 0x80721790 _REC_A1CUR_1_MBSE_S2_S1 655.35 CgkBooc_wkiDfEd_Czglhgc_fR_1a0o -327.68 327.67 FORMAT "%7.2"
 /begin AXIS_DESCR COM_AXIS NO_INPUT_QUANTITY caoddzd_oAjpfzb_cAcEEha_1nR_oa0 12 -32768 32767 AXIS_PTS_REF AXX_KL_RF_MAX_UESP FORMAT "%5.0" MONOTONY MON_INCREASE DEPOSIT ABSOLUTE /end AXIS_DESCR
/end CHARACTERISTIC
/begin CHARACTERISTIC KL_RF_MAX_UESP___MGF_CC_FF2_Slot4 "Curve maximum permissible filling over engine speed during scavenging (Slot 4, Flex Fuel 2)" CURVE 0x807D4D2A _REC_A1CUR_1_MBSE_S2_S1 655.35 CgkBooc_wkiDfEd_Czglhgc_fR_1a0o -327.68 327.67 FORMAT "%7.2"
 /begin AXIS_DESCR COM_AXIS NO_INPUT_QUANTITY caoddzd_oAjpfzb_cAcEEha_1nR_oa0 12 -32768 32767 AXIS_PTS_REF AXX_KL_RF_MAX_UESP FORMAT "%5.0" MONOTONY MON_INCREASE DEPOSIT ABSOLUTE /end AXIS_DESCR
/end CHARACTERISTIC
/begin CHARACTERISTIC KL_RF_MAX_UESP___MGF_CC_PF_Slot0 "Curve maximum permissible filling over engine speed during scavenging (Slot 0, OEM Address)" CURVE 0x80721790 _REC_A1CUR_1_MBSE_S2_S1 655.35 CgkBooc_wkiDfEd_Czglhgc_fR_1a0o -327.68 327.67 FORMAT "%7.2"
 /begin AXIS_DESCR COM_AXIS NO_INPUT_QUANTITY caoddzd_oAjpfzb_cAcEEha_1nR_oa0 12 -32768 32767 AXIS_PTS_REF AXX_KL_RF_MAX_UESP FORMAT "%5.0" MONOTONY MON_INCREASE DEPOSIT ABSOLUTE /end AXIS_DESCR
/end CHARACTERISTIC
/begin CHARACTERISTIC KL_RF_MAX_UESP___MGF_CC_PF_Slot1 "Curve maximum permissible filling over engine speed during scavenging (Slot 1, Pump Fuel)" CURVE 0x807C4948 _REC_A1CUR_1_MBSE_S2_S1 655.35 CgkBooc_wkiDfEd_Czglhgc_fR_1a0o -327.68 327.67 FORMAT "%7.2"
 /begin AXIS_DESCR COM_AXIS NO_INPUT_QUANTITY caoddzd_oAjpfzb_cAcEEha_1nR_oa0 12 -32768 32767 AXIS_PTS_REF AXX_KL_RF_MAX_UESP FORMAT "%5.0" MONOTONY MON_INCREASE DEPOSIT ABSOLUTE /end AXIS_DESCR
/end CHARACTERISTIC
/begin CHARACTERISTIC KL_RFMIN_KRSTSYS "Minimum filling for filling limitation from injection monitoring" CURVE 0x8073F5DA _REC_A1CUR_1_MBSE_S2_S1 655.35 CgkBooc_wkiDfEd_Czglhgc_fR_1a0o -327.68 327.67 FORMAT "%6.2"
 /begin AXIS_DESCR COM_AXIS Nkw caoddzd_oAjpfzb_cAcEEha_1nR_oa0 8 -32768 32767 AXIS_PTS_REF AXX_KL_RFMIN_KRSTSYS FORMAT "%5.0" MONOTONY STRICT_INCREASE DEPOSIT ABSOLUTE /end AXIS_DESCR
/end CHARACTERISTIC
/begin CHARACTERISTIC KL_RFVHUBDYNKOR "Curve Rfv_hub setpoint at F_rfv_dyn=0" CURVE 0x8071FB36 _REC_A1CUR_1_MBSE_S2_S1 327.67 CgkBooc_wkiDfEd_Czglhgc_fR_1a0o 0 327.67 FORMAT "%7.2"
 /begin AXIS_DESCR COM_AXIS NO_INPUT_QUANTITY caoddzd_oAjpfzb_cAcEEha_1nR_oa0 20 -32768 32767 AXIS_PTS_REF AXX_KL_RFVHUBDYNKOR FORMAT "%5.0" MONOTONY MON_INCREASE DEPOSIT ABSOLUTE /end AXIS_DESCR
/end CHARACTERISTIC
/begin CHARACTERISTIC KLFVSTOTF "Offset correction of MSV feedforward depending on fuel temperature" CURVE 0x807ADDBB Cur_Xu8Wu8 1.992188 fak_ub_b2 0 1.992188 FORMAT "%8.6"
 /begin AXIS_DESCR STD_AXIS tfuelsq_msg temp_ub_q0p75_o48 3 -48 143.3 FORMAT "%5.1" DEPOSIT ABSOLUTE /end AXIS_DESCR
/end CHARACTERISTIC
/begin CHARACTERISTIC KLIHDR "I-component of the rail pressure controller" CURVE 0x807A0080 KwUw 7.999878 fak_sw_b4 0 7.999878 FORMAT "%8.6"
 /begin AXIS_DESCR COM_AXIS FuPHi_pHpRglnDeLoc RBPtCel_p_0p002_1 6 -65.536 65.534 AXIS_PTS_REF SPD06HDSW FORMAT "%8.5" DEPOSIT ABSOLUTE /end AXIS_DESCR
/end CHARACTERISTIC
/begin CHARACTERISTIC KLPHDR "P-component of the rail pressure controller" CURVE 0x807A008C KwUw 7.999878 fak_sw_b4 0 7.999878 FORMAT "%8.6"
 /begin AXIS_DESCR COM_AXIS FuPHi_pHpRglnDeLoc RBPtCel_p_0p002_1 6 -65.536 65.534 AXIS_PTS_REF SPD06HDSW FORMAT "%8.5" DEPOSIT ABSOLUTE /end AXIS_DESCR
/end CHARACTERISTIC
/begin CHARACTERISTIC KLPHDRTF "Factor for P-component of high-pressure rail controller as function of temperature" CURVE 0x807A0098 Cur_Xu8Wu8 1.992188 fak_ub_b2 0 1.992188 FORMAT "%8.6"
 /begin AXIS_DESCR STD_AXIS tfuelsq_msg temp_ub_q0p75_o48 4 -48 143.3 FORMAT "%5.1" DEPOSIT ABSOLUTE /end AXIS_DESCR
/end CHARACTERISTIC
/begin CHARACTERISTIC KLVSTMSVG "Gain factor for MSV feedforward" CURVE 0x807ADDC2 KwUw 3.999939 fak_q6p1035Em5 0 3.999939 FORMAT "%8.6"
 /begin AXIS_DESCR COM_AXIS NO_INPUT_QUANTITY nmot_sw_q0p25 8 0 16383.75 AXIS_PTS_REF SNM08HDUW FORMAT "%8.2" DEPOSIT ABSOLUTE /end AXIS_DESCR
/end CHARACTERISTIC
/begin CHARACTERISTIC VSEKPMXN "Curve target fuel volume flow at full load depending on engine speed" CURVE 0x807936E5 Cur_Xu8Wu8 255 RBPtCel_vol_1p0_1 0 255 FORMAT "%5.1"
 /begin AXIS_DESCR STD_AXIS NO_INPUT_QUANTITY nmot_q40 5 0 10200 FORMAT "%5.0" DEPOSIT ABSOLUTE /end AXIS_DESCR
/end CHARACTERISTIC
/begin CHARACTERISTIC BMWchas_p_RailInjMpl_M "Rail pressure setpoint for multiple injection" MAP 0x8073C618 _REC_A1CUR_1_MBSE_U2_S1 39.9993896484375 cxdjuna_xpuCged_ocEpdua_MCRa2a0 0 39.9993896484375
 /begin AXIS_DESCR COM_AXIS Nkw caoddzd_oAjpfzb_cAcEEha_1nR_oa0 6 -32768 32767 AXIS_PTS_REF BMWchas_p_RailInjMpl_Ax FORMAT "%5.0" MONOTONY STRICT_INCREASE DEPOSIT ABSOLUTE /end AXIS_DESCR
 /begin AXIS_DESCR COM_AXIS BMWrailco_rat_VabHom_sw zyyxBpb_rEsnvtc_gktukCa_fR_5a0o 6 -1600 1599.951171875 AXIS_PTS_REF BMWchas_p_RailInjMpl_Ay FORMAT "%8.3" MONOTONY STRICT_INCREASE DEPOSIT ABSOLUTE /end AXIS_DESCR
/end CHARACTERISTIC
/begin CHARACTERISTIC BMWchas_p_RailInjSng_M "Rail pressure setpoint for single injection" MAP 0x8073C598 _REC_A1CUR_1_MBSE_U2_S1 39.9993896484375 cxdjuna_xpuCged_ocEpdua_MCRa2a0 0 39.9993896484375
 /begin AXIS_DESCR COM_AXIS Nkw caoddzd_oAjpfzb_cAcEEha_1nR_oa0 8 -32768 32767 AXIS_PTS_REF BMWchas_p_RailInjSng_Ax FORMAT "%5.0" MONOTONY STRICT_INCREASE DEPOSIT ABSOLUTE /end AXIS_DESCR
 /begin AXIS_DESCR COM_AXIS BMWrailco_rat_VabHom_sw zyyxBpb_rEsnvtc_gktukCa_fR_5a0o 8 -1600 1599.951171875 AXIS_PTS_REF BMWchas_p_RailInjSng_Ay FORMAT "%8.3" MONOTONY STRICT_INCREASE DEPOSIT ABSOLUTE /end AXIS_DESCR
/end CHARACTERISTIC
/begin CHARACTERISTIC BMWext_lam_CptPronMinLeanTq_M "Lambda lean best torque for limiting the component protection lambda" MAP 0x80719ADC _REC_A1CUR_1_MBSE_U2_S1 15.999755859375 BumqDkc_mryszAa_EcglxAc_nR_4oa0 0 15.999755859375
 /begin AXIS_DESCR COM_AXIS Nkw_atm caoddzd_oAjpfzb_cAcEEha_1nR_oa0 8 -32768 32767 AXIS_PTS_REF BMWext_lam_CptPronMinLeanTq_Ax MONOTONY STRICT_INCREASE DEPOSIT ABSOLUTE /end AXIS_DESCR
 /begin AXIS_DESCR COM_AXIS Rf_atm CgkBooc_wkiDfEd_Czglhgc_fR_1a0o 8 -327.68 327.67 AXIS_PTS_REF BMWext_lam_CptPronMinLeanTq_Ay MONOTONY STRICT_INCREASE DEPOSIT ABSOLUTE /end AXIS_DESCR
/end CHARACTERISTIC
/begin CHARACTERISTIC BMWinjmon_fac_HppEff_M "Injection map factor for high-pressure pump efficiency" MAP 0x80716280 _REC_A1CUR_1_MBSE_U2_S1 1.99996948242188 Bhvfwhc_bigEubd_BBEupBd_nR_3oa0 0 1.99996948242188 FORMAT "%6.2"
 /begin AXIS_DESCR COM_AXIS Nkw_10ms caoddzd_oAjpfzb_cAcEEha_1nR_oa0 8 -32768 32767 AXIS_PTS_REF BMWinjmon_fac_HppEff_Ax FORMAT "%5.0" MONOTONY STRICT_INCREASE DEPOSIT ABSOLUTE /end AXIS_DESCR
 /begin AXIS_DESCR COM_AXIS BMWrail_p_RpsActVal bukAcFc_hypjrAa_CBhougc_MCRooa0 4 0 131.07 AXIS_PTS_REF BMWinjmon_fac_HppEff_Ay MONOTONY STRICT_INCREASE DEPOSIT ABSOLUTE /end AXIS_DESCR
/end CHARACTERISTIC
/begin CHARACTERISTIC BMWlpa_n_EfpModSafe_M "Electric fuel pump speed setpoint safe mode" MAP 0x8071C690 _REC_A1CUR_1_MBSE_U2_S1 65535 caoddzd_oAjpfzb_cAcEEha_1nR_oa0 0 65535 FORMAT "%5.0"
 /begin AXIS_DESCR COM_AXIS BMWlpi_t_Fu_sw DchEpAd_DBCFgoa_Ckhahgc_q__aoa0 4 -327.68 327.67 AXIS_PTS_REF BMWlpa_n_EfpModSafe_Ax FORMAT "%5.2" MONOTONY STRICT_INCREASE DEPOSIT ABSOLUTE /end AXIS_DESCR
 /begin AXIS_DESCR COM_AXIS BMWlpi_volf_Fu_sw zBcBzad_vmoivka_mFzjCgc_lCRooa0 4 -327.68 327.67 AXIS_PTS_REF BMWlpa_n_EfpModSafe_Ay FORMAT "%5.2" MONOTONY STRICT_INCREASE DEPOSIT ABSOLUTE /end AXIS_DESCR
/end CHARACTERISTIC
/begin CHARACTERISTIC BMWlpsc_volf_FuEjrPmp_M "Map volume flow" MAP 0x8071CA10 _REC_A1CUR_1_MBSE_S2_S1 655.35 zBcBzad_vmoivka_mFzjCgc_lCRooa0 -327.68 327.67 FORMAT "%5.2"
 /begin AXIS_DESCR COM_AXIS BMWlpsc_p_EfpSpCtld_uw rgduxyd_mlihaBb_gsCghzb_bCRa0a0 8 0 65.535 AXIS_PTS_REF BMWlpsc_volf_FuEjrPmp_Ax FORMAT "%5.3" MONOTONY STRICT_INCREASE DEPOSIT ABSOLUTE /end AXIS_DESCR
 /begin AXIS_DESCR COM_AXIS BMWlpsc_st_TankCod_ub raChrxc_kBtBrmb_FmDuEFa_n__aa0o 4 0 255 AXIS_PTS_REF BMWlpsc_volf_FuEjrPmp_Ay FORMAT "%3.0" MONOTONY STRICT_INCREASE DEPOSIT ABSOLUTE /end AXIS_DESCR
/end CHARACTERISTIC
/begin CHARACTERISTIC BMWls_fac_rf_RednFuOctIntkT_M "Base value for the filling reduction factor depending on fuel quality and intake air temperature" MAP 0x80756657 _REC_A1CUR_1_MBSE_U1_S1 1 ggDviCc_uydFbsa_CDgnhgc_nR_2a0o 0 1 FORMAT "%6.4"
 /begin AXIS_DESCR COM_AXIS F_octan BMW_Powertrain_DxECompuMethods_Def_ub_b1_nounit 6 0 0.99609375 AXIS_PTS_REF BMWls_fac_rf_RednFuOctIntkT_Ax FORMAT "%6.1" MONOTONY STRICT_INCREASE DEPOSIT ABSOLUTE /end AXIS_DESCR
 /begin AXIS_DESCR COM_AXIS Tans BMW_q0p1_degC 6 -3276.8 3276.7 AXIS_PTS_REF BMWls_fac_rf_RednFuOctIntkT_Ay FORMAT "%6.1" MONOTONY STRICT_INCREASE DEPOSIT ABSOLUTE /end AXIS_DESCR
/end CHARACTERISTIC
/begin CHARACTERISTIC BMWls_pct_FiMaxIgOfs_M "Curve filling limitation depending on ignition angle retard" MAP 0x80721A48 _REC_A1CUR_1_MBSE_S2_S1 655.35 CgkBooc_wkiDfEd_Czglhgc_fR_1a0o -327.68 327.67 FORMAT "%7.2"
 /begin AXIS_DESCR COM_AXIS Nkw caoddzd_oAjpfzb_cAcEEha_1nR_oa0 10 -32768 32767 AXIS_PTS_REF BMWls_pct_FiMaxIgOfs_Gx FORMAT "%5.0" MONOTONY STRICT_INCREASE DEPOSIT ABSOLUTE /end AXIS_DESCR
 /begin AXIS_DESCR COM_AXIS Dzw_tot_kr BMW_q0p1_deg 8 -3276.8 3276.7 AXIS_PTS_REF BMWls_pct_FiMaxIgOfs_Gy FORMAT "%6.1" MONOTONY STRICT_INCREASE DEPOSIT ABSOLUTE /end AXIS_DESCR
/end CHARACTERISTIC
/begin CHARACTERISTIC BMWls_pct_FiMaxIgOfsSpt_M "Curve filling limitation depending on ignition angle retard in sport mode" MAP 0x80721AE8 _REC_A1CUR_1_MBSE_S2_S1 655.35 CgkBooc_wkiDfEd_Czglhgc_fR_1a0o -327.68 327.67 FORMAT "%7.2"
 /begin AXIS_DESCR COM_AXIS Nkw caoddzd_oAjpfzb_cAcEEha_1nR_oa0 10 -32768 32767 AXIS_PTS_REF BMWls_pct_FiMaxIgOfs_Gx FORMAT "%5.0" MONOTONY STRICT_INCREASE DEPOSIT ABSOLUTE /end AXIS_DESCR
 /begin AXIS_DESCR COM_AXIS Dzw_tot_kr BMW_q0p1_deg 8 -3276.8 3276.7 AXIS_PTS_REF BMWls_pct_FiMaxIgOfs_Gy FORMAT "%6.1" MONOTONY STRICT_INCREASE DEPOSIT ABSOLUTE /end AXIS_DESCR
/end CHARACTERISTIC
/begin CHARACTERISTIC BMWls_rf_MaxEgT_M "Maximum filling when limited by the component protection controller" MAP 0x80721A00 _REC_A1CUR_1_MBSE_S2_S1 655.35 ubqeuic_jteCkzd_CDglhgc_nR_1a0o -327.68 327.67 FORMAT "%7.2"
 /begin AXIS_DESCR COM_AXIS Nkw caoddzd_oAjpfzb_cAcEEha_1nR_oa0 6 -32768 32767 AXIS_PTS_REF BMWls_rf_MaxEgT_Ax FORMAT "%5.0" MONOTONY STRICT_INCREASE DEPOSIT ABSOLUTE /end AXIS_DESCR
 /begin AXIS_DESCR COM_AXIS Frfmxbsld Bhvfwhc_bigEubd_BBEupBd_nR_3oa0 6 0 1.99996948242188 AXIS_PTS_REF BMWls_rf_MaxEgT_Ay FORMAT "%14.5" MONOTONY STRICT_INCREASE DEPOSIT ABSOLUTE /end AXIS_DESCR
/end CHARACTERISTIC
/begin CHARACTERISTIC BMWls_rf_MaxFuOctIntkT_M "Maximum filling depending on engine speed and filling reduction factor at late combustion center positions due to poor fuel and high manifold temperatures" MAP 0x807218C0 _REC_A1CUR_1_MBSE_S2_S1 655.35 CgkBooc_wkiDfEd_Czglhgc_fR_1a0o -327.68 327.67 FORMAT "%7.2"
 /begin AXIS_DESCR COM_AXIS Nkw caoddzd_oAjpfzb_cAcEEha_1nR_oa0 10 -32768 32767 AXIS_PTS_REF BMWls_pct_FiMaxIgOfs_Gx FORMAT "%5.0" MONOTONY STRICT_INCREASE DEPOSIT ABSOLUTE /end AXIS_DESCR
 /begin AXIS_DESCR COM_AXIS BMWls_fac_rf_RedFil_uw FzbmlAa_gCtylrb_ckCqxAc_nR_6oa0 8 0 0.999984741210938 AXIS_PTS_REF BMWls_rf_MaxFuOctIntkT_Gy FORMAT "%7.5" MONOTONY STRICT_INCREASE DEPOSIT ABSOLUTE /end AXIS_DESCR
/end CHARACTERISTIC
/begin CHARACTERISTIC BMWls_rf_MaxFuOctIntkTSpt_M "Maximum filling depending on engine speed and filling reduction factor at late combustion center positions due to poor fuel and high manifold temperatures in sport mode" MAP 0x80721960 _REC_A1CUR_1_MBSE_S2_S1 655.35 CgkBooc_wkiDfEd_Czglhgc_fR_1a0o -327.68 327.67 FORMAT "%7.2"
 /begin AXIS_DESCR COM_AXIS Nkw caoddzd_oAjpfzb_cAcEEha_1nR_oa0 10 -32768 32767 AXIS_PTS_REF BMWls_pct_FiMaxIgOfs_Gx FORMAT "%5.0" MONOTONY STRICT_INCREASE DEPOSIT ABSOLUTE /end AXIS_DESCR
 /begin AXIS_DESCR COM_AXIS BMWls_fac_rf_RedFil_uw FzbmlAa_gCtylrb_ckCqxAc_nR_6oa0 8 0 0.999984741210938 AXIS_PTS_REF BMWls_rf_MaxFuOctIntkT_Gy FORMAT "%7.5" MONOTONY STRICT_INCREASE DEPOSIT ABSOLUTE /end AXIS_DESCR
/end CHARACTERISTIC
/begin CHARACTERISTIC BMWls_rf_MaxModEng_M "Filling cap for temporary limitation during launch control" MAP 0x807217C0 _REC_A1CUR_1_MBSE_S2_S1 655.35 CgkBooc_wkiDfEd_Czglhgc_fR_1a0o -327.68 327.67 FORMAT "%7.2"
 /begin AXIS_DESCR COM_AXIS Nkw caoddzd_oAjpfzb_cAcEEha_1nR_oa0 10 -32768 32767 AXIS_PTS_REF BMWls_pct_FiMaxIgOfs_Gx FORMAT "%5.0" MONOTONY STRICT_INCREASE DEPOSIT ABSOLUTE /end AXIS_DESCR
 /begin AXIS_DESCR COM_AXIS Dzw_tot_kr BMW_q0p1_deg 8 -3276.8 3276.7 AXIS_PTS_REF BMWls_pct_FiMaxIgOfs_Gy FORMAT "%6.1" MONOTONY STRICT_INCREASE DEPOSIT ABSOLUTE /end AXIS_DESCR
/end CHARACTERISTIC
/begin CHARACTERISTIC BMWtchctr_p_DifCrtnPp_M___MGF_CC_FF2_Slot4 "Pressure difference correction for P-component of power-based boost pressure controller (X-Axis does not switch, Slot 4, Flex Fuel 2)" MAP 0x807D04A0 _REC_A1CUR_1_MBSE_S2_S1 8191.875 BMW_p_sw_q0p125_hPa -4096 4095.875 FORMAT "%10.3"
 /begin AXIS_DESCR COM_AXIS BMWtchbas_p_Dif_sw BMW_p_sw_q0p125_hPa 12 -1000 1000 AXIS_PTS_REF BMWtchctr_p_DifCrtnPp_Ax DEPOSIT ABSOLUTE /end AXIS_DESCR
 /begin AXIS_DESCR COM_AXIS BMWtchsp_mf_Ex_uw CByjozc_eCmpBAb_pljBAmd_k__0oa0 6 0 2000 AXIS_PTS_REF BMWtchctr_p_DifCrtnPp_Ay___MGF_CC_FF2_Slot4 DEPOSIT ABSOLUTE /end AXIS_DESCR
/end CHARACTERISTIC
/begin CHARACTERISTIC BMWtchctr_p_DifCrtnPp_M___MGF_CC_PF_Slot0 "Pressure difference correction for P-component of power-based boost pressure controller (X-Axis does not switch, Slot 0, OEM Address)" MAP 0x807274D8 _REC_A1CUR_1_MBSE_S2_S1 8191.875 BMW_p_sw_q0p125_hPa -4096 4095.875 FORMAT "%10.3"
 /begin AXIS_DESCR COM_AXIS BMWtchbas_p_Dif_sw BMW_p_sw_q0p125_hPa 12 -1000 1000 AXIS_PTS_REF BMWtchctr_p_DifCrtnPp_Ax DEPOSIT ABSOLUTE /end AXIS_DESCR
 /begin AXIS_DESCR COM_AXIS BMWtchsp_mf_Ex_uw CByjozc_eCmpBAb_pljBAmd_k__0oa0 6 0 2000 AXIS_PTS_REF BMWtchctr_p_DifCrtnPp_Ay___MGF_CC_PF_Slot0 DEPOSIT ABSOLUTE /end AXIS_DESCR
/end CHARACTERISTIC
/begin CHARACTERISTIC BMWtchctr_p_DifCrtnPp_M___MGF_CC_PF_Slot1 "Pressure difference correction for P-component of power-based boost pressure controller (X-Axis does not switch, Slot 1, Pump Fuel)" MAP 0x807C0A48 _REC_A1CUR_1_MBSE_S2_S1 8191.875 BMW_p_sw_q0p125_hPa -4096 4095.875 FORMAT "%10.3"
 /begin AXIS_DESCR COM_AXIS BMWtchbas_p_Dif_sw BMW_p_sw_q0p125_hPa 12 -1000 1000 AXIS_PTS_REF BMWtchctr_p_DifCrtnPp_Ax DEPOSIT ABSOLUTE /end AXIS_DESCR
 /begin AXIS_DESCR COM_AXIS BMWtchsp_mf_Ex_uw CByjozc_eCmpBAb_pljBAmd_k__0oa0 6 0 2000 AXIS_PTS_REF BMWtchctr_p_DifCrtnPp_Ay___MGF_CC_PF_Slot1 DEPOSIT ABSOLUTE /end AXIS_DESCR
/end CHARACTERISTIC
/begin CHARACTERISTIC BMWtchctr_pct_WgBasc_M___MGF_CC_FF2_Slot4 "Wastegate position - for feedforward control (Slot 4, Flex Fuel 2)" MAP 0x807D09B0 _REC_A1CUR_1_MBSE_U2_S1 99.9984741210938 wDDoctd_cCDyaFa_AvCkvFb_nR_6o0o 0 99.9984741210938 FORMAT "%10.3"
 /begin AXIS_DESCR COM_AXIS NO_INPUT_QUANTITY ilxsavd_hkzmBfc_lAzCpAb_nR_1oa0 12 0 3.99993896484375 AXIS_PTS_REF BMWtchctr_pct_WgBasc_Ax FORMAT "%14.5" MONOTONY STRICT_INCREASE DEPOSIT ABSOLUTE /end AXIS_DESCR
 /begin AXIS_DESCR COM_AXIS NO_INPUT_QUANTITY ECeoxdb_wFseCtb_mEytEnb_k__o8a0 12 0 2559.9609375 AXIS_PTS_REF BMWtchctr_pct_WgBasc_Ay FORMAT "%10.3" MONOTONY STRICT_INCREASE DEPOSIT ABSOLUTE /end AXIS_DESCR
/end CHARACTERISTIC
/begin CHARACTERISTIC BMWtchctr_pct_WgBasc_M___MGF_CC_PF_Slot0 "Wastegate position - for feedforward control (Slot 0, OEM Address)" MAP 0x807479C4 _REC_A1CUR_1_MBSE_U2_S1 99.9984741210938 wDDoctd_cCDyaFa_AvCkvFb_nR_6o0o 0 99.9984741210938 FORMAT "%10.3"
 /begin AXIS_DESCR COM_AXIS NO_INPUT_QUANTITY ilxsavd_hkzmBfc_lAzCpAb_nR_1oa0 12 0 3.99993896484375 AXIS_PTS_REF BMWtchctr_pct_WgBasc_Ax FORMAT "%14.5" MONOTONY STRICT_INCREASE DEPOSIT ABSOLUTE /end AXIS_DESCR
 /begin AXIS_DESCR COM_AXIS NO_INPUT_QUANTITY ECeoxdb_wFseCtb_mEytEnb_k__o8a0 12 0 2559.9609375 AXIS_PTS_REF BMWtchctr_pct_WgBasc_Ay FORMAT "%10.3" MONOTONY STRICT_INCREASE DEPOSIT ABSOLUTE /end AXIS_DESCR
/end CHARACTERISTIC
/begin CHARACTERISTIC BMWtchctr_pct_WgBasc_M___MGF_CC_PF_Slot1 "Wastegate position - for feedforward control (Slot 1, Pump Fuel)" MAP 0x807C0C88 _REC_A1CUR_1_MBSE_U2_S1 99.9984741210938 wDDoctd_cCDyaFa_AvCkvFb_nR_6o0o 0 99.9984741210938 FORMAT "%10.3"
 /begin AXIS_DESCR COM_AXIS NO_INPUT_QUANTITY ilxsavd_hkzmBfc_lAzCpAb_nR_1oa0 12 0 3.99993896484375 AXIS_PTS_REF BMWtchctr_pct_WgBasc_Ax FORMAT "%14.5" MONOTONY STRICT_INCREASE DEPOSIT ABSOLUTE /end AXIS_DESCR
 /begin AXIS_DESCR COM_AXIS NO_INPUT_QUANTITY ECeoxdb_wFseCtb_mEytEnb_k__o8a0 12 0 2559.9609375 AXIS_PTS_REF BMWtchctr_pct_WgBasc_Ay FORMAT "%10.3" MONOTONY STRICT_INCREASE DEPOSIT ABSOLUTE /end AXIS_DESCR
/end CHARACTERISTIC
/begin CHARACTERISTIC BMWtchctr_pwr_Dp_M___MGF_CC_FF2_Slot4 "D-component of the power-based boost pressure controller (X-Axis and Y-Axis do not switch, Slot 4, Flex Fuel 2)" MAP 0x807D10F0 _REC_A1CUR_1_MBSE_S2_S1 127.998046875 jucyrzb_bpFgwfd_uqrfhgc_k__aoa0 -64 63.998046875 FORMAT "%10.3"
 /begin AXIS_DESCR COM_AXIS BMWtchbas_p_Dif_sw BMW_p_sw_q0p125_hPa 14 -4096 4095.875 AXIS_PTS_REF BMWtchctr_pwr_Dp_Ax FORMAT "%10.3" MONOTONY STRICT_INCREASE DEPOSIT ABSOLUTE /end AXIS_DESCR
 /begin AXIS_DESCR COM_AXIS BMWtchbas_p_DifGra_sw BMW_p_sw_q0p125_hPa 14 -4096 4095.875 AXIS_PTS_REF BMWtchctr_pwr_Dp_Ay FORMAT "%10.3" MONOTONY STRICT_INCREASE DEPOSIT ABSOLUTE /end AXIS_DESCR
/end CHARACTERISTIC
/begin CHARACTERISTIC BMWtchctr_pwr_Dp_M___MGF_CC_PF_Slot0 "D-component of the power-based boost pressure controller (X-Axis and Y-Axis do not switch, Slot 0, OEM Address)" MAP 0x80727230 _REC_A1CUR_1_MBSE_S2_S1 127.998046875 jucyrzb_bpFgwfd_uqrfhgc_k__aoa0 -64 63.998046875 FORMAT "%10.3"
 /begin AXIS_DESCR COM_AXIS BMWtchbas_p_Dif_sw BMW_p_sw_q0p125_hPa 14 -4096 4095.875 AXIS_PTS_REF BMWtchctr_pwr_Dp_Ax FORMAT "%10.3" MONOTONY STRICT_INCREASE DEPOSIT ABSOLUTE /end AXIS_DESCR
 /begin AXIS_DESCR COM_AXIS BMWtchbas_p_DifGra_sw BMW_p_sw_q0p125_hPa 14 -4096 4095.875 AXIS_PTS_REF BMWtchctr_pwr_Dp_Ay FORMAT "%10.3" MONOTONY STRICT_INCREASE DEPOSIT ABSOLUTE /end AXIS_DESCR
/end CHARACTERISTIC
/begin CHARACTERISTIC BMWtchctr_pwr_Dp_M___MGF_CC_PF_Slot1 "D-component of the power-based boost pressure controller (X-Axis and Y-Axis do not switch, Slot 1, Pump Fuel)" MAP 0x807C1108 _REC_A1CUR_1_MBSE_S2_S1 127.998046875 jucyrzb_bpFgwfd_uqrfhgc_k__aoa0 -64 63.998046875 FORMAT "%10.3"
 /begin AXIS_DESCR COM_AXIS BMWtchbas_p_Dif_sw BMW_p_sw_q0p125_hPa 14 -4096 4095.875 AXIS_PTS_REF BMWtchctr_pwr_Dp_Ax FORMAT "%10.3" MONOTONY STRICT_INCREASE DEPOSIT ABSOLUTE /end AXIS_DESCR
 /begin AXIS_DESCR COM_AXIS BMWtchbas_p_DifGra_sw BMW_p_sw_q0p125_hPa 14 -4096 4095.875 AXIS_PTS_REF BMWtchctr_pwr_Dp_Ay FORMAT "%10.3" MONOTONY STRICT_INCREASE DEPOSIT ABSOLUTE /end AXIS_DESCR
/end CHARACTERISTIC
/begin CHARACTERISTIC BMWtchctr_pwr_PctlWideRng_M___MGF_CC_FF2_Slot4 "Compressor map with required compressor / turbine power (X-Axis does not switch, Slot 4, Flex Fuel 2)" MAP 0x807D9762 _REC_A1CUR_1_MBSE_U2_S1 127.998046875 jucyrzb_bpFgwfd_uqrfhgc_k__aoa0 0 127.998046875 FORMAT "%11.4"
 /begin AXIS_DESCR COM_AXIS BMWtchsp_rat_p_CmprLim_uw acriqBc_tfkBqod_ocgjxzc_nR_8oa0 20 0 5 AXIS_PTS_REF BMWtchctr_pwr_Pctl_Ax___MGF_CC_FF2_Slot4 DEPOSIT ABSOLUTE /end AXIS_DESCR
 /begin AXIS_DESCR COM_AXIS BMWtchsp_mf_CmprNormWideRng_uw wpxDCba_sgbvDxb_FliBAmd_k__0oa0 16 0 2000 AXIS_PTS_REF BMWtchctr_pwr_PctlWideRng_Ay___MGF_CC_FF2_Slot4 DEPOSIT ABSOLUTE /end AXIS_DESCR
/end CHARACTERISTIC
/begin CHARACTERISTIC BMWtchctr_pwr_PctlWideRng_M___MGF_CC_PF_Slot0 "Compressor map with required compressor / turbine power (X-Axis does not switch, Slot 0, OEM Address)" MAP 0x80726FB0 _REC_A1CUR_1_MBSE_U2_S1 127.998046875 jucyrzb_bpFgwfd_uqrfhgc_k__aoa0 0 127.998046875 FORMAT "%11.4"
 /begin AXIS_DESCR COM_AXIS BMWtchsp_rat_p_CmprLim_uw acriqBc_tfkBqod_ocgjxzc_nR_8oa0 20 0 5 AXIS_PTS_REF BMWtchctr_pwr_Pctl_Ax___MGF_CC_PF_Slot0 DEPOSIT ABSOLUTE /end AXIS_DESCR
 /begin AXIS_DESCR COM_AXIS BMWtchsp_mf_CmprNormWideRng_uw wpxDCba_sgbvDxb_FliBAmd_k__0oa0 16 0 2000 AXIS_PTS_REF BMWtchctr_pwr_PctlWideRng_Ay___MGF_CC_PF_Slot0 DEPOSIT ABSOLUTE /end AXIS_DESCR
/end CHARACTERISTIC
/begin CHARACTERISTIC BMWtchctr_pwr_PctlWideRng_M___MGF_CC_PF_Slot1 "Compressor map with required compressor / turbine power (X-Axis does not switch, Slot 1, Pump Fuel)" MAP 0x807DA662 _REC_A1CUR_1_MBSE_U2_S1 127.998046875 jucyrzb_bpFgwfd_uqrfhgc_k__aoa0 0 127.998046875 FORMAT "%11.4"
 /begin AXIS_DESCR COM_AXIS BMWtchsp_rat_p_CmprLim_uw acriqBc_tfkBqod_ocgjxzc_nR_8oa0 20 0 5 AXIS_PTS_REF BMWtchctr_pwr_Pctl_Ax___MGF_CC_PF_Slot1 DEPOSIT ABSOLUTE /end AXIS_DESCR
 /begin AXIS_DESCR COM_AXIS BMWtchsp_mf_CmprNormWideRng_uw wpxDCba_sgbvDxb_FliBAmd_k__0oa0 16 0 2000 AXIS_PTS_REF BMWtchctr_pwr_PctlWideRng_Ay___MGF_CC_PF_Slot1 DEPOSIT ABSOLUTE /end AXIS_DESCR
/end CHARACTERISTIC
/begin CHARACTERISTIC BMWtchsp_rat_p_CmprMax_M___MGF_CC_PF_Slot0 "Max allowed compressor pressure ratio (model-based) (Slot 0, OEM Address)" MAP 0x807281F4 _REC_A1CUR_1_MBSE_U2_S1 3.99993896484375 ilxsavd_hkzmBfc_lAzCpAb_nR_1oa0 0 3.99993896484375
 /begin AXIS_DESCR COM_AXIS BMWtchsp_mf_CmprNorm_uw wpxDCba_sgbvDxb_FliBAmd_k__0oa0 8 0 4095.9375 AXIS_PTS_REF BMWtchsp_rat_p_CmprMax_Ax FORMAT "%10.3" MONOTONY STRICT_INCREASE DEPOSIT ABSOLUTE /end AXIS_DESCR
 /begin AXIS_DESCR COM_AXIS BMWtchtbc_t_BefCmpr_sw BMW_q0p1_degC 6 -3276.8 3276.7 AXIS_PTS_REF BMWtchsp_rat_p_CmprMax_Ay FORMAT "%6.1" MONOTONY STRICT_INCREASE DEPOSIT ABSOLUTE /end AXIS_DESCR
/end CHARACTERISTIC
/begin CHARACTERISTIC BMWtchsp_rat_p_CmprMax_M___MGF_CC_PF_Slot1 "Max allowed compressor pressure ratio (model-based) (Slot 1, Pump Fuel)" MAP 0x807C2250 _REC_A1CUR_1_MBSE_U2_S1 3.99993896484375 ilxsavd_hkzmBfc_lAzCpAb_nR_1oa0 0 3.99993896484375
 /begin AXIS_DESCR COM_AXIS BMWtchsp_mf_CmprNorm_uw wpxDCba_sgbvDxb_FliBAmd_k__0oa0 8 0 4095.9375 AXIS_PTS_REF BMWtchsp_rat_p_CmprMax_Ax FORMAT "%10.3" MONOTONY STRICT_INCREASE DEPOSIT ABSOLUTE /end AXIS_DESCR
 /begin AXIS_DESCR COM_AXIS BMWtchtbc_t_BefCmpr_sw BMW_q0p1_degC 6 -3276.8 3276.7 AXIS_PTS_REF BMWtchsp_rat_p_CmprMax_Ay FORMAT "%6.1" MONOTONY STRICT_INCREASE DEPOSIT ABSOLUTE /end AXIS_DESCR
/end CHARACTERISTIC
/begin CHARACTERISTIC IKCtl_facKnkRtdtCyl0_M "Retard per knock event for cylinder 0" MAP 0x807A21FE RB_Map_S16U8_S8 6 kw_q0p75 -6 0 FORMAT "%5.3"
 /begin AXIS_DESCR STD_AXIS Epm_nEng EngN 8 -16384 16383.5 FORMAT "%8.2" DEPOSIT ABSOLUTE /end AXIS_DESCR
 /begin AXIS_DESCR STD_AXIS IKCtl_facKnkInten_u8 fak_ub_b16 4 0 15.94 FORMAT "%5.2" DEPOSIT ABSOLUTE /end AXIS_DESCR
/end CHARACTERISTIC
/begin CHARACTERISTIC IKCtl_facKnkRtdtCyl1_M "Retard per knock event for cylinder 1" MAP 0x807A2236 RB_Map_S16U8_S8 6 kw_q0p75 -6 0 FORMAT "%5.3"
 /begin AXIS_DESCR STD_AXIS Epm_nEng EngN 8 -16384 16383.5 FORMAT "%8.2" DEPOSIT ABSOLUTE /end AXIS_DESCR
 /begin AXIS_DESCR STD_AXIS IKCtl_facKnkInten_u8 fak_ub_b16 4 0 15.94 FORMAT "%5.2" DEPOSIT ABSOLUTE /end AXIS_DESCR
/end CHARACTERISTIC
/begin CHARACTERISTIC IKCtl_facKnkRtdtCyl2_M "Retard per knock event for cylinder 2" MAP 0x807A226E RB_Map_S16U8_S8 6 kw_q0p75 -6 0 FORMAT "%5.3"
 /begin AXIS_DESCR STD_AXIS Epm_nEng EngN 8 -16384 16383.5 FORMAT "%8.2" DEPOSIT ABSOLUTE /end AXIS_DESCR
 /begin AXIS_DESCR STD_AXIS IKCtl_facKnkInten_u8 fak_ub_b16 4 0 15.94 FORMAT "%5.2" DEPOSIT ABSOLUTE /end AXIS_DESCR
/end CHARACTERISTIC
/begin CHARACTERISTIC IKCtl_facKnkRtdtCyl3_M "Retard per knock event for cylinder 3" MAP 0x807A22A6 RB_Map_S16U8_S8 6 kw_q0p75 -6 0 FORMAT "%5.3"
 /begin AXIS_DESCR STD_AXIS Epm_nEng EngN 8 -16384 16383.5 FORMAT "%8.2" DEPOSIT ABSOLUTE /end AXIS_DESCR
 /begin AXIS_DESCR STD_AXIS IKCtl_facKnkInten_u8 fak_ub_b16 4 0 15.94 FORMAT "%5.2" DEPOSIT ABSOLUTE /end AXIS_DESCR
/end CHARACTERISTIC
/begin CHARACTERISTIC IKCtl_facKnkRtdtCyl4_M "Retard per knock event for cylinder 4" MAP 0x807A22DE RB_Map_S16U8_S8 6 kw_q0p75 -6 0 FORMAT "%5.3"
 /begin AXIS_DESCR STD_AXIS Epm_nEng EngN 8 -16384 16383.5 FORMAT "%8.2" DEPOSIT ABSOLUTE /end AXIS_DESCR
 /begin AXIS_DESCR STD_AXIS IKCtl_facKnkInten_u8 fak_ub_b16 4 0 15.94 FORMAT "%5.2" DEPOSIT ABSOLUTE /end AXIS_DESCR
/end CHARACTERISTIC
/begin CHARACTERISTIC IKCtl_facKnkRtdtCyl5_M "Retard per knock event for cylinder 5" MAP 0x807A2316 RB_Map_S16U8_S8 6 kw_q0p75 -6 0 FORMAT "%5.3"
 /begin AXIS_DESCR STD_AXIS Epm_nEng EngN 8 -16384 16383.5 FORMAT "%8.2" DEPOSIT ABSOLUTE /end AXIS_DESCR
 /begin AXIS_DESCR STD_AXIS IKCtl_facKnkInten_u8 fak_ub_b16 4 0 15.94 FORMAT "%5.2" DEPOSIT ABSOLUTE /end AXIS_DESCR
/end CHARACTERISTIC
/begin CHARACTERISTIC IKCtl_FacKnockDetThd0_GM "Knock detection factor map cylinder counter 0" MAP 0x807A19B6 FklWUb 3.438 fak_ub_b16 0.0625 3.5 FORMAT "%5.3"
 /begin AXIS_DESCR COM_AXIS Epm_nEng EngN 16 -16384 16383.5 AXIS_PTS_REF IKCtl_nEngB16_X_AX FORMAT "%8.2" DEPOSIT ABSOLUTE /end AXIS_DESCR
 /begin AXIS_DESCR COM_AXIS AirMod_ratChrgAirCyl rel_q0p0234 4 0 1535.977 AXIS_PTS_REF IKCtl_ratLoadAddl04_X_AX FORMAT "%8.3" DEPOSIT ABSOLUTE /end AXIS_DESCR
/end CHARACTERISTIC
/begin CHARACTERISTIC IKCtl_FacKnockDetThd0_GM___MGF_CC_FF2_Slot4 "Knock detection factor map cylinder counter 0 (Slot 4, Flex Fuel 2)" MAP 0x807D4E42 FklWUb 3.438 fak_ub_b16 0.0625 3.5 FORMAT "%5.3"
 /begin AXIS_DESCR COM_AXIS Epm_nEng EngN 16 -16384 16383.5 AXIS_PTS_REF IKCtl_nEngB16_X_AX FORMAT "%8.2" DEPOSIT ABSOLUTE /end AXIS_DESCR
 /begin AXIS_DESCR COM_AXIS AirMod_ratChrgAirCyl rel_q0p0234 4 0 1535.977 AXIS_PTS_REF IKCtl_ratLoadAddl04_X_AX FORMAT "%8.3" DEPOSIT ABSOLUTE /end AXIS_DESCR
/end CHARACTERISTIC
/begin CHARACTERISTIC IKCtl_FacKnockDetThd0_GM___MGF_CC_PF_Slot0 "Knock detection factor map cylinder counter 0 (Slot 0, OEM Address)" MAP 0x807A19B6 FklWUb 3.438 fak_ub_b16 0.0625 3.5 FORMAT "%5.3"
 /begin AXIS_DESCR COM_AXIS Epm_nEng EngN 16 -16384 16383.5 AXIS_PTS_REF IKCtl_nEngB16_X_AX FORMAT "%8.2" DEPOSIT ABSOLUTE /end AXIS_DESCR
 /begin AXIS_DESCR COM_AXIS AirMod_ratChrgAirCyl rel_q0p0234 4 0 1535.977 AXIS_PTS_REF IKCtl_ratLoadAddl04_X_AX FORMAT "%8.3" DEPOSIT ABSOLUTE /end AXIS_DESCR
/end CHARACTERISTIC
/begin CHARACTERISTIC IKCtl_FacKnockDetThd0_GM___MGF_CC_PF_Slot1 "Knock detection factor map cylinder counter 0 (Slot 1, Pump Fuel)" MAP 0x807CBD3E FklWUb 3.438 fak_ub_b16 0.0625 3.5 FORMAT "%5.3"
 /begin AXIS_DESCR COM_AXIS Epm_nEng EngN 16 -16384 16383.5 AXIS_PTS_REF IKCtl_nEngB16_X_AX FORMAT "%8.2" DEPOSIT ABSOLUTE /end AXIS_DESCR
 /begin AXIS_DESCR COM_AXIS AirMod_ratChrgAirCyl rel_q0p0234 4 0 1535.977 AXIS_PTS_REF IKCtl_ratLoadAddl04_X_AX FORMAT "%8.3" DEPOSIT ABSOLUTE /end AXIS_DESCR
/end CHARACTERISTIC
/begin CHARACTERISTIC IKCtl_FacKnockDetThd1_GM "Knock detection factor map cylinder counter 1" MAP 0x807A19F6 FklWUb 3.438 fak_ub_b16 0.0625 3.5 FORMAT "%5.3"
 /begin AXIS_DESCR COM_AXIS Epm_nEng EngN 16 -16384 16383.5 AXIS_PTS_REF IKCtl_nEngB16_X_AX FORMAT "%8.2" DEPOSIT ABSOLUTE /end AXIS_DESCR
 /begin AXIS_DESCR COM_AXIS AirMod_ratChrgAirCyl rel_q0p0234 4 0 1535.977 AXIS_PTS_REF IKCtl_ratLoadAddl04_X_AX FORMAT "%8.3" DEPOSIT ABSOLUTE /end AXIS_DESCR
/end CHARACTERISTIC
/begin CHARACTERISTIC IKCtl_FacKnockDetThd1_GM___MGF_CC_FF2_Slot4 "Knock detection factor map cylinder counter 1 (Slot 4, Flex Fuel 2)" MAP 0x807D4F82 FklWUb 3.438 fak_ub_b16 0.0625 3.5 FORMAT "%5.3"
 /begin AXIS_DESCR COM_AXIS Epm_nEng EngN 16 -16384 16383.5 AXIS_PTS_REF IKCtl_nEngB16_X_AX FORMAT "%8.2" DEPOSIT ABSOLUTE /end AXIS_DESCR
 /begin AXIS_DESCR COM_AXIS AirMod_ratChrgAirCyl rel_q0p0234 4 0 1535.977 AXIS_PTS_REF IKCtl_ratLoadAddl04_X_AX FORMAT "%8.3" DEPOSIT ABSOLUTE /end AXIS_DESCR
/end CHARACTERISTIC
/begin CHARACTERISTIC IKCtl_FacKnockDetThd1_GM___MGF_CC_PF_Slot0 "Knock detection factor map cylinder counter 1 (Slot 0, OEM Address)" MAP 0x807A19F6 FklWUb 3.438 fak_ub_b16 0.0625 3.5 FORMAT "%5.3"
 /begin AXIS_DESCR COM_AXIS Epm_nEng EngN 16 -16384 16383.5 AXIS_PTS_REF IKCtl_nEngB16_X_AX FORMAT "%8.2" DEPOSIT ABSOLUTE /end AXIS_DESCR
 /begin AXIS_DESCR COM_AXIS AirMod_ratChrgAirCyl rel_q0p0234 4 0 1535.977 AXIS_PTS_REF IKCtl_ratLoadAddl04_X_AX FORMAT "%8.3" DEPOSIT ABSOLUTE /end AXIS_DESCR
/end CHARACTERISTIC
/begin CHARACTERISTIC IKCtl_FacKnockDetThd1_GM___MGF_CC_PF_Slot1 "Knock detection factor map cylinder counter 1 (Slot 1, Pump Fuel)" MAP 0x807CBF7E FklWUb 3.438 fak_ub_b16 0.0625 3.5 FORMAT "%5.3"
 /begin AXIS_DESCR COM_AXIS Epm_nEng EngN 16 -16384 16383.5 AXIS_PTS_REF IKCtl_nEngB16_X_AX FORMAT "%8.2" DEPOSIT ABSOLUTE /end AXIS_DESCR
 /begin AXIS_DESCR COM_AXIS AirMod_ratChrgAirCyl rel_q0p0234 4 0 1535.977 AXIS_PTS_REF IKCtl_ratLoadAddl04_X_AX FORMAT "%8.3" DEPOSIT ABSOLUTE /end AXIS_DESCR
/end CHARACTERISTIC
/begin CHARACTERISTIC IKCtl_FacKnockDetThd2_GM "Knock detection factor map cylinder counter 2" MAP 0x807A1A36 FklWUb 3.438 fak_ub_b16 0.0625 3.5 FORMAT "%5.3"
 /begin AXIS_DESCR COM_AXIS Epm_nEng EngN 16 -16384 16383.5 AXIS_PTS_REF IKCtl_nEngB16_X_AX FORMAT "%8.2" DEPOSIT ABSOLUTE /end AXIS_DESCR
 /begin AXIS_DESCR COM_AXIS AirMod_ratChrgAirCyl rel_q0p0234 4 0 1535.977 AXIS_PTS_REF IKCtl_ratLoadAddl04_X_AX FORMAT "%8.3" DEPOSIT ABSOLUTE /end AXIS_DESCR
/end CHARACTERISTIC
/begin CHARACTERISTIC IKCtl_FacKnockDetThd2_GM___MGF_CC_FF2_Slot4 "Knock detection factor map cylinder counter 2 (Slot 4, Flex Fuel 2)" MAP 0x807D50C2 FklWUb 3.438 fak_ub_b16 0.0625 3.5 FORMAT "%5.3"
 /begin AXIS_DESCR COM_AXIS Epm_nEng EngN 16 -16384 16383.5 AXIS_PTS_REF IKCtl_nEngB16_X_AX FORMAT "%8.2" DEPOSIT ABSOLUTE /end AXIS_DESCR
 /begin AXIS_DESCR COM_AXIS AirMod_ratChrgAirCyl rel_q0p0234 4 0 1535.977 AXIS_PTS_REF IKCtl_ratLoadAddl04_X_AX FORMAT "%8.3" DEPOSIT ABSOLUTE /end AXIS_DESCR
/end CHARACTERISTIC
/begin CHARACTERISTIC IKCtl_FacKnockDetThd2_GM___MGF_CC_PF_Slot0 "Knock detection factor map cylinder counter 2 (Slot 0, OEM Address)" MAP 0x807A1A36 FklWUb 3.438 fak_ub_b16 0.0625 3.5 FORMAT "%5.3"
 /begin AXIS_DESCR COM_AXIS Epm_nEng EngN 16 -16384 16383.5 AXIS_PTS_REF IKCtl_nEngB16_X_AX FORMAT "%8.2" DEPOSIT ABSOLUTE /end AXIS_DESCR
 /begin AXIS_DESCR COM_AXIS AirMod_ratChrgAirCyl rel_q0p0234 4 0 1535.977 AXIS_PTS_REF IKCtl_ratLoadAddl04_X_AX FORMAT "%8.3" DEPOSIT ABSOLUTE /end AXIS_DESCR
/end CHARACTERISTIC
/begin CHARACTERISTIC IKCtl_FacKnockDetThd2_GM___MGF_CC_PF_Slot1 "Knock detection factor map cylinder counter 2 (Slot 1, Pump Fuel)" MAP 0x807CC1BE FklWUb 3.438 fak_ub_b16 0.0625 3.5 FORMAT "%5.3"
 /begin AXIS_DESCR COM_AXIS Epm_nEng EngN 16 -16384 16383.5 AXIS_PTS_REF IKCtl_nEngB16_X_AX FORMAT "%8.2" DEPOSIT ABSOLUTE /end AXIS_DESCR
 /begin AXIS_DESCR COM_AXIS AirMod_ratChrgAirCyl rel_q0p0234 4 0 1535.977 AXIS_PTS_REF IKCtl_ratLoadAddl04_X_AX FORMAT "%8.3" DEPOSIT ABSOLUTE /end AXIS_DESCR
/end CHARACTERISTIC
/begin CHARACTERISTIC IKCtl_FacKnockDetThd3_GM "Knock detection factor map cylinder counter 3" MAP 0x807A1A76 FklWUb 3.438 fak_ub_b16 0.0625 3.5 FORMAT "%5.3"
 /begin AXIS_DESCR COM_AXIS Epm_nEng EngN 16 -16384 16383.5 AXIS_PTS_REF IKCtl_nEngB16_X_AX FORMAT "%8.2" DEPOSIT ABSOLUTE /end AXIS_DESCR
 /begin AXIS_DESCR COM_AXIS AirMod_ratChrgAirCyl rel_q0p0234 4 0 1535.977 AXIS_PTS_REF IKCtl_ratLoadAddl04_X_AX FORMAT "%8.3" DEPOSIT ABSOLUTE /end AXIS_DESCR
/end CHARACTERISTIC
/begin CHARACTERISTIC IKCtl_FacKnockDetThd3_GM___MGF_CC_FF2_Slot4 "Knock detection factor map cylinder counter 3 (Slot 4, Flex Fuel 2)" MAP 0x807D5202 FklWUb 3.438 fak_ub_b16 0.0625 3.5 FORMAT "%5.3"
 /begin AXIS_DESCR COM_AXIS Epm_nEng EngN 16 -16384 16383.5 AXIS_PTS_REF IKCtl_nEngB16_X_AX FORMAT "%8.2" DEPOSIT ABSOLUTE /end AXIS_DESCR
 /begin AXIS_DESCR COM_AXIS AirMod_ratChrgAirCyl rel_q0p0234 4 0 1535.977 AXIS_PTS_REF IKCtl_ratLoadAddl04_X_AX FORMAT "%8.3" DEPOSIT ABSOLUTE /end AXIS_DESCR
/end CHARACTERISTIC
/begin CHARACTERISTIC IKCtl_FacKnockDetThd3_GM___MGF_CC_PF_Slot0 "Knock detection factor map cylinder counter 3 (Slot 0, OEM Address)" MAP 0x807A1A76 FklWUb 3.438 fak_ub_b16 0.0625 3.5 FORMAT "%5.3"
 /begin AXIS_DESCR COM_AXIS Epm_nEng EngN 16 -16384 16383.5 AXIS_PTS_REF IKCtl_nEngB16_X_AX FORMAT "%8.2" DEPOSIT ABSOLUTE /end AXIS_DESCR
 /begin AXIS_DESCR COM_AXIS AirMod_ratChrgAirCyl rel_q0p0234 4 0 1535.977 AXIS_PTS_REF IKCtl_ratLoadAddl04_X_AX FORMAT "%8.3" DEPOSIT ABSOLUTE /end AXIS_DESCR
/end CHARACTERISTIC
/begin CHARACTERISTIC IKCtl_FacKnockDetThd3_GM___MGF_CC_PF_Slot1 "Knock detection factor map cylinder counter 3 (Slot 1, Pump Fuel)" MAP 0x807CC3FE FklWUb 3.438 fak_ub_b16 0.0625 3.5 FORMAT "%5.3"
 /begin AXIS_DESCR COM_AXIS Epm_nEng EngN 16 -16384 16383.5 AXIS_PTS_REF IKCtl_nEngB16_X_AX FORMAT "%8.2" DEPOSIT ABSOLUTE /end AXIS_DESCR
 /begin AXIS_DESCR COM_AXIS AirMod_ratChrgAirCyl rel_q0p0234 4 0 1535.977 AXIS_PTS_REF IKCtl_ratLoadAddl04_X_AX FORMAT "%8.3" DEPOSIT ABSOLUTE /end AXIS_DESCR
/end CHARACTERISTIC
/begin CHARACTERISTIC IKCtl_FacKnockDetThd4_GM "Knock detection factor map cylinder counter 4" MAP 0x807A1AB6 FklWUb 3.438 fak_ub_b16 0.0625 3.5 FORMAT "%5.3"
 /begin AXIS_DESCR COM_AXIS Epm_nEng EngN 16 -16384 16383.5 AXIS_PTS_REF IKCtl_nEngB16_X_AX FORMAT "%8.2" DEPOSIT ABSOLUTE /end AXIS_DESCR
 /begin AXIS_DESCR COM_AXIS AirMod_ratChrgAirCyl rel_q0p0234 4 0 1535.977 AXIS_PTS_REF IKCtl_ratLoadAddl04_X_AX FORMAT "%8.3" DEPOSIT ABSOLUTE /end AXIS_DESCR
/end CHARACTERISTIC
/begin CHARACTERISTIC IKCtl_FacKnockDetThd4_GM___MGF_CC_FF2_Slot4 "Knock detection factor map cylinder counter 4 (Slot 4, Flex Fuel 2)" MAP 0x807D5342 FklWUb 3.438 fak_ub_b16 0.0625 3.5 FORMAT "%5.3"
 /begin AXIS_DESCR COM_AXIS Epm_nEng EngN 16 -16384 16383.5 AXIS_PTS_REF IKCtl_nEngB16_X_AX FORMAT "%8.2" DEPOSIT ABSOLUTE /end AXIS_DESCR
 /begin AXIS_DESCR COM_AXIS AirMod_ratChrgAirCyl rel_q0p0234 4 0 1535.977 AXIS_PTS_REF IKCtl_ratLoadAddl04_X_AX FORMAT "%8.3" DEPOSIT ABSOLUTE /end AXIS_DESCR
/end CHARACTERISTIC
/begin CHARACTERISTIC IKCtl_FacKnockDetThd4_GM___MGF_CC_PF_Slot0 "Knock detection factor map cylinder counter 4 (Slot 0, OEM Address)" MAP 0x807A1AB6 FklWUb 3.438 fak_ub_b16 0.0625 3.5 FORMAT "%5.3"
 /begin AXIS_DESCR COM_AXIS Epm_nEng EngN 16 -16384 16383.5 AXIS_PTS_REF IKCtl_nEngB16_X_AX FORMAT "%8.2" DEPOSIT ABSOLUTE /end AXIS_DESCR
 /begin AXIS_DESCR COM_AXIS AirMod_ratChrgAirCyl rel_q0p0234 4 0 1535.977 AXIS_PTS_REF IKCtl_ratLoadAddl04_X_AX FORMAT "%8.3" DEPOSIT ABSOLUTE /end AXIS_DESCR
/end CHARACTERISTIC
/begin CHARACTERISTIC IKCtl_FacKnockDetThd4_GM___MGF_CC_PF_Slot1 "Knock detection factor map cylinder counter 4 (Slot 1, Pump Fuel)" MAP 0x807CC63E FklWUb 3.438 fak_ub_b16 0.0625 3.5 FORMAT "%5.3"
 /begin AXIS_DESCR COM_AXIS Epm_nEng EngN 16 -16384 16383.5 AXIS_PTS_REF IKCtl_nEngB16_X_AX FORMAT "%8.2" DEPOSIT ABSOLUTE /end AXIS_DESCR
 /begin AXIS_DESCR COM_AXIS AirMod_ratChrgAirCyl rel_q0p0234 4 0 1535.977 AXIS_PTS_REF IKCtl_ratLoadAddl04_X_AX FORMAT "%8.3" DEPOSIT ABSOLUTE /end AXIS_DESCR
/end CHARACTERISTIC
/begin CHARACTERISTIC IKCtl_FacKnockDetThd5_GM "Knock detection factor map cylinder counter 5" MAP 0x807A1AF6 FklWUb 3.438 fak_ub_b16 0.0625 3.5 FORMAT "%5.3"
 /begin AXIS_DESCR COM_AXIS Epm_nEng EngN 16 -16384 16383.5 AXIS_PTS_REF IKCtl_nEngB16_X_AX FORMAT "%8.2" DEPOSIT ABSOLUTE /end AXIS_DESCR
 /begin AXIS_DESCR COM_AXIS AirMod_ratChrgAirCyl rel_q0p0234 4 0 1535.977 AXIS_PTS_REF IKCtl_ratLoadAddl04_X_AX FORMAT "%8.3" DEPOSIT ABSOLUTE /end AXIS_DESCR
/end CHARACTERISTIC
/begin CHARACTERISTIC IKCtl_FacKnockDetThd5_GM___MGF_CC_FF2_Slot4 "Knock detection factor map cylinder counter 5 (Slot 4, Flex Fuel 2)" MAP 0x807D5482 FklWUb 3.438 fak_ub_b16 0.0625 3.5 FORMAT "%5.3"
 /begin AXIS_DESCR COM_AXIS Epm_nEng EngN 16 -16384 16383.5 AXIS_PTS_REF IKCtl_nEngB16_X_AX FORMAT "%8.2" DEPOSIT ABSOLUTE /end AXIS_DESCR
 /begin AXIS_DESCR COM_AXIS AirMod_ratChrgAirCyl rel_q0p0234 4 0 1535.977 AXIS_PTS_REF IKCtl_ratLoadAddl04_X_AX FORMAT "%8.3" DEPOSIT ABSOLUTE /end AXIS_DESCR
/end CHARACTERISTIC
/begin CHARACTERISTIC IKCtl_FacKnockDetThd5_GM___MGF_CC_PF_Slot0 "Knock detection factor map cylinder counter 5 (Slot 0, OEM Address)" MAP 0x807A1AF6 FklWUb 3.438 fak_ub_b16 0.0625 3.5 FORMAT "%5.3"
 /begin AXIS_DESCR COM_AXIS Epm_nEng EngN 16 -16384 16383.5 AXIS_PTS_REF IKCtl_nEngB16_X_AX FORMAT "%8.2" DEPOSIT ABSOLUTE /end AXIS_DESCR
 /begin AXIS_DESCR COM_AXIS AirMod_ratChrgAirCyl rel_q0p0234 4 0 1535.977 AXIS_PTS_REF IKCtl_ratLoadAddl04_X_AX FORMAT "%8.3" DEPOSIT ABSOLUTE /end AXIS_DESCR
/end CHARACTERISTIC
/begin CHARACTERISTIC IKCtl_FacKnockDetThd5_GM___MGF_CC_PF_Slot1 "Knock detection factor map cylinder counter 5 (Slot 1, Pump Fuel)" MAP 0x807CC87E FklWUb 3.438 fak_ub_b16 0.0625 3.5 FORMAT "%5.3"
 /begin AXIS_DESCR COM_AXIS Epm_nEng EngN 16 -16384 16383.5 AXIS_PTS_REF IKCtl_nEngB16_X_AX FORMAT "%8.2" DEPOSIT ABSOLUTE /end AXIS_DESCR
 /begin AXIS_DESCR COM_AXIS AirMod_ratChrgAirCyl rel_q0p0234 4 0 1535.977 AXIS_PTS_REF IKCtl_ratLoadAddl04_X_AX FORMAT "%8.3" DEPOSIT ABSOLUTE /end AXIS_DESCR
/end CHARACTERISTIC
/begin CHARACTERISTIC KF_BSLGF "Lambda rich running limit for component protection filling intervention" MAP 0x80719CA2 _REC_A1CUR_1_MBSE_U2_S1 15.999755859375 BumqDkc_mryszAa_EcglxAc_nR_4oa0 0 15.999755859375
 /begin AXIS_DESCR COM_AXIS Nkw_atm caoddzd_oAjpfzb_cAcEEha_1nR_oa0 4 -32768 32767 AXIS_PTS_REF AXX_KF_BSLGF MONOTONY STRICT_INCREASE DEPOSIT ABSOLUTE /end AXIS_DESCR
 /begin AXIS_DESCR COM_AXIS Rf_atm CgkBooc_wkiDfEd_Czglhgc_fR_1a0o 4 -327.68 327.67 AXIS_PTS_REF AXY_KF_BSLGF MONOTONY STRICT_INCREASE DEPOSIT ABSOLUTE /end AXIS_DESCR
/end CHARACTERISTIC
/begin CHARACTERISTIC KF_DLAMBSVST_TABG "Delta lambda for feedforward control of component protection exhaust temperature branch" MAP 0x80719FC8 _REC_A1CUR_1_MBSE_S2_S1 8 BumqDkc_mryszAa_EcglxAc_nR_4oa0 -8 0 FORMAT "%7.4"
 /begin AXIS_DESCR COM_AXIS Nkw_atm caoddzd_oAjpfzb_cAcEEha_1nR_oa0 8 -32768 32767 AXIS_PTS_REF AXX_KF_DLAMBSVST_TABG MONOTONY STRICT_INCREASE DEPOSIT ABSOLUTE /end AXIS_DESCR
 /begin AXIS_DESCR COM_AXIS Rf_atm CgkBooc_wkiDfEd_Czglhgc_fR_1a0o 8 -327.68 327.67 AXIS_PTS_REF AXY_KF_DLAMBSVST_TABG MONOTONY STRICT_INCREASE DEPOSIT ABSOLUTE /end AXIS_DESCR
/end CHARACTERISTIC
/begin CHARACTERISTIC KF_DZW_DYN "Delta ignition angle dynamic correction" MAP 0x8075CEED _REC_A1CUR_1_MBSE_S1_S1 127.5 aAwkuzc_BFpgCmb_tmDukma_q__aa0o -64 63.5 FORMAT "%4.1"
 /begin AXIS_DESCR COM_AXIS Nkw caoddzd_oAjpfzb_cAcEEha_1nR_oa0 4 -32768 32767 AXIS_PTS_REF AXX_KF_DZW_DYN FORMAT "%5.0" MONOTONY STRICT_INCREASE DEPOSIT ABSOLUTE /end AXIS_DESCR
 /begin AXIS_DESCR COM_AXIS NO_INPUT_QUANTITY CgkBooc_wkiDfEd_Czglhgc_fR_1a0o 4 -327.68 327.67 AXIS_PTS_REF AXY_KF_DZW_DYN FORMAT "%9.2" MONOTONY STRICT_INCREASE DEPOSIT ABSOLUTE /end AXIS_DESCR
/end CHARACTERISTIC
/begin CHARACTERISTIC KF_DZWT_PF1 "Temperature correction ignition angle knock limit path 1" MAP 0x8076346B _REC_A1CUR_1_MBSE_S1_S1 127.5 aAwkuzc_BFpgCmb_tmDukma_q__aa0o -64 63.5 FORMAT "%4.1"
 /begin AXIS_DESCR COM_AXIS Nkw caoddzd_oAjpfzb_cAcEEha_1nR_oa0 20 -32768 32767 AXIS_PTS_REF AXX_KF_DZWT_PF1 FORMAT "%5.0" MONOTONY MON_INCREASE DEPOSIT ABSOLUTE /end AXIS_DESCR
 /begin AXIS_DESCR COM_AXIS NO_INPUT_QUANTITY CgkBooc_wkiDfEd_Czglhgc_fR_1a0o 16 -327.68 327.67 AXIS_PTS_REF AXY_KF_DZWT_PF1 FORMAT "%9.2" MONOTONY MON_INCREASE DEPOSIT ABSOLUTE /end AXIS_DESCR
/end CHARACTERISTIC
/begin CHARACTERISTIC KF_DZWT_PF2 "Temperature correction ignition angle knock limit path 2" MAP 0x8076332B _REC_A1CUR_1_MBSE_S1_S1 127.5 aAwkuzc_BFpgCmb_tmDukma_q__aa0o -64 63.5 FORMAT "%4.1"
 /begin AXIS_DESCR COM_AXIS Nkw caoddzd_oAjpfzb_cAcEEha_1nR_oa0 20 -32768 32767 AXIS_PTS_REF AXX_KF_DZWT_PF2 FORMAT "%5.0" MONOTONY MON_INCREASE DEPOSIT ABSOLUTE /end AXIS_DESCR
 /begin AXIS_DESCR COM_AXIS NO_INPUT_QUANTITY CgkBooc_wkiDfEd_Czglhgc_fR_1a0o 16 -327.68 327.67 AXIS_PTS_REF AXY_KF_DZWT_PF2 FORMAT "%9.2" MONOTONY MON_INCREASE DEPOSIT ABSOLUTE /end AXIS_DESCR
/end CHARACTERISTIC
/begin CHARACTERISTIC KF_DZWT_UESP_PF1 "Temperature correction ignition angle knock limit path 1 scavenging" MAP 0x807632B3 _REC_A1CUR_1_MBSE_S1_S1 127.5 aAwkuzc_BFpgCmb_tmDukma_q__aa0o -64 63.5 FORMAT "%4.1"
 /begin AXIS_DESCR COM_AXIS Nkw caoddzd_oAjpfzb_cAcEEha_1nR_oa0 10 -32768 32767 AXIS_PTS_REF AXX_KF_DZWT_UESP_PF1 FORMAT "%5.0" MONOTONY STRICT_INCREASE DEPOSIT ABSOLUTE /end AXIS_DESCR
 /begin AXIS_DESCR COM_AXIS NO_INPUT_QUANTITY CgkBooc_wkiDfEd_Czglhgc_fR_1a0o 12 -327.68 327.67 AXIS_PTS_REF AXY_KF_DZWT_UESP_PF1 FORMAT "%9.2" MONOTONY STRICT_INCREASE DEPOSIT ABSOLUTE /end AXIS_DESCR
/end CHARACTERISTIC
/begin CHARACTERISTIC KF_DZWT_UESP_PF2 "Temperature correction ignition angle knock limit path 2 scavenging" MAP 0x8076323B _REC_A1CUR_1_MBSE_S1_S1 127.5 aAwkuzc_BFpgCmb_tmDukma_q__aa0o -64 63.5 FORMAT "%4.1"
 /begin AXIS_DESCR COM_AXIS Nkw caoddzd_oAjpfzb_cAcEEha_1nR_oa0 10 -32768 32767 AXIS_PTS_REF AXX_KF_DZWT_UESP_PF2 FORMAT "%5.0" MONOTONY STRICT_INCREASE DEPOSIT ABSOLUTE /end AXIS_DESCR
 /begin AXIS_DESCR COM_AXIS NO_INPUT_QUANTITY CgkBooc_wkiDfEd_Czglhgc_fR_1a0o 12 -327.68 327.67 AXIS_PTS_REF AXY_KF_DZWT_UESP_PF2 FORMAT "%9.2" MONOTONY STRICT_INCREASE DEPOSIT ABSOLUTE /end AXIS_DESCR
/end CHARACTERISTIC
/begin CHARACTERISTIC KF_EDA_ANZ_SPORT_MD_EM1_IST "Torque adjustment for the performance display" MAP 0x8070CD9A _REC_A1CUR_1_MBSE_S2_S1 6553.5 BMW_dm_sw_q0p1_Nm -3276.8 3276.7 FORMAT "%7.2"
 /begin AXIS_DESCR COM_AXIS NO_INPUT_QUANTITY BMW_dm_sw_q0p1_Nm 6 -3276.8 3276.7 AXIS_PTS_REF AXX_KF_EDA_ANZ_SPORT_MD_EM1_IST FORMAT "%7.2" MONOTONY STRICT_INCREASE DEPOSIT ABSOLUTE /end AXIS_DESCR
 /begin AXIS_DESCR COM_AXIS NO_INPUT_QUANTITY caoddzd_oAjpfzb_cAcEEha_1nR_oa0 6 -32768 32767 AXIS_PTS_REF AXY_KF_EDA_ANZ_SPORT_MD_EM1_IST FORMAT "%5.0" MONOTONY STRICT_INCREASE DEPOSIT ABSOLUTE /end AXIS_DESCR
/end CHARACTERISTIC
/begin CHARACTERISTIC KF_FDZW_DYN1 "Weighting factor dynamic correction via intake air temp and Dzw_annm for manual transmission" MAP 0x80762E63 _REC_A1CUR_1_MBSE_U1_S1 0.99609375 BMW_Powertrain_DxECompuMethods_Def_ub_b1_nounit 0 0.99609375
 /begin AXIS_DESCR COM_AXIS Tans BMW_q0p1_degC 4 -3276.8 3276.7 AXIS_PTS_REF AXX_KF_FDZW_DYN1 FORMAT "%6.1" MONOTONY STRICT_INCREASE DEPOSIT ABSOLUTE /end AXIS_DESCR
 /begin AXIS_DESCR COM_AXIS Dzw_annm BMW_q0p1_deg 4 -50 60 AXIS_PTS_REF AXY_KF_FDZW_DYN1 FORMAT "%6.1" MONOTONY STRICT_INCREASE DEPOSIT ABSOLUTE /end AXIS_DESCR
/end CHARACTERISTIC
/begin CHARACTERISTIC KF_FDZW_DYN2 "Weighting factor dynamic correction via speed and gear for manual transmission" MAP 0x80762E3B _REC_A1CUR_1_MBSE_U1_S1 0.99609375 BMW_Powertrain_DxECompuMethods_Def_ub_b1_nounit 0 0.99609375
 /begin AXIS_DESCR COM_AXIS Gangi raChrxc_kBtBrmb_FmDuEFa_n__aa0o 10 0 255 AXIS_PTS_REF AXX_KF_FDZW_DYN2 FORMAT "%3.0" MONOTONY MON_INCREASE DEPOSIT ABSOLUTE /end AXIS_DESCR
 /begin AXIS_DESCR COM_AXIS V AFeDmkb_cAbjmcc_kAkskhd_k__0oa0 4 0 360 AXIS_PTS_REF AXY_KF_FDZW_DYN2 FORMAT "%5.0" MONOTONY STRICT_INCREASE DEPOSIT ABSOLUTE /end AXIS_DESCR
/end CHARACTERISTIC
/begin CHARACTERISTIC KF_FDZW_DYN3 "Weighting factor dynamic correction via intake air temp and Dzw_annm for automatic transmission" MAP 0x80762E2B _REC_A1CUR_1_MBSE_U1_S1 0.99609375 BMW_Powertrain_DxECompuMethods_Def_ub_b1_nounit 0 0.99609375
 /begin AXIS_DESCR COM_AXIS Tans BMW_q0p1_degC 4 -3276.8 3276.7 AXIS_PTS_REF AXX_KF_FDZW_DYN3 FORMAT "%6.1" MONOTONY STRICT_INCREASE DEPOSIT ABSOLUTE /end AXIS_DESCR
 /begin AXIS_DESCR COM_AXIS Dzw_annm BMW_q0p1_deg 4 -50 60 AXIS_PTS_REF AXY_KF_FDZW_DYN3 FORMAT "%6.1" MONOTONY STRICT_INCREASE DEPOSIT ABSOLUTE /end AXIS_DESCR
/end CHARACTERISTIC
/begin CHARACTERISTIC KF_FDZW_DYN4 "Weighting factor dynamic correction via speed and gear for automatic transmission" MAP 0x80762E03 _REC_A1CUR_1_MBSE_U1_S1 0.99609375 BMW_Powertrain_DxECompuMethods_Def_ub_b1_nounit 0 0.99609375
 /begin AXIS_DESCR COM_AXIS Gangi raChrxc_kBtBrmb_FmDuEFa_n__aa0o 10 0 255 AXIS_PTS_REF AXX_KF_FDZW_DYN4 FORMAT "%3.0" MONOTONY MON_INCREASE DEPOSIT ABSOLUTE /end AXIS_DESCR
 /begin AXIS_DESCR COM_AXIS V AFeDmkb_cAbjmcc_kAkskhd_k__0oa0 4 0 360 AXIS_PTS_REF AXY_KF_FDZW_DYN4 FORMAT "%5.0" MONOTONY STRICT_INCREASE DEPOSIT ABSOLUTE /end AXIS_DESCR
/end CHARACTERISTIC
/begin CHARACTERISTIC KF_FDZWT_BEST_PF1 "Temperature correction factor for best ignition angle path 1" MAP 0x80737634 _REC_A1CUR_1_MBSE_S2_S1 3.99993896484375 ilxsavd_hkzmBfc_lAzCpAb_nR_1oa0 -2 1.99993896484375 FORMAT "%14.5"
 /begin AXIS_DESCR COM_AXIS Tmot DchEpAd_DBCFgoa_Ckhahgc_q__aoa0 6 -327.68 327.67 AXIS_PTS_REF AXX_KF_FDZWT_BEST_PF1 FORMAT "%7.2" MONOTONY STRICT_INCREASE DEPOSIT ABSOLUTE /end AXIS_DESCR
 /begin AXIS_DESCR COM_AXIS Tans BMW_q0p1_degC 6 -3276.8 3276.7 AXIS_PTS_REF AXY_KF_FDZWT_BEST_PF1 FORMAT "%6.1" MONOTONY STRICT_INCREASE DEPOSIT ABSOLUTE /end AXIS_DESCR
/end CHARACTERISTIC
/begin CHARACTERISTIC KF_FDZWT_BEST_PF2 "Temperature correction factor for best ignition angle path 2" MAP 0x807375EC _REC_A1CUR_1_MBSE_S2_S1 3.99993896484375 ilxsavd_hkzmBfc_lAzCpAb_nR_1oa0 -2 1.99993896484375 FORMAT "%14.5"
 /begin AXIS_DESCR COM_AXIS Tmot DchEpAd_DBCFgoa_Ckhahgc_q__aoa0 6 -327.68 327.67 AXIS_PTS_REF AXX_KF_FDZWT_BEST_PF2 FORMAT "%7.2" MONOTONY STRICT_INCREASE DEPOSIT ABSOLUTE /end AXIS_DESCR
 /begin AXIS_DESCR COM_AXIS Tans BMW_q0p1_degC 6 -3276.8 3276.7 AXIS_PTS_REF AXY_KF_FDZWT_BEST_PF2 FORMAT "%6.1" MONOTONY STRICT_INCREASE DEPOSIT ABSOLUTE /end AXIS_DESCR
/end CHARACTERISTIC
/begin CHARACTERISTIC KF_FDZWT_PF1 "Temperature correction factor for ignition angle knock limit path 1" MAP 0x807376F4 _REC_A1CUR_1_MBSE_S2_S1 3.9998779296875 ilxsavd_hkzmBfc_lAzCpAb_nR_1oa0 -2 1.9998779296875 FORMAT "%14.5"
 /begin AXIS_DESCR COM_AXIS Tmot DchEpAd_DBCFgoa_Ckhahgc_q__aoa0 6 -327.68 327.67 AXIS_PTS_REF AXX_KF_FDZWT_PF1 FORMAT "%7.2" MONOTONY STRICT_INCREASE DEPOSIT ABSOLUTE /end AXIS_DESCR
 /begin AXIS_DESCR COM_AXIS Tans BMW_q0p1_degC 6 -3276.8 3276.7 AXIS_PTS_REF AXY_KF_FDZWT_PF1 FORMAT "%6.1" MONOTONY STRICT_INCREASE DEPOSIT ABSOLUTE /end AXIS_DESCR
/end CHARACTERISTIC
/begin CHARACTERISTIC KF_FDZWT_PF1___MGF_CC_FF2_Slot4 "Temperature correction factor for ignition angle knock limit path 1 (Slot 4, Flex Fuel 2)" MAP 0x807D218A _REC_A1CUR_1_MBSE_S2_S1 3.9998779296875 ilxsavd_hkzmBfc_lAzCpAb_nR_1oa0 -2 1.9998779296875 FORMAT "%14.5"
 /begin AXIS_DESCR COM_AXIS Tmot DchEpAd_DBCFgoa_Ckhahgc_q__aoa0 6 -327.68 327.67 AXIS_PTS_REF AXX_KF_FDZWT_PF1 FORMAT "%7.2" MONOTONY STRICT_INCREASE DEPOSIT ABSOLUTE /end AXIS_DESCR
 /begin AXIS_DESCR COM_AXIS Tans BMW_q0p1_degC 6 -3276.8 3276.7 AXIS_PTS_REF AXY_KF_FDZWT_PF1 FORMAT "%6.1" MONOTONY STRICT_INCREASE DEPOSIT ABSOLUTE /end AXIS_DESCR
/end CHARACTERISTIC
/begin CHARACTERISTIC KF_FDZWT_PF1___MGF_CC_PF_Slot0 "Temperature correction factor for ignition angle knock limit path 1 (Slot 0, OEM Address)" MAP 0x807376F4 _REC_A1CUR_1_MBSE_S2_S1 3.9998779296875 ilxsavd_hkzmBfc_lAzCpAb_nR_1oa0 -2 1.9998779296875 FORMAT "%14.5"
 /begin AXIS_DESCR COM_AXIS Tmot DchEpAd_DBCFgoa_Ckhahgc_q__aoa0 6 -327.68 327.67 AXIS_PTS_REF AXX_KF_FDZWT_PF1 FORMAT "%7.2" MONOTONY STRICT_INCREASE DEPOSIT ABSOLUTE /end AXIS_DESCR
 /begin AXIS_DESCR COM_AXIS Tans BMW_q0p1_degC 6 -3276.8 3276.7 AXIS_PTS_REF AXY_KF_FDZWT_PF1 FORMAT "%6.1" MONOTONY STRICT_INCREASE DEPOSIT ABSOLUTE /end AXIS_DESCR
/end CHARACTERISTIC
/begin CHARACTERISTIC KF_FDZWT_PF1___MGF_CC_PF_Slot1 "Temperature correction factor for ignition angle knock limit path 1 (Slot 1, Pump Fuel)" MAP 0x807C25C8 _REC_A1CUR_1_MBSE_S2_S1 3.9998779296875 ilxsavd_hkzmBfc_lAzCpAb_nR_1oa0 -2 1.9998779296875 FORMAT "%14.5"
 /begin AXIS_DESCR COM_AXIS Tmot DchEpAd_DBCFgoa_Ckhahgc_q__aoa0 6 -327.68 327.67 AXIS_PTS_REF AXX_KF_FDZWT_PF1 FORMAT "%7.2" MONOTONY STRICT_INCREASE DEPOSIT ABSOLUTE /end AXIS_DESCR
 /begin AXIS_DESCR COM_AXIS Tans BMW_q0p1_degC 6 -3276.8 3276.7 AXIS_PTS_REF AXY_KF_FDZWT_PF1 FORMAT "%6.1" MONOTONY STRICT_INCREASE DEPOSIT ABSOLUTE /end AXIS_DESCR
/end CHARACTERISTIC
/begin CHARACTERISTIC KF_FDZWT_PF2 "Temperature correction factor for ignition angle knock limit path 2" MAP 0x807376AC _REC_A1CUR_1_MBSE_S2_S1 3.9998779296875 ilxsavd_hkzmBfc_lAzCpAb_nR_1oa0 -2 1.9998779296875 FORMAT "%14.5"
 /begin AXIS_DESCR COM_AXIS Tmot DchEpAd_DBCFgoa_Ckhahgc_q__aoa0 6 -327.68 327.67 AXIS_PTS_REF AXX_KF_FDZWT_PF2 FORMAT "%7.2" MONOTONY STRICT_INCREASE DEPOSIT ABSOLUTE /end AXIS_DESCR
 /begin AXIS_DESCR COM_AXIS Tans BMW_q0p1_degC 6 -3276.8 3276.7 AXIS_PTS_REF AXY_KF_FDZWT_PF2 FORMAT "%6.1" MONOTONY STRICT_INCREASE DEPOSIT ABSOLUTE /end AXIS_DESCR
/end CHARACTERISTIC
/begin CHARACTERISTIC KF_FDZWT_PF2___MGF_CC_FF2_Slot4 "Temperature correction factor for ignition angle knock limit path 2 (Slot 4, Flex Fuel 2)" MAP 0x807D22F2 _REC_A1CUR_1_MBSE_S2_S1 3.9998779296875 ilxsavd_hkzmBfc_lAzCpAb_nR_1oa0 -2 1.9998779296875 FORMAT "%14.5"
 /begin AXIS_DESCR COM_AXIS Tmot DchEpAd_DBCFgoa_Ckhahgc_q__aoa0 6 -327.68 327.67 AXIS_PTS_REF AXX_KF_FDZWT_PF2 FORMAT "%7.2" MONOTONY STRICT_INCREASE DEPOSIT ABSOLUTE /end AXIS_DESCR
 /begin AXIS_DESCR COM_AXIS Tans BMW_q0p1_degC 6 -3276.8 3276.7 AXIS_PTS_REF AXY_KF_FDZWT_PF2 FORMAT "%6.1" MONOTONY STRICT_INCREASE DEPOSIT ABSOLUTE /end AXIS_DESCR
/end CHARACTERISTIC
/begin CHARACTERISTIC KF_FDZWT_PF2___MGF_CC_PF_Slot0 "Temperature correction factor for ignition angle knock limit path 2 (Slot 0, OEM Address)" MAP 0x807376AC _REC_A1CUR_1_MBSE_S2_S1 3.9998779296875 ilxsavd_hkzmBfc_lAzCpAb_nR_1oa0 -2 1.9998779296875 FORMAT "%14.5"
 /begin AXIS_DESCR COM_AXIS Tmot DchEpAd_DBCFgoa_Ckhahgc_q__aoa0 6 -327.68 327.67 AXIS_PTS_REF AXX_KF_FDZWT_PF2 FORMAT "%7.2" MONOTONY STRICT_INCREASE DEPOSIT ABSOLUTE /end AXIS_DESCR
 /begin AXIS_DESCR COM_AXIS Tans BMW_q0p1_degC 6 -3276.8 3276.7 AXIS_PTS_REF AXY_KF_FDZWT_PF2 FORMAT "%6.1" MONOTONY STRICT_INCREASE DEPOSIT ABSOLUTE /end AXIS_DESCR
/end CHARACTERISTIC
/begin CHARACTERISTIC KF_FDZWT_PF2___MGF_CC_PF_Slot1 "Temperature correction factor for ignition angle knock limit path 2 (Slot 1, Pump Fuel)" MAP 0x807C26E8 _REC_A1CUR_1_MBSE_S2_S1 3.9998779296875 ilxsavd_hkzmBfc_lAzCpAb_nR_1oa0 -2 1.9998779296875 FORMAT "%14.5"
 /begin AXIS_DESCR COM_AXIS Tmot DchEpAd_DBCFgoa_Ckhahgc_q__aoa0 6 -327.68 327.67 AXIS_PTS_REF AXX_KF_FDZWT_PF2 FORMAT "%7.2" MONOTONY STRICT_INCREASE DEPOSIT ABSOLUTE /end AXIS_DESCR
 /begin AXIS_DESCR COM_AXIS Tans BMW_q0p1_degC 6 -3276.8 3276.7 AXIS_PTS_REF AXY_KF_FDZWT_PF2 FORMAT "%6.1" MONOTONY STRICT_INCREASE DEPOSIT ABSOLUTE /end AXIS_DESCR
/end CHARACTERISTIC
/begin CHARACTERISTIC KF_FMS_DKPSRPL_MN "Lower mass flow ratio for diagnostics of mass flow in intake manifold Msev_diag versus Msdk_diag" MAP 0x807521C2 _REC_A1CUR_1_MBSE_U2_S1 1.99996948242188 Bhvfwhc_bigEubd_BBEupBd_nR_3oa0 0 1.99996948242188 FORMAT "%7.4"
 /begin AXIS_DESCR COM_AXIS NO_INPUT_QUANTITY caoddzd_oAjpfzb_cAcEEha_1nR_oa0 6 0 32767 AXIS_PTS_REF AXX_KF_FMS_DKPSRPL_MN FORMAT "%5.0" MONOTONY MON_INCREASE DEPOSIT ABSOLUTE /end AXIS_DESCR
 /begin AXIS_DESCR COM_AXIS NO_INPUT_QUANTITY CgkBooc_wkiDfEd_Czglhgc_fR_1a0o 6 0 327.67 AXIS_PTS_REF AXY_KF_FMS_DKPSRPL_MN FORMAT "%7.2" MONOTONY MON_INCREASE DEPOSIT ABSOLUTE /end AXIS_DESCR
/end CHARACTERISTIC
/begin CHARACTERISTIC KF_FMS_DKPSRPL_MX "Upper mass flow ratio for diagnostics of mass flow in intake manifold Msev_diag versus Msdk_diag" MAP 0x8075217A _REC_A1CUR_1_MBSE_U2_S1 1.99996948242188 Bhvfwhc_bigEubd_BBEupBd_nR_3oa0 0 1.99996948242188 FORMAT "%7.4"
 /begin AXIS_DESCR COM_AXIS NO_INPUT_QUANTITY caoddzd_oAjpfzb_cAcEEha_1nR_oa0 6 0 32767 AXIS_PTS_REF AXX_KF_FMS_DKPSRPL_MX FORMAT "%5.0" MONOTONY MON_INCREASE DEPOSIT ABSOLUTE /end AXIS_DESCR
 /begin AXIS_DESCR COM_AXIS NO_INPUT_QUANTITY CgkBooc_wkiDfEd_Czglhgc_fR_1a0o 6 0 327.67 AXIS_PTS_REF AXY_KF_FMS_DKPSRPL_MX FORMAT "%7.2" MONOTONY MON_INCREASE DEPOSIT ABSOLUTE /end AXIS_DESCR
/end CHARACTERISTIC
/begin CHARACTERISTIC KF_FMS_HFMPL_MN "Lower mass flow ratio for HFM diagnostics Mshfm vs. Mszyl_diag" MAP 0x8073DDE0 _REC_A1CUR_1_MBSE_U2_S1 1.99996948242188 Bhvfwhc_bigEubd_BBEupBd_nR_3oa0 0 1.99996948242188 FORMAT "%7.4"
 /begin AXIS_DESCR COM_AXIS NO_INPUT_QUANTITY caoddzd_oAjpfzb_cAcEEha_1nR_oa0 6 -32768 32767 AXIS_PTS_REF AXX_KF_FMS_HFMPL_MN FORMAT "%5.0" MONOTONY MON_INCREASE DEPOSIT ABSOLUTE /end AXIS_DESCR
 /begin AXIS_DESCR COM_AXIS NO_INPUT_QUANTITY CgkBooc_wkiDfEd_Czglhgc_fR_1a0o 6 -327.68 327.67 AXIS_PTS_REF AXY_KF_FMS_HFMPL_MN FORMAT "%7.2" MONOTONY MON_INCREASE DEPOSIT ABSOLUTE /end AXIS_DESCR
/end CHARACTERISTIC
/begin CHARACTERISTIC KF_FMS_HFMPL_MX "Upper mass flow ratio for HFM diagnostics Mshfm vs. Mszyl_diag" MAP 0x8073DD98 _REC_A1CUR_1_MBSE_U2_S1 1.99996948242188 Bhvfwhc_bigEubd_BBEupBd_nR_3oa0 0 1.99996948242188 FORMAT "%7.4"
 /begin AXIS_DESCR COM_AXIS NO_INPUT_QUANTITY caoddzd_oAjpfzb_cAcEEha_1nR_oa0 6 -32768 32767 AXIS_PTS_REF AXX_KF_FMS_HFMPL_MX FORMAT "%5.0" MONOTONY MON_INCREASE DEPOSIT ABSOLUTE /end AXIS_DESCR
 /begin AXIS_DESCR COM_AXIS NO_INPUT_QUANTITY CgkBooc_wkiDfEd_Czglhgc_fR_1a0o 6 -327.68 327.67 AXIS_PTS_REF AXY_KF_FMS_HFMPL_MX FORMAT "%7.2" MONOTONY MON_INCREASE DEPOSIT ABSOLUTE /end AXIS_DESCR
/end CHARACTERISTIC
/begin CHARACTERISTIC KF_FRKKORRF_1 "Map feedforward correction bank 1" MAP 0x80714D98 _REC_A1CUR_1_MBSE_U2_S1 1.99996948242188 Bhvfwhc_bigEubd_BBEupBd_nR_3oa0 0 1.99996948242188 FORMAT "%14.5"
 /begin AXIS_DESCR COM_AXIS Nkw caoddzd_oAjpfzb_cAcEEha_1nR_oa0 16 -32768 32767 AXIS_PTS_REF AXX_KF_FRKKORRF_1 FORMAT "%5.0" MONOTONY STRICT_INCREASE DEPOSIT ABSOLUTE /end AXIS_DESCR
 /begin AXIS_DESCR COM_AXIS Rf CgkBooc_wkiDfEd_Czglhgc_fR_1a0o 16 -327.68 327.67 AXIS_PTS_REF AXY_KF_FRKKORRF_1 FORMAT "%7.2" MONOTONY STRICT_INCREASE DEPOSIT ABSOLUTE /end AXIS_DESCR
/end CHARACTERISTIC
/begin CHARACTERISTIC KF_FRKKORRF_1___MGF_CC_PF_Slot0 "Map feedforward correction bank 1 (Slot 0, OEM Address)" MAP 0x80714D98 _REC_A1CUR_1_MBSE_U2_S1 1.99996948242188 Bhvfwhc_bigEubd_BBEupBd_nR_3oa0 0 1.99996948242188 FORMAT "%14.5"
 /begin AXIS_DESCR COM_AXIS Nkw caoddzd_oAjpfzb_cAcEEha_1nR_oa0 16 -32768 32767 AXIS_PTS_REF AXX_KF_FRKKORRF_1 FORMAT "%5.0" MONOTONY STRICT_INCREASE DEPOSIT ABSOLUTE /end AXIS_DESCR
 /begin AXIS_DESCR COM_AXIS Rf CgkBooc_wkiDfEd_Czglhgc_fR_1a0o 16 -327.68 327.67 AXIS_PTS_REF AXY_KF_FRKKORRF_1 FORMAT "%7.2" MONOTONY STRICT_INCREASE DEPOSIT ABSOLUTE /end AXIS_DESCR
/end CHARACTERISTIC
/begin CHARACTERISTIC KF_FRKKORRF_1___MGF_CC_PF_Slot1 "Map feedforward correction bank 1 (Slot 1, Pump Fuel)" MAP 0x807C2808 _REC_A1CUR_1_MBSE_U2_S1 1.99996948242188 Bhvfwhc_bigEubd_BBEupBd_nR_3oa0 0 1.99996948242188 FORMAT "%14.5"
 /begin AXIS_DESCR COM_AXIS Nkw caoddzd_oAjpfzb_cAcEEha_1nR_oa0 16 -32768 32767 AXIS_PTS_REF AXX_KF_FRKKORRF_1 FORMAT "%5.0" MONOTONY STRICT_INCREASE DEPOSIT ABSOLUTE /end AXIS_DESCR
 /begin AXIS_DESCR COM_AXIS Rf CgkBooc_wkiDfEd_Czglhgc_fR_1a0o 16 -327.68 327.67 AXIS_PTS_REF AXY_KF_FRKKORRF_1 FORMAT "%7.2" MONOTONY STRICT_INCREASE DEPOSIT ABSOLUTE /end AXIS_DESCR
/end CHARACTERISTIC
/begin CHARACTERISTIC KF_KOEFF_B_LA "Coefficient B for lambda correction of ignition angle knock limit" MAP 0x80737934 _REC_A1CUR_1_MBSE_U2_S1 15.999755859375 BumqDkc_mryszAa_EcglxAc_nR_4oa0 0 15.999755859375 FORMAT "%9.4"
 /begin AXIS_DESCR COM_AXIS Nkw caoddzd_oAjpfzb_cAcEEha_1nR_oa0 6 -32768 32767 AXIS_PTS_REF AXX_KF_KOEFF_B_LA FORMAT "%5.0" MONOTONY STRICT_INCREASE DEPOSIT ABSOLUTE /end AXIS_DESCR
 /begin AXIS_DESCR COM_AXIS NO_INPUT_QUANTITY CgkBooc_wkiDfEd_Czglhgc_fR_1a0o 6 -327.68 327.67 AXIS_PTS_REF AXY_KF_KOEFF_B_LA FORMAT "%9.2" MONOTONY STRICT_INCREASE DEPOSIT ABSOLUTE /end AXIS_DESCR
/end CHARACTERISTIC
/begin CHARACTERISTIC KF_LA_BEZ "Reference lambda for lambda correction of ignition angle knock limit" MAP 0x807378D4 _REC_A1CUR_1_MBSE_U2_S1 15.999755859375 BumqDkc_mryszAa_EcglxAc_nR_4oa0 0 15.999755859375 FORMAT "%9.4"
 /begin AXIS_DESCR COM_AXIS Nkw caoddzd_oAjpfzb_cAcEEha_1nR_oa0 6 -32768 32767 AXIS_PTS_REF AXX_KF_LA_BEZ FORMAT "%5.0" MONOTONY STRICT_INCREASE DEPOSIT ABSOLUTE /end AXIS_DESCR
 /begin AXIS_DESCR COM_AXIS NO_INPUT_QUANTITY CgkBooc_wkiDfEd_Czglhgc_fR_1a0o 8 -327.68 327.67 AXIS_PTS_REF AXY_KF_LA_BEZ FORMAT "%9.2" MONOTONY MON_INCREASE DEPOSIT ABSOLUTE /end AXIS_DESCR
/end CHARACTERISTIC
/begin CHARACTERISTIC KF_LA_SK "Base lambda in homogeneous mode during super-knock" MAP 0x8074DE4E _REC_A1CUR_1_MBSE_U2_S1 15.999755859375 BumqDkc_mryszAa_EcglxAc_nR_4oa0 0 15.999755859375 FORMAT "%9.4"
 /begin AXIS_DESCR COM_AXIS Nkw caoddzd_oAjpfzb_cAcEEha_1nR_oa0 18 -32768 32767 AXIS_PTS_REF GXX_KF_LABAS FORMAT "%5.0" MONOTONY STRICT_INCREASE DEPOSIT ABSOLUTE /end AXIS_DESCR
 /begin AXIS_DESCR COM_AXIS Rf CgkBooc_wkiDfEd_Czglhgc_fR_1a0o 17 -327.68 327.67 AXIS_PTS_REF GXY_KF_LABAS FORMAT "%7.2" MONOTONY STRICT_INCREASE DEPOSIT ABSOLUTE /end AXIS_DESCR
/end CHARACTERISTIC
/begin CHARACTERISTIC KF_LABAS_1 "Base lambda in homogeneous mode bank 1" MAP 0x8074E316 _REC_A1CUR_1_MBSE_U2_S1 15.999755859375 BumqDkc_mryszAa_EcglxAc_nR_4oa0 0 15.999755859375 FORMAT "%9.4"
 /begin AXIS_DESCR COM_AXIS Nkw caoddzd_oAjpfzb_cAcEEha_1nR_oa0 18 -32768 32767 AXIS_PTS_REF GXX_KF_LABAS FORMAT "%5.0" MONOTONY STRICT_INCREASE DEPOSIT ABSOLUTE /end AXIS_DESCR
 /begin AXIS_DESCR COM_AXIS Rf CgkBooc_wkiDfEd_Czglhgc_fR_1a0o 17 -327.68 327.67 AXIS_PTS_REF GXY_KF_LABAS FORMAT "%7.2" MONOTONY STRICT_INCREASE DEPOSIT ABSOLUTE /end AXIS_DESCR
/end CHARACTERISTIC
/begin CHARACTERISTIC KF_LABAS_1___MGF_CC_FF2_Slot4 "Base lambda in homogeneous mode bank 1 (Slot 4, Flex Fuel 2)" MAP 0x807D36CA _REC_A1CUR_1_MBSE_U2_S1 15.999755859375 BumqDkc_mryszAa_EcglxAc_nR_4oa0 0 15.999755859375 FORMAT "%9.4"
 /begin AXIS_DESCR COM_AXIS Nkw caoddzd_oAjpfzb_cAcEEha_1nR_oa0 18 -32768 32767 AXIS_PTS_REF GXX_KF_LABAS FORMAT "%5.0" MONOTONY STRICT_INCREASE DEPOSIT ABSOLUTE /end AXIS_DESCR
 /begin AXIS_DESCR COM_AXIS Rf CgkBooc_wkiDfEd_Czglhgc_fR_1a0o 17 -327.68 327.67 AXIS_PTS_REF GXY_KF_LABAS FORMAT "%7.2" MONOTONY STRICT_INCREASE DEPOSIT ABSOLUTE /end AXIS_DESCR
/end CHARACTERISTIC
/begin CHARACTERISTIC KF_LABAS_1___MGF_CC_PF_Slot0 "Base lambda in homogeneous mode bank 1 (Slot 0, OEM Address)" MAP 0x8074E316 _REC_A1CUR_1_MBSE_U2_S1 15.999755859375 BumqDkc_mryszAa_EcglxAc_nR_4oa0 0 15.999755859375 FORMAT "%9.4"
 /begin AXIS_DESCR COM_AXIS Nkw caoddzd_oAjpfzb_cAcEEha_1nR_oa0 18 -32768 32767 AXIS_PTS_REF GXX_KF_LABAS FORMAT "%5.0" MONOTONY STRICT_INCREASE DEPOSIT ABSOLUTE /end AXIS_DESCR
 /begin AXIS_DESCR COM_AXIS Rf CgkBooc_wkiDfEd_Czglhgc_fR_1a0o 17 -327.68 327.67 AXIS_PTS_REF GXY_KF_LABAS FORMAT "%7.2" MONOTONY STRICT_INCREASE DEPOSIT ABSOLUTE /end AXIS_DESCR
/end CHARACTERISTIC
/begin CHARACTERISTIC KF_LABAS_1___MGF_CC_PF_Slot1 "Base lambda in homogeneous mode bank 1 (Slot 1, Pump Fuel)" MAP 0x807C3008 _REC_A1CUR_1_MBSE_U2_S1 15.999755859375 BumqDkc_mryszAa_EcglxAc_nR_4oa0 0 15.999755859375 FORMAT "%9.4"
 /begin AXIS_DESCR COM_AXIS Nkw caoddzd_oAjpfzb_cAcEEha_1nR_oa0 18 -32768 32767 AXIS_PTS_REF GXX_KF_LABAS FORMAT "%5.0" MONOTONY STRICT_INCREASE DEPOSIT ABSOLUTE /end AXIS_DESCR
 /begin AXIS_DESCR COM_AXIS Rf CgkBooc_wkiDfEd_Czglhgc_fR_1a0o 17 -327.68 327.67 AXIS_PTS_REF GXY_KF_LABAS FORMAT "%7.2" MONOTONY STRICT_INCREASE DEPOSIT ABSOLUTE /end AXIS_DESCR
/end CHARACTERISTIC
/begin CHARACTERISTIC KF_LABAS_2 "Base lambda in homogeneous mode bank 2" MAP 0x8074E0B2 _REC_A1CUR_1_MBSE_U2_S1 15.999755859375 BumqDkc_mryszAa_EcglxAc_nR_4oa0 0 15.999755859375 FORMAT "%9.4"
 /begin AXIS_DESCR COM_AXIS Nkw caoddzd_oAjpfzb_cAcEEha_1nR_oa0 18 -32768 32767 AXIS_PTS_REF GXX_KF_LABAS FORMAT "%5.0" MONOTONY STRICT_INCREASE DEPOSIT ABSOLUTE /end AXIS_DESCR
 /begin AXIS_DESCR COM_AXIS Rf CgkBooc_wkiDfEd_Czglhgc_fR_1a0o 17 -327.68 327.67 AXIS_PTS_REF GXY_KF_LABAS FORMAT "%7.2" MONOTONY STRICT_INCREASE DEPOSIT ABSOLUTE /end AXIS_DESCR
/end CHARACTERISTIC
/begin CHARACTERISTIC KF_LABAS_2___MGF_CC_FF2_Slot4 "Base lambda in homogeneous mode bank 2 (Slot 4, Flex Fuel 2)" MAP 0x807D42BE _REC_A1CUR_1_MBSE_U2_S1 15.999755859375 BumqDkc_mryszAa_EcglxAc_nR_4oa0 0 15.999755859375 FORMAT "%9.4"
 /begin AXIS_DESCR COM_AXIS Nkw caoddzd_oAjpfzb_cAcEEha_1nR_oa0 18 -32768 32767 AXIS_PTS_REF GXX_KF_LABAS FORMAT "%5.0" MONOTONY STRICT_INCREASE DEPOSIT ABSOLUTE /end AXIS_DESCR
 /begin AXIS_DESCR COM_AXIS Rf CgkBooc_wkiDfEd_Czglhgc_fR_1a0o 17 -327.68 327.67 AXIS_PTS_REF GXY_KF_LABAS FORMAT "%7.2" MONOTONY STRICT_INCREASE DEPOSIT ABSOLUTE /end AXIS_DESCR
/end CHARACTERISTIC
/begin CHARACTERISTIC KF_LABAS_2___MGF_CC_PF_Slot0 "Base lambda in homogeneous mode bank 2 (Slot 0, OEM Address)" MAP 0x8074E0B2 _REC_A1CUR_1_MBSE_U2_S1 15.999755859375 BumqDkc_mryszAa_EcglxAc_nR_4oa0 0 15.999755859375 FORMAT "%9.4"
 /begin AXIS_DESCR COM_AXIS Nkw caoddzd_oAjpfzb_cAcEEha_1nR_oa0 18 -32768 32767 AXIS_PTS_REF GXX_KF_LABAS FORMAT "%5.0" MONOTONY STRICT_INCREASE DEPOSIT ABSOLUTE /end AXIS_DESCR
 /begin AXIS_DESCR COM_AXIS Rf CgkBooc_wkiDfEd_Czglhgc_fR_1a0o 17 -327.68 327.67 AXIS_PTS_REF GXY_KF_LABAS FORMAT "%7.2" MONOTONY STRICT_INCREASE DEPOSIT ABSOLUTE /end AXIS_DESCR
/end CHARACTERISTIC
/begin CHARACTERISTIC KF_LABAS_2___MGF_CC_PF_Slot1 "Base lambda in homogeneous mode bank 2 (Slot 1, Pump Fuel)" MAP 0x807C3998 _REC_A1CUR_1_MBSE_U2_S1 15.999755859375 BumqDkc_mryszAa_EcglxAc_nR_4oa0 0 15.999755859375 FORMAT "%9.4"
 /begin AXIS_DESCR COM_AXIS Nkw caoddzd_oAjpfzb_cAcEEha_1nR_oa0 18 -32768 32767 AXIS_PTS_REF GXX_KF_LABAS FORMAT "%5.0" MONOTONY STRICT_INCREASE DEPOSIT ABSOLUTE /end AXIS_DESCR
 /begin AXIS_DESCR COM_AXIS Rf CgkBooc_wkiDfEd_Czglhgc_fR_1a0o 17 -327.68 327.67 AXIS_PTS_REF GXY_KF_LABAS FORMAT "%7.2" MONOTONY STRICT_INCREASE DEPOSIT ABSOLUTE /end AXIS_DESCR
/end CHARACTERISTIC
/begin CHARACTERISTIC KF_LAMIN_H "Lambda combustion limit rich" MAP 0x8071F2E6 _REC_A1CUR_1_MBSE_U2_S1 15.999755859375 BumqDkc_mryszAa_EcglxAc_nR_4oa0 0 15.999755859375 FORMAT "%9.4"
 /begin AXIS_DESCR COM_AXIS Nkw caoddzd_oAjpfzb_cAcEEha_1nR_oa0 6 -32768 32767 AXIS_PTS_REF AXX_KF_LAMIN_H FORMAT "%5.0" MONOTONY STRICT_INCREASE DEPOSIT ABSOLUTE /end AXIS_DESCR
 /begin AXIS_DESCR COM_AXIS Rf CgkBooc_wkiDfEd_Czglhgc_fR_1a0o 6 -327.68 327.67 AXIS_PTS_REF AXY_KF_LAMIN_H FORMAT "%7.2" MONOTONY STRICT_INCREASE DEPOSIT ABSOLUTE /end AXIS_DESCR
/end CHARACTERISTIC
/begin CHARACTERISTIC KF_MDIOP_1_TQE "optimales Referenz-Moment aus Füllung und Drehzahl" MAP 0x8072DA8C _REC_A1CUR_1_MBSE_S2_S1 6553.5 BMW_dm_sw_q0p1_Nm -3276.8 3276.7
 /begin AXIS_DESCR COM_AXIS NO_INPUT_QUANTITY CgkBooc_wkiDfEd_Czglhgc_fR_1a0o 18 -327.68 327.67 AXIS_PTS_REF AXX_KF_MDIOP_1_TQE FORMAT "%6.2" MONOTONY STRICT_INCREASE DEPOSIT ABSOLUTE /end AXIS_DESCR
 /begin AXIS_DESCR COM_AXIS NO_INPUT_QUANTITY caoddzd_oAjpfzb_cAcEEha_1nR_oa0 20 -32768 32767 AXIS_PTS_REF AXY_KF_MDIOP_1_TQE FORMAT "%5.0" MONOTONY STRICT_INCREASE DEPOSIT ABSOLUTE /end AXIS_DESCR
/end CHARACTERISTIC
/begin CHARACTERISTIC KF_MDK_MAX_GANG_NKW "KF_MDK_MAX_GANG_NKW" MAP 0x807483AE _REC_A1CUR_1_MBSE_S2_S1 6553.5 BMW_dm_sw_q0p1_Nm -3276.8 3276.7 FORMAT "%6.2"
 /begin AXIS_DESCR COM_AXIS Gang_gb1_ist raChrxc_kBtBrmb_FmDuEFa_n__aa0o 10 -128 127 AXIS_PTS_REF AXX_KF_MDK_MAX_GANG_NKW FORMAT "%6.0" MONOTONY STRICT_INCREASE DEPOSIT ABSOLUTE /end AXIS_DESCR
 /begin AXIS_DESCR COM_AXIS Nkw_plaus caoddzd_oAjpfzb_cAcEEha_1nR_oa0 8 -32768 32767 AXIS_PTS_REF AXY_KF_MDK_MAX_GANG_NKW FORMAT "%6.0" MONOTONY STRICT_INCREASE DEPOSIT ABSOLUTE /end AXIS_DESCR
/end CHARACTERISTIC
/begin CHARACTERISTIC KF_PHA_H_B1_SK_PRE "Map start angle injection event 1 preventive super-knock" MAP 0x80716640 _REC_A1CUR_1_MBSE_S2_S1 1535.9765625 aEmoCzd_erpwvfb_msfkhgc_qR_1a0o -768 767.9765625
 /begin AXIS_DESCR COM_AXIS Nkw caoddzd_oAjpfzb_cAcEEha_1nR_oa0 10 -32768 32767 AXIS_PTS_REF GXX_KF_PHA_H_B1_BAS FORMAT "%5.0" MONOTONY STRICT_INCREASE DEPOSIT ABSOLUTE /end AXIS_DESCR
 /begin AXIS_DESCR COM_AXIS NO_INPUT_QUANTITY zyyxBpb_rEsnvtc_gktukCa_fR_5a0o 12 -1600 1599.951171875 AXIS_PTS_REF GXY_KF_PHA_H_B1_BAS FORMAT "%8.3" MONOTONY STRICT_INCREASE DEPOSIT ABSOLUTE /end AXIS_DESCR
/end CHARACTERISTIC
/begin CHARACTERISTIC KF_PHA_H_B1_W "Map start angle injection event 1 warm" MAP 0x807164D0 _REC_A1CUR_1_MBSE_S2_S1 1535.9765625 aEmoCzd_erpwvfb_msfkhgc_qR_1a0o -768 767.9765625
 /begin AXIS_DESCR COM_AXIS Nkw caoddzd_oAjpfzb_cAcEEha_1nR_oa0 10 -32768 32767 AXIS_PTS_REF GXX_KF_PHA_H_B1_BAS FORMAT "%5.0" MONOTONY STRICT_INCREASE DEPOSIT ABSOLUTE /end AXIS_DESCR
 /begin AXIS_DESCR COM_AXIS NO_INPUT_QUANTITY zyyxBpb_rEsnvtc_gktukCa_fR_5a0o 12 -1600 1599.951171875 AXIS_PTS_REF GXY_KF_PHA_H_B1_BAS FORMAT "%8.3" MONOTONY STRICT_INCREASE DEPOSIT ABSOLUTE /end AXIS_DESCR
/end CHARACTERISTIC
/begin CHARACTERISTIC KF_PHA_H_B1_W___MGF_CC_PF_Slot0 "Map start angle injection event 1 warm (Slot 0, OEM Address)" MAP 0x807164D0 _REC_A1CUR_1_MBSE_S2_S1 1535.9765625 aEmoCzd_erpwvfb_msfkhgc_qR_1a0o -768 767.9765625
 /begin AXIS_DESCR COM_AXIS Nkw caoddzd_oAjpfzb_cAcEEha_1nR_oa0 10 -32768 32767 AXIS_PTS_REF GXX_KF_PHA_H_B1_BAS FORMAT "%5.0" MONOTONY STRICT_INCREASE DEPOSIT ABSOLUTE /end AXIS_DESCR
 /begin AXIS_DESCR COM_AXIS NO_INPUT_QUANTITY zyyxBpb_rEsnvtc_gktukCa_fR_5a0o 12 -1600 1599.951171875 AXIS_PTS_REF GXY_KF_PHA_H_B1_BAS FORMAT "%8.3" MONOTONY STRICT_INCREASE DEPOSIT ABSOLUTE /end AXIS_DESCR
/end CHARACTERISTIC
/begin CHARACTERISTIC KF_PHA_H_B1_W___MGF_CC_PF_Slot1 "Map start angle injection event 1 warm (Slot 1, Pump Fuel)" MAP 0x807CB2FE _REC_A1CUR_1_MBSE_S2_S1 1535.9765625 aEmoCzd_erpwvfb_msfkhgc_qR_1a0o -768 767.9765625
 /begin AXIS_DESCR COM_AXIS Nkw caoddzd_oAjpfzb_cAcEEha_1nR_oa0 10 -32768 32767 AXIS_PTS_REF GXX_KF_PHA_H_B1_BAS FORMAT "%5.0" MONOTONY STRICT_INCREASE DEPOSIT ABSOLUTE /end AXIS_DESCR
 /begin AXIS_DESCR COM_AXIS NO_INPUT_QUANTITY zyyxBpb_rEsnvtc_gktukCa_fR_5a0o 12 -1600 1599.951171875 AXIS_PTS_REF GXY_KF_PHA_H_B1_BAS FORMAT "%8.3" MONOTONY STRICT_INCREASE DEPOSIT ABSOLUTE /end AXIS_DESCR
/end CHARACTERISTIC
/begin CHARACTERISTIC KF_PHA_H_E1 "KF_PHA_H_E1" MAP 0x8071821C _REC_A1CUR_1_MBSE_S2_S1 1535.9765625 ridxkCa_Dxvxtdc_CChkhgc_nR_1a0o -768 767.9765625
 /begin AXIS_DESCR COM_AXIS Nkw caoddzd_oAjpfzb_cAcEEha_1nR_oa0 8 -32768 32767 AXIS_PTS_REF AXX_KF_PHA_H_E1 FORMAT "%5.0" MONOTONY STRICT_INCREASE DEPOSIT ABSOLUTE /end AXIS_DESCR
 /begin AXIS_DESCR COM_AXIS NO_INPUT_QUANTITY zyyxBpb_rEsnvtc_gktukCa_fR_5a0o 8 -1600 1599.951171875 AXIS_PTS_REF AXY_KF_PHA_H_E1 MONOTONY STRICT_INCREASE DEPOSIT ABSOLUTE /end AXIS_DESCR
/end CHARACTERISTIC
/begin CHARACTERISTIC KF_PHA_H_E1___MGF_CC_PF_Slot0 "KF_PHA_H_E1 (Slot 0, OEM Address)" MAP 0x8071821C _REC_A1CUR_1_MBSE_S2_S1 1535.9765625 ridxkCa_Dxvxtdc_CChkhgc_nR_1a0o -768 767.9765625
 /begin AXIS_DESCR COM_AXIS Nkw caoddzd_oAjpfzb_cAcEEha_1nR_oa0 8 -32768 32767 AXIS_PTS_REF AXX_KF_PHA_H_E1 FORMAT "%5.0" MONOTONY STRICT_INCREASE DEPOSIT ABSOLUTE /end AXIS_DESCR
 /begin AXIS_DESCR COM_AXIS NO_INPUT_QUANTITY zyyxBpb_rEsnvtc_gktukCa_fR_5a0o 8 -1600 1599.951171875 AXIS_PTS_REF AXY_KF_PHA_H_E1 MONOTONY STRICT_INCREASE DEPOSIT ABSOLUTE /end AXIS_DESCR
/end CHARACTERISTIC
/begin CHARACTERISTIC KF_PHA_H_E1___MGF_CC_PF_Slot1 "KF_PHA_H_E1 (Slot 1, Pump Fuel)" MAP 0x807CB93E _REC_A1CUR_1_MBSE_S2_S1 1535.9765625 ridxkCa_Dxvxtdc_CChkhgc_nR_1a0o -768 767.9765625
 /begin AXIS_DESCR COM_AXIS Nkw caoddzd_oAjpfzb_cAcEEha_1nR_oa0 8 -32768 32767 AXIS_PTS_REF AXX_KF_PHA_H_E1 FORMAT "%5.0" MONOTONY STRICT_INCREASE DEPOSIT ABSOLUTE /end AXIS_DESCR
 /begin AXIS_DESCR COM_AXIS NO_INPUT_QUANTITY zyyxBpb_rEsnvtc_gktukCa_fR_5a0o 8 -1600 1599.951171875 AXIS_PTS_REF AXY_KF_PHA_H_E1 MONOTONY STRICT_INCREASE DEPOSIT ABSOLUTE /end AXIS_DESCR
/end CHARACTERISTIC
/begin CHARACTERISTIC KF_POELSOLL "Oil pressure setpoint specification for regulated oil pump" MAP 0x80700FFA _REC_S5MAP_52_KF_U2_S2_S2 65535 doAbvic_Aaltzwd_vyCuowa_hCRoa0o 0 65535
 /begin AXIS_DESCR STD_AXIS Nkw caoddzd_oAjpfzb_cAcEEha_1nR_oa0 10 -32768 32767 FORMAT "%5.0" MONOTONY STRICT_INCREASE DEPOSIT ABSOLUTE /end AXIS_DESCR
 /begin AXIS_DESCR STD_AXIS Tpoel_reg BMW_q0p1_degC 6 -3276.8 3276.7 FORMAT "%6.1" MONOTONY STRICT_INCREASE DEPOSIT ABSOLUTE /end AXIS_DESCR
/end CHARACTERISTIC
/begin CHARACTERISTIC KF_POELSOLL_ADP "Load-dependent oil pressure setpoint offset" MAP 0x80700EC6 _REC_S5MAP_52_KF_U2_S2_U2 65535 doAbvic_Aaltzwd_vyCuowa_hCRoa0o 0 65535
 /begin AXIS_DESCR STD_AXIS Nkw caoddzd_oAjpfzb_cAcEEha_1nR_oa0 10 -32768 32767 FORMAT "%5.0" MONOTONY STRICT_INCREASE DEPOSIT ABSOLUTE /end AXIS_DESCR
 /begin AXIS_DESCR STD_AXIS Mdi_poel_n FzbmlAa_gCtylrb_ckCqxAc_nR_6oa0 6 0 0.999984741210938 MONOTONY STRICT_INCREASE DEPOSIT ABSOLUTE /end AXIS_DESCR
/end CHARACTERISTIC
/begin CHARACTERISTIC KF_POELSOLL_ADP_FAK "Speed and oil temperature dependent factor for considering the oil pressure offset" MAP 0x80700E88 _REC_S5MAP_52_KF_U1_S2_S2 7.96875 fqCirwd_flsbrkc_xChfaCb_n__aa0o 0 7.96875
 /begin AXIS_DESCR STD_AXIS Nkw caoddzd_oAjpfzb_cAcEEha_1nR_oa0 6 -32768 32767 FORMAT "%5.0" MONOTONY STRICT_INCREASE DEPOSIT ABSOLUTE /end AXIS_DESCR
 /begin AXIS_DESCR STD_AXIS Tpoel_reg BMW_q0p1_degC 6 -3276.8 3276.7 FORMAT "%6.1" MONOTONY STRICT_INCREASE DEPOSIT ABSOLUTE /end AXIS_DESCR
/end CHARACTERISTIC
/begin CHARACTERISTIC KF_PRAIL_H "Map rail pressure homogeneous -- with active VVT" MAP 0x807260AE _REC_A1CUR_1_MBSE_U2_S1 39.9993896484375 cxdjuna_xpuCged_ocEpdua_MCRa2a0 0 39.9993896484375 FORMAT "%9.4"
 /begin AXIS_DESCR COM_AXIS Nkw caoddzd_oAjpfzb_cAcEEha_1nR_oa0 8 -32768 32767 AXIS_PTS_REF AXX_KF_PRAIL_H FORMAT "%5.0" MONOTONY STRICT_INCREASE DEPOSIT ABSOLUTE /end AXIS_DESCR
 /begin AXIS_DESCR COM_AXIS BMWrailco_rat_VabHom_sw zyyxBpb_rEsnvtc_gktukCa_fR_5a0o 8 -1600 1599.951171875 AXIS_PTS_REF AXY_KF_PRAIL_H FORMAT "%8.3" MONOTONY STRICT_INCREASE DEPOSIT ABSOLUTE /end AXIS_DESCR
/end CHARACTERISTIC
/begin CHARACTERISTIC KF_PRAIL_H_K "Map rail pressure homogeneous cold -- with active VVT" MAP 0x80725E2E _REC_A1CUR_1_MBSE_U2_S1 39.9993896484375 cxdjuna_xpuCged_ocEpdua_MCRa2a0 0 39.9993896484375 FORMAT "%9.4"
 /begin AXIS_DESCR COM_AXIS Nkw caoddzd_oAjpfzb_cAcEEha_1nR_oa0 8 -32768 32767 AXIS_PTS_REF AXX_KF_PRAIL_H_K FORMAT "%5.0" MONOTONY STRICT_INCREASE DEPOSIT ABSOLUTE /end AXIS_DESCR
 /begin AXIS_DESCR COM_AXIS BMWrailco_rat_VabHom_sw zyyxBpb_rEsnvtc_gktukCa_fR_5a0o 8 -1600 1599.951171875 AXIS_PTS_REF AXY_KF_PRAIL_H_K FORMAT "%8.3" MONOTONY STRICT_INCREASE DEPOSIT ABSOLUTE /end AXIS_DESCR
/end CHARACTERISTIC
/begin CHARACTERISTIC KF_PRAIL_HDPWARM "Map rail pressure for protection against warm high-pressure pump" MAP 0x8072602E _REC_A1CUR_1_MBSE_U2_S1 39.9993896484375 cxdjuna_xpuCged_ocEpdua_MCRa2a0 0 39.9993896484375 FORMAT "%9.4"
 /begin AXIS_DESCR COM_AXIS Nkw caoddzd_oAjpfzb_cAcEEha_1nR_oa0 8 -32768 32767 AXIS_PTS_REF AXX_KF_PRAIL_HDPWARM FORMAT "%5.0" MONOTONY STRICT_INCREASE DEPOSIT ABSOLUTE /end AXIS_DESCR
 /begin AXIS_DESCR COM_AXIS BMWrailco_rat_VabHom_sw zyyxBpb_rEsnvtc_gktukCa_fR_5a0o 8 -1600 1599.951171875 AXIS_PTS_REF AXY_KF_PRAIL_HDPWARM FORMAT "%8.3" MONOTONY STRICT_INCREASE DEPOSIT ABSOLUTE /end AXIS_DESCR
/end CHARACTERISTIC
/begin CHARACTERISTIC KF_PRAIL_HDPWARM_KH "Map rail pressure for protection against warm HDP during catalyst heating" MAP 0x80725FAE _REC_A1CUR_1_MBSE_U2_S1 39.9993896484375 cxdjuna_xpuCged_ocEpdua_MCRa2a0 0 39.9993896484375 FORMAT "%9.4"
 /begin AXIS_DESCR COM_AXIS Nkw caoddzd_oAjpfzb_cAcEEha_1nR_oa0 8 -32768 32767 AXIS_PTS_REF AXX_KF_PRAIL_HDPWARM FORMAT "%5.0" MONOTONY STRICT_INCREASE DEPOSIT ABSOLUTE /end AXIS_DESCR
 /begin AXIS_DESCR COM_AXIS BMWrailco_rat_VabHom_sw zyyxBpb_rEsnvtc_gktukCa_fR_5a0o 8 -1600 1599.951171875 AXIS_PTS_REF AXY_KF_PRAIL_HDPWARM FORMAT "%8.3" MONOTONY STRICT_INCREASE DEPOSIT ABSOLUTE /end AXIS_DESCR
/end CHARACTERISTIC
/begin CHARACTERISTIC KF_PRAIL_HGD "Map rail pressure homogeneous -- with inactive VVT (throttled)" MAP 0x80725F2E _REC_A1CUR_1_MBSE_U2_S1 39.9993896484375 cxdjuna_xpuCged_ocEpdua_MCRa2a0 0 39.9993896484375 FORMAT "%9.4"
 /begin AXIS_DESCR COM_AXIS Nkw caoddzd_oAjpfzb_cAcEEha_1nR_oa0 8 -32768 32767 AXIS_PTS_REF AXX_KF_PRAIL_HGD FORMAT "%5.0" MONOTONY STRICT_INCREASE DEPOSIT ABSOLUTE /end AXIS_DESCR
 /begin AXIS_DESCR COM_AXIS BMWrailco_rat_VabHom_sw zyyxBpb_rEsnvtc_gktukCa_fR_5a0o 8 -1600 1599.951171875 AXIS_PTS_REF AXY_KF_PRAIL_HGD FORMAT "%8.3" MONOTONY STRICT_INCREASE DEPOSIT ABSOLUTE /end AXIS_DESCR
/end CHARACTERISTIC
/begin CHARACTERISTIC KF_PRAIL_HGD_K "Map rail pressure homogeneous cold -- with inactive VVT (throttled)" MAP 0x80725EAE _REC_A1CUR_1_MBSE_U2_S1 39.9993896484375 cxdjuna_xpuCged_ocEpdua_MCRa2a0 0 39.9993896484375 FORMAT "%9.4"
 /begin AXIS_DESCR COM_AXIS Nkw caoddzd_oAjpfzb_cAcEEha_1nR_oa0 8 -32768 32767 AXIS_PTS_REF AXX_KF_PRAIL_HGD_K FORMAT "%5.0" MONOTONY STRICT_INCREASE DEPOSIT ABSOLUTE /end AXIS_DESCR
 /begin AXIS_DESCR COM_AXIS BMWrailco_rat_VabHom_sw zyyxBpb_rEsnvtc_gktukCa_fR_5a0o 8 -1600 1599.951171875 AXIS_PTS_REF AXY_KF_PRAIL_HGD_K FORMAT "%8.3" MONOTONY STRICT_INCREASE DEPOSIT ABSOLUTE /end AXIS_DESCR
/end CHARACTERISTIC
/begin CHARACTERISTIC KF_ST_RKBAS_GD "Map base Rk quantity throttled operation" MAP 0x8074F934 _REC_A1CUR_1_MBSE_S2_S1 3199.951171875 zyyxBpb_rEsnvtc_gktukCa_fR_5a0o -1600 1599.951171875
 /begin AXIS_DESCR COM_AXIS Nkw caoddzd_oAjpfzb_cAcEEha_1nR_oa0 10 -32768 32767 AXIS_PTS_REF AXX_KF_ST_RKBAS_GD FORMAT "%5.0" MONOTONY STRICT_INCREASE DEPOSIT ABSOLUTE /end AXIS_DESCR
 /begin AXIS_DESCR COM_AXIS BMWinj_t_Eng_sw DchEpAd_DBCFgoa_Ckhahgc_q__aoa0 10 -327.68 327.67 AXIS_PTS_REF AXY_KF_ST_RKBAS_GD FORMAT "%7.2" MONOTONY STRICT_INCREASE DEPOSIT ABSOLUTE /end AXIS_DESCR
/end CHARACTERISTIC
/begin CHARACTERISTIC KF_ST_RKBAS_VVT "Map base Rk quantity VVT operation" MAP 0x8074F7A2 _REC_A1CUR_1_MBSE_S2_S1 3199.951171875 zyyxBpb_rEsnvtc_gktukCa_fR_5a0o -1600 1599.951171875
 /begin AXIS_DESCR COM_AXIS Nkw caoddzd_oAjpfzb_cAcEEha_1nR_oa0 12 -32768 32767 AXIS_PTS_REF AXX_KF_ST_RKBAS_VVT FORMAT "%5.0" MONOTONY STRICT_INCREASE DEPOSIT ABSOLUTE /end AXIS_DESCR
 /begin AXIS_DESCR COM_AXIS BMWinj_t_Eng_sw DchEpAd_DBCFgoa_Ckhahgc_q__aoa0 12 -327.68 327.67 AXIS_PTS_REF AXY_KF_ST_RKBAS_VVT FORMAT "%7.2" MONOTONY STRICT_INCREASE DEPOSIT ABSOLUTE /end AXIS_DESCR
/end CHARACTERISTIC
/begin CHARACTERISTIC KF_TD_FETTDELAY_TABG "Duration of enrichment suppression from KF_LABAS_XXX. This time depends on pipe wall temperature Tw_r1." MAP 0x80763B4F _REC_A1CUR_1_MBSE_U1_S1 51 BMW_q0p2_s 0 51
 /begin AXIS_DESCR COM_AXIS Tw_r1 BMW_q0p1_degC 6 -3276.8 3276.7 AXIS_PTS_REF AXX_KF_TD_FETTDELAY_TABG FORMAT "%6.1" MONOTONY STRICT_INCREASE DEPOSIT ABSOLUTE /end AXIS_DESCR
 /begin AXIS_DESCR COM_AXIS Nkw caoddzd_oAjpfzb_cAcEEha_1nR_oa0 4 -3277 3277 AXIS_PTS_REF AXY_KF_TD_FETTDELAY_TABG FORMAT "%5.0" MONOTONY STRICT_INCREASE DEPOSIT ABSOLUTE /end AXIS_DESCR
/end CHARACTERISTIC
/begin CHARACTERISTIC KF_ZW_PF1 "Base ignition angle path 1" MAP 0x8075CD55 _REC_A1CUR_1_MBSE_S1_S1 127.5 aAwkuzc_BFpgCmb_tmDukma_q__aa0o -64 63.5 FORMAT "%4.1"
 /begin AXIS_DESCR COM_AXIS Nkw caoddzd_oAjpfzb_cAcEEha_1nR_oa0 20 -32768 32767 AXIS_PTS_REF AXX_KF_ZW_PF1 FORMAT "%5.0" MONOTONY STRICT_INCREASE DEPOSIT ABSOLUTE /end AXIS_DESCR
 /begin AXIS_DESCR COM_AXIS NO_INPUT_QUANTITY CgkBooc_wkiDfEd_Czglhgc_fR_1a0o 20 -327.68 327.67 AXIS_PTS_REF AXY_KF_ZW_PF1 FORMAT "%9.2" MONOTONY STRICT_INCREASE DEPOSIT ABSOLUTE /end AXIS_DESCR
/end CHARACTERISTIC
/begin CHARACTERISTIC KF_ZW_PF1___MGF_CC_FF2_Slot4 "Base ignition angle path 1 (Slot 4, Flex Fuel 2)" MAP 0x807D5B02 _REC_A1CUR_1_MBSE_S1_S1 127.5 aAwkuzc_BFpgCmb_tmDukma_q__aa0o -64 63.5 FORMAT "%4.1"
 /begin AXIS_DESCR COM_AXIS Nkw caoddzd_oAjpfzb_cAcEEha_1nR_oa0 20 -32768 32767 AXIS_PTS_REF AXX_KF_ZW_PF1 FORMAT "%5.0" MONOTONY STRICT_INCREASE DEPOSIT ABSOLUTE /end AXIS_DESCR
 /begin AXIS_DESCR COM_AXIS NO_INPUT_QUANTITY CgkBooc_wkiDfEd_Czglhgc_fR_1a0o 20 -327.68 327.67 AXIS_PTS_REF AXY_KF_ZW_PF1 FORMAT "%9.2" MONOTONY STRICT_INCREASE DEPOSIT ABSOLUTE /end AXIS_DESCR
/end CHARACTERISTIC
/begin CHARACTERISTIC KF_ZW_PF1___MGF_CC_PF_Slot0 "Base ignition angle path 1 (Slot 0, OEM Address)" MAP 0x8075CD55 _REC_A1CUR_1_MBSE_S1_S1 127.5 aAwkuzc_BFpgCmb_tmDukma_q__aa0o -64 63.5 FORMAT "%4.1"
 /begin AXIS_DESCR COM_AXIS Nkw caoddzd_oAjpfzb_cAcEEha_1nR_oa0 20 -32768 32767 AXIS_PTS_REF AXX_KF_ZW_PF1 FORMAT "%5.0" MONOTONY STRICT_INCREASE DEPOSIT ABSOLUTE /end AXIS_DESCR
 /begin AXIS_DESCR COM_AXIS NO_INPUT_QUANTITY CgkBooc_wkiDfEd_Czglhgc_fR_1a0o 20 -327.68 327.67 AXIS_PTS_REF AXY_KF_ZW_PF1 FORMAT "%9.2" MONOTONY STRICT_INCREASE DEPOSIT ABSOLUTE /end AXIS_DESCR
/end CHARACTERISTIC
/begin CHARACTERISTIC KF_ZW_PF1___MGF_CC_PF_Slot1 "Base ignition angle path 1 (Slot 1, Pump Fuel)" MAP 0x807C5046 _REC_A1CUR_1_MBSE_S1_S1 127.5 aAwkuzc_BFpgCmb_tmDukma_q__aa0o -64 63.5 FORMAT "%4.1"
 /begin AXIS_DESCR COM_AXIS Nkw caoddzd_oAjpfzb_cAcEEha_1nR_oa0 20 -32768 32767 AXIS_PTS_REF AXX_KF_ZW_PF1 FORMAT "%5.0" MONOTONY STRICT_INCREASE DEPOSIT ABSOLUTE /end AXIS_DESCR
 /begin AXIS_DESCR COM_AXIS NO_INPUT_QUANTITY CgkBooc_wkiDfEd_Czglhgc_fR_1a0o 20 -327.68 327.67 AXIS_PTS_REF AXY_KF_ZW_PF1 FORMAT "%9.2" MONOTONY STRICT_INCREASE DEPOSIT ABSOLUTE /end AXIS_DESCR
/end CHARACTERISTIC
/begin CHARACTERISTIC KF_ZW_PF2 "Base ignition angle path 2" MAP 0x8075CBC5 _REC_A1CUR_1_MBSE_S1_S1 127.5 aAwkuzc_BFpgCmb_tmDukma_q__aa0o -64 63.5 FORMAT "%4.1"
 /begin AXIS_DESCR COM_AXIS Nkw caoddzd_oAjpfzb_cAcEEha_1nR_oa0 20 -32768 32767 AXIS_PTS_REF AXX_KF_ZW_PF2 FORMAT "%5.0" MONOTONY STRICT_INCREASE DEPOSIT ABSOLUTE /end AXIS_DESCR
 /begin AXIS_DESCR COM_AXIS NO_INPUT_QUANTITY CgkBooc_wkiDfEd_Czglhgc_fR_1a0o 20 -327.68 327.67 AXIS_PTS_REF AXY_KF_ZW_PF2 FORMAT "%9.2" MONOTONY STRICT_INCREASE DEPOSIT ABSOLUTE /end AXIS_DESCR
/end CHARACTERISTIC
/begin CHARACTERISTIC KF_ZW_PF2___MGF_CC_FF2_Slot4 "Base ignition angle path 2 (Slot 4, Flex Fuel 2)" MAP 0x807D62D2 _REC_A1CUR_1_MBSE_S1_S1 127.5 aAwkuzc_BFpgCmb_tmDukma_q__aa0o -64 63.5 FORMAT "%4.1"
 /begin AXIS_DESCR COM_AXIS Nkw caoddzd_oAjpfzb_cAcEEha_1nR_oa0 20 -32768 32767 AXIS_PTS_REF AXX_KF_ZW_PF2 FORMAT "%5.0" MONOTONY STRICT_INCREASE DEPOSIT ABSOLUTE /end AXIS_DESCR
 /begin AXIS_DESCR COM_AXIS NO_INPUT_QUANTITY CgkBooc_wkiDfEd_Czglhgc_fR_1a0o 20 -327.68 327.67 AXIS_PTS_REF AXY_KF_ZW_PF2 FORMAT "%9.2" MONOTONY STRICT_INCREASE DEPOSIT ABSOLUTE /end AXIS_DESCR
/end CHARACTERISTIC
/begin CHARACTERISTIC KF_ZW_PF2___MGF_CC_PF_Slot0 "Base ignition angle path 2 (Slot 0, OEM Address)" MAP 0x8075CBC5 _REC_A1CUR_1_MBSE_S1_S1 127.5 aAwkuzc_BFpgCmb_tmDukma_q__aa0o -64 63.5 FORMAT "%4.1"
 /begin AXIS_DESCR COM_AXIS Nkw caoddzd_oAjpfzb_cAcEEha_1nR_oa0 20 -32768 32767 AXIS_PTS_REF AXX_KF_ZW_PF2 FORMAT "%5.0" MONOTONY STRICT_INCREASE DEPOSIT ABSOLUTE /end AXIS_DESCR
 /begin AXIS_DESCR COM_AXIS NO_INPUT_QUANTITY CgkBooc_wkiDfEd_Czglhgc_fR_1a0o 20 -327.68 327.67 AXIS_PTS_REF AXY_KF_ZW_PF2 FORMAT "%9.2" MONOTONY STRICT_INCREASE DEPOSIT ABSOLUTE /end AXIS_DESCR
/end CHARACTERISTIC
/begin CHARACTERISTIC KF_ZW_PF2___MGF_CC_PF_Slot1 "Base ignition angle path 2 (Slot 1, Pump Fuel)" MAP 0x807C5686 _REC_A1CUR_1_MBSE_S1_S1 127.5 aAwkuzc_BFpgCmb_tmDukma_q__aa0o -64 63.5 FORMAT "%4.1"
 /begin AXIS_DESCR COM_AXIS Nkw caoddzd_oAjpfzb_cAcEEha_1nR_oa0 20 -32768 32767 AXIS_PTS_REF AXX_KF_ZW_PF2 FORMAT "%5.0" MONOTONY STRICT_INCREASE DEPOSIT ABSOLUTE /end AXIS_DESCR
 /begin AXIS_DESCR COM_AXIS NO_INPUT_QUANTITY CgkBooc_wkiDfEd_Czglhgc_fR_1a0o 20 -327.68 327.67 AXIS_PTS_REF AXY_KF_ZW_PF2 FORMAT "%9.2" MONOTONY STRICT_INCREASE DEPOSIT ABSOLUTE /end AXIS_DESCR
/end CHARACTERISTIC
/begin CHARACTERISTIC KF_ZW_S_PF1 "Base ignition angle path 1 safe" MAP 0x8075CA35 _REC_A1CUR_1_MBSE_S1_S1 127.5 aAwkuzc_BFpgCmb_tmDukma_q__aa0o -64 63.5 FORMAT "%4.1"
 /begin AXIS_DESCR COM_AXIS Nkw caoddzd_oAjpfzb_cAcEEha_1nR_oa0 20 -32768 32767 AXIS_PTS_REF AXX_KF_ZW_S_PF1 FORMAT "%5.0" MONOTONY STRICT_INCREASE DEPOSIT ABSOLUTE /end AXIS_DESCR
 /begin AXIS_DESCR COM_AXIS NO_INPUT_QUANTITY CgkBooc_wkiDfEd_Czglhgc_fR_1a0o 20 -327.68 327.67 AXIS_PTS_REF AXY_KF_ZW_S_PF1 FORMAT "%9.2" MONOTONY STRICT_INCREASE DEPOSIT ABSOLUTE /end AXIS_DESCR
/end CHARACTERISTIC
/begin CHARACTERISTIC KF_ZW_S_PF1___MGF_CC_FF2_Slot4 "Base ignition angle path 1 safe (Slot 4, Flex Fuel 2)" MAP 0x807D6AA2 _REC_A1CUR_1_MBSE_S1_S1 127.5 aAwkuzc_BFpgCmb_tmDukma_q__aa0o -64 63.5 FORMAT "%4.1"
 /begin AXIS_DESCR COM_AXIS Nkw caoddzd_oAjpfzb_cAcEEha_1nR_oa0 20 -32768 32767 AXIS_PTS_REF AXX_KF_ZW_S_PF1 FORMAT "%5.0" MONOTONY STRICT_INCREASE DEPOSIT ABSOLUTE /end AXIS_DESCR
 /begin AXIS_DESCR COM_AXIS NO_INPUT_QUANTITY CgkBooc_wkiDfEd_Czglhgc_fR_1a0o 20 -327.68 327.67 AXIS_PTS_REF AXY_KF_ZW_S_PF1 FORMAT "%9.2" MONOTONY STRICT_INCREASE DEPOSIT ABSOLUTE /end AXIS_DESCR
/end CHARACTERISTIC
/begin CHARACTERISTIC KF_ZW_S_PF1___MGF_CC_PF_Slot0 "Base ignition angle path 1 safe (Slot 0, OEM Address)" MAP 0x8075CA35 _REC_A1CUR_1_MBSE_S1_S1 127.5 aAwkuzc_BFpgCmb_tmDukma_q__aa0o -64 63.5 FORMAT "%4.1"
 /begin AXIS_DESCR COM_AXIS Nkw caoddzd_oAjpfzb_cAcEEha_1nR_oa0 20 -32768 32767 AXIS_PTS_REF AXX_KF_ZW_S_PF1 FORMAT "%5.0" MONOTONY STRICT_INCREASE DEPOSIT ABSOLUTE /end AXIS_DESCR
 /begin AXIS_DESCR COM_AXIS NO_INPUT_QUANTITY CgkBooc_wkiDfEd_Czglhgc_fR_1a0o 20 -327.68 327.67 AXIS_PTS_REF AXY_KF_ZW_S_PF1 FORMAT "%9.2" MONOTONY STRICT_INCREASE DEPOSIT ABSOLUTE /end AXIS_DESCR
/end CHARACTERISTIC
/begin CHARACTERISTIC KF_ZW_S_PF1___MGF_CC_PF_Slot1 "Base ignition angle path 1 safe (Slot 1, Pump Fuel)" MAP 0x807C5CC6 _REC_A1CUR_1_MBSE_S1_S1 127.5 aAwkuzc_BFpgCmb_tmDukma_q__aa0o -64 63.5 FORMAT "%4.1"
 /begin AXIS_DESCR COM_AXIS Nkw caoddzd_oAjpfzb_cAcEEha_1nR_oa0 20 -32768 32767 AXIS_PTS_REF AXX_KF_ZW_S_PF1 FORMAT "%5.0" MONOTONY STRICT_INCREASE DEPOSIT ABSOLUTE /end AXIS_DESCR
 /begin AXIS_DESCR COM_AXIS NO_INPUT_QUANTITY CgkBooc_wkiDfEd_Czglhgc_fR_1a0o 20 -327.68 327.67 AXIS_PTS_REF AXY_KF_ZW_S_PF1 FORMAT "%9.2" MONOTONY STRICT_INCREASE DEPOSIT ABSOLUTE /end AXIS_DESCR
/end CHARACTERISTIC
/begin CHARACTERISTIC KF_ZW_S_PF2 "Base ignition angle path 2 safe" MAP 0x8075C8A5 _REC_A1CUR_1_MBSE_S1_S1 127.5 aAwkuzc_BFpgCmb_tmDukma_q__aa0o -64 63.5 FORMAT "%4.1"
 /begin AXIS_DESCR COM_AXIS Nkw caoddzd_oAjpfzb_cAcEEha_1nR_oa0 20 -32768 32767 AXIS_PTS_REF AXX_KF_ZW_S_PF2 FORMAT "%5.0" MONOTONY STRICT_INCREASE DEPOSIT ABSOLUTE /end AXIS_DESCR
 /begin AXIS_DESCR COM_AXIS NO_INPUT_QUANTITY CgkBooc_wkiDfEd_Czglhgc_fR_1a0o 20 -327.68 327.67 AXIS_PTS_REF AXY_KF_ZW_S_PF2 FORMAT "%9.2" MONOTONY STRICT_INCREASE DEPOSIT ABSOLUTE /end AXIS_DESCR
/end CHARACTERISTIC
/begin CHARACTERISTIC KF_ZW_S_PF2___MGF_CC_FF2_Slot4 "Base ignition angle path 2 safe (Slot 4, Flex Fuel 2)" MAP 0x807D7272 _REC_A1CUR_1_MBSE_S1_S1 127.5 aAwkuzc_BFpgCmb_tmDukma_q__aa0o -64 63.5 FORMAT "%4.1"
 /begin AXIS_DESCR COM_AXIS Nkw caoddzd_oAjpfzb_cAcEEha_1nR_oa0 20 -32768 32767 AXIS_PTS_REF AXX_KF_ZW_S_PF2 FORMAT "%5.0" MONOTONY STRICT_INCREASE DEPOSIT ABSOLUTE /end AXIS_DESCR
 /begin AXIS_DESCR COM_AXIS NO_INPUT_QUANTITY CgkBooc_wkiDfEd_Czglhgc_fR_1a0o 20 -327.68 327.67 AXIS_PTS_REF AXY_KF_ZW_S_PF2 FORMAT "%9.2" MONOTONY STRICT_INCREASE DEPOSIT ABSOLUTE /end AXIS_DESCR
/end CHARACTERISTIC
/begin CHARACTERISTIC KF_ZW_S_PF2___MGF_CC_PF_Slot0 "Base ignition angle path 2 safe (Slot 0, OEM Address)" MAP 0x8075C8A5 _REC_A1CUR_1_MBSE_S1_S1 127.5 aAwkuzc_BFpgCmb_tmDukma_q__aa0o -64 63.5 FORMAT "%4.1"
 /begin AXIS_DESCR COM_AXIS Nkw caoddzd_oAjpfzb_cAcEEha_1nR_oa0 20 -32768 32767 AXIS_PTS_REF AXX_KF_ZW_S_PF2 FORMAT "%5.0" MONOTONY STRICT_INCREASE DEPOSIT ABSOLUTE /end AXIS_DESCR
 /begin AXIS_DESCR COM_AXIS NO_INPUT_QUANTITY CgkBooc_wkiDfEd_Czglhgc_fR_1a0o 20 -327.68 327.67 AXIS_PTS_REF AXY_KF_ZW_S_PF2 FORMAT "%9.2" MONOTONY STRICT_INCREASE DEPOSIT ABSOLUTE /end AXIS_DESCR
/end CHARACTERISTIC
/begin CHARACTERISTIC KF_ZW_S_PF2___MGF_CC_PF_Slot1 "Base ignition angle path 2 safe (Slot 1, Pump Fuel)" MAP 0x807C6306 _REC_A1CUR_1_MBSE_S1_S1 127.5 aAwkuzc_BFpgCmb_tmDukma_q__aa0o -64 63.5 FORMAT "%4.1"
 /begin AXIS_DESCR COM_AXIS Nkw caoddzd_oAjpfzb_cAcEEha_1nR_oa0 20 -32768 32767 AXIS_PTS_REF AXX_KF_ZW_S_PF2 FORMAT "%5.0" MONOTONY STRICT_INCREASE DEPOSIT ABSOLUTE /end AXIS_DESCR
 /begin AXIS_DESCR COM_AXIS NO_INPUT_QUANTITY CgkBooc_wkiDfEd_Czglhgc_fR_1a0o 20 -327.68 327.67 AXIS_PTS_REF AXY_KF_ZW_S_PF2 FORMAT "%9.2" MONOTONY STRICT_INCREASE DEPOSIT ABSOLUTE /end AXIS_DESCR
/end CHARACTERISTIC
/begin CHARACTERISTIC KF_ZW_UESP_PF1 "Base ignition angle scavenging path 1" MAP 0x8075C819 _REC_A1CUR_1_MBSE_S1_S1 127.5 aAwkuzc_BFpgCmb_tmDukma_q__aa0o -64 63.5 FORMAT "%4.1"
 /begin AXIS_DESCR COM_AXIS Nkw caoddzd_oAjpfzb_cAcEEha_1nR_oa0 10 -32768 32767 AXIS_PTS_REF AXX_KF_ZW_UESP_PF1 FORMAT "%5.0" MONOTONY STRICT_INCREASE DEPOSIT ABSOLUTE /end AXIS_DESCR
 /begin AXIS_DESCR COM_AXIS NO_INPUT_QUANTITY CgkBooc_wkiDfEd_Czglhgc_fR_1a0o 14 -327.68 327.67 AXIS_PTS_REF AXY_KF_ZW_UESP_PF1 FORMAT "%9.2" MONOTONY STRICT_INCREASE DEPOSIT ABSOLUTE /end AXIS_DESCR
/end CHARACTERISTIC
/begin CHARACTERISTIC KF_ZW_UESP_PF1___MGF_CC_FF2_Slot4 "Base ignition angle scavenging path 1 (Slot 4, Flex Fuel 2)" MAP 0x807D7632 _REC_A1CUR_1_MBSE_S1_S1 127.5 aAwkuzc_BFpgCmb_tmDukma_q__aa0o -64 63.5 FORMAT "%4.1"
 /begin AXIS_DESCR COM_AXIS Nkw caoddzd_oAjpfzb_cAcEEha_1nR_oa0 10 -32768 32767 AXIS_PTS_REF AXX_KF_ZW_UESP_PF1 FORMAT "%5.0" MONOTONY STRICT_INCREASE DEPOSIT ABSOLUTE /end AXIS_DESCR
 /begin AXIS_DESCR COM_AXIS NO_INPUT_QUANTITY CgkBooc_wkiDfEd_Czglhgc_fR_1a0o 14 -327.68 327.67 AXIS_PTS_REF AXY_KF_ZW_UESP_PF1 FORMAT "%9.2" MONOTONY STRICT_INCREASE DEPOSIT ABSOLUTE /end AXIS_DESCR
/end CHARACTERISTIC
/begin CHARACTERISTIC KF_ZW_UESP_PF1___MGF_CC_PF_Slot0 "Base ignition angle scavenging path 1 (Slot 0, OEM Address)" MAP 0x8075C819 _REC_A1CUR_1_MBSE_S1_S1 127.5 aAwkuzc_BFpgCmb_tmDukma_q__aa0o -64 63.5 FORMAT "%4.1"
 /begin AXIS_DESCR COM_AXIS Nkw caoddzd_oAjpfzb_cAcEEha_1nR_oa0 10 -32768 32767 AXIS_PTS_REF AXX_KF_ZW_UESP_PF1 FORMAT "%5.0" MONOTONY STRICT_INCREASE DEPOSIT ABSOLUTE /end AXIS_DESCR
 /begin AXIS_DESCR COM_AXIS NO_INPUT_QUANTITY CgkBooc_wkiDfEd_Czglhgc_fR_1a0o 14 -327.68 327.67 AXIS_PTS_REF AXY_KF_ZW_UESP_PF1 FORMAT "%9.2" MONOTONY STRICT_INCREASE DEPOSIT ABSOLUTE /end AXIS_DESCR
/end CHARACTERISTIC
/begin CHARACTERISTIC KF_ZW_UESP_PF1___MGF_CC_PF_Slot1 "Base ignition angle scavenging path 1 (Slot 1, Pump Fuel)" MAP 0x807CEB7A _REC_A1CUR_1_MBSE_S1_S1 127.5 aAwkuzc_BFpgCmb_tmDukma_q__aa0o -64 63.5 FORMAT "%4.1"
 /begin AXIS_DESCR COM_AXIS Nkw caoddzd_oAjpfzb_cAcEEha_1nR_oa0 10 -32768 32767 AXIS_PTS_REF AXX_KF_ZW_UESP_PF1 FORMAT "%5.0" MONOTONY STRICT_INCREASE DEPOSIT ABSOLUTE /end AXIS_DESCR
 /begin AXIS_DESCR COM_AXIS NO_INPUT_QUANTITY CgkBooc_wkiDfEd_Czglhgc_fR_1a0o 14 -327.68 327.67 AXIS_PTS_REF AXY_KF_ZW_UESP_PF1 FORMAT "%9.2" MONOTONY STRICT_INCREASE DEPOSIT ABSOLUTE /end AXIS_DESCR
/end CHARACTERISTIC
/begin CHARACTERISTIC KF_ZW_UESP_PF2 "Base ignition angle scavenging path 2" MAP 0x8075C78D _REC_A1CUR_1_MBSE_S1_S1 127.5 aAwkuzc_BFpgCmb_tmDukma_q__aa0o -64 63.5 FORMAT "%4.1"
 /begin AXIS_DESCR COM_AXIS Nkw caoddzd_oAjpfzb_cAcEEha_1nR_oa0 10 -32768 32767 AXIS_PTS_REF AXX_KF_ZW_UESP_PF2 FORMAT "%5.0" MONOTONY STRICT_INCREASE DEPOSIT ABSOLUTE /end AXIS_DESCR
 /begin AXIS_DESCR COM_AXIS NO_INPUT_QUANTITY CgkBooc_wkiDfEd_Czglhgc_fR_1a0o 14 -327.68 327.67 AXIS_PTS_REF AXY_KF_ZW_UESP_PF2 FORMAT "%9.2" MONOTONY STRICT_INCREASE DEPOSIT ABSOLUTE /end AXIS_DESCR
/end CHARACTERISTIC
/begin CHARACTERISTIC KF_ZW_UESP_PF2___MGF_CC_FF2_Slot4 "Base ignition angle scavenging path 2 (Slot 4, Flex Fuel 2)" MAP 0x807D78EE _REC_A1CUR_1_MBSE_S1_S1 127.5 aAwkuzc_BFpgCmb_tmDukma_q__aa0o -64 63.5 FORMAT "%4.1"
 /begin AXIS_DESCR COM_AXIS Nkw caoddzd_oAjpfzb_cAcEEha_1nR_oa0 10 -32768 32767 AXIS_PTS_REF AXX_KF_ZW_UESP_PF2 FORMAT "%5.0" MONOTONY STRICT_INCREASE DEPOSIT ABSOLUTE /end AXIS_DESCR
 /begin AXIS_DESCR COM_AXIS NO_INPUT_QUANTITY CgkBooc_wkiDfEd_Czglhgc_fR_1a0o 14 -327.68 327.67 AXIS_PTS_REF AXY_KF_ZW_UESP_PF2 FORMAT "%9.2" MONOTONY STRICT_INCREASE DEPOSIT ABSOLUTE /end AXIS_DESCR
/end CHARACTERISTIC
/begin CHARACTERISTIC KF_ZW_UESP_PF2___MGF_CC_PF_Slot0 "Base ignition angle scavenging path 2 (Slot 0, OEM Address)" MAP 0x8075C78D _REC_A1CUR_1_MBSE_S1_S1 127.5 aAwkuzc_BFpgCmb_tmDukma_q__aa0o -64 63.5 FORMAT "%4.1"
 /begin AXIS_DESCR COM_AXIS Nkw caoddzd_oAjpfzb_cAcEEha_1nR_oa0 10 -32768 32767 AXIS_PTS_REF AXX_KF_ZW_UESP_PF2 FORMAT "%5.0" MONOTONY STRICT_INCREASE DEPOSIT ABSOLUTE /end AXIS_DESCR
 /begin AXIS_DESCR COM_AXIS NO_INPUT_QUANTITY CgkBooc_wkiDfEd_Czglhgc_fR_1a0o 14 -327.68 327.67 AXIS_PTS_REF AXY_KF_ZW_UESP_PF2 FORMAT "%9.2" MONOTONY STRICT_INCREASE DEPOSIT ABSOLUTE /end AXIS_DESCR
/end CHARACTERISTIC
/begin CHARACTERISTIC KF_ZW_UESP_PF2___MGF_CC_PF_Slot1 "Base ignition angle scavenging path 2 (Slot 1, Pump Fuel)" MAP 0x807CF066 _REC_A1CUR_1_MBSE_S1_S1 127.5 aAwkuzc_BFpgCmb_tmDukma_q__aa0o -64 63.5 FORMAT "%4.1"
 /begin AXIS_DESCR COM_AXIS Nkw caoddzd_oAjpfzb_cAcEEha_1nR_oa0 10 -32768 32767 AXIS_PTS_REF AXX_KF_ZW_UESP_PF2 FORMAT "%5.0" MONOTONY STRICT_INCREASE DEPOSIT ABSOLUTE /end AXIS_DESCR
 /begin AXIS_DESCR COM_AXIS NO_INPUT_QUANTITY CgkBooc_wkiDfEd_Czglhgc_fR_1a0o 14 -327.68 327.67 AXIS_PTS_REF AXY_KF_ZW_UESP_PF2 FORMAT "%9.2" MONOTONY STRICT_INCREASE DEPOSIT ABSOLUTE /end AXIS_DESCR
/end CHARACTERISTIC
/begin CHARACTERISTIC KF_ZW_VP_PF1 "Map for ignition angle with VANOS at stop F_basis=1 path 1" MAP 0x80763F2E _REC_A1CUR_1_MBSE_S1_S1 127.5 aAwkuzc_BFpgCmb_tmDukma_q__aa0o -64 63.5 FORMAT "%4.1"
 /begin AXIS_DESCR COM_AXIS Nkw caoddzd_oAjpfzb_cAcEEha_1nR_oa0 20 -32768 32767 AXIS_PTS_REF AXX_KF_ZW_VP_PF1 FORMAT "%5.0" MONOTONY STRICT_INCREASE DEPOSIT ABSOLUTE /end AXIS_DESCR
 /begin AXIS_DESCR COM_AXIS Rf_zwv CgkBooc_wkiDfEd_Czglhgc_fR_1a0o 16 -327.68 327.67 AXIS_PTS_REF AXY_KF_ZW_VP_PF1 FORMAT "%9.2" MONOTONY STRICT_INCREASE DEPOSIT ABSOLUTE /end AXIS_DESCR
/end CHARACTERISTIC
/begin CHARACTERISTIC KF_ZW_VP_PF1___MGF_CC_FF2_Slot4 "Map for ignition angle with VANOS at stop F_basis=1 path 1 (Slot 4, Flex Fuel 2)" MAP 0x807D7E7A _REC_A1CUR_1_MBSE_S1_S1 127.5 aAwkuzc_BFpgCmb_tmDukma_q__aa0o -64 63.5 FORMAT "%4.1"
 /begin AXIS_DESCR COM_AXIS Nkw caoddzd_oAjpfzb_cAcEEha_1nR_oa0 20 -32768 32767 AXIS_PTS_REF AXX_KF_ZW_VP_PF1 FORMAT "%5.0" MONOTONY STRICT_INCREASE DEPOSIT ABSOLUTE /end AXIS_DESCR
 /begin AXIS_DESCR COM_AXIS Rf_zwv CgkBooc_wkiDfEd_Czglhgc_fR_1a0o 16 -327.68 327.67 AXIS_PTS_REF AXY_KF_ZW_VP_PF1 FORMAT "%9.2" MONOTONY STRICT_INCREASE DEPOSIT ABSOLUTE /end AXIS_DESCR
/end CHARACTERISTIC
/begin CHARACTERISTIC KF_ZW_VP_PF1___MGF_CC_PF_Slot0 "Map for ignition angle with VANOS at stop F_basis=1 path 1 (Slot 0, OEM Address)" MAP 0x80763F2E _REC_A1CUR_1_MBSE_S1_S1 127.5 aAwkuzc_BFpgCmb_tmDukma_q__aa0o -64 63.5 FORMAT "%4.1"
 /begin AXIS_DESCR COM_AXIS Nkw caoddzd_oAjpfzb_cAcEEha_1nR_oa0 20 -32768 32767 AXIS_PTS_REF AXX_KF_ZW_VP_PF1 FORMAT "%5.0" MONOTONY STRICT_INCREASE DEPOSIT ABSOLUTE /end AXIS_DESCR
 /begin AXIS_DESCR COM_AXIS Rf_zwv CgkBooc_wkiDfEd_Czglhgc_fR_1a0o 16 -327.68 327.67 AXIS_PTS_REF AXY_KF_ZW_VP_PF1 FORMAT "%9.2" MONOTONY STRICT_INCREASE DEPOSIT ABSOLUTE /end AXIS_DESCR
/end CHARACTERISTIC
/begin CHARACTERISTIC KF_ZW_VP_PF1___MGF_CC_PF_Slot1 "Map for ignition angle with VANOS at stop F_basis=1 path 1 (Slot 1, Pump Fuel)" MAP 0x807C6DA6 _REC_A1CUR_1_MBSE_S1_S1 127.5 aAwkuzc_BFpgCmb_tmDukma_q__aa0o -64 63.5 FORMAT "%4.1"
 /begin AXIS_DESCR COM_AXIS Nkw caoddzd_oAjpfzb_cAcEEha_1nR_oa0 20 -32768 32767 AXIS_PTS_REF AXX_KF_ZW_VP_PF1 FORMAT "%5.0" MONOTONY STRICT_INCREASE DEPOSIT ABSOLUTE /end AXIS_DESCR
 /begin AXIS_DESCR COM_AXIS Rf_zwv CgkBooc_wkiDfEd_Czglhgc_fR_1a0o 16 -327.68 327.67 AXIS_PTS_REF AXY_KF_ZW_VP_PF1 FORMAT "%9.2" MONOTONY STRICT_INCREASE DEPOSIT ABSOLUTE /end AXIS_DESCR
/end CHARACTERISTIC
/begin CHARACTERISTIC KF_ZW_VP_PF2 "Map for ignition angle with VANOS at stop F_basis=1 path 2" MAP 0x80763DEE _REC_A1CUR_1_MBSE_S1_S1 127.5 aAwkuzc_BFpgCmb_tmDukma_q__aa0o -64 63.5 FORMAT "%4.1"
 /begin AXIS_DESCR COM_AXIS Nkw caoddzd_oAjpfzb_cAcEEha_1nR_oa0 20 -32768 32767 AXIS_PTS_REF AXX_KF_ZW_VP_PF2 FORMAT "%5.0" MONOTONY STRICT_INCREASE DEPOSIT ABSOLUTE /end AXIS_DESCR
 /begin AXIS_DESCR COM_AXIS Rf_zwv CgkBooc_wkiDfEd_Czglhgc_fR_1a0o 16 -327.68 327.67 AXIS_PTS_REF AXY_KF_ZW_VP_PF2 FORMAT "%9.2" MONOTONY STRICT_INCREASE DEPOSIT ABSOLUTE /end AXIS_DESCR
/end CHARACTERISTIC
/begin CHARACTERISTIC KF_ZW_VP_PF2___MGF_CC_FF2_Slot4 "Map for ignition angle with VANOS at stop F_basis=1 path 2 (Slot 4, Flex Fuel 2)" MAP 0x807D84BA _REC_A1CUR_1_MBSE_S1_S1 127.5 aAwkuzc_BFpgCmb_tmDukma_q__aa0o -64 63.5 FORMAT "%4.1"
 /begin AXIS_DESCR COM_AXIS Nkw caoddzd_oAjpfzb_cAcEEha_1nR_oa0 20 -32768 32767 AXIS_PTS_REF AXX_KF_ZW_VP_PF2 FORMAT "%5.0" MONOTONY STRICT_INCREASE DEPOSIT ABSOLUTE /end AXIS_DESCR
 /begin AXIS_DESCR COM_AXIS Rf_zwv CgkBooc_wkiDfEd_Czglhgc_fR_1a0o 16 -327.68 327.67 AXIS_PTS_REF AXY_KF_ZW_VP_PF2 FORMAT "%9.2" MONOTONY STRICT_INCREASE DEPOSIT ABSOLUTE /end AXIS_DESCR
/end CHARACTERISTIC
/begin CHARACTERISTIC KF_ZW_VP_PF2___MGF_CC_PF_Slot0 "Map for ignition angle with VANOS at stop F_basis=1 path 2 (Slot 0, OEM Address)" MAP 0x80763DEE _REC_A1CUR_1_MBSE_S1_S1 127.5 aAwkuzc_BFpgCmb_tmDukma_q__aa0o -64 63.5 FORMAT "%4.1"
 /begin AXIS_DESCR COM_AXIS Nkw caoddzd_oAjpfzb_cAcEEha_1nR_oa0 20 -32768 32767 AXIS_PTS_REF AXX_KF_ZW_VP_PF2 FORMAT "%5.0" MONOTONY STRICT_INCREASE DEPOSIT ABSOLUTE /end AXIS_DESCR
 /begin AXIS_DESCR COM_AXIS Rf_zwv CgkBooc_wkiDfEd_Czglhgc_fR_1a0o 16 -327.68 327.67 AXIS_PTS_REF AXY_KF_ZW_VP_PF2 FORMAT "%9.2" MONOTONY STRICT_INCREASE DEPOSIT ABSOLUTE /end AXIS_DESCR
/end CHARACTERISTIC
/begin CHARACTERISTIC KF_ZW_VP_PF2___MGF_CC_PF_Slot1 "Map for ignition angle with VANOS at stop F_basis=1 path 2 (Slot 1, Pump Fuel)" MAP 0x807C72A6 _REC_A1CUR_1_MBSE_S1_S1 127.5 aAwkuzc_BFpgCmb_tmDukma_q__aa0o -64 63.5 FORMAT "%4.1"
 /begin AXIS_DESCR COM_AXIS Nkw caoddzd_oAjpfzb_cAcEEha_1nR_oa0 20 -32768 32767 AXIS_PTS_REF AXX_KF_ZW_VP_PF2 FORMAT "%5.0" MONOTONY STRICT_INCREASE DEPOSIT ABSOLUTE /end AXIS_DESCR
 /begin AXIS_DESCR COM_AXIS Rf_zwv CgkBooc_wkiDfEd_Czglhgc_fR_1a0o 16 -327.68 327.67 AXIS_PTS_REF AXY_KF_ZW_VP_PF2 FORMAT "%9.2" MONOTONY STRICT_INCREASE DEPOSIT ABSOLUTE /end AXIS_DESCR
/end CHARACTERISTIC
/begin FUNCTION FlexFuel_Slot4_FF2_FuelTargets "Lambda targets"
 /begin DEF_CHARACTERISTIC KF_LABAS_1___MGF_CC_FF2_Slot4 KF_LABAS_2___MGF_CC_FF2_Slot4 /end DEF_CHARACTERISTIC
/end FUNCTION
/begin FUNCTION FlexFuel_Slot4_FF2_Ignition "Timing targets"
 /begin DEF_CHARACTERISTIC KF_ZW_UESP_PF2___MGF_CC_FF2_Slot4 KF_ZW_UESP_PF1___MGF_CC_FF2_Slot4 KF_ZW_S_PF2___MGF_CC_FF2_Slot4 KF_ZW_S_PF1___MGF_CC_FF2_Slot4 KF_ZW_PF2___MGF_CC_FF2_Slot4 KF_ZW_PF1___MGF_CC_FF2_Slot4 KF_ZW_VP_PF2___MGF_CC_FF2_Slot4 KF_ZW_VP_PF1___MGF_CC_FF2_Slot4 /end DEF_CHARACTERISTIC
/end FUNCTION
/begin FUNCTION FlexFuel_Slot4_FF2_Knock "Knock factors and corrections"
 /begin DEF_CHARACTERISTIC KF_FDZWT_PF2___MGF_CC_FF2_Slot4 KF_FDZWT_PF1___MGF_CC_FF2_Slot4 IKCtl_FacKnockDetThd0_GM___MGF_CC_FF2_Slot4 IKCtl_FacKnockDetThd1_GM___MGF_CC_FF2_Slot4 IKCtl_FacKnockDetThd2_GM___MGF_CC_FF2_Slot4 IKCtl_FacKnockDetThd3_GM___MGF_CC_FF2_Slot4 IKCtl_FacKnockDetThd4_GM___MGF_CC_FF2_Slot4 IKCtl_FacKnockDetThd5_GM___MGF_CC_FF2_Slot4 /end DEF_CHARACTERISTIC
/end FUNCTION
/begin FUNCTION FlexFuel_Slot4_FF2_LoadControl "Load targets and limiters"
 /begin DEF_CHARACTERISTIC KL_RF_MAX_UESP___MGF_CC_FF2_Slot4 KL_RF_MAX___MGF_CC_FF2_Slot4 /end DEF_CHARACTERISTIC
/end FUNCTION
/begin FUNCTION FlexFuel_Slot4_FF2_WastegateControl "WGDC PIDs"
 /begin DEF_CHARACTERISTIC BMWtchctr_pwr_PctlWideRng_M___MGF_CC_FF2_Slot4 BMWtchctr_pwr_Dp_M___MGF_CC_FF2_Slot4 BMWtchctr_p_DifCrtnPp_M___MGF_CC_FF2_Slot4 BMWtchctr_pct_WgBasc_M___MGF_CC_FF2_Slot4 /end DEF_CHARACTERISTIC
/end FUNCTION
/begin FUNCTION FlexFuel_Slot4_SensorlessValues "E% without sensor (ECA)" /begin DEF_CHARACTERISTIC FlexFuelEthanolValue___MGF_CC_FF1_Slot4 /end DEF_CHARACTERISTIC /end FUNCTION
/begin FUNCTION FuelCorrection "Lambda modifiers" /begin DEF_CHARACTERISTIC KF_FRKKORRF_1 KF_PHA_H_B1_W KF_PHA_H_E1 /end DEF_CHARACTERISTIC /end FUNCTION
/begin FUNCTION FuelLimits "Lambda limits" /begin DEF_CHARACTERISTIC K_BS_MN K_FRFMXBS_MN KF_BSLGF /end DEF_CHARACTERISTIC /end FUNCTION
/begin FUNCTION FuelTargets "Lambda targets"
 /begin DEF_CHARACTERISTIC KF_LABAS_1 K_MSVANST_DIFFPRAIL BMWinjmon_fac_HppEff_M KF_PHA_H_B1_SK_PRE BMWext_lam_MinCptPronInit_Ca BMWext_lam_CptPronDfco_T KF_DLAMBSVST_TABG BMWlpa_n_EfpModMax_C BMWlpa_n_EfpModSafe_M BMWlpa_n_EfpEngStrtPRail_T BMWlpsc_volf_FuEjrPmp_M BMWlpsd_p_RailDifMax_T KF_LAMIN_H KF_PRAIL_H_K KF_PRAIL_HGD_K KF_PRAIL_HGD KF_PRAIL_HDPWARM_KH KF_PRAIL_HDPWARM KF_PRAIL_H BMWtqe_n_LamStrdMax_C KF_LA_BEZ KF_KOEFF_B_LA BMWchas_p_RailInjSng_M BMWchas_p_RailInjMpl_M BMWlpa_volf_FuFpcOvrT_C BMWlpa_volf_FuBoosRstOfs_C BMWlpa_volf_FuMaxBoosCtlr_T BMWlpsc_p_HppMax_T K_PRAIL_ST_MAX K_LA_FETTDELAY KF_LA_SK KF_LABAS_2 KF_ST_RKBAS_VVT KF_ST_RKBAS_GD BMWlpa_fac_n_PwrMgrFild_C CW_ATMOD S_PRAIL_GL_LA1 S_AUSWAHL_FETTDELAY K_T_FETTDELAY_SPERR KF_TD_FETTDELAY_TABG VSEKPMXN FuPHi_FlmMaxpl_T FWIHDR KLIHDR KLPHDR KLPHDRTF NMXHDR KLFVSTOTF KLVSTMSVG /end DEF_CHARACTERISTIC
/end FUNCTION
/begin FUNCTION GenericCharacteristics "OEM Maps"
 /begin SUB_FUNCTION FuelTargets OilPressure Exhaust TorqueLimiters DisplayCalibration LoadControl Boost EngineSpeed FuelCorrection Limits FuelLimits ExhaustGasTemperature LowPressureFuelPump Vanos WastegateControl ThrottleControl Cooling Ignition Knock MAFSensor TorqueMonitoring /end SUB_FUNCTION
/end FUNCTION
/begin FUNCTION Ignition "Timing targets"
 /begin DEF_CHARACTERISTIC KF_FDZWT_BEST_PF2 KF_FDZWT_BEST_PF1 KF_ZW_UESP_PF2 KF_ZW_UESP_PF1 KF_ZW_S_PF2 KF_ZW_S_PF1 KF_ZW_PF2 KF_ZW_PF1 KF_DZW_DYN KF_FDZW_DYN4 KF_FDZW_DYN3 KF_FDZW_DYN2 KF_FDZW_DYN1 KF_DZWT_UESP_PF2 KF_DZWT_UESP_PF1 KF_DZWT_PF2 KF_DZWT_PF1 BMW_swi_SpkPlugPronAcvn_C KF_ZW_VP_PF2 KF_ZW_VP_PF1 /end DEF_CHARACTERISTIC
/end FUNCTION
/begin FUNCTION Knock "Knock factors and corrections"
 /begin DEF_CHARACTERISTIC KF_FDZWT_PF2 KF_FDZWT_PF1 IKCtl_FacKnockDetThd0_GM IKCtl_FacKnockDetThd1_GM IKCtl_FacKnockDetThd2_GM IKCtl_FacKnockDetThd3_GM IKCtl_FacKnockDetThd4_GM IKCtl_FacKnockDetThd5_GM IKCtl_facKnkRtdtCyl0_M IKCtl_facKnkRtdtCyl1_M IKCtl_facKnkRtdtCyl2_M IKCtl_facKnkRtdtCyl3_M IKCtl_facKnkRtdtCyl4_M IKCtl_facKnkRtdtCyl5_M /end DEF_CHARACTERISTIC
/end FUNCTION
/begin FUNCTION Limits "General limiters"
 /begin DEF_CHARACTERISTIC BMWinjmon_vol_HppCmpn_C KF_MDK_MAX_GANG_NKW MoFETC_tiAccExcddThd_C VROHMAX /end DEF_CHARACTERISTIC
/end FUNCTION
/begin FUNCTION LoadControl "Load targets and limiters"
 /begin DEF_CHARACTERISTIC KF_EDA_ANZ_SPORT_MD_EM1_IST K_RFVIST_MX BMWinjafs_fac_RatAirMax_T K_RFMIN_KRSTSYS BMWext_lam_CptPronMinLeanTq_M KL_FRFMXBS KL_RFVHUBDYNKOR KL_RF_MAX_UESP KL_RF_MAX BMWls_rf_MaxModEng_M BMWls_rf_MaxFuOctIntkT_M BMWls_rf_MaxFuOctIntkTSpt_M BMWls_rf_MaxEgT_M BMWls_pct_FiMaxIgOfs_M BMWls_pct_FiMaxIgOfsSpt_M BMWls_pct_FiMaxCondRisk_T KL_LAMX BMWtchdiag_rf_SpMin_C BMWtchsp_rf_Liho_T KF_MDIOP_1_TQE KL_RFMIN_KRSTSYS BMWgpfdiag_rf_LimPclFilMin_T S_BSRFMX BMWls_fac_rf_RednFuOctIntkT_M /end DEF_CHARACTERISTIC
/end FUNCTION
/begin FUNCTION LowPressureFuelPump "LPFP targets and limiters"
 /begin DEF_CHARACTERISTIC BMWlpa_rat_EfpPwm_T BMWlpa_fac_AirLimOvrTMin_C BMWlpa_rat_AirLimMax_C BMWlpa_rat_AirLimGraNeg_C BMWlpa_rat_AirLimMin_C /end DEF_CHARACTERISTIC
/end FUNCTION
/begin FUNCTION MAFSensor "Mass air flow quotient"
 /begin DEF_CHARACTERISTIC K_HFMPLCD_NKW_MX KF_FMS_HFMPL_MX KF_FMS_HFMPL_MN KF_FMS_DKPSRPL_MX KF_FMS_DKPSRPL_MN /end DEF_CHARACTERISTIC
/end FUNCTION
/begin FUNCTION MaxCooling "Keep the engine intake cool"
 /begin DEF_CHARACTERISTIC MaxCooling_TargetFanSpeed___MGF_CC MaxCooling_TargetTemperature___MGF_CC /end DEF_CHARACTERISTIC
 /begin SUB_FUNCTION MaxCooling_Codewords /end SUB_FUNCTION
/end FUNCTION
/begin FUNCTION MaxCooling_Codewords "" /begin DEF_CHARACTERISTIC CW_MaxCooling_FanSpeed___MGF_CC CW_MaxCooling___MGF_CC /end DEF_CHARACTERISTIC /end FUNCTION
/begin FUNCTION OilPressure "Oil Pressure" /begin DEF_CHARACTERISTIC KF_POELSOLL_ADP_FAK KF_POELSOLL_ADP KF_POELSOLL /end DEF_CHARACTERISTIC /end FUNCTION
/begin FUNCTION RadiatorFlap "Force radiator flap controls" /begin SUB_FUNCTION RadiatorFlapOnTheFly_Codewords /end SUB_FUNCTION /end FUNCTION
/begin FUNCTION RadiatorFlapOnTheFly_Codewords "" /begin DEF_CHARACTERISTIC CW_RadiatorFlapOnTheFly___MGF_CC /end DEF_CHARACTERISTIC /end FUNCTION
/begin FUNCTION SwitchableMaps "Switch between 5 different calibrations"
 /begin SUB_FUNCTION SwitchableMaps_General_Codewords SwitchableMaps_Map_Codewords SwitchableMaps_Slot0 SwitchableMaps_Slot1 SwitchableMaps_Slot2 SwitchableMaps_Slot3 SwitchableMaps_Slot4 /end SUB_FUNCTION
/end FUNCTION
/begin FUNCTION SwitchableMaps_General_Codewords "" /begin DEF_CHARACTERISTIC CW_OctaneSwitch___MGF_CC /end DEF_CHARACTERISTIC /end FUNCTION
/begin FUNCTION SwitchableMaps_Map_Codewords ""
 /begin DEF_CHARACTERISTIC CW_MapSwitch_KL_RF_MAX_UESP___MGF_CC CW_MapSwitch_KL_RF_MAX___MGF_CC CW_MapSwitch_KF_ZW_S_PF2___MGF_CC CW_MapSwitch_KF_ZW_S_PF1___MGF_CC CW_MapSwitch_KF_ZW_PF2___MGF_CC CW_MapSwitch_KF_ZW_PF1___MGF_CC CW_MapSwitch_KF_ZW_VP_PF2___MGF_CC CW_MapSwitch_KF_ZW_VP_PF1___MGF_CC CW_MapSwitch_KF_FDZWT_PF2___MGF_CC CW_MapSwitch_KF_FDZWT_PF1___MGF_CC CW_MapSwitch_KF_LABAS_1___MGF_CC CW_MapSwitch_KF_LABAS_2___MGF_CC CW_MapSwitch_BMWtchctr_pct_WgBasc_M___MGF_CC CW_MapSwitch_BMWtchctr_pwr_Dp_M___MGF_CC CW_MapSwitch_BMWtchctr_pwr_PctlWideRng_M___MGF_CC CW_MapSwitch_BMWtchctr_p_DifCrtnPp_M___MGF_CC CW_MapSwitch_BMWtchsp_p_ReqMax_C___MGF_CC CW_MapSwitch_KF_FRKKORRF_1___MGF_CC CW_MapSwitch_KF_PHA_H_B1_W___MGF_CC CW_MapSwitch_KF_PHA_H_E1___MGF_CC CW_MapSwitch_KF_ZW_UESP_PF1___MGF_CC CW_MapSwitch_KF_ZW_UESP_PF2___MGF_CC CW_MapSwitch_IKCtl_FacKnockDetThd0_GM___MGF_CC CW_MapSwitch_IKCtl_FacKnockDetThd1_GM___MGF_CC CW_MapSwitch_IKCtl_FacKnockDetThd2_GM___MGF_CC CW_MapSwitch_IKCtl_FacKnockDetThd3_GM___MGF_CC CW_MapSwitch_IKCtl_FacKnockDetThd4_GM___MGF_CC CW_MapSwitch_IKCtl_FacKnockDetThd5_GM___MGF_CC CW_MapSwitch_BMWtchsp_rat_p_CmprPmp_T___MGF_CC CW_MapSwitch_BMWtchsp_rat_p_CmprMax_M___MGF_CC CW_MapSwitch_KL_MDKMX_VL_APPLZ___MGF_CC CW_MapSwitch_BMWtqe_tqc_FlApplStgNorm_T___MGF_CC CW_MapSwitch_BMWtqe_tqc_FlApplStgPwrHi_T___MGF_CC CW_MapSwitch_BMWtqe_tqc_FlApplStgPwr2_T___MGF_CC CW_MapSwitch_BMWtqe_tqc_FlApplStgPwr1_T___MGF_CC CW_MapSwitch_BMWtqe_tqc_FlApplBol_T___MGF_CC /end DEF_CHARACTERISTIC
/end FUNCTION
/begin FUNCTION SwitchableMaps_Slot0 ""
 /begin SUB_FUNCTION SwitchableMaps_Slot0_FuelTargets SwitchableMaps_Slot0_FuelCorrection SwitchableMaps_Slot0_LoadControl SwitchableMaps_Slot0_WastegateControl SwitchableMaps_Slot0_Boost SwitchableMaps_Slot0_TorqueLimiters SwitchableMaps_Slot0_Knock SwitchableMaps_Slot0_Ignition /end SUB_FUNCTION
/end FUNCTION
/begin FUNCTION SwitchableMaps_Slot0_Boost "Intake/exhaust pressure targets/limits"
 /begin DEF_CHARACTERISTIC BMWtchsp_p_ReqMax_C___MGF_CC_PF_Slot0 BMWtchsp_rat_p_CmprMax_M___MGF_CC_PF_Slot0 BMWtchsp_rat_p_CmprPmp_T___MGF_CC_PF_Slot0 /end DEF_CHARACTERISTIC
/end FUNCTION
/begin FUNCTION SwitchableMaps_Slot0_FuelCorrection "Lambda modifiers"
 /begin DEF_CHARACTERISTIC KF_FRKKORRF_1___MGF_CC_PF_Slot0 KF_PHA_H_B1_W___MGF_CC_PF_Slot0 KF_PHA_H_E1___MGF_CC_PF_Slot0 /end DEF_CHARACTERISTIC
/end FUNCTION
/begin FUNCTION SwitchableMaps_Slot0_FuelTargets "Lambda targets" /begin DEF_CHARACTERISTIC KF_LABAS_1___MGF_CC_PF_Slot0 KF_LABAS_2___MGF_CC_PF_Slot0 /end DEF_CHARACTERISTIC /end FUNCTION
/begin FUNCTION SwitchableMaps_Slot0_Ignition "Timing targets"
 /begin DEF_CHARACTERISTIC KF_ZW_UESP_PF2___MGF_CC_PF_Slot0 KF_ZW_UESP_PF1___MGF_CC_PF_Slot0 KF_ZW_S_PF2___MGF_CC_PF_Slot0 KF_ZW_S_PF1___MGF_CC_PF_Slot0 KF_ZW_PF2___MGF_CC_PF_Slot0 KF_ZW_PF1___MGF_CC_PF_Slot0 KF_ZW_VP_PF2___MGF_CC_PF_Slot0 KF_ZW_VP_PF1___MGF_CC_PF_Slot0 /end DEF_CHARACTERISTIC
/end FUNCTION
/begin FUNCTION SwitchableMaps_Slot0_Knock "Knock factors and corrections"
 /begin DEF_CHARACTERISTIC KF_FDZWT_PF2___MGF_CC_PF_Slot0 KF_FDZWT_PF1___MGF_CC_PF_Slot0 IKCtl_FacKnockDetThd0_GM___MGF_CC_PF_Slot0 IKCtl_FacKnockDetThd1_GM___MGF_CC_PF_Slot0 IKCtl_FacKnockDetThd2_GM___MGF_CC_PF_Slot0 IKCtl_FacKnockDetThd3_GM___MGF_CC_PF_Slot0 IKCtl_FacKnockDetThd4_GM___MGF_CC_PF_Slot0 IKCtl_FacKnockDetThd5_GM___MGF_CC_PF_Slot0 /end DEF_CHARACTERISTIC
/end FUNCTION
/begin FUNCTION SwitchableMaps_Slot0_LoadControl "Load targets and limiters"
 /begin DEF_CHARACTERISTIC KL_RF_MAX_UESP___MGF_CC_PF_Slot0 KL_RF_MAX___MGF_CC_PF_Slot0 /end DEF_CHARACTERISTIC
/end FUNCTION
/begin FUNCTION SwitchableMaps_Slot0_TorqueLimiters "Torque limits"
 /begin DEF_CHARACTERISTIC BMWtqe_tqc_FlApplStgPwrHi_T___MGF_CC_PF_Slot0 BMWtqe_tqc_FlApplStgPwr2_T___MGF_CC_PF_Slot0 BMWtqe_tqc_FlApplStgPwr1_T___MGF_CC_PF_Slot0 BMWtqe_tqc_FlApplStgNorm_T___MGF_CC_PF_Slot0 BMWtqe_tqc_FlApplBol_T___MGF_CC_PF_Slot0 /end DEF_CHARACTERISTIC
/end FUNCTION
/begin FUNCTION SwitchableMaps_Slot0_WastegateControl "WGDC PIDs"
 /begin DEF_CHARACTERISTIC BMWtchctr_pwr_PctlWideRng_M___MGF_CC_PF_Slot0 BMWtchctr_pwr_Dp_M___MGF_CC_PF_Slot0 BMWtchctr_p_DifCrtnPp_M___MGF_CC_PF_Slot0 BMWtchctr_pct_WgBasc_M___MGF_CC_PF_Slot0 /end DEF_CHARACTERISTIC
/end FUNCTION
/begin FUNCTION SwitchableMaps_Slot1 ""
 /begin SUB_FUNCTION SwitchableMaps_Slot1_Codewords SwitchableMaps_Slot1_FuelTargets SwitchableMaps_Slot1_FuelCorrection SwitchableMaps_Slot1_LoadControl SwitchableMaps_Slot1_WastegateControl SwitchableMaps_Slot1_Boost SwitchableMaps_Slot1_TorqueLimiters SwitchableMaps_Slot1_Knock SwitchableMaps_Slot1_Ignition /end SUB_FUNCTION
/end FUNCTION
/begin FUNCTION SwitchableMaps_Slot1_Boost "Intake/exhaust pressure targets/limits"
 /begin DEF_CHARACTERISTIC BMWtchsp_p_ReqMax_C___MGF_CC_PF_Slot1 BMWtchsp_rat_p_CmprMax_M___MGF_CC_PF_Slot1 BMWtchsp_rat_p_CmprPmp_T___MGF_CC_PF_Slot1 /end DEF_CHARACTERISTIC
/end FUNCTION
/begin FUNCTION SwitchableMaps_Slot1_Codewords "" /begin DEF_CHARACTERISTIC CW_MapSwitch_Slot1___MGF_CC /end DEF_CHARACTERISTIC /end FUNCTION
/begin FUNCTION SwitchableMaps_Slot1_FuelCorrection "Lambda modifiers"
 /begin DEF_CHARACTERISTIC KF_FRKKORRF_1___MGF_CC_PF_Slot1 KF_PHA_H_B1_W___MGF_CC_PF_Slot1 KF_PHA_H_E1___MGF_CC_PF_Slot1 /end DEF_CHARACTERISTIC
/end FUNCTION
/begin FUNCTION SwitchableMaps_Slot1_FuelTargets "Lambda targets" /begin DEF_CHARACTERISTIC KF_LABAS_1___MGF_CC_PF_Slot1 KF_LABAS_2___MGF_CC_PF_Slot1 /end DEF_CHARACTERISTIC /end FUNCTION
/begin FUNCTION SwitchableMaps_Slot1_Ignition "Timing targets"
 /begin DEF_CHARACTERISTIC KF_ZW_UESP_PF2___MGF_CC_PF_Slot1 KF_ZW_UESP_PF1___MGF_CC_PF_Slot1 KF_ZW_S_PF2___MGF_CC_PF_Slot1 KF_ZW_S_PF1___MGF_CC_PF_Slot1 KF_ZW_PF2___MGF_CC_PF_Slot1 KF_ZW_PF1___MGF_CC_PF_Slot1 KF_ZW_VP_PF2___MGF_CC_PF_Slot1 KF_ZW_VP_PF1___MGF_CC_PF_Slot1 /end DEF_CHARACTERISTIC
/end FUNCTION
/begin FUNCTION SwitchableMaps_Slot1_Knock "Knock factors and corrections"
 /begin DEF_CHARACTERISTIC KF_FDZWT_PF2___MGF_CC_PF_Slot1 KF_FDZWT_PF1___MGF_CC_PF_Slot1 IKCtl_FacKnockDetThd0_GM___MGF_CC_PF_Slot1 IKCtl_FacKnockDetThd1_GM___MGF_CC_PF_Slot1 IKCtl_FacKnockDetThd2_GM___MGF_CC_PF_Slot1 IKCtl_FacKnockDetThd3_GM___MGF_CC_PF_Slot1 IKCtl_FacKnockDetThd4_GM___MGF_CC_PF_Slot1 IKCtl_FacKnockDetThd5_GM___MGF_CC_PF_Slot1 /end DEF_CHARACTERISTIC
/end FUNCTION
/begin FUNCTION SwitchableMaps_Slot1_LoadControl "Load targets and limiters"
 /begin DEF_CHARACTERISTIC KL_RF_MAX_UESP___MGF_CC_PF_Slot1 KL_RF_MAX___MGF_CC_PF_Slot1 /end DEF_CHARACTERISTIC
/end FUNCTION
/begin FUNCTION SwitchableMaps_Slot1_TorqueLimiters "Torque limits"
 /begin DEF_CHARACTERISTIC BMWtqe_tqc_FlApplStgPwrHi_T___MGF_CC_PF_Slot1 BMWtqe_tqc_FlApplStgPwr2_T___MGF_CC_PF_Slot1 BMWtqe_tqc_FlApplStgPwr1_T___MGF_CC_PF_Slot1 BMWtqe_tqc_FlApplStgNorm_T___MGF_CC_PF_Slot1 BMWtqe_tqc_FlApplBol_T___MGF_CC_PF_Slot1 /end DEF_CHARACTERISTIC
/end FUNCTION
/begin FUNCTION SwitchableMaps_Slot1_WastegateControl "WGDC PIDs"
 /begin DEF_CHARACTERISTIC BMWtchctr_pwr_PctlWideRng_M___MGF_CC_PF_Slot1 BMWtchctr_pwr_Dp_M___MGF_CC_PF_Slot1 BMWtchctr_p_DifCrtnPp_M___MGF_CC_PF_Slot1 BMWtchctr_pct_WgBasc_M___MGF_CC_PF_Slot1 /end DEF_CHARACTERISTIC
/end FUNCTION
/begin FUNCTION SwitchableMaps_Slot2 ""
 /begin SUB_FUNCTION SwitchableMaps_Slot2_Codewords SwitchableMaps_Slot2_FuelTargets SwitchableMaps_Slot2_FuelCorrection SwitchableMaps_Slot2_LoadControl SwitchableMaps_Slot2_WastegateControl SwitchableMaps_Slot2_Boost SwitchableMaps_Slot2_TorqueLimiters SwitchableMaps_Slot2_Knock SwitchableMaps_Slot2_Ignition /end SUB_FUNCTION
/end FUNCTION
/begin COMPU_METHOD ___MGF_CC_Pedal_x100_d256 "default compuMethod" RAT_FUNC "%6.3" "%" COEFFS 0 256 0 0 0 100 /end COMPU_METHOD
/begin COMPU_METHOD aAwkuzc_BFpgCmb_tmDukma_q__aa0o "aAwkuzc_BFpgCmb_tmDukma_q__aa0o" RAT_FUNC "%6.3" "°" COEFFS 0 2 0 0 0 1 /end COMPU_METHOD
/begin COMPU_METHOD acriqBc_tfkBqod_ocgjxzc_nR_8oa0 "acriqBc_tfkBqod_ocgjxzc_nR_8oa0" RAT_FUNC "%6.3" "-" COEFFS 0 8192 0 0 0 1 /end COMPU_METHOD
/begin COMPU_METHOD aEmoCzd_erpwvfb_msfkhgc_qR_1a0o "aEmoCzd_erpwvfb_msfkhgc_qR_1a0o" RAT_FUNC "%6.3" "°" COEFFS 0 128 0 0 0 3 /end COMPU_METHOD
/begin COMPU_METHOD AFeDmkb_cAbjmcc_kAkskhd_k__0oa0 "AFeDmkb_cAbjmcc_kAkskhd_k__0oa0" RAT_FUNC "%6.3" "km/h" COEFFS 0 1 0 0 0 1 /end COMPU_METHOD
/begin COMPU_METHOD B_TRUE "" TAB_VERB "%6.3" "" COMPU_TAB_REF ACCLNTVLV_ASWTYPTWINFLWSTD_SY_Compu /end COMPU_METHOD
/begin COMPU_METHOD Bhvfwhc_bigEubd_BBEupBd_nR_3oa0 "Bhvfwhc_bigEubd_BBEupBd_nR_3oa0" RAT_FUNC "%6.3" "-" COEFFS 0 32768 0 0 0 1 /end COMPU_METHOD
/begin COMPU_METHOD BMW_dm_sw_q0p1_Nm "" RAT_FUNC "%6.3" "Nm" COEFFS 0 10 0 0 0 1 /end COMPU_METHOD
/begin COMPU_METHOD BMW_p_sw_q0p125_hPa "" RAT_FUNC "%6.3" "hPa" COEFFS 0 8 0 0 0 1 /end COMPU_METHOD
/begin COMPU_METHOD BMW_Powertrain_DxECompuMethods_Def_ub_b1_nounit "Def_ub_b1" RAT_FUNC "%6.3" "-" COEFFS 0 256 0 0 0 1 /end COMPU_METHOD
/begin COMPU_METHOD BMW_q0p1_deg "" RAT_FUNC "%6.3" "°" COEFFS 0 10 0 0 0 1 /end COMPU_METHOD
/begin COMPU_METHOD BMW_q0p1_degC "" RAT_FUNC "%6.3" "°C" COEFFS 0 10 0 0 0 1 /end COMPU_METHOD
/begin COMPU_METHOD BMW_q0p2_s "" RAT_FUNC "%6.3" "s" COEFFS 0 5 0 0 0 1 /end COMPU_METHOD
/begin COMPU_METHOD BMW_q1_millisecond "" RAT_FUNC "%6.2" "ms" COEFFS 0 1 0 0 0 1 /end COMPU_METHOD
/begin COMPU_METHOD bukAcFc_hypjrAa_CBhougc_MCRooa0 "bukAcFc_hypjrAa_CBhougc_MCRooa0" RAT_FUNC "%6.3" "MPa" COEFFS 0 500 0 0 0 1 /end COMPU_METHOD
/begin COMPU_METHOD BumqDkc_mryszAa_EcglxAc_nR_4oa0 "BumqDkc_mryszAa_EcglxAc_nR_4oa0" RAT_FUNC "%6.3" "-" COEFFS 0 4096 0 0 0 1 /end COMPU_METHOD
/begin COMPU_METHOD caoddzd_oAjpfzb_cAcEEha_1nR_oa0 "Def_q1" RAT_FUNC "%6.3" "1/min" COEFFS 0 1 0 0 0 1 /end COMPU_METHOD
/begin COMPU_METHOD CByjozc_eCmpBAb_pljBAmd_k__0oa0 "CByjozc_eCmpBAb_pljBAmd_k__0oa0" RAT_FUNC "%6.3" "kg/h" COEFFS 0 32 0 0 0 1 /end COMPU_METHOD
/begin COMPU_METHOD CgkBooc_wkiDfEd_Czglhgc_fR_1a0o "Def_q0p01" RAT_FUNC "%6.3" "%" COEFFS 0 100 0 0 0 1 /end COMPU_METHOD
/begin COMPU_METHOD cxdjuna_xpuCged_ocEpdua_MCRa2a0 "cxdjuna_xpuCged_ocEpdua_MCRa2a0" RAT_FUNC "%6.3" "MPa" COEFFS 0 8192 0 0 0 5 /end COMPU_METHOD
/begin COMPU_METHOD DchEpAd_DBCFgoa_Ckhahgc_q__aoa0 "DchEpAd_DBCFgoa_Ckhahgc_q__aoa0" RAT_FUNC "%6.3" "°C" COEFFS 0 100 0 0 0 1 /end COMPU_METHOD
/begin COMPU_METHOD doAbvic_Aaltzwd_vyCuowa_hCRoa0o "doAbvic_Aaltzwd_vyCuowa_hCRoa0o" RAT_FUNC "%6.3" "hPa" COEFFS 0 1 0 0 0 1 /end COMPU_METHOD
/begin COMPU_METHOD ECeoxdb_wFseCtb_mEytEnb_k__o8a0 "ECeoxdb_wFseCtb_mEytEnb_k__o8a0" RAT_FUNC "%6.3" "kg/h" COEFFS 0 128 0 0 0 5 /end COMPU_METHOD
/begin COMPU_METHOD EngN "" RAT_FUNC "%6.3" "rpm" COEFFS 0 2 0 0 0 1 /end COMPU_METHOD
/begin COMPU_METHOD fak_q6p1035Em5 "" RAT_FUNC "%7.6" "-" COEFFS 0 65536 0 0 0 4 /end COMPU_METHOD
/begin COMPU_METHOD fak_sw_b4 "" RAT_FUNC "%6.5" "-" COEFFS 0 65536 0 0 0 8 /end COMPU_METHOD
/begin COMPU_METHOD fak_ub_b16 "" RAT_FUNC "%6.4" "-" COEFFS 0 256 0 0 0 16 /end COMPU_METHOD
/begin COMPU_METHOD fak_ub_b2 "" RAT_FUNC "%8.5" "-" COEFFS 0 256 0 0 0 2 /end COMPU_METHOD
/begin COMPU_METHOD fgjpsvb_fDqjECa_acgrbDd_n_dae__ "Def_bool" TAB_VERB "%6.3" "-" COMPU_TAB_REF ADqnehd_cFCEtgc_vrrfDpc_ntd_1G2 /end COMPU_METHOD
/begin COMPU_METHOD fqCirwd_flsbrkc_xChfaCb_n__aa0o "fqCirwd_flsbrkc_xChfaCb_n__aa0o" RAT_FUNC "%6.3" "-" COEFFS 0 32 0 0 0 1 /end COMPU_METHOD
/begin COMPU_METHOD FzbmlAa_gCtylrb_ckCqxAc_nR_6oa0 "FzbmlAa_gCtylrb_ckCqxAc_nR_6oa0" RAT_FUNC "%6.3" "-" COEFFS 0 65536 0 0 0 1 /end COMPU_METHOD
/begin COMPU_METHOD ggDviCc_uydFbsa_CDgnhgc_nR_2a0o "ggDviCc_uydFbsa_CDgnhgc_nR_2a0o" RAT_FUNC "%6.3" "-" COEFFS 0 200 0 0 0 1 /end COMPU_METHOD
/begin COMPU_METHOD hcpywvc_dcqzDlc_FmDugua_s__aa0o "Def_q1" RAT_FUNC "%6.3" "s" COEFFS 0 1 0 0 0 1 /end COMPU_METHOD
/begin COMPU_METHOD ilxsavd_hkzmBfc_lAzCpAb_nR_1oa0 "ilxsavd_hkzmBfc_lAzCpAb_nR_1oa0" RAT_FUNC "%6.3" "-" COEFFS 0 16384 0 0 0 1 /end COMPU_METHOD
/begin COMPU_METHOD jucyrzb_bpFgwfd_uqrfhgc_k__aoa0 "jucyrzb_bpFgwfd_uqrfhgc_k__aoa0" RAT_FUNC "%6.3" "kW" COEFFS 0 512 0 0 0 1 /end COMPU_METHOD
/begin COMPU_METHOD kEEdlBb_gsrEhkd_rmDuAhc_uCRoa0o "kEEdlBb_gsrEhkd_rmDuAhc_uCRoa0o" RAT_FUNC "%6.3" "ul" COEFFS 0 1 0 0 0 1 /end COMPU_METHOD
/begin COMPU_METHOD kw_q0p75 "" RAT_FUNC "%6.3" "Grad KW" COEFFS 0 4 0 0 0 3 /end COMPU_METHOD
/begin COMPU_METHOD n_sw_q0p5 "" RAT_FUNC "%6.3" "1/min" COEFFS 0 2 0 0 0 1 /end COMPU_METHOD
/begin COMPU_METHOD nmot_q40 "" RAT_FUNC "%6.1" "1/min" COEFFS 0 1 0 0 0 40 /end COMPU_METHOD
/begin COMPU_METHOD nmot_sw_q0p25 "" RAT_FUNC "%6.3" "1/min" COEFFS 0 1 0 0 0 0.25 /end COMPU_METHOD
/begin COMPU_METHOD raChrxc_kBtBrmb_FmDuEFa_n__aa0o "Def_q1" RAT_FUNC "%6.3" "-" COEFFS 0 1 0 0 0 1 /end COMPU_METHOD
/begin COMPU_METHOD RBPtCel_p_0p002_1 "" RAT_FUNC "%6.4" "MPa" COEFFS 0 1000 0 0 0 2 /end COMPU_METHOD
/begin COMPU_METHOD RBPtCel_vol_1p0_1 "" RAT_FUNC "%6.2" "l" COEFFS 0 1 0 0 0 1 /end COMPU_METHOD
/begin COMPU_METHOD rel_q0p0234 "" RAT_FUNC "%6.4" "%" COEFFS 0 128 0 0 0 3 /end COMPU_METHOD
/begin COMPU_METHOD rel_q0p046875 "" RAT_FUNC "%6.4" "%" COEFFS 0 65536 0 0 0 3072 /end COMPU_METHOD
/begin COMPU_METHOD rgduxyd_mlihaBb_gsCghzb_bCRa0a0 "rgduxyd_mlihaBb_gsCghzb_bCRa0a0" RAT_FUNC "%6.3" "bar" COEFFS 0 1000 0 0 0 1 /end COMPU_METHOD
/begin COMPU_METHOD ridxkCa_Dxvxtdc_CChkhgc_nR_1a0o "ridxkCa_Dxvxtdc_CChkhgc_nR_1a0o" RAT_FUNC "%6.3" "-" COEFFS 0 128 0 0 0 3 /end COMPU_METHOD
/begin COMPU_METHOD temp_ub_q0p75_o48 "" RAT_FUNC "%6.2" "Grad C" COEFFS 0 1 48 0 0 0.75 /end COMPU_METHOD
/begin COMPU_METHOD ubqeuic_jteCkzd_CDglhgc_nR_1a0o "Def_q0p01" RAT_FUNC "%6.3" "-" COEFFS 0 100 0 0 0 1 /end COMPU_METHOD
/begin COMPU_METHOD vfzg_uw_b512 "" RAT_FUNC "%6.4" "km/h" COEFFS 0 65536 0 0 0 512 /end COMPU_METHOD
/begin COMPU_METHOD wDDoctd_cCDyaFa_AvCkvFb_nR_6o0o "wDDoctd_cCDyaFa_AvCkvFb_nR_6o0o" RAT_FUNC "%6.3" "-" COEFFS 0 16384 0 0 0 25 /end COMPU_METHOD
/begin COMPU_METHOD wpxDCba_sgbvDxb_FliBAmd_k__0oa0 "wpxDCba_sgbvDxb_FliBAmd_k__0oa0" RAT_FUNC "%6.3" "kg/h" COEFFS 0 16 0 0 0 1 /end COMPU_METHOD
/begin COMPU_METHOD zBcBzad_vmoivka_mFzjCgc_lCRooa0 "zBcBzad_vmoivka_mFzjCgc_lCRooa0" RAT_FUNC "%6.3" "l/h" COEFFS 0 100 0 0 0 1 /end COMPU_METHOD
/begin COMPU_METHOD zyyxBpb_rEsnvtc_gktukCa_fR_5a0o "zyyxBpb_rEsnvtc_gktukCa_fR_5a0o" RAT_FUNC "%6.3" "%" COEFFS 0 512 0 0 0 25 /end COMPU_METHOD
/begin COMPU_VTAB ACCLNTVLV_ASWTYPTWINFLWSTD_SY_Compu "" TAB_VERB 1 0 "" /end COMPU_VTAB
/begin COMPU_VTAB ADqnehd_cFCEtgc_vrrfDpc_ntd_1G2 "ADqnehd_cFCEtgc_vrrfDpc_ntd_1G2" TAB_VERB 1 0 "" DEFAULT_VALUE "Zustand nicht definiert" /end COMPU_VTAB
/begin RECORD_LAYOUT _REC_A1AXS_1_MBSE_S1 ALIGNMENT_BYTE 1 ALIGNMENT_WORD 2 ALIGNMENT_LONG 4 ALIGNMENT_FLOAT32_IEEE 4 ALIGNMENT_FLOAT64_IEEE 4 AXIS_PTS_X 1 SBYTE INDEX_INCR DIRECT /end RECORD_LAYOUT
/begin RECORD_LAYOUT _REC_A1AXS_1_MBSE_S2 ALIGNMENT_BYTE 1 ALIGNMENT_WORD 2 ALIGNMENT_LONG 4 ALIGNMENT_FLOAT32_IEEE 4 ALIGNMENT_FLOAT64_IEEE 4 AXIS_PTS_X 1 SWORD INDEX_INCR DIRECT /end RECORD_LAYOUT
/begin RECORD_LAYOUT _REC_A1AXS_1_MBSE_U1 ALIGNMENT_BYTE 1 ALIGNMENT_WORD 2 ALIGNMENT_LONG 4 ALIGNMENT_FLOAT32_IEEE 4 ALIGNMENT_FLOAT64_IEEE 4 AXIS_PTS_X 1 UBYTE INDEX_INCR DIRECT /end RECORD_LAYOUT
/begin RECORD_LAYOUT _REC_A1AXS_1_MBSE_U2 ALIGNMENT_BYTE 1 ALIGNMENT_WORD 2 ALIGNMENT_LONG 4 ALIGNMENT_FLOAT32_IEEE 4 ALIGNMENT_FLOAT64_IEEE 4 AXIS_PTS_X 1 UWORD INDEX_INCR DIRECT /end RECORD_LAYOUT
/begin RECORD_LAYOUT _REC_A1CUR_1_MBSE_S1_S1 ALIGNMENT_BYTE 1 ALIGNMENT_WORD 2 ALIGNMENT_LONG 4 ALIGNMENT_FLOAT32_IEEE 4 ALIGNMENT_FLOAT64_IEEE 4 FNC_VALUES 1 SBYTE ROW_DIR DIRECT /end RECORD_LAYOUT
/begin RECORD_LAYOUT _REC_A1CUR_1_MBSE_S2_S1 ALIGNMENT_BYTE 1 ALIGNMENT_WORD 2 ALIGNMENT_LONG 4 ALIGNMENT_FLOAT32_IEEE 4 ALIGNMENT_FLOAT64_IEEE 4 FNC_VALUES 1 SWORD ROW_DIR DIRECT /end RECORD_LAYOUT
/begin RECORD_LAYOUT _REC_A1CUR_1_MBSE_U1_S1 ALIGNMENT_BYTE 1 ALIGNMENT_WORD 2 ALIGNMENT_LONG 4 ALIGNMENT_FLOAT32_IEEE 4 ALIGNMENT_FLOAT64_IEEE 4 FNC_VALUES 1 UBYTE ROW_DIR DIRECT /end RECORD_LAYOUT
/begin RECORD_LAYOUT _REC_A1CUR_1_MBSE_U2_S1 ALIGNMENT_BYTE 1 ALIGNMENT_WORD 2 ALIGNMENT_LONG 4 ALIGNMENT_FLOAT32_IEEE 4 ALIGNMENT_FLOAT64_IEEE 4 FNC_VALUES 1 UWORD ROW_DIR DIRECT /end RECORD_LAYOUT
/begin RECORD_LAYOUT _REC_S5MAP_52_KF_U1_S2_S2 ALIGNMENT_BYTE 1 ALIGNMENT_WORD 2 ALIGNMENT_LONG 4 ALIGNMENT_FLOAT32_IEEE 4 ALIGNMENT_FLOAT64_IEEE 4 NO_AXIS_PTS_X 1 UBYTE NO_AXIS_PTS_Y 2 UBYTE AXIS_PTS_X 3 SWORD INDEX_INCR DIRECT AXIS_PTS_Y 4 SWORD INDEX_INCR DIRECT FNC_VALUES 5 UBYTE COLUMN_DIR DIRECT /end RECORD_LAYOUT
/begin RECORD_LAYOUT _REC_S5MAP_52_KF_U2_S2_S2 ALIGNMENT_BYTE 1 ALIGNMENT_WORD 2 ALIGNMENT_LONG 4 ALIGNMENT_FLOAT32_IEEE 4 ALIGNMENT_FLOAT64_IEEE 4 NO_AXIS_PTS_X 1 UBYTE NO_AXIS_PTS_Y 2 UBYTE AXIS_PTS_X 3 SWORD INDEX_INCR DIRECT AXIS_PTS_Y 4 SWORD INDEX_INCR DIRECT FNC_VALUES 5 UWORD COLUMN_DIR DIRECT /end RECORD_LAYOUT
/begin RECORD_LAYOUT _REC_S5MAP_52_KF_U2_S2_U2 ALIGNMENT_BYTE 1 ALIGNMENT_WORD 2 ALIGNMENT_LONG 4 ALIGNMENT_FLOAT32_IEEE 4 ALIGNMENT_FLOAT64_IEEE 4 NO_AXIS_PTS_X 1 UBYTE NO_AXIS_PTS_Y 2 UBYTE AXIS_PTS_X 3 SWORD INDEX_INCR DIRECT AXIS_PTS_Y 4 UWORD INDEX_INCR DIRECT FNC_VALUES 5 UWORD COLUMN_DIR DIRECT /end RECORD_LAYOUT
/begin RECORD_LAYOUT Axis_Xs16 ALIGNMENT_BYTE 1 ALIGNMENT_WORD 2 ALIGNMENT_LONG 4 ALIGNMENT_FLOAT32_IEEE 4 ALIGNMENT_FLOAT64_IEEE 4 NO_AXIS_PTS_X 1 SWORD AXIS_PTS_X 2 SWORD INDEX_INCR DIRECT /end RECORD_LAYOUT
/begin RECORD_LAYOUT Axis_Xu16 ALIGNMENT_BYTE 1 ALIGNMENT_WORD 2 ALIGNMENT_LONG 4 ALIGNMENT_FLOAT32_IEEE 4 ALIGNMENT_FLOAT64_IEEE 4 NO_AXIS_PTS_X 1 UWORD AXIS_PTS_X 2 UWORD INDEX_INCR DIRECT /end RECORD_LAYOUT
/begin RECORD_LAYOUT Cur_Xu8Wu8 ALIGNMENT_BYTE 1 ALIGNMENT_WORD 2 ALIGNMENT_LONG 4 ALIGNMENT_FLOAT32_IEEE 4 ALIGNMENT_FLOAT64_IEEE 4 NO_AXIS_PTS_X 1 UBYTE AXIS_PTS_X 2 UBYTE INDEX_INCR DIRECT FNC_VALUES 3 UBYTE COLUMN_DIR DIRECT /end RECORD_LAYOUT
/begin RECORD_LAYOUT CurG_Ws16 ALIGNMENT_BYTE 1 ALIGNMENT_WORD 2 ALIGNMENT_LONG 4 ALIGNMENT_FLOAT32_IEEE 4 ALIGNMENT_FLOAT64_IEEE 4 FNC_VALUES 1 SWORD COLUMN_DIR DIRECT /end RECORD_LAYOUT
/begin RECORD_LAYOUT FklWUb ALIGNMENT_BYTE 1 ALIGNMENT_WORD 2 ALIGNMENT_LONG 4 ALIGNMENT_FLOAT32_IEEE 4 ALIGNMENT_FLOAT64_IEEE 4 FNC_VALUES 1 UBYTE COLUMN_DIR DIRECT /end RECORD_LAYOUT
/begin RECORD_LAYOUT KwUw ALIGNMENT_BYTE 1 ALIGNMENT_WORD 2 ALIGNMENT_LONG 4 ALIGNMENT_FLOAT32_IEEE 4 ALIGNMENT_FLOAT64_IEEE 4 FNC_VALUES 1 UWORD COLUMN_DIR DIRECT /end RECORD_LAYOUT
/begin RECORD_LAYOUT RB_Curve_S16_U16_Static ALIGNMENT_BYTE 1 ALIGNMENT_WORD 2 ALIGNMENT_LONG 4 ALIGNMENT_FLOAT32_IEEE 4 ALIGNMENT_FLOAT64_IEEE 4 NO_AXIS_PTS_X 1 SWORD AXIS_PTS_X 2 SWORD INDEX_INCR DIRECT FNC_VALUES 3 UWORD COLUMN_DIR DIRECT STATIC_RECORD_LAYOUT /end RECORD_LAYOUT
/begin RECORD_LAYOUT RB_Map_S16U8_S8 ALIGNMENT_BYTE 1 ALIGNMENT_WORD 2 ALIGNMENT_LONG 4 ALIGNMENT_FLOAT32_IEEE 4 ALIGNMENT_FLOAT64_IEEE 4 NO_AXIS_PTS_X 1 SWORD NO_AXIS_PTS_Y 2 SWORD AXIS_PTS_X 3 SWORD INDEX_INCR DIRECT AXIS_PTS_Y 4 UBYTE INDEX_INCR DIRECT FNC_VALUES 5 SBYTE COLUMN_DIR DIRECT /end RECORD_LAYOUT
/end MODULE
/end PROJECT
