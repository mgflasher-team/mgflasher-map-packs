/*
The MG Flasher Team
10/16/2026
Created with optimization mode
*/
ASAP2_VERSION 1 60
/begin PROJECT MG1CS049_S58_F4C2L8Y8B "MG1CS049"
/begin HEADER "" VERSION "F4C2L8Y8B" PROJECT_NO MG1CS049_S58_F4C2L8Y8B /end HEADER
/begin MODULE DIM ""
/begin MOD_PAR "MG1CS049" VERSION "F4C2L8Y8B" CUSTOMER_NO "11" USER "APPLICATOR" ECU "MG1CS049" CPU_TYPE "IFX" EPK "53/1/MG1CS049/11/MG1CS049_S58_F4C2L8Y8B//F4C2L8Y8B///" ADDR_EPK 0x80765831
 /begin MEMORY_SEGMENT Pst80000000 "" RESERVED FLASH INTERN 0x80000000 0x20 -1 -1 -1 -1 -1 /end MEMORY_SEGMENT
 /begin MEMORY_SEGMENT Pst80000020 "" RESERVED FLASH INTERN 0x80000020 0xBFE0 -1 -1 -1 -1 -1 /end MEMORY_SEGMENT
 /begin MEMORY_SEGMENT Pst80010000 "" RESERVED FLASH INTERN 0x80010000 0x8000 -1 -1 -1 -1 -1 /end MEMORY_SEGMENT
 /begin MEMORY_SEGMENT Pst80080000 "" CODE FLASH INTERN 0x80080000 0x67F7E0 -1 -1 -1 -1 -1
  /begin IF_DATA XCPplus
   /begin SEGMENT 0x0 0x1 0x0 0x0 0x0 /begin CHECKSUM XCP_CRC_32 /end CHECKSUM
    /begin PAGE 0x0 ECU_ACCESS_WITH_XCP_ONLY XCP_READ_ACCESS_WITH_ECU_ONLY XCP_WRITE_ACCESS_NOT_ALLOWED /end PAGE
   /end SEGMENT
  /end IF_DATA
 /end MEMORY_SEGMENT
 /begin MEMORY_SEGMENT Pst806FF7E0 "" RESERVED FLASH INTERN 0x806FF7E0 0x520 -1 -1 -1 -1 -1 /end MEMORY_SEGMENT
 /begin MEMORY_SEGMENT Pst807FF7E0 "" RESERVED FLASH INTERN 0x807FF7E0 0x520 -1 -1 -1 -1 -1 /end MEMORY_SEGMENT
 /begin MEMORY_SEGMENT Pst80028000 "" CODE FLASH INTERN 0x80028000 0x37D00 -1 -1 -1 -1 -1
  /begin IF_DATA XCPplus
   /begin SEGMENT 0x2 0x1 0x0 0x0 0x0 /begin CHECKSUM XCP_CRC_32 /end CHECKSUM
    /begin PAGE 0x0 ECU_ACCESS_WITH_XCP_ONLY XCP_READ_ACCESS_WITH_ECU_ONLY XCP_WRITE_ACCESS_NOT_ALLOWED /end PAGE
   /end SEGMENT
  /end IF_DATA
 /end MEMORY_SEGMENT
 /begin MEMORY_SEGMENT Pst80018100 "" RESERVED FLASH INTERN 0x80018100 0x3F00 -1 -1 -1 -1 -1 /end MEMORY_SEGMENT
 /begin MEMORY_SEGMENT Pst80060100 "" RESERVED FLASH INTERN 0x80060100 0x1FF00 -1 -1 -1 -1 -1 /end MEMORY_SEGMENT
 /begin MEMORY_SEGMENT Pst80018000 "" RESERVED FLASH INTERN 0x80018000 0x100 -1 -1 -1 -1 -1 /end MEMORY_SEGMENT
 /begin MEMORY_SEGMENT Pst80060000 "" RESERVED FLASH INTERN 0x80060000 0x100 -1 -1 -1 -1 -1 /end MEMORY_SEGMENT
 /begin MEMORY_SEGMENT Pst80020000 "" RESERVED FLASH INTERN 0x80020000 0x300 -1 -1 -1 -1 -1 /end MEMORY_SEGMENT
 /begin MEMORY_SEGMENT Pst8005FD00 "" RESERVED FLASH INTERN 0x8005FD00 0x300 -1 -1 -1 -1 -1 /end MEMORY_SEGMENT
 /begin MEMORY_SEGMENT Pst806FFD00 "" RESERVED FLASH INTERN 0x806FFD00 0x300 -1 -1 -1 -1 -1 /end MEMORY_SEGMENT
 /begin MEMORY_SEGMENT Pst807FFD08 "" RESERVED FLASH INTERN 0x807FFD08 0x104 -1 -1 -1 -1 -1 /end MEMORY_SEGMENT
 /begin MEMORY_SEGMENT Pst807FFFDC "" RESERVED FLASH INTERN 0x807FFFDC 0x24 -1 -1 -1 -1 -1 /end MEMORY_SEGMENT
 /begin MEMORY_SEGMENT Dst80700000 "" DATA FLASH INTERN 0x80700000 0xFF7E0 -1 -1 -1 -1 -1
  /begin IF_DATA XCPplus
   /begin SEGMENT 0x1 0x2 0x0 0x0 0x0 /begin CHECKSUM XCP_CRC_32 /end CHECKSUM
    /begin PAGE 0x0 ECU_ACCESS_DONT_CARE XCP_READ_ACCESS_DONT_CARE XCP_WRITE_ACCESS_NOT_ALLOWED /end PAGE
    /begin PAGE 0x1 ECU_ACCESS_DONT_CARE XCP_READ_ACCESS_DONT_CARE XCP_WRITE_ACCESS_WITH_ECU_ONLY /end PAGE
   /end SEGMENT
  /end IF_DATA
 /end MEMORY_SEGMENT
 /begin MEMORY_SEGMENT Dst807FFD00 "" DATA FLASH INTERN 0x807FFD00 0x8 -1 -1 -1 -1 -1
  /begin IF_DATA XCPplus
   /begin SEGMENT 0x3 0x2 0x0 0x0 0x0 /begin CHECKSUM XCP_CRC_32 /end CHECKSUM
    /begin PAGE 0x0 ECU_ACCESS_DONT_CARE XCP_READ_ACCESS_DONT_CARE XCP_WRITE_ACCESS_NOT_ALLOWED /end PAGE
    /begin PAGE 0x1 ECU_ACCESS_DONT_CARE XCP_READ_ACCESS_DONT_CARE XCP_WRITE_ACCESS_WITH_ECU_ONLY /end PAGE
   /end SEGMENT
  /end IF_DATA
 /end MEMORY_SEGMENT
 /begin MEMORY_SEGMENT Dst807FFE0C "" DATA FLASH INTERN 0x807FFE0C 0x1D0 -1 -1 -1 -1 -1
  /begin IF_DATA XCPplus
   /begin SEGMENT 0x4 0x2 0x0 0x0 0x0 /begin CHECKSUM XCP_CRC_32 /end CHECKSUM
    /begin PAGE 0x0 ECU_ACCESS_DONT_CARE XCP_READ_ACCESS_DONT_CARE XCP_WRITE_ACCESS_NOT_ALLOWED /end PAGE
    /begin PAGE 0x1 ECU_ACCESS_DONT_CARE XCP_READ_ACCESS_DONT_CARE XCP_WRITE_ACCESS_WITH_ECU_ONLY /end PAGE
   /end SEGMENT
  /end IF_DATA
 /end MEMORY_SEGMENT
 /begin MEMORY_SEGMENT RamAFE70000 "" VARIABLES RAM INTERN 0xAFE70000 0x8000 -1 -1 -1 -1 -1
  /begin IF_DATA XCPplus
   /begin SEGMENT 0x5 0x0 0x0 0x0 0x0 /end SEGMENT
  /end IF_DATA
 /end MEMORY_SEGMENT
 /begin MEMORY_SEGMENT RamB0000000 "" VARIABLES RAM INTERN 0xB0000000 0x8000 -1 -1 -1 -1 -1
  /begin IF_DATA XCPplus
   /begin SEGMENT 0x6 0x0 0x0 0x0 0x0 /end SEGMENT
  /end IF_DATA
 /end MEMORY_SEGMENT
 /begin MEMORY_SEGMENT Ram70100000 "" VARIABLES RAM INTERN 0x70100000 0x8000 -1 -1 -1 -1 -1
  /begin IF_DATA XCPplus
   /begin SEGMENT 0x7 0x0 0x0 0x0 0x0 /end SEGMENT
  /end IF_DATA
 /end MEMORY_SEGMENT
 /begin MEMORY_SEGMENT Ram60100000 "" VARIABLES RAM INTERN 0x60100000 0x8000 -1 -1 -1 -1 -1
  /begin IF_DATA XCPplus
   /begin SEGMENT 0x8 0x0 0x0 0x0 0x0 /end SEGMENT
  /end IF_DATA
 /end MEMORY_SEGMENT
 /begin MEMORY_SEGMENT Ram50100000 "" VARIABLES RAM INTERN 0x50100000 0x8000 -1 -1 -1 -1 -1
  /begin IF_DATA XCPplus
   /begin SEGMENT 0x9 0x0 0x0 0x0 0x0 /end SEGMENT
  /end IF_DATA
 /end MEMORY_SEGMENT
 /begin MEMORY_SEGMENT Ram70000000 "" VARIABLES RAM INTERN 0x70000000 0x1E000 -1 -1 -1 -1 -1
  /begin IF_DATA XCPplus
   /begin SEGMENT 0xA 0x0 0x0 0x0 0x0 /end SEGMENT
  /end IF_DATA
 /end MEMORY_SEGMENT
 /begin MEMORY_SEGMENT Ram60000000 "" VARIABLES RAM INTERN 0x60000000 0x3C000 -1 -1 -1 -1 -1
  /begin IF_DATA XCPplus
   /begin SEGMENT 0xB 0x0 0x0 0x0 0x0 /end SEGMENT
  /end IF_DATA
 /end MEMORY_SEGMENT
 /begin MEMORY_SEGMENT Ram50000000 "" VARIABLES RAM INTERN 0x50000000 0x3C000 -1 -1 -1 -1 -1
  /begin IF_DATA XCPplus
   /begin SEGMENT 0xC 0x0 0x0 0x0 0x0 /end SEGMENT
  /end IF_DATA
 /end MEMORY_SEGMENT
 /begin MEMORY_SEGMENT RamBF1F0E70 "" VARIABLES RAM INTERN 0xBF1F0E70 0xF190 -1 -1 -1 -1 -1
  /begin IF_DATA XCPplus
   /begin SEGMENT 0xD 0x0 0x0 0x0 0x0 /end SEGMENT
  /end IF_DATA
 /end MEMORY_SEGMENT
 /begin MEMORY_SEGMENT RamBF1E0000 "" CALIBRATION_VARIABLES RAM INTERN 0xBF1E0000 0x10E70 -1 -1 -1 -1 -1
  /begin IF_DATA XCPplus
   /begin SEGMENT 0xE 0x0 0x0 0x0 0x0 /end SEGMENT
  /end IF_DATA
 /end MEMORY_SEGMENT
/end MOD_PAR
/begin MOD_COMMON "" BYTE_ORDER MSB_LAST DEPOSIT ABSOLUTE ALIGNMENT_BYTE 1 ALIGNMENT_WORD 2 ALIGNMENT_LONG 4 ALIGNMENT_FLOAT32_IEEE 4 ALIGNMENT_FLOAT64_IEEE 4 /end MOD_COMMON
/begin AXIS_PTS Antilag_BMWtchctr_p_DifCrtnPp_Ax___MGF_CC_PF "AXX_KF_PDIFF_ATLR_P" 0x807278D4 BMWtchbas_p_Dif_sw _REC_A1AXS_1_MBSE_S2 8191.875 BMW_p_sw_q0p125_hPa 12 -4096 4095.875 FORMAT "%10.3" DEPOSIT ABSOLUTE /end AXIS_PTS
/begin AXIS_PTS Antilag_BMWtchctr_p_DifCrtnPp_Ay___MGF_CC_PF "AXY_KF_PDIFF_ATLR_P" 0x807C0002 BMWtchsp_mf_Ex_uw _REC_A1AXS_1_MBSE_U2 2047.96875 CByjozc_eCmpBAb_pljBAmd_k__0oa0 6 0 2047.96875 FORMAT "%10.3" DEPOSIT ABSOLUTE /end AXIS_PTS
/begin AXIS_PTS Antilag_BMWtchctr_p_DifCrtnPpDyn_Ax___MGF_CC_PF "AXX_KF_PDIFF_ATLR_P" 0x807278F8 BMWtchbas_p_Dif_sw _REC_A1AXS_1_MBSE_S2 8191.875 BMW_p_sw_q0p125_hPa 12 -4096 4095.875 FORMAT "%10.3" DEPOSIT ABSOLUTE /end AXIS_PTS
/begin AXIS_PTS Antilag_BMWtchctr_p_DifCrtnPpDyn_Ay___MGF_CC_PF "AXY_KF_PDIFF_ATLR_P" 0x807C009E BMWtchsp_mf_Ex_uw _REC_A1AXS_1_MBSE_U2 2047.96875 CByjozc_eCmpBAb_pljBAmd_k__0oa0 6 0 2047.96875 FORMAT "%10.3" DEPOSIT ABSOLUTE /end AXIS_PTS
/begin AXIS_PTS Antilag_BMWtchctr_pwr_Pctl_Ax___MGF_CC_PF "AXX_KF_ATL_PVERD" 0x807C02C2 BMWtchsp_rat_p_CmprLim_uw _REC_A1AXS_1_MBSE_U2 7.9998779296875 acriqBc_tfkBqod_ocgjxzc_nR_8oa0 20 0 7.9998779296875 FORMAT "%11.4" DEPOSIT ABSOLUTE /end AXIS_PTS
/begin AXIS_PTS Antilag_BMWtchctr_pwr_PctlWideRng_Ay___MGF_CC_PF "BMWtchctr_pwr_PctlWideRng_Ay" 0x807D8902 BMWtchsp_mf_CmprNormWideRng_uw _REC_A1AXS_1_MBSE_U2 4095.9375 wpxDCba_sgbvDxb_FliBAmd_k__0oa0 16 0 4095.9375 FORMAT "%10.3" DEPOSIT ABSOLUTE /end AXIS_PTS
/begin AXIS_PTS Antilag_IgnRoll_X_Axis___MGF_CC_PF "Ignition setpoint: Engine speed [Nkw] vs Boost actual [Ps]" 0x807C08E8 Nkw ___MGF_CC_Antilag_Ign_Roll_xAxis 0 caoddzd_oAjpfzb_cAcEEha_1nR_oa0 10 0 15000 /end AXIS_PTS
/begin AXIS_PTS Antilag_IgnRoll_Y_Axis___MGF_CC_PF "Ignition setpoint: Engine speed [Nkw] vs Boost actual [Ps]" 0x807C09C8 Ps ___MGF_CC_Antilag_Ign_Roll_xAxis 0 BMW_p_sw_q0p125_hPa 10 -3000 3000 /end AXIS_PTS
/begin AXIS_PTS Antilag_IgnStand_X_Axis___MGF_CC_PF "Ignition setpoint: Engine speed [Nkw] vs Boost actual [Ps]" 0x807C08FC Nkw ___MGF_CC_Antilag_Ign_Roll_xAxis 0 caoddzd_oAjpfzb_cAcEEha_1nR_oa0 10 0 15000 /end AXIS_PTS
/begin AXIS_PTS Antilag_IgnStand_Y_Axis___MGF_CC_PF "Ignition setpoint: Engine speed [Nkw] vs Boost actual [Ps]" 0x807C09DC Ps ___MGF_CC_Antilag_Ign_Roll_xAxis 0 BMW_p_sw_q0p125_hPa 10 -3000 3000 /end AXIS_PTS
/begin AXIS_PTS Antilag_LambdaRoll_X_Axis___MGF_CC_PF "Fueling setpoint: Engine speed [Nkw] vs Exhaust Gas Temperature [EGT] before turbine [Tabg_vl_xab]" 0x807C0910 Nkw ___MGF_CC_Antilag_Ign_Roll_xAxis 0 caoddzd_oAjpfzb_cAcEEha_1nR_oa0 10 0 15000 /end AXIS_PTS
/begin AXIS_PTS Antilag_LambdaRoll_Y_Axis___MGF_CC_PF "Fueling setpoint: Engine speed [Nkw] vs Exhaust Gas Temperature [EGT] before turbine [Tabg_vl_xab]" 0x807C09F0 Tabg_vl_xab ___MGF_CC_Antilag_Ign_Roll_xAxis 0 BMW_q0p1_degC 10 -3000 3000 /end AXIS_PTS
/begin AXIS_PTS Antilag_LambdaStand_X_Axis___MGF_CC_PF "Fueling setpoint: Engine speed [Nkw] vs Exhaust Gas Temperature [EGT] before turbine [Tabg_vl_xab]" 0x807C0924 Nkw ___MGF_CC_Antilag_Ign_Roll_xAxis 0 caoddzd_oAjpfzb_cAcEEha_1nR_oa0 10 0 15000 /end AXIS_PTS
/begin AXIS_PTS Antilag_LambdaStand_Y_Axis___MGF_CC_PF "Fueling setpoint: Engine speed [Nkw] vs Exhaust Gas Temperature [EGT] before turbine [Tabg_vl_xab]" 0x807C0A04 Tabg_vl_xab ___MGF_CC_Antilag_Ign_Roll_xAxis 0 BMW_q0p1_degC 10 -3000 3000 /end AXIS_PTS
/begin AXIS_PTS AXX_FlexFuel_StartupEnrichment___MGF_CC "Flex Fuel Toel axis" 0x807CFF46 Toel ___MGF_CC_Antilag_Ign_Roll_xAxis 0 BMW_q0p1_degC 16 0 0 DEPOSIT ABSOLUTE /end AXIS_PTS
/begin AXIS_PTS AXX_KF_DPLDS_PRED "Nkw" 0x80746CB8 Nkw _REC_A1AXS_1_MBSE_S2 32767 caoddzd_oAjpfzb_cAcEEha_1nR_oa0 6 0 32767 FORMAT "%5.0" DEPOSIT ABSOLUTE /end AXIS_PTS
/begin AXIS_PTS AXX_KF_DPLDSOLL_SPORT "Nkw" 0x807220A8 NO_INPUT_QUANTITY _REC_A1AXS_1_MBSE_S2 32767 caoddzd_oAjpfzb_cAcEEha_1nR_oa0 6 0 32767 FORMAT "%5.0" DEPOSIT ABSOLUTE /end AXIS_PTS
/begin AXIS_PTS AXX_KF_DZWMIN_NORMAL_SOT "AXX_KF_DZWMIN_NORMAL_SOT" 0x8073830C Nkw _REC_A1AXS_1_MBSE_S2 65535 caoddzd_oAjpfzb_cAcEEha_1nR_oa0 6 -32768 32767 FORMAT "%5.0" DEPOSIT ABSOLUTE /end AXIS_PTS
/begin AXIS_PTS AXX_KF_DZWMIN_SPORT_SOT "AXX_KF_DZWMIN_SPORT_SOT" 0x807382F0 Nkw _REC_A1AXS_1_MBSE_S2 65535 caoddzd_oAjpfzb_cAcEEha_1nR_oa0 6 -32768 32767 FORMAT "%5.0" DEPOSIT ABSOLUTE /end AXIS_PTS
/begin AXIS_PTS AXX_KF_FDZWT_PF1 "AXX_KF_FDZWT_PF1" 0x80737760 Tmot _REC_A1AXS_1_MBSE_S2 655.35 DchEpAd_DBCFgoa_Ckhahgc_q__aoa0 6 -327.68 327.67 FORMAT "%7.2" DEPOSIT ABSOLUTE /end AXIS_PTS
/begin AXIS_PTS AXX_KF_FDZWT_PF2 "AXX_KF_FDZWT_PF2" 0x80737754 Tmot _REC_A1AXS_1_MBSE_S2 655.35 DchEpAd_DBCFgoa_Ckhahgc_q__aoa0 6 -327.68 327.67 FORMAT "%7.2" DEPOSIT ABSOLUTE /end AXIS_PTS
/begin AXIS_PTS AXX_KF_FRKKORRF_1 "AXX_KF_FRKKORRF_1" 0x80714FD0 Nkw _REC_A1AXS_1_MBSE_S2 65535 caoddzd_oAjpfzb_cAcEEha_1nR_oa0 16 -32768 32767 FORMAT "%5.0" DEPOSIT ABSOLUTE /end AXIS_PTS
/begin AXIS_PTS AXX_KF_KLIMA_KKS "AXX_KF_KLIMA_KKS" 0x80761B79 Nelueft_klima_wm _REC_A1AXS_1_MBSE_U1 99.609375 BMW_q0p3906_PERC 6 0 99.609375 DEPOSIT ABSOLUTE /end AXIS_PTS
/begin AXIS_PTS AXX_KF_LA_EZA "AXX_KF_LA_EZA" 0x8071F29C Nkw _REC_A1AXS_1_MBSE_S2 65535 caoddzd_oAjpfzb_cAcEEha_1nR_oa0 6 -32768 32767 FORMAT "%5.0" DEPOSIT ABSOLUTE /end AXIS_PTS
/begin AXIS_PTS AXX_KF_MD_RES_NST_KEY "AXX_KF_MD_RES_NST_KEY" 0x80731D26 Tn_start_10 _REC_A1AXS_1_MBSE_U2 655.35 camcxxd_bxlpdsa_Cshlhgc_sR_1a0o 4 0 655.35 FORMAT "%7.2" DEPOSIT ABSOLUTE /end AXIS_PTS
/begin AXIS_PTS AXX_KF_N_GASSTOSS_UND_ANFAHR "KF_N_GASSTOSS_UND_ANFAHR" 0x8072912E NO_INPUT_QUANTITY _REC_A1AXS_1_MBSE_S2 1310.7 jgbhAma_smpAegb_hlEBAmd_k__0oa0 6 -655.36 655.34 FORMAT "%7.2" DEPOSIT ABSOLUTE /end AXIS_PTS
/begin AXIS_PTS AXX_KF_NEL_OPF_V "AXX_KF_NEL_OPF_V" 0x8074B8F6 T_opf_in_wm _REC_A1AXS_1_MBSE_S2 6553.5 BMW_q0p1_degC 10 -3276.8 3276.7 DEPOSIT ABSOLUTE /end AXIS_PTS
/begin AXIS_PTS AXX_KF_NEL_TABG "AXX_KF_NEL_TABG" 0x8074B8EE Tabg_wm _REC_A1AXS_1_MBSE_S2 6553.5 BMW_q0p1_degC 4 -3276.8 3276.7 FORMAT "%6.1" DEPOSIT ABSOLUTE /end AXIS_PTS
/begin AXIS_PTS AXX_KF_NEL_TANS "AXX_KF_NEL_TANS" 0x8074B8E6 Dtans_tumg_wm _REC_A1AXS_1_MBSE_S2 6553.5 BMW_q0p1_degC 4 -3276.8 3276.7 FORMAT "%6.1" DEPOSIT ABSOLUTE /end AXIS_PTS
/begin AXIS_PTS AXX_KF_NEL_TGET "AXX_KF_NEL_TGET" 0x8074B87A Tget_wm _REC_A1AXS_1_MBSE_S2 655.35 DchEpAd_DBCFgoa_Ckhahgc_q__aoa0 8 -327.68 327.67 FORMAT "%6.2" DEPOSIT ABSOLUTE /end AXIS_PTS
/begin AXIS_PTS AXX_KF_NEL_TMOT_TKA "AXX_KF_NEL_TMOT_TKA" 0x8074B862 Dtmot_tkwsoll_f _REC_A1AXS_1_MBSE_S2 655.35 DchEpAd_DBCFgoa_Ckhahgc_q__aoa0 12 -327.68 327.67 FORMAT "%6.2" DEPOSIT ABSOLUTE /end AXIS_PTS
/begin AXIS_PTS AXX_KF_NEL_VSKR "AXX_KF_NEL_VSKR" 0x8074B97A Vskr_mw_wm _REC_A1AXS_1_MBSE_U2 65535 fpBesqd_hAxmiba_AAwtged_u__0oa0 6 0 65535 DEPOSIT ABSOLUTE /end AXIS_PTS
/begin AXIS_PTS AXX_KF_NEWP_LLK_TANS "AXX_KF_NEWP_LLK_TANS" 0x8074BE6C Dtans_tumg_wm _REC_A1AXS_1_MBSE_S2 6553.5 BMW_q0p1_degC 6 -3276.8 3276.7 DEPOSIT ABSOLUTE /end AXIS_PTS
/begin AXIS_PTS AXX_KF_NMAX_ANFAHR_MODE_0 "KF_NMAX_ANFAHR_MODE_0" 0x807296A6 NO_INPUT_QUANTITY _REC_A1AXS_1_MBSE_S2 1310.7 jgbhAma_smpAegb_hlEBAmd_k__0oa0 6 -655.36 655.34 FORMAT "%7.2" DEPOSIT ABSOLUTE /end AXIS_PTS
/begin AXIS_PTS AXX_KF_NMAX_ANFAHR_MODE_1 "KF_NMAX_ANFAHR_MODE_1" 0x8072969A NO_INPUT_QUANTITY _REC_A1AXS_1_MBSE_S2 1310.7 jgbhAma_smpAegb_hlEBAmd_k__0oa0 6 -655.36 655.34 FORMAT "%7.2" DEPOSIT ABSOLUTE /end AXIS_PTS
/begin AXIS_PTS AXX_KF_NMAX_ANFAHR_MODE_2 "KF_NMAX_ANFAHR_MODE_2" 0x8072968E NO_INPUT_QUANTITY _REC_A1AXS_1_MBSE_S2 1310.7 jgbhAma_smpAegb_hlEBAmd_k__0oa0 6 -655.36 655.34 FORMAT "%7.2" DEPOSIT ABSOLUTE /end AXIS_PTS
/begin AXIS_PTS AXX_KF_PHA_H_E1 "AXX_KF_PHA_H_E1" 0x80718C14 Nkw _REC_A1AXS_1_MBSE_S2 65535 caoddzd_oAjpfzb_cAcEEha_1nR_oa0 8 -32768 32767 FORMAT "%5.0" DEPOSIT ABSOLUTE /end AXIS_PTS
/begin AXIS_PTS AXX_KF_TA_IKSOLL "AXX_KF_TA_IKSOLL" 0x80719F34 Nkw_atm _REC_A1AXS_1_MBSE_S2 65535 caoddzd_oAjpfzb_cAcEEha_1nR_oa0 4 -32768 32767 DEPOSIT ABSOLUTE /end AXIS_PTS
/begin AXIS_PTS AXX_KF_TA_VKSOLL "AXX_KF_TA_VKSOLL" 0x80719F2C Nkw_atm _REC_A1AXS_1_MBSE_S2 65535 caoddzd_oAjpfzb_cAcEEha_1nR_oa0 4 -32768 32767 DEPOSIT ABSOLUTE /end AXIS_PTS
/begin AXIS_PTS AXX_KF_ZW_PF1 "AXX_KF_ZW_PF1" 0x807375A2 Nkw _REC_A1AXS_1_MBSE_S2 65535 caoddzd_oAjpfzb_cAcEEha_1nR_oa0 20 -32768 32767 FORMAT "%5.0" DEPOSIT ABSOLUTE /end AXIS_PTS
/begin AXIS_PTS AXX_KF_ZW_PF2 "AXX_KF_ZW_PF2" 0x8073757A Nkw _REC_A1AXS_1_MBSE_S2 65535 caoddzd_oAjpfzb_cAcEEha_1nR_oa0 20 -32768 32767 FORMAT "%5.0" DEPOSIT ABSOLUTE /end AXIS_PTS
/begin AXIS_PTS AXX_KF_ZW_S_PF1 "AXX_KF_ZW_S_PF1" 0x80737552 Nkw _REC_A1AXS_1_MBSE_S2 65535 caoddzd_oAjpfzb_cAcEEha_1nR_oa0 20 -32768 32767 FORMAT "%5.0" DEPOSIT ABSOLUTE /end AXIS_PTS
/begin AXIS_PTS AXX_KF_ZW_S_PF2 "AXX_KF_ZW_S_PF2" 0x8073752A Nkw _REC_A1AXS_1_MBSE_S2 65535 caoddzd_oAjpfzb_cAcEEha_1nR_oa0 20 -32768 32767 FORMAT "%5.0" DEPOSIT ABSOLUTE /end AXIS_PTS
/begin AXIS_PTS AXX_KF_ZW_UESP_PF1 "AXX_KF_ZW_UESP_PF1" 0x80737516 Nkw _REC_A1AXS_1_MBSE_S2 65535 caoddzd_oAjpfzb_cAcEEha_1nR_oa0 10 -32768 32767 FORMAT "%5.0" DEPOSIT ABSOLUTE /end AXIS_PTS
/begin AXIS_PTS AXX_KF_ZW_UESP_PF2 "AXX_KF_ZW_UESP_PF2" 0x80737502 Nkw _REC_A1AXS_1_MBSE_S2 65535 caoddzd_oAjpfzb_cAcEEha_1nR_oa0 10 -32768 32767 FORMAT "%5.0" DEPOSIT ABSOLUTE /end AXIS_PTS
/begin AXIS_PTS AXX_KF_ZW_VP_PF1 "AXX_KF_ZW_VP_PF1" 0x8074F60A Nkw _REC_A1AXS_1_MBSE_S2 65535 caoddzd_oAjpfzb_cAcEEha_1nR_oa0 20 -32768 32767 FORMAT "%5.0" DEPOSIT ABSOLUTE /end AXIS_PTS
/begin AXIS_PTS AXX_KF_ZW_VP_PF2 "AXX_KF_ZW_VP_PF2" 0x8074F5E2 Nkw _REC_A1AXS_1_MBSE_S2 65535 caoddzd_oAjpfzb_cAcEEha_1nR_oa0 20 -32768 32767 FORMAT "%5.0" DEPOSIT ABSOLUTE /end AXIS_PTS
/begin AXIS_PTS AXX_KF_ZWMIN_KSOT "AXX_KF_ZWMIN_KSOT" 0x807382E0 Nkw _REC_A1AXS_1_MBSE_S2 65535 caoddzd_oAjpfzb_cAcEEha_1nR_oa0 8 -32768 32767 FORMAT "%5.0" DEPOSIT ABSOLUTE /end AXIS_PTS
/begin AXIS_PTS AXX_KF_ZWMIN_WSOT "AXX_KF_ZWMIN_WSOT" 0x807382D0 Nkw _REC_A1AXS_1_MBSE_S2 65535 caoddzd_oAjpfzb_cAcEEha_1nR_oa0 8 -32768 32767 FORMAT "%5.0" DEPOSIT ABSOLUTE /end AXIS_PTS
/begin AXIS_PTS AXX_KL_FK_TUMG_OPF "AXX_KL_FK_TUMG_OPF" 0x8074B8B2 Tumg_wm _REC_A1AXS_1_MBSE_S2 6553.5 BMW_q0p1_degC 10 -3276.8 3276.7 DEPOSIT ABSOLUTE /end AXIS_PTS
/begin AXIS_PTS AXX_KL_FLD_KKS "AXX_KL_FLD_KKS" 0x8074B9F2 F_pld_wm_f _REC_A1AXS_1_MBSE_U2 7.9998779296875 acriqBc_tfkBqod_ocgjxzc_nR_8oa0 6 0 7.9998779296875 DEPOSIT ABSOLUTE /end AXIS_PTS
/begin AXIS_PTS AXX_KL_NEL_I "AXX_KL_NEL_I" 0x8074B85A Dtmot_tkwsoll_elue _REC_A1AXS_1_MBSE_S2 655.35 DchEpAd_DBCFgoa_Ckhahgc_q__aoa0 4 -327.68 327.67 DEPOSIT ABSOLUTE /end AXIS_PTS
/begin AXIS_PTS AXX_KL_NEL_KLIMA_MX "AXX_KL_NEL_KLIMA_MX" 0x8074B23A Tumg_wm _REC_A1AXS_1_MBSE_S2 6553.5 BMW_q0p1_degC 4 -3276.8 3276.7 DEPOSIT ABSOLUTE /end AXIS_PTS
/begin AXIS_PTS AXX_KL_NEL_SPL "AXX_KL_NEL_SPL" 0x8074B952 V_wm _REC_A1AXS_1_MBSE_U2 6553.5 BMW_q0p1_kilometer_per_hour 4 0 6553.5 DEPOSIT ABSOLUTE /end AXIS_PTS
/begin AXIS_PTS AXX_KL_NEL_TABG_TUMG "AXX_KL_NEL_TABG_TUMG" 0x8074B8AA Tumg_wm _REC_A1AXS_1_MBSE_S2 6553.5 BMW_q0p1_degC 4 -3276.8 3276.7 DEPOSIT ABSOLUTE /end AXIS_PTS
/begin AXIS_PTS AXX_KL_NEL_TANS_KLOPF "AXX_KL_NEL_TANS_KLOPF" 0x8074B8A2 Dtans_tumg_wm _REC_A1AXS_1_MBSE_S2 6553.5 BMW_q0p1_degC 4 -3276.8 3276.7 FORMAT "%6.1" DEPOSIT ABSOLUTE /end AXIS_PTS
/begin AXIS_PTS AXX_KL_NEL_TDME "AXX_KL_NEL_TDME" 0x8074B852 Tdme_wm _REC_A1AXS_1_MBSE_S2 655.35 DchEpAd_DBCFgoa_Ckhahgc_q__aoa0 4 -327.68 327.67 FORMAT "%6.2" DEPOSIT ABSOLUTE /end AXIS_PTS
/begin AXIS_PTS AXX_KL_NEL_TEGS "AXX_KL_NEL_TEGS" 0x8074B986 Tegs_wm _REC_A1AXS_1_MBSE_S2 65535 BufnDdb_jpjgsgc_jmDugsa_qCRoa0o 4 -32768 32767 FORMAT "%6.0" DEPOSIT ABSOLUTE /end AXIS_PTS
/begin AXIS_PTS AXX_KL_NEL_TKA "AXX_KL_NEL_TKA" 0x8074B846 Tka_wm _REC_A1AXS_1_MBSE_S2 655.35 DchEpAd_DBCFgoa_Ckhahgc_q__aoa0 6 -327.68 327.67 FORMAT "%6.2" DEPOSIT ABSOLUTE /end AXIS_PTS
/begin AXIS_PTS AXX_KL_NEL_TMOT "AXX_KL_NEL_TMOT" 0x8074B82E Dtmot_tkwsoll_f _REC_A1AXS_1_MBSE_S2 655.35 DchEpAd_DBCFgoa_Ckhahgc_q__aoa0 12 -327.68 327.67 FORMAT "%6.2" DEPOSIT ABSOLUTE /end AXIS_PTS
/begin AXIS_PTS AXX_KL_NEL_V_MX "AXX_KL_NEL_V_MX" 0x8074B94A V_wm _REC_A1AXS_1_MBSE_U2 6553.5 BMW_q0p1_kilometer_per_hour 4 0 6553.5 FORMAT "%6.1" DEPOSIT ABSOLUTE /end AXIS_PTS
/begin AXIS_PTS AXX_KL_NEL_VSKR_TUMG "AXX_KL_NEL_VSKR_TUMG" 0x8074B89A Tumg_wm _REC_A1AXS_1_MBSE_S2 6553.5 BMW_q0p1_degC 4 -3276.8 3276.7 DEPOSIT ABSOLUTE /end AXIS_PTS
/begin AXIS_PTS AXX_KL_NEWP_KLIMA_MX "AXX_KL_NEWP_KLIMA_MX" 0x8074B232 Tumg_wm _REC_A1AXS_1_MBSE_S2 6553.5 BMW_q0p1_degC 4 -3276.8 3276.7 DEPOSIT ABSOLUTE /end AXIS_PTS
/begin AXIS_PTS AXX_KL_NKW_SOUND_MNMX "AXX_KL_NKW_SOUND_MNMX" 0x807596F2 Gangi _REC_A1AXS_1_MBSE_U1 255 raChrxc_kBtBrmb_FmDuEFa_n__aa0o 8 0 255 FORMAT "%3.0" DEPOSIT ABSOLUTE /end AXIS_PTS
/begin AXIS_PTS AXX_KL_PSPVDK_SOLMAXGD "Nkw" 0x8071F586 NO_INPUT_QUANTITY _REC_A1AXS_1_MBSE_S2 32767 caoddzd_oAjpfzb_cAcEEha_1nR_oa0 6 0 32767 FORMAT "%5.0" DEPOSIT ABSOLUTE /end AXIS_PTS
/begin AXIS_PTS AXX_KL_RF_MAX "Nkw" 0x80721C38 NO_INPUT_QUANTITY _REC_A1AXS_1_MBSE_S2 65535 caoddzd_oAjpfzb_cAcEEha_1nR_oa0 12 -32768 32767 FORMAT "%5.0" DEPOSIT ABSOLUTE /end AXIS_PTS
/begin AXIS_PTS AXX_KL_RF_MAX_UESP "Nkw" 0x80721C20 NO_INPUT_QUANTITY _REC_A1AXS_1_MBSE_S2 65535 caoddzd_oAjpfzb_cAcEEha_1nR_oa0 12 -32768 32767 FORMAT "%5.0" DEPOSIT ABSOLUTE /end AXIS_PTS
/begin AXIS_PTS AXX_KL_RFTNLMX "Nkw" 0x8071FAC6 NO_INPUT_QUANTITY _REC_A1AXS_1_MBSE_S2 32767 caoddzd_oAjpfzb_cAcEEha_1nR_oa0 10 0 32767 FORMAT "%5.0" DEPOSIT ABSOLUTE /end AXIS_PTS
/begin AXIS_PTS AXX_KL_T_IKAT_SOUND_MX "AXX_KL_T_IKAT_SOUND_MX" 0x807596EE Anz_b_sound _REC_A1AXS_1_MBSE_U1 255 raChrxc_kBtBrmb_FmDuEFa_n__aa0o 4 0 255 FORMAT "%5.0" DEPOSIT ABSOLUTE /end AXIS_PTS
/begin AXIS_PTS AXX_KL_TD_SOUND_MX "AXX_KL_TD_SOUND_MX" 0x8072E82C V_fzg_plaus _REC_A1AXS_1_MBSE_S2 1310.7 jgbhAma_smpAegb_hlEBAmd_k__0oa0 4 -655.36 655.34 FORMAT "%6.2" DEPOSIT ABSOLUTE /end AXIS_PTS
/begin AXIS_PTS AXX_KL_TD_SOUND_MX_FREI "AXX_KL_TD_SOUND_MX_FREI" 0x8072E824 V_fzg_plaus _REC_A1AXS_1_MBSE_S2 1310.7 jgbhAma_smpAegb_hlEBAmd_k__0oa0 4 -655.36 655.34 FORMAT "%6.2" DEPOSIT ABSOLUTE /end AXIS_PTS
/begin AXIS_PTS AXX_KL_TD_SOUND_MX_SPORT "AXX_KL_TD_SOUND_MX_SPORT" 0x8072E81C V_fzg_plaus _REC_A1AXS_1_MBSE_S2 1310.7 jgbhAma_smpAegb_hlEBAmd_k__0oa0 4 -655.36 655.34 FORMAT "%6.2" DEPOSIT ABSOLUTE /end AXIS_PTS
/begin AXIS_PTS AXX_KL_TKW_HI "Coolant target temperature in High operating mode depending on ambient temperature" 0x807373BE Tumg_wm _REC_A1AXS_1_MBSE_S2 6553.5 BMW_q0p1_degC 4 -3276.8 3276.7 DEPOSIT ABSOLUTE /end AXIS_PTS
/begin AXIS_PTS AXX_KL_TKW_NO "AXX_KL_TKW_NO" 0x807373B6 Tumg_wm _REC_A1AXS_1_MBSE_S2 6553.5 BMW_q0p1_degC 4 -3276.8 3276.7 DEPOSIT ABSOLUTE /end AXIS_PTS
/begin AXIS_PTS AXY_KF_DPLDS_PRED "Drf_s2spred" 0x80746CA4 Drf_s2spred _REC_A1AXS_1_MBSE_U2 655.35 CgkBooc_wkiDfEd_Czglhgc_fR_1a0o 6 0 655.35 DEPOSIT ABSOLUTE /end AXIS_PTS
/begin AXIS_PTS AXY_KF_DPLDSOLL_SPORT "F_psspu" 0x8072207C NO_INPUT_QUANTITY _REC_A1AXS_1_MBSE_U2 7.9998779296875 acriqBc_tfkBqod_ocgjxzc_nR_8oa0 6 0 7.9998779296875 FORMAT "%7.5" DEPOSIT ABSOLUTE /end AXIS_PTS
/begin AXIS_PTS AXY_KF_DZWMIN_NORMAL_SOT "AXY_KF_DZWMIN_NORMAL_SOT" 0x807382C8 V _REC_A1AXS_1_MBSE_U2 65535 AFeDmkb_cAbjmcc_kAkskhd_k__0oa0 4 0 65535 FORMAT "%5.0" DEPOSIT ABSOLUTE /end AXIS_PTS
/begin AXIS_PTS AXY_KF_DZWMIN_SPORT_SOT "AXY_KF_DZWMIN_SPORT_SOT" 0x807382B0 V _REC_A1AXS_1_MBSE_U2 65535 AFeDmkb_cAbjmcc_kAkskhd_k__0oa0 4 0 65535 FORMAT "%5.0" DEPOSIT ABSOLUTE /end AXIS_PTS
/begin AXIS_PTS AXY_KF_FDZWT_PF1 "AXY_KF_FDZWT_PF1" 0x80737748 Tans _REC_A1AXS_1_MBSE_S2 6553.5 BMW_q0p1_degC 6 -3276.8 3276.7 FORMAT "%6.1" DEPOSIT ABSOLUTE /end AXIS_PTS
/begin AXIS_PTS AXY_KF_FDZWT_PF2 "AXY_KF_FDZWT_PF2" 0x8073773C Tans _REC_A1AXS_1_MBSE_S2 6553.5 BMW_q0p1_degC 6 -3276.8 3276.7 FORMAT "%6.1" DEPOSIT ABSOLUTE /end AXIS_PTS
/begin AXIS_PTS AXY_KF_FRKKORRF_1 "AXY_KF_FRKKORRF_1" 0x80714F98 Rf _REC_A1AXS_1_MBSE_S2 655.35 CgkBooc_wkiDfEd_Czglhgc_fR_1a0o 16 -327.68 327.67 FORMAT "%7.2" DEPOSIT ABSOLUTE /end AXIS_PTS
/begin AXIS_PTS AXY_KF_KLIMA_KKS "AXY_KF_KLIMA_KKS" 0x8074B242 V_wm _REC_A1AXS_1_MBSE_U2 6553.5 BMW_q0p1_kilometer_per_hour 6 0 6553.5 DEPOSIT ABSOLUTE /end AXIS_PTS
/begin AXIS_PTS AXY_KF_LA_EZA "AXY_KF_LA_EZA" 0x8071F212 Rf _REC_A1AXS_1_MBSE_S2 655.35 CgkBooc_wkiDfEd_Czglhgc_fR_1a0o 6 -327.68 327.67 FORMAT "%7.2" DEPOSIT ABSOLUTE /end AXIS_PTS
/begin AXIS_PTS AXY_KF_MD_RES_NST_KEY "AXY_KF_MD_RES_NST_KEY" 0x80731D16 Tmot _REC_A1AXS_1_MBSE_S2 655.35 DchEpAd_DBCFgoa_Ckhahgc_q__aoa0 4 -327.68 327.67 FORMAT "%7.2" DEPOSIT ABSOLUTE /end AXIS_PTS
/begin AXIS_PTS AXY_KF_N_GASSTOSS_UND_ANFAHR "KF_NMAX_ANFAHR_MODE_0" 0x80729112 NO_INPUT_QUANTITY _REC_A1AXS_1_MBSE_S2 1599.9755859375 vfyBdwd_ftexgja_BcFdiDd_fR_1a0o 4 -800 799.9755859375 FORMAT "%7.2" DEPOSIT ABSOLUTE /end AXIS_PTS
/begin AXIS_PTS AXY_KF_NEL_OPF_V "AXY_KF_NEL_OPF_V" 0x8074B936 V_wm _REC_A1AXS_1_MBSE_U2 6553.5 BMW_q0p1_kilometer_per_hour 10 0 6553.5 DEPOSIT ABSOLUTE /end AXIS_PTS
/begin AXIS_PTS AXY_KF_NEL_TABG "AXY_KF_NEL_TABG" 0x8074B92E V_wm _REC_A1AXS_1_MBSE_U2 6553.5 BMW_q0p1_kilometer_per_hour 4 0 6553.5 FORMAT "%6.1" DEPOSIT ABSOLUTE /end AXIS_PTS
/begin AXIS_PTS AXY_KF_NEL_TANS "AXY_KF_NEL_TANS" 0x8074B892 Tumg_wm _REC_A1AXS_1_MBSE_S2 6553.5 BMW_q0p1_degC 4 -3276.8 3276.7 FORMAT "%6.1" DEPOSIT ABSOLUTE /end AXIS_PTS
/begin AXIS_PTS AXY_KF_NEL_TGET "AXY_KF_NEL_TGET" 0x8074B91E V_wm _REC_A1AXS_1_MBSE_U2 6553.5 BMW_q0p1_kilometer_per_hour 8 0 6553.5 DEPOSIT ABSOLUTE /end AXIS_PTS
/begin AXIS_PTS AXY_KF_NEL_TMOT_TKA "AXY_KF_NEL_TMOT_TKA" 0x8074B7F6 Dtkwsoll_tka_f _REC_A1AXS_1_MBSE_S2 655.35 DchEpAd_DBCFgoa_Ckhahgc_q__aoa0 8 -327.68 327.67 FORMAT "%6.2" DEPOSIT ABSOLUTE /end AXIS_PTS
/begin AXIS_PTS AXY_KF_NEL_VSKR "AXY_KF_NEL_VSKR" 0x8074B916 V_wm _REC_A1AXS_1_MBSE_U2 6553.5 BMW_q0p1_kilometer_per_hour 4 0 6553.5 FORMAT "%6.1" DEPOSIT ABSOLUTE /end AXIS_PTS
/begin AXIS_PTS AXY_KF_NEWP_LLK_TANS "AXY_KF_NEWP_LLK_TANS" 0x8074BE60 Tumg_wm _REC_A1AXS_1_MBSE_S2 6553.5 BMW_q0p1_degC 6 -3276.8 3276.7 DEPOSIT ABSOLUTE /end AXIS_PTS
/begin AXIS_PTS AXY_KF_NMAX_ANFAHR_MODE_0 "KF_NMAX_ANFAHR_MODE_0" 0x807295FA NO_INPUT_QUANTITY _REC_A1AXS_1_MBSE_S2 1599.9755859375 vfyBdwd_ftexgja_BcFdiDd_fR_1a0o 4 -800 799.9755859375 FORMAT "%7.2" DEPOSIT ABSOLUTE /end AXIS_PTS
/begin AXIS_PTS AXY_KF_NMAX_ANFAHR_MODE_1 "KF_NMAX_ANFAHR_MODE_1" 0x807295F2 NO_INPUT_QUANTITY _REC_A1AXS_1_MBSE_S2 1599.9755859375 vfyBdwd_ftexgja_BcFdiDd_fR_1a0o 4 -800 799.9755859375 FORMAT "%7.2" DEPOSIT ABSOLUTE /end AXIS_PTS
/begin AXIS_PTS AXY_KF_NMAX_ANFAHR_MODE_2 "KF_NMAX_ANFAHR_MODE_2" 0x807295EA NO_INPUT_QUANTITY _REC_A1AXS_1_MBSE_S2 1599.9755859375 vfyBdwd_ftexgja_BcFdiDd_fR_1a0o 4 -800 799.9755859375 FORMAT "%7.2" DEPOSIT ABSOLUTE /end AXIS_PTS
/begin AXIS_PTS AXY_KF_PHA_H_E1 "AXY_KF_PHA_H_E1" 0x80718B8C NO_INPUT_QUANTITY _REC_A1AXS_1_MBSE_S2 3199.951171875 zyyxBpb_rEsnvtc_gktukCa_fR_5a0o 8 -1600 1599.951171875 DEPOSIT ABSOLUTE /end AXIS_PTS
/begin AXIS_PTS AXY_KF_TA_IKSOLL "AXY_KF_TA_IKSOLL" 0x80719F24 Rf_atm _REC_A1AXS_1_MBSE_S2 655.35 CgkBooc_wkiDfEd_Czglhgc_fR_1a0o 4 -327.68 327.67 DEPOSIT ABSOLUTE /end AXIS_PTS
/begin AXIS_PTS AXY_KF_TA_VKSOLL "AXY_KF_TA_VKSOLL" 0x80719F1C Rf_atm _REC_A1AXS_1_MBSE_S2 655.35 CgkBooc_wkiDfEd_Czglhgc_fR_1a0o 4 -327.68 327.67 DEPOSIT ABSOLUTE /end AXIS_PTS
/begin AXIS_PTS AXY_KF_ZW_PF1 "AXY_KF_ZW_PF1" 0x807374DA NO_INPUT_QUANTITY _REC_A1AXS_1_MBSE_S2 655.35 CgkBooc_wkiDfEd_Czglhgc_fR_1a0o 20 -327.68 327.67 FORMAT "%9.2" DEPOSIT ABSOLUTE /end AXIS_PTS
/begin AXIS_PTS AXY_KF_ZW_PF2 "AXY_KF_ZW_PF2" 0x807374B2 NO_INPUT_QUANTITY _REC_A1AXS_1_MBSE_S2 655.35 CgkBooc_wkiDfEd_Czglhgc_fR_1a0o 20 -327.68 327.67 FORMAT "%9.2" DEPOSIT ABSOLUTE /end AXIS_PTS
/begin AXIS_PTS AXY_KF_ZW_S_PF1 "AXY_KF_ZW_S_PF1" 0x8073748A NO_INPUT_QUANTITY _REC_A1AXS_1_MBSE_S2 655.35 CgkBooc_wkiDfEd_Czglhgc_fR_1a0o 20 -327.68 327.67 FORMAT "%9.2" DEPOSIT ABSOLUTE /end AXIS_PTS
/begin AXIS_PTS AXY_KF_ZW_S_PF2 "AXY_KF_ZW_S_PF2" 0x80737462 NO_INPUT_QUANTITY _REC_A1AXS_1_MBSE_S2 655.35 CgkBooc_wkiDfEd_Czglhgc_fR_1a0o 20 -327.68 327.67 FORMAT "%9.2" DEPOSIT ABSOLUTE /end AXIS_PTS
/begin AXIS_PTS AXY_KF_ZW_UESP_PF1 "AXY_KF_ZW_UESP_PF1" 0x80737446 NO_INPUT_QUANTITY _REC_A1AXS_1_MBSE_S2 655.35 CgkBooc_wkiDfEd_Czglhgc_fR_1a0o 14 -327.68 327.67 FORMAT "%9.2" DEPOSIT ABSOLUTE /end AXIS_PTS
/begin AXIS_PTS AXY_KF_ZW_UESP_PF2 "AXY_KF_ZW_UESP_PF2" 0x8073742A NO_INPUT_QUANTITY _REC_A1AXS_1_MBSE_S2 655.35 CgkBooc_wkiDfEd_Czglhgc_fR_1a0o 14 -327.68 327.67 FORMAT "%9.2" DEPOSIT ABSOLUTE /end AXIS_PTS
/begin AXIS_PTS AXY_KF_ZW_VP_PF1 "AXY_KF_ZW_VP_PF1" 0x8074F5C2 Rf_zwv _REC_A1AXS_1_MBSE_S2 655.35 CgkBooc_wkiDfEd_Czglhgc_fR_1a0o 16 -327.68 327.67 FORMAT "%9.2" DEPOSIT ABSOLUTE /end AXIS_PTS
/begin AXIS_PTS AXY_KF_ZW_VP_PF2 "AXY_KF_ZW_VP_PF2" 0x8074F5A2 Rf_zwv _REC_A1AXS_1_MBSE_S2 655.35 CgkBooc_wkiDfEd_Czglhgc_fR_1a0o 16 -327.68 327.67 FORMAT "%9.2" DEPOSIT ABSOLUTE /end AXIS_PTS
/begin AXIS_PTS AXY_KF_ZWMIN_KSOT "AXY_KF_ZWMIN_KSOT" 0x807382A0 NO_INPUT_QUANTITY _REC_A1AXS_1_MBSE_S2 655.35 CgkBooc_wkiDfEd_Czglhgc_fR_1a0o 8 -327.68 327.67 FORMAT "%9.4" DEPOSIT ABSOLUTE /end AXIS_PTS
/begin AXIS_PTS AXY_KF_ZWMIN_WSOT "AXY_KF_ZWMIN_WSOT" 0x80738290 NO_INPUT_QUANTITY _REC_A1AXS_1_MBSE_S2 655.35 CgkBooc_wkiDfEd_Czglhgc_fR_1a0o 8 -327.68 327.67 FORMAT "%9.4" DEPOSIT ABSOLUTE /end AXIS_PTS
/begin AXIS_PTS BlendFactorAxis___MGF_CC "Flex Fuel blending factor axis" 0x807CFF66 FlexFuelEthanolContentValue___MGF_CC ___MGF_CC_FlexFuelBlendFactorAxis21x1 0 FlexFuelEthanolContentValue_CompuMethod 21 0 0 DEPOSIT ABSOLUTE /end AXIS_PTS
/begin AXIS_PTS BMWausy_p_DifCat_Ax "Mass flow through catalyst for pressure loss across catalyst" 0x80711B4E NO_INPUT_QUANTITY _REC_A1AXS_1_MBSE_U2 2559.9609375 ECeoxdb_wFseCtb_mEytEnb_k__o8a0 8 0 2559.9609375 FORMAT "%8.3" DEPOSIT ABSOLUTE /end AXIS_PTS
/begin AXIS_PTS BMWchas_st_OpmBasCatCold_Ax "Axis for BMWchas_st_OpmBasCatCold_T" 0x8073D630 BMWchst_t_Eng_sw _REC_A1AXS_1_MBSE_S2 655.35 DchEpAd_DBCFgoa_Ckhahgc_q__aoa0 8 -327.68 327.67 FORMAT "%6.2" DEPOSIT ABSOLUTE /end AXIS_PTS
/begin AXIS_PTS BMWchas_st_OpmBasLiOff_Ax "Axis for BMWchas_st_OpmBasLiOff_T" 0x8073D620 BMWchst_t_Eng_sw _REC_A1AXS_1_MBSE_S2 655.35 DchEpAd_DBCFgoa_Ckhahgc_q__aoa0 8 -327.68 327.67 FORMAT "%6.2" DEPOSIT ABSOLUTE /end AXIS_PTS
/begin AXIS_PTS BMWchas_tq_ResExhFlpClsd_Ax "Catalyst heating after start, torque result exhaust flap closed X-axis" 0x8073CF10 Nkw _REC_A1AXS_1_MBSE_S2 65535 caoddzd_oAjpfzb_cAcEEha_1nR_oa0 8 -32768 32767 FORMAT "%5.0" DEPOSIT ABSOLUTE /end AXIS_PTS
/begin AXIS_PTS BMWgpfheat_p_RailInjMpl_Ax "GPF heating, rail pressure injection multiple X-axis" 0x8071D290 Nkw _REC_A1AXS_1_MBSE_S2 65535 caoddzd_oAjpfzb_cAcEEha_1nR_oa0 6 -32768 32767 FORMAT "%5.0" DEPOSIT ABSOLUTE /end AXIS_PTS
/begin AXIS_PTS BMWgpfheat_p_RailInjMpl_Ay "GPF heating, rail pressure injection multiple Y-axis" 0x8071D284 BMWrailco_rat_VabHom_sw _REC_A1AXS_1_MBSE_S2 3199.951171875 zyyxBpb_rEsnvtc_gktukCa_fR_5a0o 6 -1600 1599.951171875 FORMAT "%8.3" DEPOSIT ABSOLUTE /end AXIS_PTS
/begin AXIS_PTS BMWgpfheat_p_RailInjSng_Ax "GPF heating, rail pressure injection single X-axis" 0x8071D278 Nkw _REC_A1AXS_1_MBSE_S2 65535 caoddzd_oAjpfzb_cAcEEha_1nR_oa0 6 -32768 32767 FORMAT "%5.0" DEPOSIT ABSOLUTE /end AXIS_PTS
/begin AXIS_PTS BMWgpfheat_p_RailInjSng_Ay "GPF heating, rail pressure injection single Y-axis" 0x8071D26C BMWrailco_rat_VabHom_sw _REC_A1AXS_1_MBSE_S2 3199.951171875 zyyxBpb_rEsnvtc_gktukCa_fR_5a0o 6 -1600 1599.951171875 FORMAT "%8.3" DEPOSIT ABSOLUTE /end AXIS_PTS
/begin AXIS_PTS BMWgpfheat_tq_ResExhFlpClsd_Ax "GPF heating, torque result exhaust flap closed X-axis" 0x8071D982 Nkw _REC_A1AXS_1_MBSE_S2 65535 caoddzd_oAjpfzb_cAcEEha_1nR_oa0 8 -32768 32767 FORMAT "%5.0" DEPOSIT ABSOLUTE /end AXIS_PTS
/begin AXIS_PTS BMWlpa_n_EfpEngStrtAmb_Ax "Electric fuel pump speed setpoint for start ambient X-axis" 0x8071C774 Tumg _REC_A1AXS_1_MBSE_S2 6553.5 BMW_q0p1_degC 4 -3276.8 3276.7 FORMAT "%6.1" DEPOSIT ABSOLUTE /end AXIS_PTS
/begin AXIS_PTS BMWlpa_n_EfpEngStrtAmb_Ay "Electric fuel pump speed setpoint for start ambient Y-axis" 0x8071C76C Pumg _REC_A1AXS_1_MBSE_U2 8191.875 BMW_p_sw_q0p125_hPa 4 0 8191.875 FORMAT "%8.3" DEPOSIT ABSOLUTE /end AXIS_PTS
/begin AXIS_PTS BMWosc_n_Gb1Max_Ax "Maximum reliable engine speed for gearbox protection" 0x8075EB35 Gangi _REC_A1AXS_1_MBSE_U1 255 raChrxc_kBtBrmb_FmDuEFa_n__aa0o 10 0 255 FORMAT "%3.0" DEPOSIT ABSOLUTE /end AXIS_PTS
/begin AXIS_PTS BMWshl_n_SpdMaxAt_Ax "X-axis BMWshl_n_SpdMaxAt" 0x807653DF Gangi _REC_A1AXS_1_MBSE_U1 255 raChrxc_kBtBrmb_FmDuEFa_n__aa0o 8 0 255 FORMAT "%3.0" DEPOSIT ABSOLUTE /end AXIS_PTS
/begin AXIS_PTS BMWshl_n_SpdMaxMt_Ax "X-axis BMWshl_n_SpdMaxMt" 0x807653D9 Gangi _REC_A1AXS_1_MBSE_U1 255 raChrxc_kBtBrmb_FmDuEFa_n__aa0o 6 0 255 FORMAT "%3.0" DEPOSIT ABSOLUTE /end AXIS_PTS
/begin AXIS_PTS BMWtchctr_fac_pwr_CompLimPctl_Ax "AXX_KL_F_PTURBVST" 0x80747E20 BMWtchsp_mf_CmprNorm_uw _REC_A1AXS_1_MBSE_U2 4095.9375 wpxDCba_sgbvDxb_FliBAmd_k__0oa0 6 0 4095.9375 FORMAT "%10.3" DEPOSIT ABSOLUTE /end AXIS_PTS
/begin AXIS_PTS BMWtchctr_p_DifCrtnPp_Ax "AXX_KF_PDIFF_ATLR_P" 0x807278D4 BMWtchbas_p_Dif_sw _REC_A1AXS_1_MBSE_S2 8191.875 BMW_p_sw_q0p125_hPa 12 -4096 4095.875 FORMAT "%10.3" DEPOSIT ABSOLUTE /end AXIS_PTS
/begin AXIS_PTS BMWtchctr_p_DifCrtnPp_Ay___MGF_CC_FF1_Slot0 "AXY_KF_PDIFF_ATLR_P (Slot 0, Flex Fuel 1)" 0x807C24C2 BMWtchsp_mf_Ex_uw _REC_A1AXS_1_MBSE_U2 2047.96875 CByjozc_eCmpBAb_pljBAmd_k__0oa0 6 0 2047.96875 FORMAT "%10.3" DEPOSIT ABSOLUTE /end AXIS_PTS
/begin AXIS_PTS BMWtchctr_pct_WgBasc_Ax "AXX_KF_WGPOS_VST" 0x80747D14 NO_INPUT_QUANTITY _REC_A1AXS_1_MBSE_U2 3.99993896484375 ilxsavd_hkzmBfc_lAzCpAb_nR_1oa0 12 0 3.99993896484375 FORMAT "%14.5" DEPOSIT ABSOLUTE /end AXIS_PTS
/begin AXIS_PTS BMWtchctr_pct_WgBasc_Ay "AXY_KF_WGPOS_VST" 0x80747CFC NO_INPUT_QUANTITY _REC_A1AXS_1_MBSE_U2 2559.9609375 ECeoxdb_wFseCtb_mEytEnb_k__o8a0 12 0 2559.9609375 FORMAT "%10.3" DEPOSIT ABSOLUTE /end AXIS_PTS
/begin AXIS_PTS BMWtchctr_pwr_Dp_Ax "AXX_KF_PATLR_D" 0x8072787C BMWtchbas_p_Dif_sw _REC_A1AXS_1_MBSE_S2 8191.875 BMW_p_sw_q0p125_hPa 14 -4096 4095.875 FORMAT "%10.3" DEPOSIT ABSOLUTE /end AXIS_PTS
/begin AXIS_PTS BMWtchctr_pwr_Dp_Ay "AXY_KF_PATLR_D" 0x80727860 BMWtchbas_p_DifGra_sw _REC_A1AXS_1_MBSE_S2 8191.875 BMW_p_sw_q0p125_hPa 14 -4096 4095.875 FORMAT "%10.3" DEPOSIT ABSOLUTE /end AXIS_PTS
/begin AXIS_PTS BMWtchctr_pwr_Pctl_Ax___MGF_CC_FF1_Slot0 "AXX_KF_ATL_PVERD (Slot 0, Flex Fuel 1)" 0x807C4FE4 BMWtchsp_rat_p_CmprLim_uw _REC_A1AXS_1_MBSE_U2 7.9998779296875 acriqBc_tfkBqod_ocgjxzc_nR_8oa0 20 0 7.9998779296875 FORMAT "%11.4" DEPOSIT ABSOLUTE /end AXIS_PTS
/begin AXIS_PTS BMWtchctr_pwr_PctlWideRng_Ay___MGF_CC_FF1_Slot0 "BMWtchctr_pwr_PctlWideRng_Ay (Slot 0, Flex Fuel 1)" 0x807D8CC2 BMWtchsp_mf_CmprNormWideRng_uw _REC_A1AXS_1_MBSE_U2 4095.9375 wpxDCba_sgbvDxb_FliBAmd_k__0oa0 16 0 4095.9375 FORMAT "%10.3" DEPOSIT ABSOLUTE /end AXIS_PTS
/begin AXIS_PTS BMWtchctr_rat_p_ComprLimPctl_Ax "AXX_KL_FPLDSVLD_MN_DIS" 0x80747E08 BMWtchsp_mf_CmprNorm_uw _REC_A1AXS_1_MBSE_U2 4095.9375 wpxDCba_sgbvDxb_FliBAmd_k__0oa0 12 0 4095.9375 FORMAT "%10.3" DEPOSIT ABSOLUTE /end AXIS_PTS
/begin AXIS_PTS BMWtchctr_t_ExGasMdl_Ax "AXX_KF_TABGATL" 0x80747CD0 Nkw _REC_A1AXS_1_MBSE_S2 65535 caoddzd_oAjpfzb_cAcEEha_1nR_oa0 6 -32768 32767 FORMAT "%5.0" DEPOSIT ABSOLUTE /end AXIS_PTS
/begin AXIS_PTS BMWtchctr_t_ExGasMdl_Ay "AXY_KF_TABGATL" 0x80747CC4 Rf _REC_A1AXS_1_MBSE_S2 655.35 CgkBooc_wkiDfEd_Czglhgc_fR_1a0o 6 -327.68 327.67 FORMAT "%7.2" DEPOSIT ABSOLUTE /end AXIS_PTS
/begin AXIS_PTS BMWtchctr_t_ExGasMdlScav_Ax "AXX_KF_TABGATL" 0x80747CE8 Nkw _REC_A1AXS_1_MBSE_S2 65535 caoddzd_oAjpfzb_cAcEEha_1nR_oa0 6 -32768 32767 FORMAT "%5.0" DEPOSIT ABSOLUTE /end AXIS_PTS
/begin AXIS_PTS BMWtchctr_t_ExGasMdlScav_Ay "AXY_KF_TABGATL" 0x80747CDC Rf _REC_A1AXS_1_MBSE_S2 655.35 CgkBooc_wkiDfEd_Czglhgc_fR_1a0o 6 -327.68 327.67 FORMAT "%7.2" DEPOSIT ABSOLUTE /end AXIS_PTS
/begin AXIS_PTS BMWtchob_fac_tq_Delt_Ax "AXX_KL_FDMDMX_OB" 0x80727E26 Tans _REC_A1AXS_1_MBSE_S2 6553.5 BMW_q0p1_degC 4 -3276.8 3276.7 FORMAT "%6.1" DEPOSIT ABSOLUTE /end AXIS_PTS
/begin AXIS_PTS BMWtchsp_fac_FilPRatCmpr_Ax "AXX_KL_FK_PLDSVLD" 0x8072855C BMWtchsp_mf_CmprNorm_uw _REC_A1AXS_1_MBSE_U2 4095.9375 wpxDCba_sgbvDxb_FliBAmd_k__0oa0 4 0 4095.9375 FORMAT "%10.3" DEPOSIT ABSOLUTE /end AXIS_PTS
/begin AXIS_PTS BMWtchsp_fac_mf_FilCmprNorm_Ax "AXX_KL_FK_MSSOLATL" 0x8072859E NO_INPUT_QUANTITY _REC_A1AXS_1_MBSE_U2 4095.9375 wpxDCba_sgbvDxb_FliBAmd_k__0oa0 4 0 4095.9375 FORMAT "%10.3" DEPOSIT ABSOLUTE /end AXIS_PTS
/begin AXIS_PTS BMWtchsp_rat_p_CmprMax_Ax "AXX_KF_FPLDMAX" 0x807284AC BMWtchsp_mf_CmprNorm_uw _REC_A1AXS_1_MBSE_U2 4095.9375 wpxDCba_sgbvDxb_FliBAmd_k__0oa0 8 0 4095.9375 FORMAT "%10.3" DEPOSIT ABSOLUTE /end AXIS_PTS
/begin AXIS_PTS BMWtchsp_rat_p_CmprMax_Ay "AXY_KF_FPLDMAX" 0x807284A0 BMWtchtbc_t_BefCmpr_sw _REC_A1AXS_1_MBSE_S2 6553.5 BMW_q0p1_degC 6 -3276.8 3276.7 FORMAT "%6.1" DEPOSIT ABSOLUTE /end AXIS_PTS
/begin AXIS_PTS BMWtchsp_rat_p_CmprMaxRace_Ax "AXX_KF_FPLDMAX" 0x807284D8 BMWtchsp_mf_CmprNorm_uw _REC_A1AXS_1_MBSE_U2 4095.9375 wpxDCba_sgbvDxb_FliBAmd_k__0oa0 8 0 4095.9375 FORMAT "%10.3" DEPOSIT ABSOLUTE /end AXIS_PTS
/begin AXIS_PTS BMWtchsp_rat_p_CmprMaxRace_Ay "AXY_KF_FPLDMAX" 0x807284CC BMWtchtbc_t_BefCmpr_sw _REC_A1AXS_1_MBSE_S2 6553.5 BMW_q0p1_degC 6 -3276.8 3276.7 FORMAT "%6.1" DEPOSIT ABSOLUTE /end AXIS_PTS
/begin AXIS_PTS BMWtchsp_rat_p_CmprMaxTMax_Ax "Axis" 0x807284BC NO_INPUT_QUANTITY _REC_A1AXS_1_MBSE_U2 3.99993896484375 epDxoEa_vnwexaa_kAzmuka_q__14a0 8 0 3.99993896484375 DEPOSIT ABSOLUTE /end AXIS_PTS
/begin AXIS_PTS BMWtchsp_rat_p_CmprPmp_Ax "AXX_KL_FPLDPUMP" 0x80728490 BMWtchsp_mf_CmprNorm_uw _REC_A1AXS_1_MBSE_U2 4095.9375 wpxDCba_sgbvDxb_FliBAmd_k__0oa0 8 0 4095.9375 FORMAT "%10.3" DEPOSIT ABSOLUTE /end AXIS_PTS
/begin AXIS_PTS BMWtqe_n_EngLhModEngDynSp_Ax "Torque engine RPM engine limit high mode engine dynamic setpoint X-axis" 0x80761A47 BMW_mod_EngDynSp _REC_A1AXS_1_MBSE_U1 255 raChrxc_kBtBrmb_FmDuEFa_n__aa0o 8 0 255 DEPOSIT ABSOLUTE /end AXIS_PTS
/begin AXIS_PTS BMWtqe_n_NMaxEngTqLimd_Ax "Torque engine RPM speed maximum engine torque limited X-axis" 0x80761A50 BMWtqe_fac_EngTqLimd _REC_A1AXS_1_MBSE_U1 0.99609375 BMW_Powertrain_DxECompuMethods_Def_ub_b1_nounit 5 0 0.99609375 DEPOSIT ABSOLUTE /end AXIS_PTS
/begin AXIS_PTS BMWtqe_st_SptDet4NoiseAcvn_Ax "Torque engine status sport detection 4 noise activation X-axis" 0x80759743 Status_usecase_antr _REC_A1AXS_1_MBSE_U1 11 raChrxc_kBtBrmb_FmDuEFa_n__aa0o 12 0 11 FORMAT "%6.0" DEPOSIT ABSOLUTE /end AXIS_PTS
/begin AXIS_PTS BMWtqe_st_SptDet4NoiseAcvn_Ay "Torque engine status sport detection 4 noise activation Y-axis" 0x8075973F St_dsc_can _REC_A1AXS_1_MBSE_U1 11 raChrxc_kBtBrmb_FmDuEFa_n__aa0o 4 0 11 FORMAT "%3.0" DEPOSIT ABSOLUTE /end AXIS_PTS
/begin AXIS_PTS BMWtqe_tqc_FlApplStg_Ax "Torque engine, crankshaft torque full load application stage X-axis" 0x807314C0 Nkw_ref _REC_A1AXS_1_MBSE_S2 65535 caoddzd_oAjpfzb_cAcEEha_1nR_oa0 18 -32768 32767 DEPOSIT ABSOLUTE /end AXIS_PTS
/begin AXIS_PTS GXX_KF_LABAS "Group X-axis for KF_LABASxxx and KF_LA_SK" 0x8074E59C Nkw _REC_A1AXS_1_MBSE_S2 65535 caoddzd_oAjpfzb_cAcEEha_1nR_oa0 18 -32768 32767 FORMAT "%5.0" DEPOSIT ABSOLUTE /end AXIS_PTS
/begin AXIS_PTS GXX_KF_PHA_H_B1_BAS "GXX_KF_PHA_H_B1_BAS" 0x80716BA8 Nkw _REC_A1AXS_1_MBSE_S2 65535 caoddzd_oAjpfzb_cAcEEha_1nR_oa0 10 -32768 32767 FORMAT "%5.0" DEPOSIT ABSOLUTE /end AXIS_PTS
/begin AXIS_PTS GXY_KF_LABAS "Group Y-axis for KF_LABASxxx and KF_LA_SK" 0x8074E57A Rf _REC_A1AXS_1_MBSE_S2 655.35 CgkBooc_wkiDfEd_Czglhgc_fR_1a0o 17 -327.68 327.67 FORMAT "%7.2" DEPOSIT ABSOLUTE /end AXIS_PTS
/begin AXIS_PTS GXY_KF_PHA_H_B1_BAS "GXY_KF_PHA_H_B1_BAS input Rk_soll_h_xlb" 0x80716B80 NO_INPUT_QUANTITY _REC_A1AXS_1_MBSE_S2 3199.951171875 zyyxBpb_rEsnvtc_gktukCa_fR_5a0o 12 -1600 1599.951171875 FORMAT "%8.3" DEPOSIT ABSOLUTE /end AXIS_PTS
/begin AXIS_PTS IKCtl_nEngB16_X_AX "KR: Breakpoint distribution engine speed of group B" 0x807A0A74 Epm_nEng Axis_Xs16 32767.5 EngN 16 -16384 16383.5 FORMAT "%8.2" DEPOSIT ABSOLUTE /end AXIS_PTS
/begin AXIS_PTS IKCtl_ratLoadAddl04_X_AX "Support point distribution relative filling, 4 support points" 0x807A0AB2 AirMod_ratChrgAirCyl Axis_Xu16 1535.977 rel_q0p0234 4 0 1535.977 FORMAT "%8.3" DEPOSIT ABSOLUTE /end AXIS_PTS
/begin CHARACTERISTIC AKR_dmHFMThdMin_C "Minimum threshold for HFM value to close exhaust flap" VALUE 0x807907FE KwUw 6553.5 asfzqDd_xfCuqha_hliBAmd_k__0oa0 0 6553.5 FORMAT "%8.3" /end CHARACTERISTIC
/begin CHARACTERISTIC AKR_stSpt_C "Sport mode status" VALUE 0x80790CF4 FklWUb 255 DEZ 0 255 FORMAT "%5.1" /end CHARACTERISTIC
/begin CHARACTERISTIC Antilag_ActivationDelay___MGF_CC_PF "Activation delay" VALUE 0x807C0000 KwUw 655.35 camcxxd_bxlpdsa_Cshlhgc_sR_1a0o 0 60 /end CHARACTERISTIC
/begin CHARACTERISTIC Antilag_CoolantTempMax___MGF_CC_PF "Maximum coolant temperature" VALUE 0x807C058A KwUw 255 DchEpAd_DBCFgoa_Ckhahgc_q__aoa0 -300 300 FORMAT "%7.0" PHYS_UNIT "-" /end CHARACTERISTIC
/begin CHARACTERISTIC Antilag_CoolantTempMin___MGF_CC_PF "Minimum coolant temperature" VALUE 0x807C058C KwUw 255 DchEpAd_DBCFgoa_Ckhahgc_q__aoa0 -300 300 FORMAT "%7.0" PHYS_UNIT "-" /end CHARACTERISTIC
/begin CHARACTERISTIC Antilag_CutMethod___MGF_CC_PF "Method used to hold engine speed: 0 = fuel cut (bit of stuttering but safe), 1 = ignition cut (flame mode, very aggressive), 3 = factory rpm limiter (default, smoothest and safest)" VALUE 0x807C4A3C FklWUb 255 ___MGF_CC_EngineSpeedCutMethodCompuMethod 0 3 FORMAT "%7.0" /end CHARACTERISTIC
/begin CHARACTERISTIC Antilag_EgtTempMax___MGF_CC_PF "Maximum exhaust gas temperature [EGT]" VALUE 0x807C058E KwUw 255 BMW_q0p1_degC -1000 2000 FORMAT "%7.0" PHYS_UNIT "-" /end CHARACTERISTIC
/begin CHARACTERISTIC Antilag_IatTempMax___MGF_CC_PF "Maximum intake air temperature [IAT]" VALUE 0x807C4A3D FklWUb 255 ___MGF_CC_TemperatureCelsius_x3_d4_s48 -300 300 FORMAT "%7.0" PHYS_UNIT "-" /end CHARACTERISTIC
/begin CHARACTERISTIC Antilag_MaxDuration___MGF_CC_PF "Maximum usage duration" VALUE 0x807C08B0 KwUw 655.35 camcxxd_bxlpdsa_Cshlhgc_sR_1a0o 0 5000 /end CHARACTERISTIC
/begin CHARACTERISTIC Antilag_OverBoostThreshold___MGF_CC_PF "Maximum over boost" VALUE 0x807C08B2 KwUw 255 BMW_p_sw_q0p125_hPa 0 5000 FORMAT "%7.0" PHYS_UNIT "-" /end CHARACTERISTIC
/begin CHARACTERISTIC Antilag_Pedal___MGF_CC_PF "Pedal threshold for activation" VALUE 0x807C4A3E FklWUb 255 ___MGF_CC_Pedal_x100_d256 0 100 FORMAT "%7.0" PHYS_UNIT "-" /end CHARACTERISTIC
/begin CHARACTERISTIC Antilag_RollingSpeedThreshold___MGF_CC_PF "Speed threshold to detect rolling" VALUE 0x807C08B4 KwUw 255 ___MGF_CC_Speedkmh_d64 0 300 FORMAT "%7.0" PHYS_UNIT "-" /end CHARACTERISTIC
/begin CHARACTERISTIC Antilag_RollRpmMax___MGF_CC_PF "RPM maximum engagement" VALUE 0x807C08B6 KwUw 32767.5 EngN 0 15000 FORMAT "%8.2" /end CHARACTERISTIC
/begin CHARACTERISTIC Antilag_RollRpmMin___MGF_CC_PF "RPM minimum engagement" VALUE 0x807C08B8 KwUw 32767.5 EngN 0 15000 FORMAT "%8.2" /end CHARACTERISTIC
/begin CHARACTERISTIC Antilag_RpmDelayUntilCutRoll___MGF_CC_PF "RPM delay until cut" VALUE 0x807C08BA KwUw 32767.5 EngN 0 20000 FORMAT "%8.2" /end CHARACTERISTIC
/begin CHARACTERISTIC Antilag_RpmDelayUntilCutStand___MGF_CC_PF "RPM delay until cut" VALUE 0x807C08BC KwUw 32767.5 EngN 0 20000 FORMAT "%8.2" /end CHARACTERISTIC
/begin CHARACTERISTIC Antilag_RpmSetpoint___MGF_CC_PF "RPM setpoint" VALUE 0x807C08BE CurG_Ws16 32767.5 EngN 0 15000 FORMAT "%8.2" /end CHARACTERISTIC
/begin CHARACTERISTIC Antilag_TargetBoostRoll___MGF_CC_PF "Boost pressure setpoint" VALUE 0x807C08E4 KwUw 255 BMW_p_sw_q0p125_hPa 0 3000 FORMAT "%7.0" PHYS_UNIT "-" /end CHARACTERISTIC
/begin CHARACTERISTIC Antilag_TargetBoostStand___MGF_CC_PF "Boost pressure setpoint" VALUE 0x807C08E6 KwUw 255 BMW_p_sw_q0p125_hPa 0 3000 FORMAT "%7.0" PHYS_UNIT "-" /end CHARACTERISTIC
/begin CHARACTERISTIC Antilag_TargetNumberOfCylindersToSuppress___MGF_CC_PF "Target number of cylinders to suppress during antilag" VALUE 0x807C2491 FklWUb 8 raChrxc_kBtBrmb_FmDuEFa_n__aa0o 0 8 FORMAT "%3.0" /end CHARACTERISTIC
/begin CHARACTERISTIC BMWchas_tq_ResExhFlpClsdHys_C "Hysterese für das schließen der Abgasklappe " VALUE 0x8073BB4A CurG_Ws16 6553.5 BMW_dm_sw_q0p1_Nm -3276.8 3276.7 FORMAT "%6.1" /end CHARACTERISTIC
/begin CHARACTERISTIC BMWchas_v_IdlGearAcvMin_C "Threshold vehicle velocity for setting gear engaged for manual transmission vehicles" VALUE 0x8073BB46 CurG_Ws16 1310.7 jgbhAma_smpAegb_hlEBAmd_k__0oa0 -655.36 655.34 FORMAT "%6.2" /end CHARACTERISTIC
/begin CHARACTERISTIC BMWchas_v_MaxExhFlpClsd_C "Maximum speed up to which the exhaust flap should remain closed" VALUE 0x8073BB42 CurG_Ws16 1310.7 jgbhAma_smpAegb_hlEBAmd_k__0oa0 -655.36 655.34 FORMAT "%6.2" /end CHARACTERISTIC
/begin CHARACTERISTIC BMWchst_t_CatMax_C "Threshold catalyst temperature for canceling catalyst heating" VALUE 0x80711EBE CurG_Ws16 6553.5 BMW_q0p1_degC -3276.8 3276.7 /end CHARACTERISTIC
/begin CHARACTERISTIC BMWgpfdiag_m_ThdAshSnsr_C "Threshold for setting PWarnAsche regarding learned ash mass" VALUE 0x80741280 CurG_Ws16 511.9921875 bqonsub_DgsgbFa_Czglhgc_gR_1a0o -256 255.9921875 /end CHARACTERISTIC
/begin CHARACTERISTIC BMWgpfheat_p_RailTstrPcg_C "GPF heating, rail pressure setpoint for preconditioning" VALUE 0x8071D174 KwUw 39.9993896484375 cxdjuna_xpuCged_ocEpdua_MCRa2a0 0 39.9993896484375 /end CHARACTERISTIC
/begin CHARACTERISTIC BMWgpfheat_tq_ResExhFlpClsdHys_C "Hysterese für das schließen der Abgasklappe " VALUE 0x8071D2D4 CurG_Ws16 6553.5 BMW_dm_sw_q0p1_Nm -3276.8 3276.7 FORMAT "%6.1" /end CHARACTERISTIC
/begin CHARACTERISTIC BMWgpfp_swi_PclFil_C "Manual switch to activate GPF functionality in Gpf_Cluster. NOTE: The switch is only evaluated in the INI function. Changes to the switch must be flashed and the ECU must enter sleep mode." VALUE 0x80756180 FklWUb 1 fgjpsvb_fDqjECa_acgrbDd_n_dae__ 0 1 /end CHARACTERISTIC
/begin CHARACTERISTIC BMWosd_pwr_MaxSptDispkW_C "Sport display range end power - raw value in kW" VALUE 0x8070CD02 KwUw 65535 raChrxc_kBtBrmb_FmDuEFa_n__aa0o 0 65535 /end CHARACTERISTIC
/begin CHARACTERISTIC BMWosd_tq_MaxSptDispNm_C "Sport display range end torque - raw value in Nm" VALUE 0x8070CCFE KwUw 65535 lFwocba_tlxgpab_wmDuExd_NCRoa0o 0 65535 /end CHARACTERISTIC
/begin CHARACTERISTIC BMWshl_n_ThdSpdDispSegAlOn_C "RPM threshold at which shift lights always flash" VALUE 0x8075197E CurG_Ws16 10000 caoddzd_oAjpfzb_cAcEEha_1nR_oa0 0 10000 /end CHARACTERISTIC
/begin CHARACTERISTIC BMWtchbas_cw_Noise_C "Configuration for wastegate opening for acoustic reasons" VALUE 0x807570BF FklWUb 255 raChrxc_kBtBrmb_FmDuEFa_n__aa0o 0 255 FORMAT "%5.0" /end CHARACTERISTIC
/begin CHARACTERISTIC BMWtchbpi_p_MaxTcSptDisp_C "Display range boost pressure" VALUE 0x80765792 FklWUb 12.75 qDyjaAb_mviibsd_eCcdamc_bCRooa0 0 12.75 /end CHARACTERISTIC
/begin CHARACTERISTIC BMWtchob_p_DifEnd_C "Control deviation for overboost end" VALUE 0x80727C4E CurG_Ws16 8191.875 BMW_p_sw_q0p125_hPa -4096 4095.875 FORMAT "%10.3" /end CHARACTERISTIC
/begin CHARACTERISTIC BMWtchob_p_DifGraTrigMin_C "Control deviation gradient for triggering overboost" VALUE 0x80727E3A CurG_Ws16 8191.875 BMW_p_sw_q0p125_hPa -4096 4095.875 FORMAT "%10.3" /end CHARACTERISTIC
/begin CHARACTERISTIC BMWtchsp_p_OfsMax_C "Offset on Pld_soll_max. This is subtracted from Pld_soll_max. If actual pressure Pvdkds rises above this threshold, Rf_max_pldmax calculation is activated (load is high enough for Fups and Pirg to be used for Rfmax calculation)" VALUE 0x807281E2 KwUw 8191.875 BMW_p_sw_q0p125_hPa 0 8191.875 FORMAT "%10.3" /end CHARACTERISTIC
/begin CHARACTERISTIC BMWtchsp_p_ReqMax_C "Maximum target boost pressure due to boost pressure sensor diagnostics" VALUE 0x807281DE KwUw 8191.875 BMW_p_sw_q0p125_hPa 0 8191.875 FORMAT "%10.3" /end CHARACTERISTIC
/begin CHARACTERISTIC BMWtchsp_p_ReqMax_C___MGF_CC_FF1_Slot0 "Maximum target boost pressure due to boost pressure sensor diagnostics (Slot 0, Flex Fuel 1)" VALUE 0x807C25B6 KwUw 8191.875 BMW_p_sw_q0p125_hPa 0 8191.875 FORMAT "%10.3" /end CHARACTERISTIC
/begin CHARACTERISTIC BMWtchsp_p_ReqMax_C___MGF_CC_FF2_Slot0 "Maximum target boost pressure due to boost pressure sensor diagnostics (Slot 0, Flex Fuel 2)" VALUE 0x807D2060 KwUw 8191.875 BMW_p_sw_q0p125_hPa 0 8191.875 FORMAT "%10.3" /end CHARACTERISTIC
/begin CHARACTERISTIC BMWtqe_swi_NoiseWiDiDfco_C "Switch to activate overrun burble functionality despite prohibition SA" VALUE 0x807596AE FklWUb 1 fgjpsvb_fDqjECa_acgrbDd_n_dae__ 0 1 /end CHARACTERISTIC
/begin CHARACTERISTIC CcmEnterMenuDelay___MGF_CC_PF "Delay to enter Custom Code Menu, CCM" VALUE 0x807C2410 KwUw 655.35 camcxxd_bxlpdsa_Cshlhgc_sR_1a0o 0 5000 /end CHARACTERISTIC
/begin CHARACTERISTIC CcmTimeout___MGF_CC_PF "Timeout until automatic exit of Custom Code Menu, CCM" VALUE 0x807C2412 KwUw 655.35 camcxxd_bxlpdsa_Cshlhgc_sR_1a0o 0 5000 /end CHARACTERISTIC
/begin CHARACTERISTIC CustomCanBusCruiseControlIdMap___MGF_CC_PF "CAN bus ID for cruise control module (Default = 0x189)" VALUE 0x807C248C KwUw 255 raChrxc_kBtBrmb_FmDuEFa_n__aa0o 0 4095 FORMAT "%7.0" /end CHARACTERISTIC
/begin CHARACTERISTIC CustomCanBusEcaIdMap___MGF_CC_PF "CAN bus ID for Ethanol Content Analyzer (ECA) module (Commonly 0x0EC, 0x0EB, or 0x4CB)" VALUE 0x807D88F2 KwUw 255 raChrxc_kBtBrmb_FmDuEFa_n__aa0o 0 4095 FORMAT "%7.0" /end CHARACTERISTIC
/begin CHARACTERISTIC CustomCanBusMotivReflexOutputIdMap___MGF_CC_PF "CAN bus ID for Motiv's Re|Flex module (Commonly 0x0EC, 0x0EB, 0x4CB, or 0x334)" VALUE 0x807D88F6 KwUw 255 raChrxc_kBtBrmb_FmDuEFa_n__aa0o 0 4095 FORMAT "%7.0" /end CHARACTERISTIC
/begin CHARACTERISTIC CustomCanBusTurnSignalIdMap___MGF_CC_PF "CAN bus ID for turn signal module (Default = 0x1EE)" VALUE 0x807D88FA KwUw 255 raChrxc_kBtBrmb_FmDuEFa_n__aa0o 0 4095 FORMAT "%7.0" /end CHARACTERISTIC
/begin CHARACTERISTIC CW_Antilag___MGF_CC "Antilag Codeword: Set 1 (true) to enable function and 0 (false) to disable function" VALUE 0x807C4A3F FklWUb 1 B_TRUE 0 1 FORMAT "%13.11" /end CHARACTERISTIC
/begin CHARACTERISTIC CW_BurblesOnTheFly___MGF_CC "Burbles On-The-Fly Codeword: Set 1 (true) to enable function and 0 (false) to disable function" VALUE 0x807C4A40 FklWUb 1 B_TRUE 0 1 FORMAT "%13.11" /end CHARACTERISTIC
/begin CHARACTERISTIC CW_CruiseControlConfig___MGF_CC "Cruise Control Config Codeword: Set 1 (true) if using RockerCombo and 0 (false) if using UniRocker" VALUE 0x807C2467 FklWUb 1 B_TRUE 0 1 FORMAT "%13.11" /end CHARACTERISTIC
/begin CHARACTERISTIC CW_CustomCodeMenu___MGF_CC "Custom Code Menu Codeword: Set 1 (true) to enable function and 0 (false) to disable function" VALUE 0x807C2466 FklWUb 1 B_TRUE 0 1 FORMAT "%13.11" /end CHARACTERISTIC
/begin CHARACTERISTIC CW_ExhaustFlapOnTheFly___MGF_CC "Exhaust Flap On-The-Fly Codeword: Set 1 (true) to enable function and 0 (false) to disable function" VALUE 0x807C2468 FklWUb 1 B_TRUE 0 1 FORMAT "%13.11" /end CHARACTERISTIC
/begin CHARACTERISTIC CW_FlexFuel___MGF_CC "Flex Fuel Codeword: Set 1 (true) to enable function and 0 (false) to disable function" VALUE 0x807C2469 FklWUb 1 B_TRUE 0 1 FORMAT "%13.11" /end CHARACTERISTIC
/begin CHARACTERISTIC CW_FlexFuelBlending___MGF_CC "Flex Fuel Blending Codeword: Set 1 (true) to enable function and 0 (false) to disable function" VALUE 0x807C246A FklWUb 1 B_TRUE 0 1 FORMAT "%13.11" /end CHARACTERISTIC
/begin CHARACTERISTIC CW_FlexFuelBlending_BMWtchctr_p_DifCrtnPp_M___MGF_CC "BMWtchctr_p_DifCrtnPp_M Blending Codeword: Set 1 (true) to enable blending of this map and 0 (false) to disable blending of this map (in all slots)" VALUE 0x807C2489 FklWUb 1 B_TRUE 0 1 FORMAT "%13.11" /end CHARACTERISTIC
/begin CHARACTERISTIC CW_FlexFuelBlending_BMWtchctr_pct_WgBasc_M___MGF_CC "BMWtchctr_pct_WgBasc_M Blending Codeword: Set 1 (true) to enable blending of this map and 0 (false) to disable blending of this map (in all slots)" VALUE 0x807C248A FklWUb 1 B_TRUE 0 1 FORMAT "%13.11" /end CHARACTERISTIC
/begin CHARACTERISTIC CW_FlexFuelBlending_BMWtchctr_pwr_Dp_M___MGF_CC "BMWtchctr_pwr_Dp_M Blending Codeword: Set 1 (true) to enable blending of this map and 0 (false) to disable blending of this map (in all slots)" VALUE 0x807C248B FklWUb 1 B_TRUE 0 1 FORMAT "%13.11" /end CHARACTERISTIC
/begin CHARACTERISTIC CW_FlexFuelBlending_BMWtchctr_pwr_PctlWideRng_M___MGF_CC "BMWtchctr_pwr_PctlWideRng_M Blending Codeword: Set 1 (true) to enable blending of this map and 0 (false) to disable blending of this map (in all slots)" VALUE 0x807D8901 FklWUb 1 B_TRUE 0 1 FORMAT "%13.11" /end CHARACTERISTIC
/begin CHARACTERISTIC CW_FlexFuelBlending_BMWtchsp_p_ReqMax_C___MGF_CC "BMWtchsp_p_ReqMax_C Blending Codeword: Set 1 (true) to enable blending of this map and 0 (false) to disable blending of this map (in all slots)" VALUE 0x807C248F FklWUb 1 B_TRUE 0 1 FORMAT "%13.11" /end CHARACTERISTIC
/begin CHARACTERISTIC CW_FlexFuelBlending_IKCtl_FacKnockDetThd0_GM___MGF_CC "IKCtl_FacKnockDetThd0_GM Blending Codeword: Set 1 (true) to enable blending of this map and 0 (false) to disable blending of this map (in all slots)" VALUE 0x807C5045 FklWUb 1 B_TRUE 0 1 FORMAT "%13.11" /end CHARACTERISTIC
/begin CHARACTERISTIC CW_FlexFuelBlending_IKCtl_FacKnockDetThd1_GM___MGF_CC "IKCtl_FacKnockDetThd1_GM Blending Codeword: Set 1 (true) to enable blending of this map and 0 (false) to disable blending of this map (in all slots)" VALUE 0x807D88E5 FklWUb 1 B_TRUE 0 1 FORMAT "%13.11" /end CHARACTERISTIC
/begin CHARACTERISTIC CW_FlexFuelBlending_IKCtl_FacKnockDetThd2_GM___MGF_CC "IKCtl_FacKnockDetThd2_GM Blending Codeword: Set 1 (true) to enable blending of this map and 0 (false) to disable blending of this map (in all slots)" VALUE 0x807D88E6 FklWUb 1 B_TRUE 0 1 FORMAT "%13.11" /end CHARACTERISTIC
/begin CHARACTERISTIC CW_FlexFuelBlending_IKCtl_FacKnockDetThd3_GM___MGF_CC "IKCtl_FacKnockDetThd3_GM Blending Codeword: Set 1 (true) to enable blending of this map and 0 (false) to disable blending of this map (in all slots)" VALUE 0x807D88E7 FklWUb 1 B_TRUE 0 1 FORMAT "%13.11" /end CHARACTERISTIC
/begin CHARACTERISTIC CW_FlexFuelBlending_IKCtl_FacKnockDetThd4_GM___MGF_CC "IKCtl_FacKnockDetThd4_GM Blending Codeword: Set 1 (true) to enable blending of this map and 0 (false) to disable blending of this map (in all slots)" VALUE 0x807D88E8 FklWUb 1 B_TRUE 0 1 FORMAT "%13.11" /end CHARACTERISTIC
/begin CHARACTERISTIC CW_FlexFuelBlending_IKCtl_FacKnockDetThd5_GM___MGF_CC "IKCtl_FacKnockDetThd5_GM Blending Codeword: Set 1 (true) to enable blending of this map and 0 (false) to disable blending of this map (in all slots)" VALUE 0x807D88E9 FklWUb 1 B_TRUE 0 1 FORMAT "%13.11" /end CHARACTERISTIC
/begin CHARACTERISTIC CW_FlexFuelBlending_KF_FDZWT_PF1___MGF_CC "KF_FDZWT_PF1 Blending Codeword: Set 1 (true) to enable blending of this map and 0 (false) to disable blending of this map (in all slots)" VALUE 0x807D88EA FklWUb 1 B_TRUE 0 1 FORMAT "%13.11" /end CHARACTERISTIC
/begin CHARACTERISTIC CW_FlexFuelBlending_KF_FDZWT_PF2___MGF_CC "KF_FDZWT_PF2 Blending Codeword: Set 1 (true) to enable blending of this map and 0 (false) to disable blending of this map (in all slots)" VALUE 0x807D88EB FklWUb 1 B_TRUE 0 1 FORMAT "%13.11" /end CHARACTERISTIC
/begin CHARACTERISTIC CW_FlexFuelBlending_KF_FRKKORRF_1___MGF_CC "KF_FRKKORRF_1 Blending Codeword: Set 1 (true) to enable blending of this map and 0 (false) to disable blending of this map (in all slots)" VALUE 0x807D88EC FklWUb 1 B_TRUE 0 1 FORMAT "%13.11" /end CHARACTERISTIC
/begin CHARACTERISTIC CW_FlexFuelBlending_KF_LABAS_1___MGF_CC "KF_LABAS_1 Blending Codeword: Set 1 (true) to enable blending of this map and 0 (false) to disable blending of this map (in all slots)" VALUE 0x807D88ED FklWUb 1 B_TRUE 0 1 FORMAT "%13.11" /end CHARACTERISTIC
/begin CHARACTERISTIC CW_FlexFuelBlending_KF_LABAS_2___MGF_CC "KF_LABAS_2 Blending Codeword: Set 1 (true) to enable blending of this map and 0 (false) to disable blending of this map (in all slots)" VALUE 0x807D88EE FklWUb 1 B_TRUE 0 1 FORMAT "%13.11" /end CHARACTERISTIC
/begin CHARACTERISTIC CW_FlexFuelBlending_KF_PHA_H_B1_W___MGF_CC "KF_PHA_H_B1_W Blending Codeword: Set 1 (true) to enable blending of this map and 0 (false) to disable blending of this map (in all slots)" VALUE 0x807D88EF FklWUb 1 B_TRUE 0 1 FORMAT "%13.11" /end CHARACTERISTIC
/begin CHARACTERISTIC CW_FlexFuelBlending_KF_PHA_H_E1___MGF_CC "KF_PHA_H_E1 Blending Codeword: Set 1 (true) to enable blending of this map and 0 (false) to disable blending of this map (in all slots)" VALUE 0x807D88F0 FklWUb 1 B_TRUE 0 1 FORMAT "%13.11" /end CHARACTERISTIC
/begin CHARACTERISTIC CW_FlexFuelBlending_KF_ZW_PF1___MGF_CC "KF_ZW_PF1 Blending Codeword: Set 1 (true) to enable blending of this map and 0 (false) to disable blending of this map (in all slots)" VALUE 0x807D88F1 FklWUb 1 B_TRUE 0 1 FORMAT "%13.11" /end CHARACTERISTIC
/begin CHARACTERISTIC CW_FlexFuelBlending_KF_ZW_PF2___MGF_CC "KF_ZW_PF2 Blending Codeword: Set 1 (true) to enable blending of this map and 0 (false) to disable blending of this map (in all slots)" VALUE 0x807D88F4 FklWUb 1 B_TRUE 0 1 FORMAT "%13.11" /end CHARACTERISTIC
/begin CHARACTERISTIC CW_FlexFuelBlending_KF_ZW_S_PF1___MGF_CC "KF_ZW_S_PF1 Blending Codeword: Set 1 (true) to enable blending of this map and 0 (false) to disable blending of this map (in all slots)" VALUE 0x807D88F5 FklWUb 1 B_TRUE 0 1 FORMAT "%13.11" /end CHARACTERISTIC
/begin CHARACTERISTIC CW_FlexFuelBlending_KF_ZW_S_PF2___MGF_CC "KF_ZW_S_PF2 Blending Codeword: Set 1 (true) to enable blending of this map and 0 (false) to disable blending of this map (in all slots)" VALUE 0x807D88F8 FklWUb 1 B_TRUE 0 1 FORMAT "%13.11" /end CHARACTERISTIC
/begin CHARACTERISTIC CW_FlexFuelBlending_KF_ZW_UESP_PF1___MGF_CC "KF_ZW_UESP_PF1 Blending Codeword: Set 1 (true) to enable blending of this map and 0 (false) to disable blending of this map (in all slots)" VALUE 0x807D88F9 FklWUb 1 B_TRUE 0 1 FORMAT "%13.11" /end CHARACTERISTIC
/begin CHARACTERISTIC CW_FlexFuelBlending_KF_ZW_UESP_PF2___MGF_CC "KF_ZW_UESP_PF2 Blending Codeword: Set 1 (true) to enable blending of this map and 0 (false) to disable blending of this map (in all slots)" VALUE 0x807D88FC FklWUb 1 B_TRUE 0 1 FORMAT "%13.11" /end CHARACTERISTIC
/begin CHARACTERISTIC CW_FlexFuelBlending_KF_ZW_VP_PF1___MGF_CC "KF_ZW_VP_PF1 Blending Codeword: Set 1 (true) to enable blending of this map and 0 (false) to disable blending of this map (in all slots)" VALUE 0x807D88FD FklWUb 1 B_TRUE 0 1 FORMAT "%13.11" /end CHARACTERISTIC
/begin CHARACTERISTIC CW_FlexFuelBlending_KF_ZW_VP_PF2___MGF_CC "KF_ZW_VP_PF2 Blending Codeword: Set 1 (true) to enable blending of this map and 0 (false) to disable blending of this map (in all slots)" VALUE 0x807D88FE FklWUb 1 B_TRUE 0 1 FORMAT "%13.11" /end CHARACTERISTIC
/begin CHARACTERISTIC CW_FlexFuelBlending_KL_RF_MAX___MGF_CC "KL_RF_MAX Blending Codeword: Set 1 (true) to enable blending of this map and 0 (false) to disable blending of this map (in all slots)" VALUE 0x807D88FF FklWUb 1 B_TRUE 0 1 FORMAT "%13.11" /end CHARACTERISTIC
/begin CHARACTERISTIC CW_FlexFuelBlending_KL_RF_MAX_UESP___MGF_CC "KL_RF_MAX_UESP Blending Codeword: Set 1 (true) to enable blending of this map and 0 (false) to disable blending of this map (in all slots)" VALUE 0x807D8900 FklWUb 1 B_TRUE 0 1 FORMAT "%13.11" /end CHARACTERISTIC
/begin CHARACTERISTIC CW_FlexFuelBlending_Slot0___MGF_CC "Flex Fuel Blending  Slot 0 Codeword: Set 1 (true) to enable function and 0 (false) to disable function" VALUE 0x807C25C4 FklWUb 1 B_TRUE 0 1 FORMAT "%13.11" /end CHARACTERISTIC
/begin CHARACTERISTIC CW_LowPressureFuelPressureSensorInstalled___MGF_CC "Low Pressure Fuel Pressure Sensor Installed Codeword: Set 1 (true) if (Motiv or Fuel-It) low pressure fuel pressure sensor is installed and 0 (false) if not installed" VALUE 0x807C2484 FklWUb 1 B_TRUE 0 1 FORMAT "%13.11" /end CHARACTERISTIC
/begin CHARACTERISTIC CW_MgfLimpModeProtectionEnabled___MGF_CC "Mgf Limp Mode Protection Enabled Codeword: Set 1 (true) if MG Flasher's protective limp mode should be enabled and 0 (false) if disabled" VALUE 0x807C2487 FklWUb 1 B_TRUE 0 1 FORMAT "%13.11" /end CHARACTERISTIC
/begin CHARACTERISTIC CW_MotivReflexInstalled___MGF_CC "Motiv Reflex Installed Codeword: Set 1 (true) if Motiv Re|Flex is installed and 0 (false) if not installed" VALUE 0x807C2488 FklWUb 1 B_TRUE 0 1 FORMAT "%13.11" /end CHARACTERISTIC
/begin CHARACTERISTIC CW_SensorEthanol___MGF_CC "Sensor Ethanol Codeword: Set 1 (true) if flex fuel sensor is installed on PT-CAN2 and 0 (false) if not installed " VALUE 0x807C246C FklWUb 1 B_TRUE 0 1 FORMAT "%13.11" /end CHARACTERISTIC
/begin CHARACTERISTIC CW_SOUND "CW_SOUND" VALUE 0x807596D8 FklWUb 255 raChrxc_kBtBrmb_FmDuEFa_n__aa0o 0 255 FORMAT "%7.0" /end CHARACTERISTIC
/begin CHARACTERISTIC CW_UseAllCruiseControlCanBusData___MGF_CC "Use All Cruise Control Can Bus Data Codeword: Set 1 (true) to use all cruise control CAN bus data and 0 (false) to use only Rocker data" VALUE 0x807C246D FklWUb 1 B_TRUE 0 1 FORMAT "%13.11" /end CHARACTERISTIC
/begin CHARACTERISTIC CW_UseMultipleFlexFuelSlots___MGF_CC "Use Multiple Flex Fuel Slots Codeword: Set 1 (true) to use each Flex Fuel map slot and 0 (false) to use only Slot 0" VALUE 0x807C2486 FklWUb 1 B_TRUE 0 1 FORMAT "%13.11" /end CHARACTERISTIC
/begin CHARACTERISTIC CW_UsePumpFuelMapWhenBlendFactorIsGreaterThan1___MGF_CC "Use Pump Fuel Map When Blend Factor Is Greater Than 1 Codeword: Set 1 (true) to use Pump Fuel map slots for lower bounds when Blend Factor is greater than 100% and 0 (false) to use Flex Fuel #1 map slots" VALUE 0x807C2485 FklWUb 1 B_TRUE 0 1 FORMAT "%13.11" /end CHARACTERISTIC
/begin CHARACTERISTIC CWAKR "Codeword for exhaust flap control" VALUE 0x80790D3A KwUw 65535 DEZ 0 65535 FORMAT "%8.2" /end CHARACTERISTIC
/begin CHARACTERISTIC CWSTEGSPROGAKR "Codeword for exhaust flap control via stegsprog" VALUE 0x80790D42 FklWUb 255 DEZ 0 255 FORMAT "%5.1" /end CHARACTERISTIC
/begin CHARACTERISTIC CWVMAXCOD "Codeword VMAX coding active" VALUE 0x807ADBA9 FklWUb 255 DEZ 0 255 FORMAT "%5.1" /end CHARACTERISTIC
/begin CHARACTERISTIC ExhaustFlapClosedMaxLoad___MGF_CC_PF "Maximum load before overriding user selection and opening exhaust flaps" VALUE 0x807C2414 CurG_Ws16 255 CgkBooc_wkiDfEd_Czglhgc_fR_1a0o -327 327 FORMAT "%7.0" PHYS_UNIT "-" /end CHARACTERISTIC
/begin CHARACTERISTIC FlexFuelEthanolDisplayActivationDelay___MGF_CC_PF "Delay to display flex fuel ethanol content on the dash" VALUE 0x807C2416 KwUw 655.35 camcxxd_bxlpdsa_Cshlhgc_sR_1a0o 0 5000 /end CHARACTERISTIC
/begin CHARACTERISTIC K_EDA_MD_ANZ_BS_SCAL_CODE0 "Base scaling per range in the display" VALUE 0x80753D3F FklWUb 255 raChrxc_kBtBrmb_FmDuEFa_n__aa0o 0 255 /end CHARACTERISTIC
/begin CHARACTERISTIC K_EDA_MD_ANZ_BS_SCAL_CODE1 "Base scaling per range in the display" VALUE 0x80753D3D FklWUb 255 raChrxc_kBtBrmb_FmDuEFa_n__aa0o 0 255 /end CHARACTERISTIC
/begin CHARACTERISTIC K_EDA_MD_ANZ_BS_SCAL_CODE2 "Base scaling per range in the display" VALUE 0x80753D3B FklWUb 255 raChrxc_kBtBrmb_FmDuEFa_n__aa0o 0 255 /end CHARACTERISTIC
/begin CHARACTERISTIC K_EDA_MD_ANZ_BS_SCAL_CODE3 "Base scaling per range in the display" VALUE 0x80753D39 FklWUb 255 raChrxc_kBtBrmb_FmDuEFa_n__aa0o 0 255 /end CHARACTERISTIC
/begin CHARACTERISTIC K_EDA_MD_ANZ_BS_SCAL_CODE4 "Base scaling per range in the display" VALUE 0x80753D37 FklWUb 255 raChrxc_kBtBrmb_FmDuEFa_n__aa0o 0 255 /end CHARACTERISTIC
/begin CHARACTERISTIC K_EDA_P_ANZ_SPORT_BS_SCAL_CODE0 "Base scaling per range in the display" VALUE 0x80753D31 FklWUb 255 raChrxc_kBtBrmb_FmDuEFa_n__aa0o 0 255 /end CHARACTERISTIC
/begin CHARACTERISTIC K_EDA_P_ANZ_SPORT_BS_SCAL_CODE1 "Base scaling per range in the display" VALUE 0x80753D30 FklWUb 255 raChrxc_kBtBrmb_FmDuEFa_n__aa0o 0 255 /end CHARACTERISTIC
/begin CHARACTERISTIC K_EDA_P_ANZ_SPORT_BS_SCAL_CODE2 "Base scaling per range in the display" VALUE 0x80753D2F FklWUb 255 raChrxc_kBtBrmb_FmDuEFa_n__aa0o 0 255 /end CHARACTERISTIC
/begin CHARACTERISTIC K_EDA_P_ANZ_SPORT_BS_SCAL_CODE3 "Base scaling per range in the display" VALUE 0x80753D2E FklWUb 255 raChrxc_kBtBrmb_FmDuEFa_n__aa0o 0 255 /end CHARACTERISTIC
/begin CHARACTERISTIC K_F_SOT_RUECKBLICK_RS "Offset for overrun burble factor during downshift" VALUE 0x80753C71 FklWUb 0.99609375 BMW_Powertrain_DxECompuMethods_Def_ub_b1_nounit 0 0.99609375 FORMAT "%6.4" /end CHARACTERISTIC
/begin CHARACTERISTIC K_F_SOT_RUECKBLICK_STAND "Factor for overrun burble at standstill" VALUE 0x80753C70 FklWUb 0.99609375 BMW_Powertrain_DxECompuMethods_Def_ub_b1_nounit 0 0.99609375 FORMAT "%6.4" /end CHARACTERISTIC
/begin CHARACTERISTIC K_FK_NEL_VSKR "Filtering of E-fan request based on fuel consumption" VALUE 0x80761D24 FklWUb 0.99609375 BMW_Powertrain_DxECompuMethods_Def_ub_b1_nounit 0 0.99609375 FORMAT "%6.4" /end CHARACTERISTIC
/begin CHARACTERISTIC K_MAX_PSSOLBER "Maximum Ps_soll_offs (for calculation of Ps_soll_sm_nl)" VALUE 0x8071F8DE CurG_Ws16 8191.875 BMW_p_sw_q0p125_hPa -4096 4095.875 FORMAT "%8.3" /end CHARACTERISTIC
/begin CHARACTERISTIC K_N_GB1_IN_MAX_OSC "Max speed for GB1 (gearbox stage 1) protection" VALUE 0x8073A708 CurG_Ws16 65535 caoddzd_oAjpfzb_cAcEEha_1nR_oa0 -32768 32767 FORMAT "%5.0" /end CHARACTERISTIC
/begin CHARACTERISTIC K_NADONNMX "Upper engine speed limit for releasing N.N. adaptation, throttle or lift (B_mradon)" VALUE 0x80712C0C CurG_Ws16 32767 caoddzd_oAjpfzb_cAcEEha_1nR_oa0 0 32767 FORMAT "%5.0" /end CHARACTERISTIC
/begin CHARACTERISTIC K_NKW_MAX "Max crankshaft speed" VALUE 0x8072A04A CurG_Ws16 32767 caoddzd_oAjpfzb_cAcEEha_1nR_oa0 0 32767 FORMAT "%5.0" /end CHARACTERISTIC
/begin CHARACTERISTIC K_NMX_VM_ABS "Max applicable engine speed (N_vm_max)" VALUE 0x80731EF8 CurG_Ws16 65535 caoddzd_oAjpfzb_cAcEEha_1nR_oa0 -32768 32767 FORMAT "%5.0" /end CHARACTERISTIC
/begin CHARACTERISTIC K_NMX_VM_BA_GD "Maximum speed in throttled operating mode (GD)" VALUE 0x8074AEE8 CurG_Ws16 65535 caoddzd_oAjpfzb_cAcEEha_1nR_oa0 -32768 32767 FORMAT "%5.0" /end CHARACTERISTIC
/begin CHARACTERISTIC K_NMX_VM_BA_VVT "Maximum speed in VVT operating mode" VALUE 0x8074AEE6 CurG_Ws16 65535 caoddzd_oAjpfzb_cAcEEha_1nR_oa0 -32768 32767 FORMAT "%5.0" /end CHARACTERISTIC
/begin CHARACTERISTIC K_NMX_VM_FETRAWE "Maximum speed in FETRAWE mode" VALUE 0x80731EF4 CurG_Ws16 65535 caoddzd_oAjpfzb_cAcEEha_1nR_oa0 -32768 32767 FORMAT "%5.0" /end CHARACTERISTIC
/begin CHARACTERISTIC K_NMX_VM_OG_COMFORT "Upper RPM limit in COMFORT mode (Status_usecase_antr)" VALUE 0x8074AEE4 CurG_Ws16 65535 caoddzd_oAjpfzb_cAcEEha_1nR_oa0 -32768 32767 FORMAT "%5.0" /end CHARACTERISTIC
/begin CHARACTERISTIC K_NMX_VM_OG_ECO "Upper RPM limit in ECO mode (Status_usecase_antr)" VALUE 0x8074AEE2 CurG_Ws16 65535 caoddzd_oAjpfzb_cAcEEha_1nR_oa0 -32768 32767 FORMAT "%5.0" /end CHARACTERISTIC
/begin CHARACTERISTIC K_NMX_VM_OG_RENNSTART "Upper RPM limit in LAUNCH CONTROL mode (Status_usecase_antr)" VALUE 0x8074AEE0 CurG_Ws16 65535 caoddzd_oAjpfzb_cAcEEha_1nR_oa0 -32768 32767 FORMAT "%5.0" /end CHARACTERISTIC
/begin CHARACTERISTIC K_NMX_VM_OG_SPORT "Upper RPM limit in SPORT mode (Status_usecase_antr)" VALUE 0x8074AEDE CurG_Ws16 65535 caoddzd_oAjpfzb_cAcEEha_1nR_oa0 -32768 32767 FORMAT "%5.0" /end CHARACTERISTIC
/begin CHARACTERISTIC K_NMX_VM_OG_SPORTPLUS "Upper RPM limit in SPORT PLUS mode (Status_usecase_antr)" VALUE 0x8074AEDC CurG_Ws16 65535 caoddzd_oAjpfzb_cAcEEha_1nR_oa0 -32768 32767 FORMAT "%5.0" /end CHARACTERISTIC
/begin CHARACTERISTIC K_PAK_MX "Maximum exhaust manifold pressure" VALUE 0x80711818 KwUw 8191.875 BMW_p_sw_q0p125_hPa 0 8191.875 FORMAT "%7.1" /end CHARACTERISTIC
/begin CHARACTERISTIC K_PAM_MODE_FUELLUNGSEG_NKW_HYS "Hysteresis for RPM thresholds for downshift of Pam_fuellungsseg_mode (2->1 or 1->0)" VALUE 0x80713782 CurG_Ws16 65535 caoddzd_oAjpfzb_cAcEEha_1nR_oa0 -32768 32767 FORMAT "%5.0" /end CHARACTERISTIC
/begin CHARACTERISTIC K_PAM_MODE_FUELLUNGSEG_NKW1 "RPM threshold for switching Pam_fuellungseg_mode from 0 to 1" VALUE 0x80713786 CurG_Ws16 32767 caoddzd_oAjpfzb_cAcEEha_1nR_oa0 0 32767 FORMAT "%5.0" /end CHARACTERISTIC
/begin CHARACTERISTIC K_PAM_MODE_FUELLUNGSEG_NKW2 "RPM threshold for switching Pam_fuellungseg_mode from 1 to 2" VALUE 0x80713784 CurG_Ws16 32767 caoddzd_oAjpfzb_cAcEEha_1nR_oa0 0 32767 FORMAT "%5.0" /end CHARACTERISTIC
/begin CHARACTERISTIC K_QS_ANF_KLIMA_MX "Maximum considered heat flow request from IHKA" VALUE 0x80761B04 FklWUb 99.609375 BMW_q0p3906_PERC 0 99.609375 /end CHARACTERISTIC
/begin CHARACTERISTIC K_T_NK_SOUND_MX "K_T_NK_SOUND_MX" VALUE 0x8072E77A CurG_Ws16 6553.5 BMW_q0p1_degC -3276.8 3276.7 /end CHARACTERISTIC
/begin CHARACTERISTIC K_T_SOUND_MN "K_T_SOUND_MN" VALUE 0x8072E778 CurG_Ws16 655.35 DchEpAd_DBCFgoa_Ckhahgc_q__aoa0 -327.68 327.67 /end CHARACTERISTIC
/begin CHARACTERISTIC K_T_VL_SOUND_MX "K_T_VL_SOUND_MX" VALUE 0x8072E776 CurG_Ws16 6553.5 BMW_q0p1_degC -3276.8 3276.7 /end CHARACTERISTIC
/begin CHARACTERISTIC K_TDOFF_HEIZ_OPF "OPF heating time delay for E-fan request" VALUE 0x8074B6AC KwUw 6553.5 BMW_q0p1__ 0 6553.5 /end CHARACTERISTIC
/begin CHARACTERISTIC K_TDON_HEIZ_OPF "OPF heating time delay for E-fan request" VALUE 0x8074B6AA KwUw 6553.5 BMW_q0p1__ 0 6553.5 /end CHARACTERISTIC
/begin CHARACTERISTIC K_TKW_MX "Coolant target temperature in MAX operating mode" VALUE 0x80737394 CurG_Ws16 655.35 DchEpAd_DBCFgoa_Ckhahgc_q__aoa0 -327.68 327.67 /end CHARACTERISTIC
/begin CHARACTERISTIC K_TKW_WA "Coolant target temperature in warm-up operating mode" VALUE 0x80737390 CurG_Ws16 655.35 DchEpAd_DBCFgoa_Ckhahgc_q__aoa0 -327.68 327.67 /end CHARACTERISTIC
/begin CHARACTERISTIC K_V_SOT_MN "Min. vehicle speed for overrun burble" VALUE 0x8070C92A CurG_Ws16 1310.7 Asyaixa_wdvtenb_FCefaCb_n__aa0o -655.36 655.34 FORMAT "%7.1" /end CHARACTERISTIC
/begin CHARACTERISTIC K_V_SOUND_MN "K_V_SOUND_MN" VALUE 0x8072E774 KwUw 1310.7 jgbhAma_smpAegb_hlEBAmd_k__0oa0 0 1310.7 /end CHARACTERISTIC
/begin CHARACTERISTIC K_V_SOUND_MX "K_V_SOUND_MX" VALUE 0x8072E772 KwUw 1310.7 jgbhAma_smpAegb_hlEBAmd_k__0oa0 0 1310.7 /end CHARACTERISTIC
/begin CHARACTERISTIC NMAX "RPM limiter" VALUE 0x807A5F38 KwUw 16383.75 nmot_sw_q0p25 0 16383.75 FORMAT "%8.2" /end CHARACTERISTIC
/begin CHARACTERISTIC NMAXKR "RPM limit at safety retard of knock control" VALUE 0x807A5F3C KwUw 16383.75 nmot_sw_q0p25 0 16383.75 FORMAT "%8.2" /end CHARACTERISTIC
/begin CHARACTERISTIC NMAXSWT "RPM limit via SWT" VALUE 0x807A5F40 KwUw 16383.75 nmot_sw_q0p25 0 16383.75 FORMAT "%8.2" /end CHARACTERISTIC
/begin CHARACTERISTIC NWARNORINI "Tachometer orange zone start RPM" VALUE 0x807915FE KwUw 16383.75 nmot_sw_q0p25 0 16383.75 FORMAT "%8.2" /end CHARACTERISTIC
/begin CHARACTERISTIC PFlt_stActv_C "Activation of particle filter functionality" VALUE 0x807A8210 FklWUb 255 BMW_ba_poel__ 0 255 FORMAT "%5.1" /end CHARACTERISTIC
/begin CHARACTERISTIC PFlt_stPfilTyp_C "Bit-coded type of the particle filter" VALUE 0x807A8211 FklWUb 255 BMW_ba_poel__ 0 255 FORMAT "%5.1" /end CHARACTERISTIC
/begin CHARACTERISTIC PVDMX "Upper pressure threshold for range check" VALUE 0x80797736 KwUw 5119.922 p_uw_q0p078 0 5119.922 FORMAT "%8.3" /end CHARACTERISTIC
/begin CHARACTERISTIC TMOTAKR "Temperature threshold for engine temperature dependent exhaust flap control" VALUE 0x80790D49 FklWUb 191.3 temp_ub_q0p75_o48 -48 143.3 FORMAT "%5.1" /end CHARACTERISTIC
/begin CHARACTERISTIC TVSTAKR "Delay time for exhaust flap actuation after start" VALUE 0x80790D4A KwUw 655.35 t10msxs_ub_b2p55 0 655.35 FORMAT "%8.4" /end CHARACTERISTIC
/begin CHARACTERISTIC UniRockerEnterDetectionDelay___MGF_CC_PF "Delay for 'enter' button detection with UniRocker button configuration in Custom Code Menu, CCM" VALUE 0x807C2418 KwUw 655.35 camcxxd_bxlpdsa_Cshlhgc_sR_1a0o 0 5000 /end CHARACTERISTIC
/begin CHARACTERISTIC VMAXOVC "Vmax limitation value, variant-coded" VALUE 0x807ADC28 KwUw 511.9922 vfzg_sw_q0p00781 0 511.9922 FORMAT "%8.4" /end CHARACTERISTIC
/begin CHARACTERISTIC VMINAKR "Minimum vehicle speed for pulse output" VALUE 0x80790D4C FklWUb 318.8 vfzg_ub_q1p25 0 318.8 FORMAT "%5.1" /end CHARACTERISTIC
/begin CHARACTERISTIC Antilag_SafetyTorqueCap___MGF_CC_PF "Target torque during antilag safety shutdown" CURVE 0x807C08C0 _REC_A1CUR_1_MBSE_S2_S1 6553.5 BMW_dm_sw_q0p1_Nm -3000 3000 FORMAT "%6.1" MATRIX_DIM 18 1 1
 /begin AXIS_DESCR COM_AXIS Nkw_ref caoddzd_oAjpfzb_cAcEEha_1nR_oa0 18 -32768 32767 AXIS_PTS_REF BMWtqe_tqc_FlApplStg_Ax MONOTONY STRICT_INCREASE DEPOSIT ABSOLUTE /end AXIS_DESCR
/end CHARACTERISTIC
/begin CHARACTERISTIC BMWausy_p_DifCat_T "Exhaust system pressure loss across the catalyst depending on mass flow" CURVE 0x80711AAE _REC_A1CUR_1_MBSE_U2_S1 8191.875 BMW_p_sw_q0p125_hPa 0 8191.875 FORMAT "%8.3"
 /begin AXIS_DESCR COM_AXIS NO_INPUT_QUANTITY ECeoxdb_wFseCtb_mEytEnb_k__o8a0 8 0 2559.9609375 AXIS_PTS_REF BMWausy_p_DifCat_Ax FORMAT "%8.3" MONOTONY STRICT_INCREASE DEPOSIT ABSOLUTE /end AXIS_DESCR
/end CHARACTERISTIC
/begin CHARACTERISTIC BMWchas_st_OpmBasCatCold_T "Basic catalyst heating mode wish while catalyst is cold" CURVE 0x8075EE0F _REC_A1CUR_1_MBSE_U1_S1 3 wDvwtyd_Bhgozed_DCekdfb_nsttFSS 0 3
 /begin AXIS_DESCR COM_AXIS BMWchst_t_Eng_sw DchEpAd_DBCFgoa_Ckhahgc_q__aoa0 8 -327.68 327.67 AXIS_PTS_REF BMWchas_st_OpmBasCatCold_Ax FORMAT "%6.2" MONOTONY MON_INCREASE DEPOSIT ABSOLUTE /end AXIS_DESCR
/end CHARACTERISTIC
/begin CHARACTERISTIC BMWchas_st_OpmBasLiOff_T "Basic catalyst heating mode wish after catalyst light-off has been reached" CURVE 0x8075EE07 _REC_A1CUR_1_MBSE_U1_S1 3 wDvwtyd_Bhgozed_DCekdfb_nsttFSS 0 3
 /begin AXIS_DESCR COM_AXIS BMWchst_t_Eng_sw DchEpAd_DBCFgoa_Ckhahgc_q__aoa0 8 -327.68 327.67 AXIS_PTS_REF BMWchas_st_OpmBasLiOff_Ax FORMAT "%6.2" MONOTONY MON_INCREASE DEPOSIT ABSOLUTE /end AXIS_DESCR
/end CHARACTERISTIC
/begin CHARACTERISTIC BMWchas_tq_ResExhFlpClsd_T "Torque reserve above which the exhaust flap should be closed for acoustic reasons" CURVE 0x8073CEB4 _REC_A1CUR_1_MBSE_S2_S1 6553.5 BMW_dm_sw_q0p1_Nm -3276.8 3276.7 FORMAT "%6.1"
 /begin AXIS_DESCR COM_AXIS Nkw caoddzd_oAjpfzb_cAcEEha_1nR_oa0 8 -32768 32767 AXIS_PTS_REF BMWchas_tq_ResExhFlpClsd_Ax FORMAT "%5.0" MONOTONY STRICT_INCREASE DEPOSIT ABSOLUTE /end AXIS_DESCR
/end CHARACTERISTIC
/begin CHARACTERISTIC BMWgpfheat_tq_ResExhFlpClsd_T "Torque reserve above which the exhaust flap should be closed for acoustic reasons" CURVE 0x8071D8A2 _REC_A1CUR_1_MBSE_S2_S1 6553.5 BMW_dm_sw_q0p1_Nm -3276.8 3276.7 FORMAT "%6.1"
 /begin AXIS_DESCR COM_AXIS Nkw caoddzd_oAjpfzb_cAcEEha_1nR_oa0 8 -32768 32767 AXIS_PTS_REF BMWgpfheat_tq_ResExhFlpClsd_Ax FORMAT "%5.0" MONOTONY STRICT_INCREASE DEPOSIT ABSOLUTE /end AXIS_DESCR
/end CHARACTERISTIC
/begin CHARACTERISTIC BMWosc_n_Gb1Max_MT "Maximum reliable engine speed for gearbox protection in manual transmission" CURVE 0x8073A744 _REC_A1CUR_1_MBSE_S2_S1 65535 caoddzd_oAjpfzb_cAcEEha_1nR_oa0 -32768 32767 FORMAT "%5.0"
 /begin AXIS_DESCR COM_AXIS Gangi raChrxc_kBtBrmb_FmDuEFa_n__aa0o 10 0 255 AXIS_PTS_REF BMWosc_n_Gb1Max_Ax FORMAT "%3.0" MONOTONY STRICT_INCREASE DEPOSIT ABSOLUTE /end AXIS_DESCR
/end CHARACTERISTIC
/begin CHARACTERISTIC BMWosc_n_Gb1Max_T "Maximum reliable engine speed for gearbox protection" CURVE 0x8073A730 _REC_A1CUR_1_MBSE_S2_S1 65535 caoddzd_oAjpfzb_cAcEEha_1nR_oa0 -32768 32767 FORMAT "%5.0"
 /begin AXIS_DESCR COM_AXIS Gangi raChrxc_kBtBrmb_FmDuEFa_n__aa0o 10 0 255 AXIS_PTS_REF BMWosc_n_Gb1Max_Ax FORMAT "%3.0" MONOTONY STRICT_INCREASE DEPOSIT ABSOLUTE /end AXIS_DESCR
/end CHARACTERISTIC
/begin CHARACTERISTIC BMWshl_n_SpdMaxAt_T "Gear-dependent maximum RPM for automatic transmission shift light" CURVE 0x80751946 _REC_A1CUR_1_MBSE_S2_S1 65535 caoddzd_oAjpfzb_cAcEEha_1nR_oa0 -32768 32767
 /begin AXIS_DESCR COM_AXIS Gangi raChrxc_kBtBrmb_FmDuEFa_n__aa0o 8 0 255 AXIS_PTS_REF BMWshl_n_SpdMaxAt_Ax FORMAT "%3.0" MONOTONY STRICT_INCREASE DEPOSIT ABSOLUTE /end AXIS_DESCR
/end CHARACTERISTIC
/begin CHARACTERISTIC BMWshl_n_SpdMaxMt_T "Gear-dependent maximum RPM for manual transmission shift light" CURVE 0x8075193A _REC_A1CUR_1_MBSE_S2_S1 65535 caoddzd_oAjpfzb_cAcEEha_1nR_oa0 -32768 32767
 /begin AXIS_DESCR COM_AXIS Gangi raChrxc_kBtBrmb_FmDuEFa_n__aa0o 6 0 255 AXIS_PTS_REF BMWshl_n_SpdMaxMt_Ax FORMAT "%3.0" MONOTONY STRICT_INCREASE DEPOSIT ABSOLUTE /end AXIS_DESCR
/end CHARACTERISTIC
/begin CHARACTERISTIC BMWtchctr_fac_pwr_CompLimPctl_T "Feedforward factor up to which the controller can raise compressor power above feedforward using P and D components" CURVE 0x80747DFC _REC_A1CUR_1_MBSE_U2_S1 1.99996948242188 Bhvfwhc_bigEubd_BBEupBd_nR_3oa0 0 1.99996948242188 FORMAT "%11.4"
 /begin AXIS_DESCR COM_AXIS BMWtchsp_mf_CmprNorm_uw wpxDCba_sgbvDxb_FliBAmd_k__0oa0 6 0 4095.9375 AXIS_PTS_REF BMWtchctr_fac_pwr_CompLimPctl_Ax FORMAT "%10.3" MONOTONY STRICT_INCREASE DEPOSIT ABSOLUTE /end AXIS_DESCR
/end CHARACTERISTIC
/begin CHARACTERISTIC BMWtchctr_rat_p_ComprLimPctl_T "Minimum limit of target charge factor for aborting boost pressure control with decreasing target pressure" CURVE 0x80747DE4 _REC_A1CUR_1_MBSE_U2_S1 7.9998779296875 acriqBc_tfkBqod_ocgjxzc_nR_8oa0 0 7.9998779296875 FORMAT "%10.3"
 /begin AXIS_DESCR COM_AXIS BMWtchsp_mf_CmprNorm_uw wpxDCba_sgbvDxb_FliBAmd_k__0oa0 12 0 4095.9375 AXIS_PTS_REF BMWtchctr_rat_p_ComprLimPctl_Ax FORMAT "%10.3" MONOTONY STRICT_INCREASE DEPOSIT ABSOLUTE /end AXIS_DESCR
/end CHARACTERISTIC
/begin CHARACTERISTIC BMWtchob_fac_tq_Delt_T "Reduction factor for overboost torque via intake air temperature" CURVE 0x80727DB8 _REC_A1CUR_1_MBSE_U2_S1 0.999984741210938 FzbmlAa_gCtylrb_ckCqxAc_nR_6oa0 0 0.999984741210938 FORMAT "%6.4"
 /begin AXIS_DESCR COM_AXIS Tans BMW_q0p1_degC 4 -3276.8 3276.7 AXIS_PTS_REF BMWtchob_fac_tq_Delt_Ax FORMAT "%6.1" MONOTONY STRICT_INCREASE DEPOSIT ABSOLUTE /end AXIS_DESCR
/end CHARACTERISTIC
/begin CHARACTERISTIC BMWtchsp_fac_FilPRatCmpr_T "Filter constant for target pressure ratio" CURVE 0x80728460 _REC_A1CUR_1_MBSE_U2_S1 0.999984741210938 FzbmlAa_gCtylrb_ckCqxAc_nR_6oa0 0 0.999984741210938 FORMAT "%14.5"
 /begin AXIS_DESCR COM_AXIS BMWtchsp_mf_CmprNorm_uw wpxDCba_sgbvDxb_FliBAmd_k__0oa0 4 0 4095.9375 AXIS_PTS_REF BMWtchsp_fac_FilPRatCmpr_Ax FORMAT "%10.3" MONOTONY STRICT_INCREASE DEPOSIT ABSOLUTE /end AXIS_DESCR
/end CHARACTERISTIC
/begin CHARACTERISTIC BMWtchsp_fac_mf_FilCmprNorm_T "Filter constant for corrected target mass flow" CURVE 0x80728586 _REC_A1CUR_1_MBSE_U2_S1 0.999984741210938 FzbmlAa_gCtylrb_ckCqxAc_nR_6oa0 0 0.999984741210938 FORMAT "%14.5"
 /begin AXIS_DESCR COM_AXIS NO_INPUT_QUANTITY wpxDCba_sgbvDxb_FliBAmd_k__0oa0 4 0 4095.9375 AXIS_PTS_REF BMWtchsp_fac_mf_FilCmprNorm_Ax FORMAT "%10.3" MONOTONY STRICT_INCREASE DEPOSIT ABSOLUTE /end AXIS_DESCR
/end CHARACTERISTIC
/begin CHARACTERISTIC BMWtchsp_rat_p_CmprMaxTMax_T "Maximum boost ratio to maintain the maximum compressor outlet temperature. Physical conversion: output = input ^ (k / (k-1))" CURVE 0x80728430 _REC_A1CUR_1_MBSE_U2_S1 3.99993896484375 ilxsavd_hkzmBfc_lAzCpAb_nR_1oa0 0 3.99993896484375
 /begin AXIS_DESCR COM_AXIS NO_INPUT_QUANTITY epDxoEa_vnwexaa_kAzmuka_q__14a0 8 0 3.99993896484375 AXIS_PTS_REF BMWtchsp_rat_p_CmprMaxTMax_Ax MONOTONY STRICT_INCREASE DEPOSIT ABSOLUTE /end AXIS_DESCR
/end CHARACTERISTIC
/begin CHARACTERISTIC BMWtchsp_rat_p_CmprPmp_T "KL_FPLDPUMP" CURVE 0x80728420 _REC_A1CUR_1_MBSE_U2_S1 3.99993896484375 ilxsavd_hkzmBfc_lAzCpAb_nR_1oa0 0 3.99993896484375
 /begin AXIS_DESCR COM_AXIS BMWtchsp_mf_CmprNorm_uw wpxDCba_sgbvDxb_FliBAmd_k__0oa0 8 0 4095.9375 AXIS_PTS_REF BMWtchsp_rat_p_CmprPmp_Ax FORMAT "%10.3" MONOTONY STRICT_INCREASE DEPOSIT ABSOLUTE /end AXIS_DESCR
/end CHARACTERISTIC
/begin CHARACTERISTIC BMWtqe_b_Clu4NoiseDeac_T "Torque engine clutch noise deactivation curve" CURVE 0x80759733 _REC_A1CUR_1_MBSE_U1_S1 1 fgjpsvb_fDqjECa_acgrbDd_n_dae__ 0 1
 /begin AXIS_DESCR COM_AXIS Status_usecase_antr raChrxc_kBtBrmb_FmDuEFa_n__aa0o 12 0 11 AXIS_PTS_REF BMWtqe_st_SptDet4NoiseAcvn_Ax FORMAT "%6.0" MONOTONY STRICT_INCREASE DEPOSIT ABSOLUTE /end AXIS_DESCR
/end CHARACTERISTIC
/begin CHARACTERISTIC BMWtqe_n_EngLhModEngDynSp_T "Upper Nmax limit depending on BMW_mod_EngDynSp" CURVE 0x8074AEEE _REC_A1CUR_1_MBSE_S2_S1 65535 caoddzd_oAjpfzb_cAcEEha_1nR_oa0 -32768 32767 FORMAT "%5.0"
 /begin AXIS_DESCR COM_AXIS BMW_mod_EngDynSp raChrxc_kBtBrmb_FmDuEFa_n__aa0o 8 0 255 AXIS_PTS_REF BMWtqe_n_EngLhModEngDynSp_Ax MONOTONY STRICT_INCREASE DEPOSIT ABSOLUTE /end AXIS_DESCR
/end CHARACTERISTIC
/begin CHARACTERISTIC BMWtqe_n_NMaxEngTqLimdAt_T "N_vm_max limitation depending on torque limitation for an automatic transmission" CURVE 0x8074AF14 _REC_A1CUR_1_MBSE_S2_S1 65535 caoddzd_oAjpfzb_cAcEEha_1nR_oa0 -32768 32767 FORMAT "%6.0"
 /begin AXIS_DESCR COM_AXIS BMWtqe_fac_EngTqLimd BMW_Powertrain_DxECompuMethods_Def_ub_b1_nounit 5 0 0.99609375 AXIS_PTS_REF BMWtqe_n_NMaxEngTqLimd_Ax MONOTONY STRICT_INCREASE DEPOSIT ABSOLUTE /end AXIS_DESCR
/end CHARACTERISTIC
/begin CHARACTERISTIC BMWtqe_n_NMaxEngTqLimdDct_T "N_vm_max limitation depending on torque limitation for a dual-clutch transmission (DCT)" CURVE 0x8074AF0A _REC_A1CUR_1_MBSE_S2_S1 65535 caoddzd_oAjpfzb_cAcEEha_1nR_oa0 -32768 32767 FORMAT "%6.0"
 /begin AXIS_DESCR COM_AXIS BMWtqe_fac_EngTqLimd BMW_Powertrain_DxECompuMethods_Def_ub_b1_nounit 5 0 0.99609375 AXIS_PTS_REF BMWtqe_n_NMaxEngTqLimd_Ax MONOTONY STRICT_INCREASE DEPOSIT ABSOLUTE /end AXIS_DESCR
/end CHARACTERISTIC
/begin CHARACTERISTIC BMWtqe_n_NMaxEngTqLimdMt_T "N_vm_max limitation depending on torque limitation for a manual transmission" CURVE 0x8074AF00 _REC_A1CUR_1_MBSE_S2_S1 65535 caoddzd_oAjpfzb_cAcEEha_1nR_oa0 -32768 32767 FORMAT "%6.0"
 /begin AXIS_DESCR COM_AXIS BMWtqe_fac_EngTqLimd BMW_Powertrain_DxECompuMethods_Def_ub_b1_nounit 5 0 0.99609375 AXIS_PTS_REF BMWtqe_n_NMaxEngTqLimd_Ax MONOTONY STRICT_INCREASE DEPOSIT ABSOLUTE /end AXIS_DESCR
/end CHARACTERISTIC
/begin CHARACTERISTIC EngPrt_nMax_CUR "Maximum permissible engine speed (steady-state)" CURVE 0x807A5F16 RB_Curve_S8_U16_Static 16383.75 nmot_sw_q0p25 0 16383.75 FORMAT "%8.2"
 /begin AXIS_DESCR STD_AXIS EngPrt_NMAXSgangsis_mp DEZ 11 -128 127 FORMAT "%5.1" DEPOSIT ABSOLUTE /end AXIS_DESCR
/end CHARACTERISTIC
/begin CHARACTERISTIC FlexFuelBlendFactor___Boost_Slot_0___MGF_CC "Flex Fuel blending factor for Boost_Slot_0" CURVE 0x807D8606 FklWUb 0 FlexFuelEthanolContentValue_CompuMethod 0 0 MATRIX_DIM 21 1 1
 /begin AXIS_DESCR COM_AXIS FlexFuelEthanolContentValue___MGF_CC FlexFuelEthanolContentValue_CompuMethod 21 0 0 AXIS_PTS_REF BlendFactorAxis___MGF_CC DEPOSIT ABSOLUTE /end AXIS_DESCR
/end CHARACTERISTIC
/begin CHARACTERISTIC FlexFuelBlendFactor___FuelCorrection_Slot_0___MGF_CC "Flex Fuel blending factor for FuelCorrection_Slot_0" CURVE 0x807D866F FklWUb 0 FlexFuelEthanolContentValue_CompuMethod 0 0 MATRIX_DIM 21 1 1
 /begin AXIS_DESCR COM_AXIS FlexFuelEthanolContentValue___MGF_CC FlexFuelEthanolContentValue_CompuMethod 21 0 0 AXIS_PTS_REF BlendFactorAxis___MGF_CC DEPOSIT ABSOLUTE /end AXIS_DESCR
/end CHARACTERISTIC
/begin CHARACTERISTIC FlexFuelBlendFactor___FuelTargets_Slot_0___MGF_CC "Flex Fuel blending factor for FuelTargets_Slot_0" CURVE 0x807D86D8 FklWUb 0 FlexFuelEthanolContentValue_CompuMethod 0 0 MATRIX_DIM 21 1 1
 /begin AXIS_DESCR COM_AXIS FlexFuelEthanolContentValue___MGF_CC FlexFuelEthanolContentValue_CompuMethod 21 0 0 AXIS_PTS_REF BlendFactorAxis___MGF_CC DEPOSIT ABSOLUTE /end AXIS_DESCR
/end CHARACTERISTIC
/begin CHARACTERISTIC FlexFuelBlendFactor___Ignition_Slot_0___MGF_CC "Flex Fuel blending factor for Ignition_Slot_0" CURVE 0x807D8741 FklWUb 0 FlexFuelEthanolContentValue_CompuMethod 0 0 MATRIX_DIM 21 1 1
 /begin AXIS_DESCR COM_AXIS FlexFuelEthanolContentValue___MGF_CC FlexFuelEthanolContentValue_CompuMethod 21 0 0 AXIS_PTS_REF BlendFactorAxis___MGF_CC DEPOSIT ABSOLUTE /end AXIS_DESCR
/end CHARACTERISTIC
/begin CHARACTERISTIC FlexFuelBlendFactor___Knock_Slot_0___MGF_CC "Flex Fuel blending factor for Knock_Slot_0" CURVE 0x807D87AA FklWUb 0 FlexFuelEthanolContentValue_CompuMethod 0 0 MATRIX_DIM 21 1 1
 /begin AXIS_DESCR COM_AXIS FlexFuelEthanolContentValue___MGF_CC FlexFuelEthanolContentValue_CompuMethod 21 0 0 AXIS_PTS_REF BlendFactorAxis___MGF_CC DEPOSIT ABSOLUTE /end AXIS_DESCR
/end CHARACTERISTIC
/begin CHARACTERISTIC FlexFuelBlendFactor___LoadControl_Slot_0___MGF_CC "Flex Fuel blending factor for LoadControl_Slot_0" CURVE 0x807D8813 FklWUb 0 FlexFuelEthanolContentValue_CompuMethod 0 0 MATRIX_DIM 21 1 1
 /begin AXIS_DESCR COM_AXIS FlexFuelEthanolContentValue___MGF_CC FlexFuelEthanolContentValue_CompuMethod 21 0 0 AXIS_PTS_REF BlendFactorAxis___MGF_CC DEPOSIT ABSOLUTE /end AXIS_DESCR
/end CHARACTERISTIC
/begin CHARACTERISTIC FlexFuelBlendFactor___WastegateControl_Slot_0___MGF_CC "Flex Fuel blending factor for WastegateControl_Slot_0" CURVE 0x807D887C FklWUb 0 FlexFuelEthanolContentValue_CompuMethod 0 0 MATRIX_DIM 21 1 1
 /begin AXIS_DESCR COM_AXIS FlexFuelEthanolContentValue___MGF_CC FlexFuelEthanolContentValue_CompuMethod 21 0 0 AXIS_PTS_REF BlendFactorAxis___MGF_CC DEPOSIT ABSOLUTE /end AXIS_DESCR
/end CHARACTERISTIC
/begin CHARACTERISTIC KL_FK_TUMG_OPF "Factor for adjusting OPF regeneration fan request depending on ambient temperature" CURVE 0x80761D36 _REC_A1CUR_1_MBSE_U1_S1 5.1 Asyaixa_wdvtenb_FCefaCb_n__aa0o 0 5.1
 /begin AXIS_DESCR COM_AXIS Tumg_wm BMW_q0p1_degC 10 -3276.8 3276.7 AXIS_PTS_REF AXX_KL_FK_TUMG_OPF MONOTONY STRICT_INCREASE DEPOSIT ABSOLUTE /end AXIS_DESCR
/end CHARACTERISTIC
/begin CHARACTERISTIC KL_FLD_KKS "Request for switching the intake manifold flap depending on the filtered average throttle pressure" CURVE 0x80761F89 _REC_A1CUR_1_MBSE_U1_S1 10 raChrxc_kBtBrmb_FmDuEFa_n__aa0o 0 10
 /begin AXIS_DESCR COM_AXIS F_pld_wm_f acriqBc_tfkBqod_ocgjxzc_nR_8oa0 6 0 7.9998779296875 AXIS_PTS_REF AXX_KL_FLD_KKS MONOTONY STRICT_INCREASE DEPOSIT ABSOLUTE /end AXIS_DESCR
/end CHARACTERISTIC
/begin CHARACTERISTIC KL_NEL_I "Weighting factor for accumulated coolant difference" CURVE 0x8074B6B2 _REC_A1CUR_1_MBSE_S2_S1 655.35 lCylrsa_tioqzad_Csrxmdd_f__o0a0 -327.68 327.67 FORMAT "%6.2"
 /begin AXIS_DESCR COM_AXIS Dtmot_tkwsoll_elue DchEpAd_DBCFgoa_Ckhahgc_q__aoa0 4 -327.68 327.67 AXIS_PTS_REF AXX_KL_NEL_I MONOTONY STRICT_INCREASE DEPOSIT ABSOLUTE /end AXIS_DESCR
/end CHARACTERISTIC
/begin CHARACTERISTIC KL_NEL_KLIMA_MX "Maximum electric fan speed request from air conditioning depending on ambient temperature" CURVE 0x80761B4D _REC_A1CUR_1_MBSE_U1_S1 99.609375 BMW_q0p3906_PERC 0 99.609375
 /begin AXIS_DESCR COM_AXIS Tumg_wm BMW_q0p1_degC 4 -3276.8 3276.7 AXIS_PTS_REF AXX_KL_NEL_KLIMA_MX MONOTONY STRICT_INCREASE DEPOSIT ABSOLUTE /end AXIS_DESCR
/end CHARACTERISTIC
/begin CHARACTERISTIC KL_NEL_SPL "Electric fan speed request to support engine compartment purging" CURVE 0x80761D7A _REC_A1CUR_1_MBSE_U1_S1 99.609375 BMW_q0p3906_PERC 0 99.609375
 /begin AXIS_DESCR COM_AXIS V_wm BMW_q0p1_kilometer_per_hour 4 0 6553.5 AXIS_PTS_REF AXX_KL_NEL_SPL MONOTONY STRICT_INCREASE DEPOSIT ABSOLUTE /end AXIS_DESCR
/end CHARACTERISTIC
/begin CHARACTERISTIC KL_NEL_TABG_TUMG "Factor for adjusting electric fan speed based on exhaust gas temperature" CURVE 0x80761D44 _REC_A1CUR_1_MBSE_U1_S1 0.99609375 BMW_Powertrain_DxECompuMethods_Def_ub_b1_nounit 0 0.99609375 FORMAT "%6.4"
 /begin AXIS_DESCR COM_AXIS Tumg_wm BMW_q0p1_degC 4 -3276.8 3276.7 AXIS_PTS_REF AXX_KL_NEL_TABG_TUMG MONOTONY STRICT_INCREASE DEPOSIT ABSOLUTE /end AXIS_DESCR
/end CHARACTERISTIC
/begin CHARACTERISTIC KL_NEL_TANS_KLOPF "Electric fan speed request due to intake air temperature from knock detection" CURVE 0x80761D76 _REC_A1CUR_1_MBSE_U1_S1 99.609375 BMW_q0p3906_PERC 0 99.609375
 /begin AXIS_DESCR COM_AXIS Dtans_tumg_wm BMW_q0p1_degC 4 -3276.8 3276.7 AXIS_PTS_REF AXX_KL_NEL_TANS_KLOPF FORMAT "%6.1" MONOTONY STRICT_INCREASE DEPOSIT ABSOLUTE /end AXIS_DESCR
/end CHARACTERISTIC
/begin CHARACTERISTIC KL_NEL_TDME "Electric fan speed request due to DME temperature" CURVE 0x80761D72 _REC_A1CUR_1_MBSE_U1_S1 99.609375 BMW_q0p3906_PERC 0 99.609375
 /begin AXIS_DESCR COM_AXIS Tdme_wm DchEpAd_DBCFgoa_Ckhahgc_q__aoa0 4 -327.68 327.67 AXIS_PTS_REF AXX_KL_NEL_TDME FORMAT "%6.2" MONOTONY STRICT_INCREASE DEPOSIT ABSOLUTE /end AXIS_DESCR
/end CHARACTERISTIC
/begin CHARACTERISTIC KL_NEL_TEGS "Electric fan speed request due to EGS temperature" CURVE 0x80761D6E _REC_A1CUR_1_MBSE_U1_S1 99.609375 BMW_q0p3906_PERC 0 99.609375
 /begin AXIS_DESCR COM_AXIS Tegs_wm BufnDdb_jpjgsgc_jmDugsa_qCRoa0o 4 -32768 32767 AXIS_PTS_REF AXX_KL_NEL_TEGS FORMAT "%6.0" MONOTONY STRICT_INCREASE DEPOSIT ABSOLUTE /end AXIS_DESCR
/end CHARACTERISTIC
/begin CHARACTERISTIC KL_NEL_TKA "Electric fan speed request depending on coolant radiator outlet temperature" CURVE 0x80761D68 _REC_A1CUR_1_MBSE_U1_S1 99.609375 BMW_q0p3906_PERC 0 99.609375
 /begin AXIS_DESCR COM_AXIS Tka_wm DchEpAd_DBCFgoa_Ckhahgc_q__aoa0 6 -327.68 327.67 AXIS_PTS_REF AXX_KL_NEL_TKA FORMAT "%6.2" MONOTONY STRICT_INCREASE DEPOSIT ABSOLUTE /end AXIS_DESCR
/end CHARACTERISTIC
/begin CHARACTERISTIC KL_NEL_TMOT "Electric fan speed request due to engine temperature" CURVE 0x80761D5C _REC_A1CUR_1_MBSE_U1_S1 99.609375 BMW_q0p3906_PERC 0 99.609375
 /begin AXIS_DESCR COM_AXIS Dtmot_tkwsoll_f DchEpAd_DBCFgoa_Ckhahgc_q__aoa0 12 -327.68 327.67 AXIS_PTS_REF AXX_KL_NEL_TMOT FORMAT "%6.2" MONOTONY STRICT_INCREASE DEPOSIT ABSOLUTE /end AXIS_DESCR
/end CHARACTERISTIC
/begin CHARACTERISTIC KL_NEL_V_MX "Maximum electric fan speed request from integrated coolant difference depending on vehicle speed" CURVE 0x80761D48 _REC_A1CUR_1_MBSE_U1_S1 99.609375 BMW_q0p3906_PERC 0 99.609375
 /begin AXIS_DESCR COM_AXIS V_wm BMW_q0p1_kilometer_per_hour 4 0 6553.5 AXIS_PTS_REF AXX_KL_NEL_V_MX FORMAT "%6.1" MONOTONY STRICT_INCREASE DEPOSIT ABSOLUTE /end AXIS_DESCR
/end CHARACTERISTIC
/begin CHARACTERISTIC KL_NEL_VSKR_TUMG "Factor for adjusting E-fan speed based on fuel consumption" CURVE 0x80761D40 _REC_A1CUR_1_MBSE_U1_S1 0.99609375 BMW_Powertrain_DxECompuMethods_Def_ub_b1_nounit 0 0.99609375 FORMAT "%6.4"
 /begin AXIS_DESCR COM_AXIS Tumg_wm BMW_q0p1_degC 4 -3276.8 3276.7 AXIS_PTS_REF AXX_KL_NEL_VSKR_TUMG MONOTONY STRICT_INCREASE DEPOSIT ABSOLUTE /end AXIS_DESCR
/end CHARACTERISTIC
/begin CHARACTERISTIC KL_NEWP_KLIMA_MX "Maximum permissible EWP speed request from air conditioning depending on ambient temperature" CURVE 0x80761B51 _REC_A1CUR_1_MBSE_U1_S1 100 nnxvdDd_vDnjvqd_FmDuEEa_f__aa0o 0 100
 /begin AXIS_DESCR COM_AXIS Tumg_wm BMW_q0p1_degC 4 -3276.8 3276.7 AXIS_PTS_REF AXX_KL_NEWP_KLIMA_MX MONOTONY STRICT_INCREASE DEPOSIT ABSOLUTE /end AXIS_DESCR
/end CHARACTERISTIC
/begin CHARACTERISTIC KL_NKW_SOUND_MN "Min. RPM threshold for activation of BMWtqe_b_NoisePre_bo depending on gear" CURVE 0x8072E79A _REC_A1CUR_1_MBSE_S2_S1 65535 caoddzd_oAjpfzb_cAcEEha_1nR_oa0 -32768 32767
 /begin AXIS_DESCR COM_AXIS Gangi raChrxc_kBtBrmb_FmDuEFa_n__aa0o 8 0 255 AXIS_PTS_REF AXX_KL_NKW_SOUND_MNMX FORMAT "%3.0" MONOTONY STRICT_INCREASE DEPOSIT ABSOLUTE /end AXIS_DESCR
/end CHARACTERISTIC
/begin CHARACTERISTIC KL_NKW_SOUND_MX "Max. RPM threshold for activation of BMWtqe_b_NoisePre_bo depending on gear" CURVE 0x8072E78A _REC_A1CUR_1_MBSE_S2_S1 65535 caoddzd_oAjpfzb_cAcEEha_1nR_oa0 -32768 32767
 /begin AXIS_DESCR COM_AXIS Gangi raChrxc_kBtBrmb_FmDuEFa_n__aa0o 8 0 255 AXIS_PTS_REF AXX_KL_NKW_SOUND_MNMX FORMAT "%3.0" MONOTONY STRICT_INCREASE DEPOSIT ABSOLUTE /end AXIS_DESCR
/end CHARACTERISTIC
/begin CHARACTERISTIC KL_PSPVDK_SOLMAXGD "Maximum target pressure ratio across throttle; speed-dependent with intercooler behind throttle" CURVE 0x8071F57A _REC_A1CUR_1_MBSE_U2_S1 3.99993896484375 ilxsavd_hkzmBfc_lAzCpAb_nR_1oa0 0 3.99993896484375 FORMAT "%7.4"
 /begin AXIS_DESCR COM_AXIS NO_INPUT_QUANTITY caoddzd_oAjpfzb_cAcEEha_1nR_oa0 6 0 32767 AXIS_PTS_REF AXX_KL_PSPVDK_SOLMAXGD FORMAT "%5.0" MONOTONY STRICT_INCREASE DEPOSIT ABSOLUTE /end AXIS_DESCR
/end CHARACTERISTIC
/begin CHARACTERISTIC KL_RF_MAX___MGF_CC_FF1_Slot0 "Curve maximum permissible filling over engine speed (Slot 0, Flex Fuel 1)" CURVE 0x807CBB6E _REC_A1CUR_1_MBSE_S2_S1 655.35 CgkBooc_wkiDfEd_Czglhgc_fR_1a0o -327.68 327.67 FORMAT "%7.2"
 /begin AXIS_DESCR COM_AXIS NO_INPUT_QUANTITY caoddzd_oAjpfzb_cAcEEha_1nR_oa0 12 -32768 32767 AXIS_PTS_REF AXX_KL_RF_MAX FORMAT "%5.0" MONOTONY MON_INCREASE DEPOSIT ABSOLUTE /end AXIS_DESCR
/end CHARACTERISTIC
/begin CHARACTERISTIC KL_RF_MAX_FlexFuelSensorFailure___MGF_CC_PF "Fallback [KL_RF_MAX] when flex fuel ethanol sensor fails" CURVE 0x807CFF16 _REC_A1CUR_1_MBSE_S2_S1 655.35 CgkBooc_wkiDfEd_Czglhgc_fR_1a0o -327.68 327.67 FORMAT "%7.2"
 /begin AXIS_DESCR COM_AXIS NO_INPUT_QUANTITY caoddzd_oAjpfzb_cAcEEha_1nR_oa0 12 -32768 32767 AXIS_PTS_REF AXX_KL_RF_MAX FORMAT "%5.0" MONOTONY MON_INCREASE DEPOSIT ABSOLUTE /end AXIS_DESCR
/end CHARACTERISTIC
/begin CHARACTERISTIC KL_RF_MAX_UESP___MGF_CC_FF1_Slot0 "Curve maximum permissible filling over engine speed during scavenging (Slot 0, Flex Fuel 1)" CURVE 0x807CBBE6 _REC_A1CUR_1_MBSE_S2_S1 655.35 CgkBooc_wkiDfEd_Czglhgc_fR_1a0o -327.68 327.67 FORMAT "%7.2"
 /begin AXIS_DESCR COM_AXIS NO_INPUT_QUANTITY caoddzd_oAjpfzb_cAcEEha_1nR_oa0 12 -32768 32767 AXIS_PTS_REF AXX_KL_RF_MAX_UESP FORMAT "%5.0" MONOTONY MON_INCREASE DEPOSIT ABSOLUTE /end AXIS_DESCR
/end CHARACTERISTIC
/begin CHARACTERISTIC KL_RF_MAX_UESP_FlexFuelSensorFailure___MGF_CC_PF "Fallback [KL_RF_MAX_UESP] when flex fuel ethanol sensor fails" CURVE 0x807CFF2E _REC_A1CUR_1_MBSE_S2_S1 655.35 CgkBooc_wkiDfEd_Czglhgc_fR_1a0o -327.68 327.67 FORMAT "%7.2"
 /begin AXIS_DESCR COM_AXIS NO_INPUT_QUANTITY caoddzd_oAjpfzb_cAcEEha_1nR_oa0 12 -32768 32767 AXIS_PTS_REF AXX_KL_RF_MAX_UESP FORMAT "%5.0" MONOTONY MON_INCREASE DEPOSIT ABSOLUTE /end AXIS_DESCR
/end CHARACTERISTIC
/begin CHARACTERISTIC KL_RFTNLMX "Maximum nonlinear Drf for calculation of Ps_soll_sm_nl" CURVE 0x8071FA2C _REC_A1CUR_1_MBSE_S2_S1 327.67 CgkBooc_wkiDfEd_Czglhgc_fR_1a0o 0 327.67 FORMAT "%7.2"
 /begin AXIS_DESCR COM_AXIS NO_INPUT_QUANTITY caoddzd_oAjpfzb_cAcEEha_1nR_oa0 10 0 32767 AXIS_PTS_REF AXX_KL_RFTNLMX FORMAT "%5.0" MONOTONY MON_INCREASE DEPOSIT ABSOLUTE /end AXIS_DESCR
/end CHARACTERISTIC
/begin CHARACTERISTIC KL_T_IKAT_SOUND_MX "Temperaturschwelle Kat fürSchubblubberfreigabe " CURVE 0x8072E782 _REC_A1CUR_1_MBSE_S2_S1 6553.5 BMW_q0p1_degC -3276.8 3276.7
 /begin AXIS_DESCR COM_AXIS Anz_b_sound raChrxc_kBtBrmb_FmDuEFa_n__aa0o 4 0 255 AXIS_PTS_REF AXX_KL_T_IKAT_SOUND_MX FORMAT "%5.0" MONOTONY STRICT_INCREASE DEPOSIT ABSOLUTE /end AXIS_DESCR
/end CHARACTERISTIC
/begin CHARACTERISTIC KL_TD_SOUND_MX "KL_TD_SOUND_MX" CURVE 0x8072E814 _REC_A1CUR_1_MBSE_U2_S1 655.35 camcxxd_bxlpdsa_Cshlhgc_sR_1a0o 0 655.35
 /begin AXIS_DESCR COM_AXIS V_fzg_plaus jgbhAma_smpAegb_hlEBAmd_k__0oa0 4 -655.36 655.34 AXIS_PTS_REF AXX_KL_TD_SOUND_MX FORMAT "%6.2" MONOTONY STRICT_INCREASE DEPOSIT ABSOLUTE /end AXIS_DESCR
/end CHARACTERISTIC
/begin CHARACTERISTIC KL_TD_SOUND_MX_FREI "Sound duration freely configurable" CURVE 0x8072E80C _REC_A1CUR_1_MBSE_U2_S1 655.35 camcxxd_bxlpdsa_Cshlhgc_sR_1a0o 0 655.35
 /begin AXIS_DESCR COM_AXIS V_fzg_plaus jgbhAma_smpAegb_hlEBAmd_k__0oa0 4 -655.36 655.34 AXIS_PTS_REF AXX_KL_TD_SOUND_MX_FREI FORMAT "%6.2" MONOTONY STRICT_INCREASE DEPOSIT ABSOLUTE /end AXIS_DESCR
/end CHARACTERISTIC
/begin CHARACTERISTIC KL_TD_SOUND_MX_SPORT "KL_TD_SOUND_MX_SPORT" CURVE 0x8072E804 _REC_A1CUR_1_MBSE_U2_S1 655.35 camcxxd_bxlpdsa_Cshlhgc_sR_1a0o 0 655.35
 /begin AXIS_DESCR COM_AXIS V_fzg_plaus jgbhAma_smpAegb_hlEBAmd_k__0oa0 4 -655.36 655.34 AXIS_PTS_REF AXX_KL_TD_SOUND_MX_SPORT FORMAT "%6.2" MONOTONY STRICT_INCREASE DEPOSIT ABSOLUTE /end AXIS_DESCR
/end CHARACTERISTIC
/begin CHARACTERISTIC KL_TKW_HI "Coolant target temperature in high operating mode depending on ambient temperature" CURVE 0x807373A6 _REC_A1CUR_1_MBSE_S2_S1 655.35 DchEpAd_DBCFgoa_Ckhahgc_q__aoa0 -327.68 327.67
 /begin AXIS_DESCR COM_AXIS Tumg_wm BMW_q0p1_degC 4 -3276.8 3276.7 AXIS_PTS_REF AXX_KL_TKW_HI MONOTONY STRICT_INCREASE DEPOSIT ABSOLUTE /end AXIS_DESCR
/end CHARACTERISTIC
/begin CHARACTERISTIC KL_TKW_NO "Coolant target temperature in normal operating mode depending on ambient temperature" CURVE 0x8073739E _REC_A1CUR_1_MBSE_S2_S1 655.35 DchEpAd_DBCFgoa_Ckhahgc_q__aoa0 -327.68 327.67
 /begin AXIS_DESCR COM_AXIS Tumg_wm BMW_q0p1_degC 4 -3276.8 3276.7 AXIS_PTS_REF AXX_KL_TKW_NO MONOTONY STRICT_INCREASE DEPOSIT ABSOLUTE /end AXIS_DESCR
/end CHARACTERISTIC
/begin CHARACTERISTIC NMAXTMM "RPM limiter at high engine temperature" CURVE 0x807A5F42 KlAUbSstUbWUw_Static 16383.75 nmot_sw_q0p25 0 16383.75 FORMAT "%8.2"
 /begin AXIS_DESCR STD_AXIS EngPrt_t1_mp temp_ub_q0p75_o48 4 -48 143.3 FORMAT "%5.1" DEPOSIT ABSOLUTE /end AXIS_DESCR
/end CHARACTERISTIC
/begin CHARACTERISTIC NMAXTO "RPM limiter at high oil temperature" CURVE 0x807A5F50 KlAxU8SstxU16WU16 16383.75 nmot_sw_q0p25 0 16383.75 FORMAT "%8.2"
 /begin AXIS_DESCR STD_AXIS EngPrt_t2_mp temp_q0p0234_o273 4 -273.15 1262.827 FORMAT "%8.3" DEPOSIT ABSOLUTE /end AXIS_DESCR
/end CHARACTERISTIC
/begin CHARACTERISTIC AKRGRCC "Map for exhaust flap control depending on current gear and engine speed, with closed convertible top" MAP 0x8078F5DE Map_Xs16Ys16Ws16 400 ___MGF_CC_Pedal_x100_d256 -200 200 FORMAT "%8.4"
 /begin AXIS_DESCR STD_AXIS gangakr DEZ 10 0 127 FORMAT "%8.4" DEPOSIT ABSOLUTE /end AXIS_DESCR
 /begin AXIS_DESCR STD_AXIS Epm_nEngLRes nmot_q40 12 0 10200 FORMAT "%8.2" DEPOSIT ABSOLUTE /end AXIS_DESCR
/end CHARACTERISTIC
/begin CHARACTERISTIC AKRGRCC_VAR1 "Map for exhaust flap control depending on current gear and engine speed, with closed convertible top and sport button active" MAP 0x8078FFB6 Map_Xs16Ys16Ws16 400 ___MGF_CC_Pedal_x100_d256 -200 200 FORMAT "%8.4"
 /begin AXIS_DESCR STD_AXIS gangakr DEZ 6 0 127 FORMAT "%8.4" DEPOSIT ABSOLUTE /end AXIS_DESCR
 /begin AXIS_DESCR STD_AXIS Epm_nEngLRes nmot_q40 8 0 10200 FORMAT "%8.2" DEPOSIT ABSOLUTE /end AXIS_DESCR
/end CHARACTERISTIC
/begin CHARACTERISTIC AKRGRCC_VAR2 "Map for exhaust flap control depending on current gear and engine speed, with closed convertible top and sport button active" MAP 0x80790036 Map_Xs16Ys16Ws16 400 ___MGF_CC_Pedal_x100_d256 -200 200 FORMAT "%8.4"
 /begin AXIS_DESCR STD_AXIS gangakr DEZ 6 0 127 FORMAT "%8.4" DEPOSIT ABSOLUTE /end AXIS_DESCR
 /begin AXIS_DESCR STD_AXIS Epm_nEngLRes nmot_q40 8 0 10200 FORMAT "%8.2" DEPOSIT ABSOLUTE /end AXIS_DESCR
/end CHARACTERISTIC
/begin CHARACTERISTIC AKRGRCC_VAR3 "Map for exhaust flap control depending on current gear and engine speed, with closed convertible top and sport button active" MAP 0x807900B6 Map_Xs16Ys16Ws16 400 ___MGF_CC_Pedal_x100_d256 -200 200 FORMAT "%8.4"
 /begin AXIS_DESCR STD_AXIS gangakr DEZ 6 0 127 FORMAT "%8.4" DEPOSIT ABSOLUTE /end AXIS_DESCR
 /begin AXIS_DESCR STD_AXIS Epm_nEngLRes nmot_q40 8 0 10200 FORMAT "%8.2" DEPOSIT ABSOLUTE /end AXIS_DESCR
/end CHARACTERISTIC
/begin CHARACTERISTIC AKRGRCCAT "Map for exhaust flap control depending on current gear and engine speed (DCT or AT gearbox), with closed convertible top" MAP 0x8078F6FE Map_Xs16Ys16Ws16 400 ___MGF_CC_Pedal_x100_d256 -200 200 FORMAT "%8.4"
 /begin AXIS_DESCR STD_AXIS gangakr DEZ 10 0 127 FORMAT "%8.4" DEPOSIT ABSOLUTE /end AXIS_DESCR
 /begin AXIS_DESCR STD_AXIS Epm_nEngLRes nmot_q40 12 0 10200 FORMAT "%8.2" DEPOSIT ABSOLUTE /end AXIS_DESCR
/end CHARACTERISTIC
/begin CHARACTERISTIC AKRGRCCAT_VAR1 "Map for exhaust flap control depending on current gear and engine speed (DCT or AT gearbox), with closed convertible top" MAP 0x8078FB2A Map_Xs16Ys16Ws16 400 ___MGF_CC_Pedal_x100_d256 -200 200 FORMAT "%8.4"
 /begin AXIS_DESCR STD_AXIS gangakr DEZ 8 0 127 FORMAT "%8.4" DEPOSIT ABSOLUTE /end AXIS_DESCR
 /begin AXIS_DESCR STD_AXIS Epm_nEngLRes nmot_q40 8 0 10200 FORMAT "%8.2" DEPOSIT ABSOLUTE /end AXIS_DESCR
/end CHARACTERISTIC
/begin CHARACTERISTIC AKRGRCCAT_VAR2 "Map for exhaust flap control depending on current gear and engine speed (DCT or AT gearbox), with closed convertible top" MAP 0x8078FBCE Map_Xs16Ys16Ws16 400 ___MGF_CC_Pedal_x100_d256 -200 200 FORMAT "%8.4"
 /begin AXIS_DESCR STD_AXIS gangakr DEZ 8 0 127 FORMAT "%8.4" DEPOSIT ABSOLUTE /end AXIS_DESCR
 /begin AXIS_DESCR STD_AXIS Epm_nEngLRes nmot_q40 8 0 10200 FORMAT "%8.2" DEPOSIT ABSOLUTE /end AXIS_DESCR
/end CHARACTERISTIC
/begin CHARACTERISTIC AKRGRCCAT_VAR3 "Map for exhaust flap control depending on current gear and engine speed (DCT or AT gearbox), with closed convertible top" MAP 0x8078FC72 Map_Xs16Ys16Ws16 400 ___MGF_CC_Pedal_x100_d256 -200 200 FORMAT "%8.4"
 /begin AXIS_DESCR STD_AXIS gangakr DEZ 8 0 127 FORMAT "%8.4" DEPOSIT ABSOLUTE /end AXIS_DESCR
 /begin AXIS_DESCR STD_AXIS Epm_nEngLRes nmot_q40 8 0 10200 FORMAT "%8.2" DEPOSIT ABSOLUTE /end AXIS_DESCR
/end CHARACTERISTIC
/begin CHARACTERISTIC AKRGRCCATM "Map for exhaust flap control depending on current gear and engine speed (DCT or AT gearbox), with closed convertible top and sport button active" MAP 0x8078F81E Map_Xs16Ys16Ws16 400 ___MGF_CC_Pedal_x100_d256 -200 200 FORMAT "%8.4"
 /begin AXIS_DESCR STD_AXIS gangakr DEZ 10 0 127 FORMAT "%8.4" DEPOSIT ABSOLUTE /end AXIS_DESCR
 /begin AXIS_DESCR STD_AXIS Epm_nEngLRes nmot_q40 12 0 10200 FORMAT "%8.2" DEPOSIT ABSOLUTE /end AXIS_DESCR
/end CHARACTERISTIC
/begin CHARACTERISTIC AKRGRCCATM_VAR1 "Map for exhaust flap control depending on current gear and engine speed (DCT or AT gearbox), with closed convertible top and sport button active" MAP 0x8078F93E Map_Xs16Ys16Ws16 400 ___MGF_CC_Pedal_x100_d256 -200 200 FORMAT "%8.4"
 /begin AXIS_DESCR STD_AXIS gangakr DEZ 8 0 127 FORMAT "%8.4" DEPOSIT ABSOLUTE /end AXIS_DESCR
 /begin AXIS_DESCR STD_AXIS Epm_nEngLRes nmot_q40 8 0 10200 FORMAT "%8.2" DEPOSIT ABSOLUTE /end AXIS_DESCR
/end CHARACTERISTIC
/begin CHARACTERISTIC AKRGRCCATM_VAR2 "Map for exhaust flap control depending on current gear and engine speed (DCT or AT gearbox), with closed convertible top and sport button active" MAP 0x8078F9E2 Map_Xs16Ys16Ws16 400 ___MGF_CC_Pedal_x100_d256 -200 200 FORMAT "%8.4"
 /begin AXIS_DESCR STD_AXIS gangakr DEZ 8 0 127 FORMAT "%8.4" DEPOSIT ABSOLUTE /end AXIS_DESCR
 /begin AXIS_DESCR STD_AXIS Epm_nEngLRes nmot_q40 8 0 10200 FORMAT "%8.2" DEPOSIT ABSOLUTE /end AXIS_DESCR
/end CHARACTERISTIC
/begin CHARACTERISTIC AKRGRCCATM_VAR3 "Map for exhaust flap control depending on current gear and engine speed (DCT or AT gearbox), with closed convertible top and sport button active" MAP 0x8078FA86 Map_Xs16Ys16Ws16 400 ___MGF_CC_Pedal_x100_d256 -200 200 FORMAT "%8.4"
 /begin AXIS_DESCR STD_AXIS gangakr DEZ 8 0 127 FORMAT "%8.4" DEPOSIT ABSOLUTE /end AXIS_DESCR
 /begin AXIS_DESCR STD_AXIS Epm_nEngLRes nmot_q40 8 0 10200 FORMAT "%8.2" DEPOSIT ABSOLUTE /end AXIS_DESCR
/end CHARACTERISTIC
/begin CHARACTERISTIC AKRGRCCM "Map for exhaust flap control depending on current gear and engine speed, with closed convertible top and sport button active" MAP 0x8078FD16 Map_Xs16Ys16Ws16 400 ___MGF_CC_Pedal_x100_d256 -200 200 FORMAT "%8.4"
 /begin AXIS_DESCR STD_AXIS gangakr DEZ 10 0 127 FORMAT "%8.4" DEPOSIT ABSOLUTE /end AXIS_DESCR
 /begin AXIS_DESCR STD_AXIS Epm_nEngLRes nmot_q40 12 0 10200 FORMAT "%8.2" DEPOSIT ABSOLUTE /end AXIS_DESCR
/end CHARACTERISTIC
/begin CHARACTERISTIC AKRGRCCM_VAR1 "Map for exhaust flap control depending on current gear and engine speed, with closed convertible top and sport button active" MAP 0x8078FE36 Map_Xs16Ys16Ws16 400 ___MGF_CC_Pedal_x100_d256 -200 200 FORMAT "%8.4"
 /begin AXIS_DESCR STD_AXIS gangakr DEZ 6 0 127 FORMAT "%8.4" DEPOSIT ABSOLUTE /end AXIS_DESCR
 /begin AXIS_DESCR STD_AXIS Epm_nEngLRes nmot_q40 8 0 10200 FORMAT "%8.2" DEPOSIT ABSOLUTE /end AXIS_DESCR
/end CHARACTERISTIC
/begin CHARACTERISTIC AKRGRCCM_VAR2 "Map for exhaust flap control depending on current gear and engine speed, with closed convertible top and sport button active" MAP 0x8078FEB6 Map_Xs16Ys16Ws16 400 ___MGF_CC_Pedal_x100_d256 -200 200 FORMAT "%8.4"
 /begin AXIS_DESCR STD_AXIS gangakr DEZ 6 0 127 FORMAT "%8.4" DEPOSIT ABSOLUTE /end AXIS_DESCR
 /begin AXIS_DESCR STD_AXIS Epm_nEngLRes nmot_q40 8 0 10200 FORMAT "%8.2" DEPOSIT ABSOLUTE /end AXIS_DESCR
/end CHARACTERISTIC
/begin CHARACTERISTIC AKRGRCCM_VAR3 "Map for exhaust flap control depending on current gear and engine speed, with closed convertible top and sport button active" MAP 0x8078FF36 Map_Xs16Ys16Ws16 400 ___MGF_CC_Pedal_x100_d256 -200 200 FORMAT "%8.4"
 /begin AXIS_DESCR STD_AXIS gangakr DEZ 6 0 127 FORMAT "%8.4" DEPOSIT ABSOLUTE /end AXIS_DESCR
 /begin AXIS_DESCR STD_AXIS Epm_nEngLRes nmot_q40 8 0 10200 FORMAT "%8.2" DEPOSIT ABSOLUTE /end AXIS_DESCR
/end CHARACTERISTIC
/begin CHARACTERISTIC AKRGRCO "Map for exhaust flap control depending on current gear and engine speed, with open convertible top" MAP 0x80790136 Map_Xs16Ys16Ws16 400 ___MGF_CC_Pedal_x100_d256 -200 200 FORMAT "%8.4"
 /begin AXIS_DESCR STD_AXIS gangakr DEZ 10 0 127 FORMAT "%8.4" DEPOSIT ABSOLUTE /end AXIS_DESCR
 /begin AXIS_DESCR STD_AXIS Epm_nEngLRes nmot_q40 12 0 10200 FORMAT "%8.2" DEPOSIT ABSOLUTE /end AXIS_DESCR
/end CHARACTERISTIC
/begin CHARACTERISTIC AKRGRCO_VAR1 "Map for exhaust flap control depending on current gear and engine speed, with open convertible top" MAP 0x8079077E Map_Xs16Ys16Ws16 400 ___MGF_CC_Pedal_x100_d256 -200 200 FORMAT "%8.4"
 /begin AXIS_DESCR STD_AXIS gangakr DEZ 6 0 127 FORMAT "%8.4" DEPOSIT ABSOLUTE /end AXIS_DESCR
 /begin AXIS_DESCR STD_AXIS Epm_nEngLRes nmot_q40 8 0 10200 FORMAT "%8.2" DEPOSIT ABSOLUTE /end AXIS_DESCR
/end CHARACTERISTIC
/begin CHARACTERISTIC AKRGRCOAT "Map for exhaust flap control depending on current gear and engine speed (DCT or AT gearbox), with open convertible top" MAP 0x80790256 Map_Xs16Ys16Ws16 400 ___MGF_CC_Pedal_x100_d256 -200 200 FORMAT "%8.4"
 /begin AXIS_DESCR STD_AXIS gangakr DEZ 10 0 127 FORMAT "%8.4" DEPOSIT ABSOLUTE /end AXIS_DESCR
 /begin AXIS_DESCR STD_AXIS Epm_nEngLRes nmot_q40 12 0 10200 FORMAT "%8.2" DEPOSIT ABSOLUTE /end AXIS_DESCR
/end CHARACTERISTIC
/begin CHARACTERISTIC AKRGRCOAT_VAR1 "Map for exhaust flap control depending on current gear and engine speed (DCT or AT gearbox), with open convertible top" MAP 0x8079053A Map_Xs16Ys16Ws16 400 ___MGF_CC_Pedal_x100_d256 -200 200 FORMAT "%8.4"
 /begin AXIS_DESCR STD_AXIS gangakr DEZ 8 0 127 FORMAT "%8.4" DEPOSIT ABSOLUTE /end AXIS_DESCR
 /begin AXIS_DESCR STD_AXIS Epm_nEngLRes nmot_q40 8 0 10200 FORMAT "%8.2" DEPOSIT ABSOLUTE /end AXIS_DESCR
/end CHARACTERISTIC
/begin CHARACTERISTIC AKRGRCOATM "Map for exhaust flap control depending on current gear and engine speed (DCT or AT gearbox), with open convertible top and sport button active" MAP 0x80790376 Map_Xs16Ys16Ws16 400 ___MGF_CC_Pedal_x100_d256 -200 200 FORMAT "%8.4"
 /begin AXIS_DESCR STD_AXIS gangakr DEZ 10 0 127 FORMAT "%8.4" DEPOSIT ABSOLUTE /end AXIS_DESCR
 /begin AXIS_DESCR STD_AXIS Epm_nEngLRes nmot_q40 12 0 10200 FORMAT "%8.2" DEPOSIT ABSOLUTE /end AXIS_DESCR
/end CHARACTERISTIC
/begin CHARACTERISTIC AKRGRCOATM_VAR1 "Map for exhaust flap control depending on current gear and engine speed (DCT or AT gearbox), with open convertible top and sport button active" MAP 0x80790496 Map_Xs16Ys16Ws16 400 ___MGF_CC_Pedal_x100_d256 -200 200 FORMAT "%8.4"
 /begin AXIS_DESCR STD_AXIS gangakr DEZ 8 0 127 FORMAT "%8.4" DEPOSIT ABSOLUTE /end AXIS_DESCR
 /begin AXIS_DESCR STD_AXIS Epm_nEngLRes nmot_q40 8 0 10200 FORMAT "%8.2" DEPOSIT ABSOLUTE /end AXIS_DESCR
/end CHARACTERISTIC
/begin CHARACTERISTIC AKRGRCOM "Map for exhaust flap control depending on current gear and engine speed, with open convertible top and sport button active" MAP 0x807905DE Map_Xs16Ys16Ws16 400 ___MGF_CC_Pedal_x100_d256 -200 200 FORMAT "%8.4"
 /begin AXIS_DESCR STD_AXIS gangakr DEZ 10 0 127 FORMAT "%8.4" DEPOSIT ABSOLUTE /end AXIS_DESCR
 /begin AXIS_DESCR STD_AXIS Epm_nEngLRes nmot_q40 12 0 10200 FORMAT "%8.2" DEPOSIT ABSOLUTE /end AXIS_DESCR
/end CHARACTERISTIC
/begin CHARACTERISTIC AKRGRCOM_VAR1 "Map for exhaust flap control depending on current gear and engine speed, with open convertible top and sport button active" MAP 0x807906FE Map_Xs16Ys16Ws16 400 ___MGF_CC_Pedal_x100_d256 -200 200 FORMAT "%8.4"
 /begin AXIS_DESCR STD_AXIS gangakr DEZ 6 0 127 FORMAT "%8.4" DEPOSIT ABSOLUTE /end AXIS_DESCR
 /begin AXIS_DESCR STD_AXIS Epm_nEngLRes nmot_q40 8 0 10200 FORMAT "%8.2" DEPOSIT ABSOLUTE /end AXIS_DESCR
/end CHARACTERISTIC
/begin CHARACTERISTIC Antilag_BMWtchctr_p_DifCrtnPp_M___MGF_CC_PF "Pressure difference correction for P-component of power-based boost pressure controller (X-Axis does not switch, )" MAP 0x807C000E _REC_A1CUR_1_MBSE_S2_S1 8191.875 BMW_p_sw_q0p125_hPa -4096 4095.875 FORMAT "%10.3"
 /begin AXIS_DESCR COM_AXIS BMWtchbas_p_Dif_sw BMW_p_sw_q0p125_hPa 12 -4096 4095.875 AXIS_PTS_REF Antilag_BMWtchctr_p_DifCrtnPp_Ax___MGF_CC_PF FORMAT "%10.3" MONOTONY MON_INCREASE DEPOSIT ABSOLUTE /end AXIS_DESCR
 /begin AXIS_DESCR COM_AXIS BMWtchsp_mf_Ex_uw CByjozc_eCmpBAb_pljBAmd_k__0oa0 6 0 2047.96875 AXIS_PTS_REF Antilag_BMWtchctr_p_DifCrtnPp_Ay___MGF_CC_PF FORMAT "%10.3" MONOTONY STRICT_INCREASE DEPOSIT ABSOLUTE /end AXIS_DESCR
/end CHARACTERISTIC
/begin CHARACTERISTIC Antilag_BMWtchctr_p_DifCrtnPpDyn_M___MGF_CC_PF "Pressure difference correction for P-component of power-based boost pressure controller (X-Axis does not switch, )" MAP 0x807C00AA _REC_A1CUR_1_MBSE_S2_S1 8191.875 BMW_p_sw_q0p125_hPa -4096 4095.875 FORMAT "%10.3"
 /begin AXIS_DESCR COM_AXIS BMWtchbas_p_Dif_sw BMW_p_sw_q0p125_hPa 12 -4096 4095.875 AXIS_PTS_REF Antilag_BMWtchctr_p_DifCrtnPpDyn_Ax___MGF_CC_PF FORMAT "%10.3" MONOTONY MON_INCREASE DEPOSIT ABSOLUTE /end AXIS_DESCR
 /begin AXIS_DESCR COM_AXIS BMWtchsp_mf_Ex_uw CByjozc_eCmpBAb_pljBAmd_k__0oa0 6 0 2047.96875 AXIS_PTS_REF Antilag_BMWtchctr_p_DifCrtnPpDyn_Ay___MGF_CC_PF FORMAT "%10.3" MONOTONY STRICT_INCREASE DEPOSIT ABSOLUTE /end AXIS_DESCR
/end CHARACTERISTIC
/begin CHARACTERISTIC Antilag_BMWtchctr_pwr_Dp_M___MGF_CC_PF "D-component of the power-based boost pressure controller (X-Axis and Y-Axis do not switch)" MAP 0x807C013A _REC_A1CUR_1_MBSE_S2_S1 127.998046875 jucyrzb_bpFgwfd_uqrfhgc_k__aoa0 -64 63.998046875 FORMAT "%10.3"
 /begin AXIS_DESCR COM_AXIS BMWtchbas_p_Dif_sw BMW_p_sw_q0p125_hPa 14 -4096 4095.875 AXIS_PTS_REF BMWtchctr_pwr_Dp_Ax FORMAT "%10.3" MONOTONY STRICT_INCREASE DEPOSIT ABSOLUTE /end AXIS_DESCR
 /begin AXIS_DESCR COM_AXIS BMWtchbas_p_DifGra_sw BMW_p_sw_q0p125_hPa 14 -4096 4095.875 AXIS_PTS_REF BMWtchctr_pwr_Dp_Ay FORMAT "%10.3" MONOTONY STRICT_INCREASE DEPOSIT ABSOLUTE /end AXIS_DESCR
/end CHARACTERISTIC
/begin CHARACTERISTIC Antilag_BMWtchctr_pwr_PctlWideRng_M___MGF_CC_PF "Compressor map with required compressor / turbine power ()" MAP 0x807D8922 _REC_A1CUR_1_MBSE_U2_S1 127.998046875 jucyrzb_bpFgwfd_uqrfhgc_k__aoa0 0 127.998046875 FORMAT "%11.4"
 /begin AXIS_DESCR COM_AXIS BMWtchsp_rat_p_CmprLim_uw acriqBc_tfkBqod_ocgjxzc_nR_8oa0 20 0 7.9998779296875 AXIS_PTS_REF Antilag_BMWtchctr_pwr_Pctl_Ax___MGF_CC_PF FORMAT "%11.4" MONOTONY MON_INCREASE DEPOSIT ABSOLUTE /end AXIS_DESCR
 /begin AXIS_DESCR COM_AXIS BMWtchsp_mf_CmprNormWideRng_uw wpxDCba_sgbvDxb_FliBAmd_k__0oa0 16 0 4095.9375 AXIS_PTS_REF Antilag_BMWtchctr_pwr_PctlWideRng_Ay___MGF_CC_PF FORMAT "%10.3" MONOTONY STRICT_INCREASE DEPOSIT ABSOLUTE /end AXIS_DESCR
/end CHARACTERISTIC
/begin CHARACTERISTIC Antilag_IgnRoll___MGF_CC_PF "Ignition setpoint: Engine speed [Nkw] vs Boost actual [Ps]" MAP 0x807C0590 CurG_Ws16 0 ___MGF_CC_IgnitionTiming_d10 -100 100 MATRIX_DIM 10 10 1
 /begin AXIS_DESCR COM_AXIS Nkw caoddzd_oAjpfzb_cAcEEha_1nR_oa0 10 0 15000 AXIS_PTS_REF Antilag_IgnRoll_X_Axis___MGF_CC_PF DEPOSIT ABSOLUTE /end AXIS_DESCR
 /begin AXIS_DESCR COM_AXIS Ps BMW_p_sw_q0p125_hPa 10 -3000 3000 AXIS_PTS_REF Antilag_IgnRoll_Y_Axis___MGF_CC_PF DEPOSIT ABSOLUTE /end AXIS_DESCR
/end CHARACTERISTIC
/begin CHARACTERISTIC Antilag_IgnStand___MGF_CC_PF "Ignition setpoint: Engine speed [Nkw] vs Boost actual [Ps]" MAP 0x807C0658 CurG_Ws16 0 ___MGF_CC_IgnitionTiming_d10 -100 100 MATRIX_DIM 10 10 1
 /begin AXIS_DESCR COM_AXIS Nkw caoddzd_oAjpfzb_cAcEEha_1nR_oa0 10 0 15000 AXIS_PTS_REF Antilag_IgnStand_X_Axis___MGF_CC_PF DEPOSIT ABSOLUTE /end AXIS_DESCR
 /begin AXIS_DESCR COM_AXIS Ps BMW_p_sw_q0p125_hPa 10 -3000 3000 AXIS_PTS_REF Antilag_IgnStand_Y_Axis___MGF_CC_PF DEPOSIT ABSOLUTE /end AXIS_DESCR
/end CHARACTERISTIC
/begin CHARACTERISTIC Antilag_LambdaRoll___MGF_CC_PF "Fueling setpoint: Engine speed [Nkw] vs Exhaust Gas Temperature [EGT] before turbine [Tabg_vl_xab]" MAP 0x807C0720 KwUw 0 ___MGF_CC_Fueling_d10 0 2 MATRIX_DIM 10 10 1
 /begin AXIS_DESCR COM_AXIS Nkw caoddzd_oAjpfzb_cAcEEha_1nR_oa0 10 0 15000 AXIS_PTS_REF Antilag_LambdaRoll_X_Axis___MGF_CC_PF DEPOSIT ABSOLUTE /end AXIS_DESCR
 /begin AXIS_DESCR COM_AXIS Tabg_vl_xab BMW_q0p1_degC 10 -3000 3000 AXIS_PTS_REF Antilag_LambdaRoll_Y_Axis___MGF_CC_PF DEPOSIT ABSOLUTE /end AXIS_DESCR
/end CHARACTERISTIC
/begin CHARACTERISTIC Antilag_LambdaStand___MGF_CC_PF "Fueling setpoint: Engine speed [Nkw] vs Exhaust Gas Temperature [EGT] before turbine [Tabg_vl_xab]" MAP 0x807C07E8 KwUw 0 ___MGF_CC_Fueling_d10 0 2 MATRIX_DIM 10 10 1
 /begin AXIS_DESCR COM_AXIS Nkw caoddzd_oAjpfzb_cAcEEha_1nR_oa0 10 0 15000 AXIS_PTS_REF Antilag_LambdaStand_X_Axis___MGF_CC_PF DEPOSIT ABSOLUTE /end AXIS_DESCR
 /begin AXIS_DESCR COM_AXIS Tabg_vl_xab BMW_q0p1_degC 10 -3000 3000 AXIS_PTS_REF Antilag_LambdaStand_Y_Axis___MGF_CC_PF DEPOSIT ABSOLUTE /end AXIS_DESCR
/end CHARACTERISTIC
/begin CHARACTERISTIC BMWgpfheat_p_RailInjMpl_M "GPF heating, rail pressure setpoint for multiple injection" MAP 0x8071D20C _REC_A1CUR_1_MBSE_U2_S1 39.9993896484375 cxdjuna_xpuCged_ocEpdua_MCRa2a0 0 39.9993896484375
 /begin AXIS_DESCR COM_AXIS Nkw caoddzd_oAjpfzb_cAcEEha_1nR_oa0 6 -32768 32767 AXIS_PTS_REF BMWgpfheat_p_RailInjMpl_Ax FORMAT "%5.0" MONOTONY STRICT_INCREASE DEPOSIT ABSOLUTE /end AXIS_DESCR
 /begin AXIS_DESCR COM_AXIS BMWrailco_rat_VabHom_sw zyyxBpb_rEsnvtc_gktukCa_fR_5a0o 6 -1600 1599.951171875 AXIS_PTS_REF BMWgpfheat_p_RailInjMpl_Ay FORMAT "%8.3" MONOTONY STRICT_INCREASE DEPOSIT ABSOLUTE /end AXIS_DESCR
/end CHARACTERISTIC
/begin CHARACTERISTIC BMWgpfheat_p_RailInjSng_M "GPF heating, rail pressure setpoint for single injection" MAP 0x8071D1C4 _REC_A1CUR_1_MBSE_U2_S1 39.9993896484375 cxdjuna_xpuCged_ocEpdua_MCRa2a0 0 39.9993896484375
 /begin AXIS_DESCR COM_AXIS Nkw caoddzd_oAjpfzb_cAcEEha_1nR_oa0 6 -32768 32767 AXIS_PTS_REF BMWgpfheat_p_RailInjSng_Ax FORMAT "%5.0" MONOTONY STRICT_INCREASE DEPOSIT ABSOLUTE /end AXIS_DESCR
 /begin AXIS_DESCR COM_AXIS BMWrailco_rat_VabHom_sw zyyxBpb_rEsnvtc_gktukCa_fR_5a0o 6 -1600 1599.951171875 AXIS_PTS_REF BMWgpfheat_p_RailInjSng_Ay FORMAT "%8.3" MONOTONY STRICT_INCREASE DEPOSIT ABSOLUTE /end AXIS_DESCR
/end CHARACTERISTIC
/begin CHARACTERISTIC BMWlpa_n_EfpEngStrtAmb_M "Electric fuel pump speed setpoint for start ambient" MAP 0x8071C748 _REC_A1CUR_1_MBSE_U2_S1 65535 caoddzd_oAjpfzb_cAcEEha_1nR_oa0 0 65535 FORMAT "%5.0"
 /begin AXIS_DESCR COM_AXIS Tumg BMW_q0p1_degC 4 -3276.8 3276.7 AXIS_PTS_REF BMWlpa_n_EfpEngStrtAmb_Ax FORMAT "%6.1" MONOTONY STRICT_INCREASE DEPOSIT ABSOLUTE /end AXIS_DESCR
 /begin AXIS_DESCR COM_AXIS Pumg BMW_p_sw_q0p125_hPa 4 0 8191.875 AXIS_PTS_REF BMWlpa_n_EfpEngStrtAmb_Ay FORMAT "%8.3" MONOTONY STRICT_INCREASE DEPOSIT ABSOLUTE /end AXIS_DESCR
/end CHARACTERISTIC
/begin CHARACTERISTIC BMWtchctr_p_DifCrtnPp_M___MGF_CC_FF1_Slot0 "Pressure difference correction for P-component of power-based boost pressure controller (X-Axis does not switch, Slot 0, Flex Fuel 1)" MAP 0x807C44D8 _REC_A1CUR_1_MBSE_S2_S1 8191.875 BMW_p_sw_q0p125_hPa -4096 4095.875 FORMAT "%10.3"
 /begin AXIS_DESCR COM_AXIS BMWtchbas_p_Dif_sw BMW_p_sw_q0p125_hPa 12 -1000 1000 AXIS_PTS_REF BMWtchctr_p_DifCrtnPp_Ax DEPOSIT ABSOLUTE /end AXIS_DESCR
 /begin AXIS_DESCR COM_AXIS BMWtchsp_mf_Ex_uw CByjozc_eCmpBAb_pljBAmd_k__0oa0 6 0 2000 AXIS_PTS_REF BMWtchctr_p_DifCrtnPp_Ay___MGF_CC_FF1_Slot0 DEPOSIT ABSOLUTE /end AXIS_DESCR
/end CHARACTERISTIC
/begin CHARACTERISTIC BMWtchctr_pct_WgBasc_M___MGF_CC_FF1_Slot0 "Wastegate position - for feedforward control (Slot 0, Flex Fuel 1)" MAP 0x807C4B64 _REC_A1CUR_1_MBSE_U2_S1 99.9984741210938 wDDoctd_cCDyaFa_AvCkvFb_nR_6o0o 0 99.9984741210938 FORMAT "%10.3"
 /begin AXIS_DESCR COM_AXIS NO_INPUT_QUANTITY ilxsavd_hkzmBfc_lAzCpAb_nR_1oa0 12 0 3.99993896484375 AXIS_PTS_REF BMWtchctr_pct_WgBasc_Ax FORMAT "%14.5" MONOTONY STRICT_INCREASE DEPOSIT ABSOLUTE /end AXIS_DESCR
 /begin AXIS_DESCR COM_AXIS NO_INPUT_QUANTITY ECeoxdb_wFseCtb_mEytEnb_k__o8a0 12 0 2559.9609375 AXIS_PTS_REF BMWtchctr_pct_WgBasc_Ay FORMAT "%10.3" MONOTONY STRICT_INCREASE DEPOSIT ABSOLUTE /end AXIS_DESCR
/end CHARACTERISTIC
/begin CHARACTERISTIC BMWtchctr_pwr_Dp_M___MGF_CC_FF1_Slot0 "D-component of the power-based boost pressure controller (X-Axis and Y-Axis do not switch, Slot 0, Flex Fuel 1)" MAP 0x807C7A26 _REC_A1CUR_1_MBSE_S2_S1 127.998046875 jucyrzb_bpFgwfd_uqrfhgc_k__aoa0 -64 63.998046875 FORMAT "%10.3"
 /begin AXIS_DESCR COM_AXIS BMWtchbas_p_Dif_sw BMW_p_sw_q0p125_hPa 14 -4096 4095.875 AXIS_PTS_REF BMWtchctr_pwr_Dp_Ax FORMAT "%10.3" MONOTONY STRICT_INCREASE DEPOSIT ABSOLUTE /end AXIS_DESCR
 /begin AXIS_DESCR COM_AXIS BMWtchbas_p_DifGra_sw BMW_p_sw_q0p125_hPa 14 -4096 4095.875 AXIS_PTS_REF BMWtchctr_pwr_Dp_Ay FORMAT "%10.3" MONOTONY STRICT_INCREASE DEPOSIT ABSOLUTE /end AXIS_DESCR
/end CHARACTERISTIC
/begin CHARACTERISTIC BMWtchctr_pwr_PctlWideRng_M___MGF_CC_FF1_Slot0 "Compressor map with required compressor / turbine power (X-Axis does not switch, Slot 0, Flex Fuel 1)" MAP 0x807DA3E2 _REC_A1CUR_1_MBSE_U2_S1 127.998046875 jucyrzb_bpFgwfd_uqrfhgc_k__aoa0 0 127.998046875 FORMAT "%11.4"
 /begin AXIS_DESCR COM_AXIS BMWtchsp_rat_p_CmprLim_uw acriqBc_tfkBqod_ocgjxzc_nR_8oa0 20 0 5 AXIS_PTS_REF BMWtchctr_pwr_Pctl_Ax___MGF_CC_FF1_Slot0 DEPOSIT ABSOLUTE /end AXIS_DESCR
 /begin AXIS_DESCR COM_AXIS BMWtchsp_mf_CmprNormWideRng_uw wpxDCba_sgbvDxb_FliBAmd_k__0oa0 16 0 2000 AXIS_PTS_REF BMWtchctr_pwr_PctlWideRng_Ay___MGF_CC_FF1_Slot0 DEPOSIT ABSOLUTE /end AXIS_DESCR
/end CHARACTERISTIC
/begin CHARACTERISTIC BMWtchctr_t_ExGasMdl_M "Exhaust gas temperature during dynamic load changes for physical turbocharger feedforward control" MAP 0x80747934 _REC_A1CUR_1_MBSE_S2_S1 6553.5 BMW_q0p1_degC -3276.8 3276.7 FORMAT "%7.1"
 /begin AXIS_DESCR COM_AXIS Nkw caoddzd_oAjpfzb_cAcEEha_1nR_oa0 6 -32768 32767 AXIS_PTS_REF BMWtchctr_t_ExGasMdl_Ax FORMAT "%5.0" MONOTONY STRICT_INCREASE DEPOSIT ABSOLUTE /end AXIS_DESCR
 /begin AXIS_DESCR COM_AXIS Rf CgkBooc_wkiDfEd_Czglhgc_fR_1a0o 6 -327.68 327.67 AXIS_PTS_REF BMWtchctr_t_ExGasMdl_Ay FORMAT "%7.2" MONOTONY STRICT_INCREASE DEPOSIT ABSOLUTE /end AXIS_DESCR
/end CHARACTERISTIC
/begin CHARACTERISTIC BMWtchctr_t_ExGasMdlScav_M "Exhaust gas temperature during dynamic load changes for physical turbocharger feedforward control" MAP 0x8074797C _REC_A1CUR_1_MBSE_S2_S1 6553.5 BMW_q0p1_degC -3276.8 3276.7 FORMAT "%7.1"
 /begin AXIS_DESCR COM_AXIS Nkw caoddzd_oAjpfzb_cAcEEha_1nR_oa0 6 -32768 32767 AXIS_PTS_REF BMWtchctr_t_ExGasMdlScav_Ax FORMAT "%5.0" MONOTONY STRICT_INCREASE DEPOSIT ABSOLUTE /end AXIS_DESCR
 /begin AXIS_DESCR COM_AXIS Rf CgkBooc_wkiDfEd_Czglhgc_fR_1a0o 6 -327.68 327.67 AXIS_PTS_REF BMWtchctr_t_ExGasMdlScav_Ay FORMAT "%7.2" MONOTONY STRICT_INCREASE DEPOSIT ABSOLUTE /end AXIS_DESCR
/end CHARACTERISTIC
/begin CHARACTERISTIC BMWtchsp_rat_p_CmprMax_M "Max allowed compressor pressure ratio (model-based)" MAP 0x807281F4 _REC_A1CUR_1_MBSE_U2_S1 3.99993896484375 ilxsavd_hkzmBfc_lAzCpAb_nR_1oa0 0 3.99993896484375
 /begin AXIS_DESCR COM_AXIS BMWtchsp_mf_CmprNorm_uw wpxDCba_sgbvDxb_FliBAmd_k__0oa0 8 0 4095.9375 AXIS_PTS_REF BMWtchsp_rat_p_CmprMax_Ax FORMAT "%10.3" MONOTONY STRICT_INCREASE DEPOSIT ABSOLUTE /end AXIS_DESCR
 /begin AXIS_DESCR COM_AXIS BMWtchtbc_t_BefCmpr_sw BMW_q0p1_degC 6 -3276.8 3276.7 AXIS_PTS_REF BMWtchsp_rat_p_CmprMax_Ay FORMAT "%6.1" MONOTONY STRICT_INCREASE DEPOSIT ABSOLUTE /end AXIS_DESCR
/end CHARACTERISTIC
/begin CHARACTERISTIC BMWtchsp_rat_p_CmprMaxRace_M "Max compressor pressure ratio (race mode)" MAP 0x80728254 _REC_A1CUR_1_MBSE_U2_S1 3.99993896484375 ilxsavd_hkzmBfc_lAzCpAb_nR_1oa0 0 3.99993896484375
 /begin AXIS_DESCR COM_AXIS BMWtchsp_mf_CmprNorm_uw wpxDCba_sgbvDxb_FliBAmd_k__0oa0 8 0 4095.9375 AXIS_PTS_REF BMWtchsp_rat_p_CmprMaxRace_Ax FORMAT "%10.3" MONOTONY STRICT_INCREASE DEPOSIT ABSOLUTE /end AXIS_DESCR
 /begin AXIS_DESCR COM_AXIS BMWtchtbc_t_BefCmpr_sw BMW_q0p1_degC 6 -3276.8 3276.7 AXIS_PTS_REF BMWtchsp_rat_p_CmprMaxRace_Ay FORMAT "%6.1" MONOTONY STRICT_INCREASE DEPOSIT ABSOLUTE /end AXIS_DESCR
/end CHARACTERISTIC
/begin CHARACTERISTIC BMWtqe_st_SptDet4NoiseAcvn_M "Torque engine status sport detection 4 noise activation map" MAP 0x807596FB _REC_A1CUR_1_MBSE_U1_S1 255 raChrxc_kBtBrmb_FmDuEFa_n__aa0o 0 255 FORMAT "%3.0"
 /begin AXIS_DESCR COM_AXIS Status_usecase_antr raChrxc_kBtBrmb_FmDuEFa_n__aa0o 12 0 11 AXIS_PTS_REF BMWtqe_st_SptDet4NoiseAcvn_Ax FORMAT "%6.0" MONOTONY STRICT_INCREASE DEPOSIT ABSOLUTE /end AXIS_DESCR
 /begin AXIS_DESCR COM_AXIS St_dsc_can raChrxc_kBtBrmb_FmDuEFa_n__aa0o 4 0 11 AXIS_PTS_REF BMWtqe_st_SptDet4NoiseAcvn_Ay FORMAT "%3.0" MONOTONY STRICT_INCREASE DEPOSIT ABSOLUTE /end AXIS_DESCR
/end CHARACTERISTIC
/begin CHARACTERISTIC FlexFuel_StartupEnrichment___MGF_CC "Flex fuel warm up enrichment" MAP 0x807CFF90 _REC_A1CUR_1_MBSE_U2_S1 0 ___MGF_CC_FlexFuel_StartupEnrichment_d100 0.5 2 MATRIX_DIM 21 16 1
 /begin AXIS_DESCR COM_AXIS FlexFuelEthanolContentValue___MGF_CC FlexFuelEthanolContentValue_CompuMethod 21 0 0 AXIS_PTS_REF BlendFactorAxis___MGF_CC DEPOSIT ABSOLUTE /end AXIS_DESCR
 /begin AXIS_DESCR COM_AXIS Toel BMW_q0p1_degC 16 0 0 AXIS_PTS_REF AXX_FlexFuel_StartupEnrichment___MGF_CC DEPOSIT ABSOLUTE /end AXIS_DESCR
/end CHARACTERISTIC
/begin CHARACTERISTIC IKCtl_FacKnockDetThd0_GM___MGF_CC_FF1_Slot0 "Knock detection factor map cylinder counter 0 (Slot 0, Flex Fuel 1)" MAP 0x807CBCFE FklWUb 3.438 fak_ub_b16 0.0625 3.5 FORMAT "%5.3"
 /begin AXIS_DESCR COM_AXIS Epm_nEng EngN 16 -16384 16383.5 AXIS_PTS_REF IKCtl_nEngB16_X_AX FORMAT "%8.2" DEPOSIT ABSOLUTE /end AXIS_DESCR
 /begin AXIS_DESCR COM_AXIS AirMod_ratChrgAirCyl rel_q0p0234 4 0 1535.977 AXIS_PTS_REF IKCtl_ratLoadAddl04_X_AX FORMAT "%8.3" DEPOSIT ABSOLUTE /end AXIS_DESCR
/end CHARACTERISTIC
/begin CHARACTERISTIC IKCtl_FacKnockDetThd1_GM___MGF_CC_FF1_Slot0 "Knock detection factor map cylinder counter 1 (Slot 0, Flex Fuel 1)" MAP 0x807CBF3E FklWUb 3.438 fak_ub_b16 0.0625 3.5 FORMAT "%5.3"
 /begin AXIS_DESCR COM_AXIS Epm_nEng EngN 16 -16384 16383.5 AXIS_PTS_REF IKCtl_nEngB16_X_AX FORMAT "%8.2" DEPOSIT ABSOLUTE /end AXIS_DESCR
 /begin AXIS_DESCR COM_AXIS AirMod_ratChrgAirCyl rel_q0p0234 4 0 1535.977 AXIS_PTS_REF IKCtl_ratLoadAddl04_X_AX FORMAT "%8.3" DEPOSIT ABSOLUTE /end AXIS_DESCR
/end CHARACTERISTIC
/begin CHARACTERISTIC IKCtl_FacKnockDetThd2_GM___MGF_CC_FF1_Slot0 "Knock detection factor map cylinder counter 2 (Slot 0, Flex Fuel 1)" MAP 0x807CC17E FklWUb 3.438 fak_ub_b16 0.0625 3.5 FORMAT "%5.3"
 /begin AXIS_DESCR COM_AXIS Epm_nEng EngN 16 -16384 16383.5 AXIS_PTS_REF IKCtl_nEngB16_X_AX FORMAT "%8.2" DEPOSIT ABSOLUTE /end AXIS_DESCR
 /begin AXIS_DESCR COM_AXIS AirMod_ratChrgAirCyl rel_q0p0234 4 0 1535.977 AXIS_PTS_REF IKCtl_ratLoadAddl04_X_AX FORMAT "%8.3" DEPOSIT ABSOLUTE /end AXIS_DESCR
/end CHARACTERISTIC
/begin CHARACTERISTIC IKCtl_FacKnockDetThd3_GM___MGF_CC_FF1_Slot0 "Knock detection factor map cylinder counter 3 (Slot 0, Flex Fuel 1)" MAP 0x807CC3BE FklWUb 3.438 fak_ub_b16 0.0625 3.5 FORMAT "%5.3"
 /begin AXIS_DESCR COM_AXIS Epm_nEng EngN 16 -16384 16383.5 AXIS_PTS_REF IKCtl_nEngB16_X_AX FORMAT "%8.2" DEPOSIT ABSOLUTE /end AXIS_DESCR
 /begin AXIS_DESCR COM_AXIS AirMod_ratChrgAirCyl rel_q0p0234 4 0 1535.977 AXIS_PTS_REF IKCtl_ratLoadAddl04_X_AX FORMAT "%8.3" DEPOSIT ABSOLUTE /end AXIS_DESCR
/end CHARACTERISTIC
/begin CHARACTERISTIC IKCtl_FacKnockDetThd4_GM___MGF_CC_FF1_Slot0 "Knock detection factor map cylinder counter 4 (Slot 0, Flex Fuel 1)" MAP 0x807CC5FE FklWUb 3.438 fak_ub_b16 0.0625 3.5 FORMAT "%5.3"
 /begin AXIS_DESCR COM_AXIS Epm_nEng EngN 16 -16384 16383.5 AXIS_PTS_REF IKCtl_nEngB16_X_AX FORMAT "%8.2" DEPOSIT ABSOLUTE /end AXIS_DESCR
 /begin AXIS_DESCR COM_AXIS AirMod_ratChrgAirCyl rel_q0p0234 4 0 1535.977 AXIS_PTS_REF IKCtl_ratLoadAddl04_X_AX FORMAT "%8.3" DEPOSIT ABSOLUTE /end AXIS_DESCR
/end CHARACTERISTIC
/begin CHARACTERISTIC IKCtl_FacKnockDetThd5_GM___MGF_CC_FF1_Slot0 "Knock detection factor map cylinder counter 5 (Slot 0, Flex Fuel 1)" MAP 0x807CC83E FklWUb 3.438 fak_ub_b16 0.0625 3.5 FORMAT "%5.3"
 /begin AXIS_DESCR COM_AXIS Epm_nEng EngN 16 -16384 16383.5 AXIS_PTS_REF IKCtl_nEngB16_X_AX FORMAT "%8.2" DEPOSIT ABSOLUTE /end AXIS_DESCR
 /begin AXIS_DESCR COM_AXIS AirMod_ratChrgAirCyl rel_q0p0234 4 0 1535.977 AXIS_PTS_REF IKCtl_ratLoadAddl04_X_AX FORMAT "%8.3" DEPOSIT ABSOLUTE /end AXIS_DESCR
/end CHARACTERISTIC
/begin CHARACTERISTIC KF_DPLDS_PRED "Offset target boost pressure as f(engine speed, dynamic Rf_soll damping)" MAP 0x80746B94 _REC_A1CUR_1_MBSE_U2_S1 8191.875 rAdkuaa_wDllxja_BnDuEFa_n__aa0o 0 8191.875
 /begin AXIS_DESCR COM_AXIS Nkw caoddzd_oAjpfzb_cAcEEha_1nR_oa0 6 0 32767 AXIS_PTS_REF AXX_KF_DPLDS_PRED FORMAT "%5.0" MONOTONY MON_INCREASE DEPOSIT ABSOLUTE /end AXIS_DESCR
 /begin AXIS_DESCR COM_AXIS Drf_s2spred CgkBooc_wkiDfEd_Czglhgc_fR_1a0o 6 0 655.35 AXIS_PTS_REF AXY_KF_DPLDS_PRED MONOTONY MON_INCREASE DEPOSIT ABSOLUTE /end AXIS_DESCR
/end CHARACTERISTIC
/begin CHARACTERISTIC KF_DPLDSOLL_SPORT "Map boost pressure offset on target boost pressure (in sport mode)" MAP 0x80721FE4 _REC_A1CUR_1_MBSE_U2_S1 8191.875 BMW_p_sw_q0p125_hPa 0 8191.875 FORMAT "%8.3"
 /begin AXIS_DESCR COM_AXIS NO_INPUT_QUANTITY caoddzd_oAjpfzb_cAcEEha_1nR_oa0 6 0 32767 AXIS_PTS_REF AXX_KF_DPLDSOLL_SPORT FORMAT "%5.0" MONOTONY MON_INCREASE DEPOSIT ABSOLUTE /end AXIS_DESCR
 /begin AXIS_DESCR COM_AXIS NO_INPUT_QUANTITY acriqBc_tfkBqod_ocgjxzc_nR_8oa0 6 0 7.9998779296875 AXIS_PTS_REF AXY_KF_DPLDSOLL_SPORT FORMAT "%7.5" MONOTONY MON_INCREASE DEPOSIT ABSOLUTE /end AXIS_DESCR
/end CHARACTERISTIC
/begin CHARACTERISTIC KF_DZWMIN_NORMAL_SOT "Ignition angle intervention for sound tuning" MAP 0x8075E1B9 _REC_A1CUR_1_MBSE_S1_S1 127.5 aAwkuzc_BFpgCmb_tmDukma_q__aa0o -64 63.5
 /begin AXIS_DESCR COM_AXIS Nkw caoddzd_oAjpfzb_cAcEEha_1nR_oa0 6 -32768 32767 AXIS_PTS_REF AXX_KF_DZWMIN_NORMAL_SOT FORMAT "%5.0" MONOTONY STRICT_INCREASE DEPOSIT ABSOLUTE /end AXIS_DESCR
 /begin AXIS_DESCR COM_AXIS V AFeDmkb_cAbjmcc_kAkskhd_k__0oa0 4 0 65535 AXIS_PTS_REF AXY_KF_DZWMIN_NORMAL_SOT FORMAT "%5.0" MONOTONY STRICT_INCREASE DEPOSIT ABSOLUTE /end AXIS_DESCR
/end CHARACTERISTIC
/begin CHARACTERISTIC KF_DZWMIN_SPORT_SOT "Ignition angle intervention for sound tuning at B_sport" MAP 0x8075E161 _REC_A1CUR_1_MBSE_S1_S1 127.5 aAwkuzc_BFpgCmb_tmDukma_q__aa0o -64 63.5
 /begin AXIS_DESCR COM_AXIS Nkw caoddzd_oAjpfzb_cAcEEha_1nR_oa0 6 -32768 32767 AXIS_PTS_REF AXX_KF_DZWMIN_SPORT_SOT FORMAT "%5.0" MONOTONY STRICT_INCREASE DEPOSIT ABSOLUTE /end AXIS_DESCR
 /begin AXIS_DESCR COM_AXIS V AFeDmkb_cAbjmcc_kAkskhd_k__0oa0 4 0 65535 AXIS_PTS_REF AXY_KF_DZWMIN_SPORT_SOT FORMAT "%5.0" MONOTONY STRICT_INCREASE DEPOSIT ABSOLUTE /end AXIS_DESCR
/end CHARACTERISTIC
/begin CHARACTERISTIC KF_FDZWT_PF1___MGF_CC_FF1_Slot0 "Temperature correction factor for ignition angle knock limit path 1 (Slot 0, Flex Fuel 1)" MAP 0x807C8AB6 _REC_A1CUR_1_MBSE_S2_S1 3.9998779296875 ilxsavd_hkzmBfc_lAzCpAb_nR_1oa0 -2 1.9998779296875 FORMAT "%14.5"
 /begin AXIS_DESCR COM_AXIS Tmot DchEpAd_DBCFgoa_Ckhahgc_q__aoa0 6 -327.68 327.67 AXIS_PTS_REF AXX_KF_FDZWT_PF1 FORMAT "%7.2" MONOTONY STRICT_INCREASE DEPOSIT ABSOLUTE /end AXIS_DESCR
 /begin AXIS_DESCR COM_AXIS Tans BMW_q0p1_degC 6 -3276.8 3276.7 AXIS_PTS_REF AXY_KF_FDZWT_PF1 FORMAT "%6.1" MONOTONY STRICT_INCREASE DEPOSIT ABSOLUTE /end AXIS_DESCR
/end CHARACTERISTIC
/begin CHARACTERISTIC KF_FDZWT_PF2___MGF_CC_FF1_Slot0 "Temperature correction factor for ignition angle knock limit path 2 (Slot 0, Flex Fuel 1)" MAP 0x807C8C1E _REC_A1CUR_1_MBSE_S2_S1 3.9998779296875 ilxsavd_hkzmBfc_lAzCpAb_nR_1oa0 -2 1.9998779296875 FORMAT "%14.5"
 /begin AXIS_DESCR COM_AXIS Tmot DchEpAd_DBCFgoa_Ckhahgc_q__aoa0 6 -327.68 327.67 AXIS_PTS_REF AXX_KF_FDZWT_PF2 FORMAT "%7.2" MONOTONY STRICT_INCREASE DEPOSIT ABSOLUTE /end AXIS_DESCR
 /begin AXIS_DESCR COM_AXIS Tans BMW_q0p1_degC 6 -3276.8 3276.7 AXIS_PTS_REF AXY_KF_FDZWT_PF2 FORMAT "%6.1" MONOTONY STRICT_INCREASE DEPOSIT ABSOLUTE /end AXIS_DESCR
/end CHARACTERISTIC
/begin CHARACTERISTIC KF_FRKKORRF_1___MGF_CC_FF1_Slot0 "Map feedforward correction bank 1 (Slot 0, Flex Fuel 1)" MAP 0x807C9466 _REC_A1CUR_1_MBSE_U2_S1 1.99996948242188 Bhvfwhc_bigEubd_BBEupBd_nR_3oa0 0 1.99996948242188 FORMAT "%14.5"
 /begin AXIS_DESCR COM_AXIS Nkw caoddzd_oAjpfzb_cAcEEha_1nR_oa0 16 -32768 32767 AXIS_PTS_REF AXX_KF_FRKKORRF_1 FORMAT "%5.0" MONOTONY STRICT_INCREASE DEPOSIT ABSOLUTE /end AXIS_DESCR
 /begin AXIS_DESCR COM_AXIS Rf CgkBooc_wkiDfEd_Czglhgc_fR_1a0o 16 -327.68 327.67 AXIS_PTS_REF AXY_KF_FRKKORRF_1 FORMAT "%7.2" MONOTONY STRICT_INCREASE DEPOSIT ABSOLUTE /end AXIS_DESCR
/end CHARACTERISTIC
/begin CHARACTERISTIC KF_FRKKORRF_1___MGF_CC_FF2_Slot0 "Map feedforward correction bank 1 (Slot 0, Flex Fuel 2)" MAP 0x807D233A _REC_A1CUR_1_MBSE_U2_S1 1.99996948242188 Bhvfwhc_bigEubd_BBEupBd_nR_3oa0 0 1.99996948242188 FORMAT "%14.5"
 /begin AXIS_DESCR COM_AXIS Nkw caoddzd_oAjpfzb_cAcEEha_1nR_oa0 16 -32768 32767 AXIS_PTS_REF AXX_KF_FRKKORRF_1 FORMAT "%5.0" MONOTONY STRICT_INCREASE DEPOSIT ABSOLUTE /end AXIS_DESCR
 /begin AXIS_DESCR COM_AXIS Rf CgkBooc_wkiDfEd_Czglhgc_fR_1a0o 16 -327.68 327.67 AXIS_PTS_REF AXY_KF_FRKKORRF_1 FORMAT "%7.2" MONOTONY STRICT_INCREASE DEPOSIT ABSOLUTE /end AXIS_DESCR
/end CHARACTERISTIC
/begin CHARACTERISTIC KF_KLIMA_KKS "Map for converting air flap position depending on climate fan request and vehicle speed" MAP 0x80761B55 _REC_A1CUR_1_MBSE_U1_S1 10 raChrxc_kBtBrmb_FmDuEFa_n__aa0o 0 10
 /begin AXIS_DESCR COM_AXIS Nelueft_klima_wm BMW_q0p3906_PERC 6 0 99.609375 AXIS_PTS_REF AXX_KF_KLIMA_KKS MONOTONY STRICT_INCREASE DEPOSIT ABSOLUTE /end AXIS_DESCR
 /begin AXIS_DESCR COM_AXIS V_wm BMW_q0p1_kilometer_per_hour 6 0 6553.5 AXIS_PTS_REF AXY_KF_KLIMA_KKS MONOTONY STRICT_INCREASE DEPOSIT ABSOLUTE /end AXIS_DESCR
/end CHARACTERISTIC
/begin CHARACTERISTIC KF_LA_EZA "Lambda setpoint for single cylinder deactivation" MAP 0x8071F040 _REC_A1CUR_1_MBSE_U2_S1 15.999755859375 BumqDkc_mryszAa_EcglxAc_nR_4oa0 0 15.999755859375 FORMAT "%9.4"
 /begin AXIS_DESCR COM_AXIS Nkw caoddzd_oAjpfzb_cAcEEha_1nR_oa0 6 -32768 32767 AXIS_PTS_REF AXX_KF_LA_EZA FORMAT "%5.0" MONOTONY STRICT_INCREASE DEPOSIT ABSOLUTE /end AXIS_DESCR
 /begin AXIS_DESCR COM_AXIS Rf CgkBooc_wkiDfEd_Czglhgc_fR_1a0o 6 -327.68 327.67 AXIS_PTS_REF AXY_KF_LA_EZA FORMAT "%7.2" MONOTONY STRICT_INCREASE DEPOSIT ABSOLUTE /end AXIS_DESCR
/end CHARACTERISTIC
/begin CHARACTERISTIC KF_LABAS_1___MGF_CC_FF1_Slot0 "Base lambda in homogeneous mode bank 1 (Slot 0, Flex Fuel 1)" MAP 0x807C9FF6 _REC_A1CUR_1_MBSE_U2_S1 15.999755859375 BumqDkc_mryszAa_EcglxAc_nR_4oa0 0 15.999755859375 FORMAT "%9.4"
 /begin AXIS_DESCR COM_AXIS Nkw caoddzd_oAjpfzb_cAcEEha_1nR_oa0 18 -32768 32767 AXIS_PTS_REF GXX_KF_LABAS FORMAT "%5.0" MONOTONY STRICT_INCREASE DEPOSIT ABSOLUTE /end AXIS_DESCR
 /begin AXIS_DESCR COM_AXIS Rf CgkBooc_wkiDfEd_Czglhgc_fR_1a0o 17 -327.68 327.67 AXIS_PTS_REF GXY_KF_LABAS FORMAT "%7.2" MONOTONY STRICT_INCREASE DEPOSIT ABSOLUTE /end AXIS_DESCR
/end CHARACTERISTIC
/begin CHARACTERISTIC KF_LABAS_1___MGF_CC_FF2_Slot0 "Base lambda in homogeneous mode bank 1 (Slot 0, Flex Fuel 2)" MAP 0x807D2D3A _REC_A1CUR_1_MBSE_U2_S1 15.999755859375 BumqDkc_mryszAa_EcglxAc_nR_4oa0 0 15.999755859375 FORMAT "%9.4"
 /begin AXIS_DESCR COM_AXIS Nkw caoddzd_oAjpfzb_cAcEEha_1nR_oa0 18 -32768 32767 AXIS_PTS_REF GXX_KF_LABAS FORMAT "%5.0" MONOTONY STRICT_INCREASE DEPOSIT ABSOLUTE /end AXIS_DESCR
 /begin AXIS_DESCR COM_AXIS Rf CgkBooc_wkiDfEd_Czglhgc_fR_1a0o 17 -327.68 327.67 AXIS_PTS_REF GXY_KF_LABAS FORMAT "%7.2" MONOTONY STRICT_INCREASE DEPOSIT ABSOLUTE /end AXIS_DESCR
/end CHARACTERISTIC
/begin CHARACTERISTIC KF_LABAS_2___MGF_CC_FF1_Slot0 "Base lambda in homogeneous mode bank 2 (Slot 0, Flex Fuel 1)" MAP 0x807CABEA _REC_A1CUR_1_MBSE_U2_S1 15.999755859375 BumqDkc_mryszAa_EcglxAc_nR_4oa0 0 15.999755859375 FORMAT "%9.4"
 /begin AXIS_DESCR COM_AXIS Nkw caoddzd_oAjpfzb_cAcEEha_1nR_oa0 18 -32768 32767 AXIS_PTS_REF GXX_KF_LABAS FORMAT "%5.0" MONOTONY STRICT_INCREASE DEPOSIT ABSOLUTE /end AXIS_DESCR
 /begin AXIS_DESCR COM_AXIS Rf CgkBooc_wkiDfEd_Czglhgc_fR_1a0o 17 -327.68 327.67 AXIS_PTS_REF GXY_KF_LABAS FORMAT "%7.2" MONOTONY STRICT_INCREASE DEPOSIT ABSOLUTE /end AXIS_DESCR
/end CHARACTERISTIC
/begin CHARACTERISTIC KF_LABAS_2___MGF_CC_FF2_Slot0 "Base lambda in homogeneous mode bank 2 (Slot 0, Flex Fuel 2)" MAP 0x807D392E _REC_A1CUR_1_MBSE_U2_S1 15.999755859375 BumqDkc_mryszAa_EcglxAc_nR_4oa0 0 15.999755859375 FORMAT "%9.4"
 /begin AXIS_DESCR COM_AXIS Nkw caoddzd_oAjpfzb_cAcEEha_1nR_oa0 18 -32768 32767 AXIS_PTS_REF GXX_KF_LABAS FORMAT "%5.0" MONOTONY STRICT_INCREASE DEPOSIT ABSOLUTE /end AXIS_DESCR
 /begin AXIS_DESCR COM_AXIS Rf CgkBooc_wkiDfEd_Czglhgc_fR_1a0o 17 -327.68 327.67 AXIS_PTS_REF GXY_KF_LABAS FORMAT "%7.2" MONOTONY STRICT_INCREASE DEPOSIT ABSOLUTE /end AXIS_DESCR
/end CHARACTERISTIC
/begin CHARACTERISTIC KF_MD_RES_NST_KEY "Torque reserve during post-start" MAP 0x80731C0A _REC_A1CUR_1_MBSE_S2_S1 6553.5 BMW_dm_sw_q0p1_Nm -3276.8 3276.7 FORMAT "%6.1"
 /begin AXIS_DESCR COM_AXIS Tn_start_10 camcxxd_bxlpdsa_Cshlhgc_sR_1a0o 4 0 655.35 AXIS_PTS_REF AXX_KF_MD_RES_NST_KEY FORMAT "%7.2" MONOTONY STRICT_INCREASE DEPOSIT ABSOLUTE /end AXIS_DESCR
 /begin AXIS_DESCR COM_AXIS Tmot DchEpAd_DBCFgoa_Ckhahgc_q__aoa0 4 -327.68 327.67 AXIS_PTS_REF AXY_KF_MD_RES_NST_KEY FORMAT "%7.2" MONOTONY STRICT_INCREASE DEPOSIT ABSOLUTE /end AXIS_DESCR
/end CHARACTERISTIC
/begin CHARACTERISTIC KF_N_GASSTOSS_ANFAHR_KUPP "Max. permissible launch RPM (normal mode) with clutch depressed" MAP 0x807290D2 _REC_A1CUR_1_MBSE_S2_S1 65535 caoddzd_oAjpfzb_cAcEEha_1nR_oa0 -32768 32767 FORMAT "%5.0"
 /begin AXIS_DESCR COM_AXIS NO_INPUT_QUANTITY jgbhAma_smpAegb_hlEBAmd_k__0oa0 6 -655.36 655.34 AXIS_PTS_REF AXX_KF_N_GASSTOSS_UND_ANFAHR FORMAT "%7.2" MONOTONY STRICT_INCREASE DEPOSIT ABSOLUTE /end AXIS_DESCR
 /begin AXIS_DESCR COM_AXIS NO_INPUT_QUANTITY vfyBdwd_ftexgja_BcFdiDd_fR_1a0o 4 -800 799.9755859375 AXIS_PTS_REF AXY_KF_N_GASSTOSS_UND_ANFAHR FORMAT "%7.2" MONOTONY STRICT_INCREASE DEPOSIT ABSOLUTE /end AXIS_DESCR
/end CHARACTERISTIC
/begin CHARACTERISTIC KF_N_GASSTOSS_UND_ANFAHR "Max. permissible launch RPM (normal mode)" MAP 0x80729072 _REC_A1CUR_1_MBSE_S2_S1 65535 caoddzd_oAjpfzb_cAcEEha_1nR_oa0 -32768 32767 FORMAT "%5.0"
 /begin AXIS_DESCR COM_AXIS NO_INPUT_QUANTITY jgbhAma_smpAegb_hlEBAmd_k__0oa0 6 -655.36 655.34 AXIS_PTS_REF AXX_KF_N_GASSTOSS_UND_ANFAHR FORMAT "%7.2" MONOTONY STRICT_INCREASE DEPOSIT ABSOLUTE /end AXIS_DESCR
 /begin AXIS_DESCR COM_AXIS NO_INPUT_QUANTITY vfyBdwd_ftexgja_BcFdiDd_fR_1a0o 4 -800 799.9755859375 AXIS_PTS_REF AXY_KF_N_GASSTOSS_UND_ANFAHR FORMAT "%7.2" MONOTONY STRICT_INCREASE DEPOSIT ABSOLUTE /end AXIS_DESCR
/end CHARACTERISTIC
/begin CHARACTERISTIC KF_NEL_OPF_V "E-fan speed request based on OPF temperature over vehicle speed" MAP 0x80761E56 _REC_A1CUR_1_MBSE_U1_S1 99.609375 BMW_q0p3906_PERC 0 99.609375
 /begin AXIS_DESCR COM_AXIS T_opf_in_wm BMW_q0p1_degC 10 -3276.8 3276.7 AXIS_PTS_REF AXX_KF_NEL_OPF_V MONOTONY STRICT_INCREASE DEPOSIT ABSOLUTE /end AXIS_DESCR
 /begin AXIS_DESCR COM_AXIS V_wm BMW_q0p1_kilometer_per_hour 10 0 6553.5 AXIS_PTS_REF AXY_KF_NEL_OPF_V MONOTONY STRICT_INCREASE DEPOSIT ABSOLUTE /end AXIS_DESCR
/end CHARACTERISTIC
/begin CHARACTERISTIC KF_NEL_TABG "Electric fan speed request due to exhaust gas temperature" MAP 0x80761E46 _REC_A1CUR_1_MBSE_U1_S1 99.609375 BMW_q0p3906_PERC 0 99.609375
 /begin AXIS_DESCR COM_AXIS Tabg_wm BMW_q0p1_degC 4 -3276.8 3276.7 AXIS_PTS_REF AXX_KF_NEL_TABG FORMAT "%6.1" MONOTONY STRICT_INCREASE DEPOSIT ABSOLUTE /end AXIS_DESCR
 /begin AXIS_DESCR COM_AXIS V_wm BMW_q0p1_kilometer_per_hour 4 0 6553.5 AXIS_PTS_REF AXY_KF_NEL_TABG FORMAT "%6.1" MONOTONY STRICT_INCREASE DEPOSIT ABSOLUTE /end AXIS_DESCR
/end CHARACTERISTIC
/begin CHARACTERISTIC KF_NEL_TANS "Electric fan speed request due to intake air temperature" MAP 0x80761E36 _REC_A1CUR_1_MBSE_U1_S1 99.609375 BMW_q0p3906_PERC 0 99.609375
 /begin AXIS_DESCR COM_AXIS Dtans_tumg_wm BMW_q0p1_degC 4 -3276.8 3276.7 AXIS_PTS_REF AXX_KF_NEL_TANS FORMAT "%6.1" MONOTONY STRICT_INCREASE DEPOSIT ABSOLUTE /end AXIS_DESCR
 /begin AXIS_DESCR COM_AXIS Tumg_wm BMW_q0p1_degC 4 -3276.8 3276.7 AXIS_PTS_REF AXY_KF_NEL_TANS FORMAT "%6.1" MONOTONY STRICT_INCREASE DEPOSIT ABSOLUTE /end AXIS_DESCR
/end CHARACTERISTIC
/begin CHARACTERISTIC KF_NEL_TGET "E-fan speed request based on transmission oil temperature and speed" MAP 0x80761DF6 _REC_A1CUR_1_MBSE_U1_S1 99.609375 BMW_q0p3906_PERC 0 99.609375
 /begin AXIS_DESCR COM_AXIS Tget_wm DchEpAd_DBCFgoa_Ckhahgc_q__aoa0 8 -327.68 327.67 AXIS_PTS_REF AXX_KF_NEL_TGET FORMAT "%6.2" MONOTONY STRICT_INCREASE DEPOSIT ABSOLUTE /end AXIS_DESCR
 /begin AXIS_DESCR COM_AXIS V_wm BMW_q0p1_kilometer_per_hour 8 0 6553.5 AXIS_PTS_REF AXY_KF_NEL_TGET MONOTONY STRICT_INCREASE DEPOSIT ABSOLUTE /end AXIS_DESCR
/end CHARACTERISTIC
/begin CHARACTERISTIC KF_NEL_TMOT_TKA "E-fan speed request based on delta coolant target temp to engine temp over radiator outlet temp" MAP 0x80761D96 _REC_A1CUR_1_MBSE_U1_S1 99.609375 BMW_q0p3906_PERC 0 99.609375
 /begin AXIS_DESCR COM_AXIS Dtmot_tkwsoll_f DchEpAd_DBCFgoa_Ckhahgc_q__aoa0 12 -327.68 327.67 AXIS_PTS_REF AXX_KF_NEL_TMOT_TKA FORMAT "%6.2" MONOTONY STRICT_INCREASE DEPOSIT ABSOLUTE /end AXIS_DESCR
 /begin AXIS_DESCR COM_AXIS Dtkwsoll_tka_f DchEpAd_DBCFgoa_Ckhahgc_q__aoa0 8 -327.68 327.67 AXIS_PTS_REF AXY_KF_NEL_TMOT_TKA FORMAT "%6.2" MONOTONY STRICT_INCREASE DEPOSIT ABSOLUTE /end AXIS_DESCR
/end CHARACTERISTIC
/begin CHARACTERISTIC KF_NEL_VSKR "E-fan speed request based on fuel consumption" MAP 0x80761D7E _REC_A1CUR_1_MBSE_U1_S1 99.609375 BMW_q0p3906_PERC 0 99.609375
 /begin AXIS_DESCR COM_AXIS Vskr_mw_wm fpBesqd_hAxmiba_AAwtged_u__0oa0 6 0 65535 AXIS_PTS_REF AXX_KF_NEL_VSKR MONOTONY STRICT_INCREASE DEPOSIT ABSOLUTE /end AXIS_DESCR
 /begin AXIS_DESCR COM_AXIS V_wm BMW_q0p1_kilometer_per_hour 4 0 6553.5 AXIS_PTS_REF AXY_KF_NEL_VSKR FORMAT "%6.1" MONOTONY STRICT_INCREASE DEPOSIT ABSOLUTE /end AXIS_DESCR
/end CHARACTERISTIC
/begin CHARACTERISTIC KF_NEWP_LLK_TANS "EW_LLK request depending on intake air temperature and difference between intake air temperature and ambient temperature" MAP 0x807620BB _REC_A1CUR_1_MBSE_U1_S1 100 nnxvdDd_vDnjvqd_FmDuEEa_f__aa0o 0 100
 /begin AXIS_DESCR COM_AXIS Dtans_tumg_wm BMW_q0p1_degC 6 -3276.8 3276.7 AXIS_PTS_REF AXX_KF_NEWP_LLK_TANS MONOTONY STRICT_INCREASE DEPOSIT ABSOLUTE /end AXIS_DESCR
 /begin AXIS_DESCR COM_AXIS Tumg_wm BMW_q0p1_degC 6 -3276.8 3276.7 AXIS_PTS_REF AXY_KF_NEWP_LLK_TANS MONOTONY STRICT_INCREASE DEPOSIT ABSOLUTE /end AXIS_DESCR
/end CHARACTERISTIC
/begin CHARACTERISTIC KF_NMAX_ANFAHR_MODE_0 "Max. permissible launch RPM (normal mode)" MAP 0x807294EE _REC_A1CUR_1_MBSE_S2_S1 65535 caoddzd_oAjpfzb_cAcEEha_1nR_oa0 -32768 32767 FORMAT "%5.0"
 /begin AXIS_DESCR COM_AXIS NO_INPUT_QUANTITY jgbhAma_smpAegb_hlEBAmd_k__0oa0 6 -655.36 655.34 AXIS_PTS_REF AXX_KF_NMAX_ANFAHR_MODE_0 FORMAT "%7.2" MONOTONY STRICT_INCREASE DEPOSIT ABSOLUTE /end AXIS_DESCR
 /begin AXIS_DESCR COM_AXIS NO_INPUT_QUANTITY vfyBdwd_ftexgja_BcFdiDd_fR_1a0o 4 -800 799.9755859375 AXIS_PTS_REF AXY_KF_NMAX_ANFAHR_MODE_0 FORMAT "%7.2" MONOTONY STRICT_INCREASE DEPOSIT ABSOLUTE /end AXIS_DESCR
/end CHARACTERISTIC
/begin CHARACTERISTIC KF_NMAX_ANFAHR_MODE_1 "Max. permissible launch RPM (A_max mode / DTC)" MAP 0x807294BE _REC_A1CUR_1_MBSE_S2_S1 65535 caoddzd_oAjpfzb_cAcEEha_1nR_oa0 -32768 32767 FORMAT "%5.0"
 /begin AXIS_DESCR COM_AXIS NO_INPUT_QUANTITY jgbhAma_smpAegb_hlEBAmd_k__0oa0 6 -655.36 655.34 AXIS_PTS_REF AXX_KF_NMAX_ANFAHR_MODE_1 FORMAT "%7.2" MONOTONY STRICT_INCREASE DEPOSIT ABSOLUTE /end AXIS_DESCR
 /begin AXIS_DESCR COM_AXIS NO_INPUT_QUANTITY vfyBdwd_ftexgja_BcFdiDd_fR_1a0o 4 -800 799.9755859375 AXIS_PTS_REF AXY_KF_NMAX_ANFAHR_MODE_1 FORMAT "%7.2" MONOTONY STRICT_INCREASE DEPOSIT ABSOLUTE /end AXIS_DESCR
/end CHARACTERISTIC
/begin CHARACTERISTIC KF_NMAX_ANFAHR_MODE_2 "Max. permissible launch RPM (smoky burnout mode / DSC off)" MAP 0x8072948E _REC_A1CUR_1_MBSE_S2_S1 65535 caoddzd_oAjpfzb_cAcEEha_1nR_oa0 -32768 32767 FORMAT "%5.0"
 /begin AXIS_DESCR COM_AXIS NO_INPUT_QUANTITY jgbhAma_smpAegb_hlEBAmd_k__0oa0 6 -655.36 655.34 AXIS_PTS_REF AXX_KF_NMAX_ANFAHR_MODE_2 FORMAT "%7.2" MONOTONY STRICT_INCREASE DEPOSIT ABSOLUTE /end AXIS_DESCR
 /begin AXIS_DESCR COM_AXIS NO_INPUT_QUANTITY vfyBdwd_ftexgja_BcFdiDd_fR_1a0o 4 -800 799.9755859375 AXIS_PTS_REF AXY_KF_NMAX_ANFAHR_MODE_2 FORMAT "%7.2" MONOTONY STRICT_INCREASE DEPOSIT ABSOLUTE /end AXIS_DESCR
/end CHARACTERISTIC
/begin CHARACTERISTIC KF_PHA_H_B1_W___MGF_CC_FF1_Slot0 "Map start angle injection event 1 warm (Slot 0, Flex Fuel 1)" MAP 0x807CB20E _REC_A1CUR_1_MBSE_S2_S1 1535.9765625 aEmoCzd_erpwvfb_msfkhgc_qR_1a0o -768 767.9765625
 /begin AXIS_DESCR COM_AXIS Nkw caoddzd_oAjpfzb_cAcEEha_1nR_oa0 10 -32768 32767 AXIS_PTS_REF GXX_KF_PHA_H_B1_BAS FORMAT "%5.0" MONOTONY STRICT_INCREASE DEPOSIT ABSOLUTE /end AXIS_DESCR
 /begin AXIS_DESCR COM_AXIS NO_INPUT_QUANTITY zyyxBpb_rEsnvtc_gktukCa_fR_5a0o 12 -1600 1599.951171875 AXIS_PTS_REF GXY_KF_PHA_H_B1_BAS FORMAT "%8.3" MONOTONY STRICT_INCREASE DEPOSIT ABSOLUTE /end AXIS_DESCR
/end CHARACTERISTIC
/begin CHARACTERISTIC KF_PHA_H_B1_W___MGF_CC_FF2_Slot0 "Map start angle injection event 1 warm (Slot 0, Flex Fuel 2)" MAP 0x807D4522 _REC_A1CUR_1_MBSE_S2_S1 1535.9765625 aEmoCzd_erpwvfb_msfkhgc_qR_1a0o -768 767.9765625
 /begin AXIS_DESCR COM_AXIS Nkw caoddzd_oAjpfzb_cAcEEha_1nR_oa0 10 -32768 32767 AXIS_PTS_REF GXX_KF_PHA_H_B1_BAS FORMAT "%5.0" MONOTONY STRICT_INCREASE DEPOSIT ABSOLUTE /end AXIS_DESCR
 /begin AXIS_DESCR COM_AXIS NO_INPUT_QUANTITY zyyxBpb_rEsnvtc_gktukCa_fR_5a0o 12 -1600 1599.951171875 AXIS_PTS_REF GXY_KF_PHA_H_B1_BAS FORMAT "%8.3" MONOTONY STRICT_INCREASE DEPOSIT ABSOLUTE /end AXIS_DESCR
/end CHARACTERISTIC
/begin CHARACTERISTIC KF_PHA_H_E1___MGF_CC_FF1_Slot0 "KF_PHA_H_E1 (Slot 0, Flex Fuel 1)" MAP 0x807CB8BE _REC_A1CUR_1_MBSE_S2_S1 1535.9765625 ridxkCa_Dxvxtdc_CChkhgc_nR_1a0o -768 767.9765625
 /begin AXIS_DESCR COM_AXIS Nkw caoddzd_oAjpfzb_cAcEEha_1nR_oa0 8 -32768 32767 AXIS_PTS_REF AXX_KF_PHA_H_E1 FORMAT "%5.0" MONOTONY STRICT_INCREASE DEPOSIT ABSOLUTE /end AXIS_DESCR
 /begin AXIS_DESCR COM_AXIS NO_INPUT_QUANTITY zyyxBpb_rEsnvtc_gktukCa_fR_5a0o 8 -1600 1599.951171875 AXIS_PTS_REF AXY_KF_PHA_H_E1 MONOTONY STRICT_INCREASE DEPOSIT ABSOLUTE /end AXIS_DESCR
/end CHARACTERISTIC
/begin CHARACTERISTIC KF_PHA_H_E1___MGF_CC_FF2_Slot0 "KF_PHA_H_E1 (Slot 0, Flex Fuel 2)" MAP 0x807D49D2 _REC_A1CUR_1_MBSE_S2_S1 1535.9765625 ridxkCa_Dxvxtdc_CChkhgc_nR_1a0o -768 767.9765625
 /begin AXIS_DESCR COM_AXIS Nkw caoddzd_oAjpfzb_cAcEEha_1nR_oa0 8 -32768 32767 AXIS_PTS_REF AXX_KF_PHA_H_E1 FORMAT "%5.0" MONOTONY STRICT_INCREASE DEPOSIT ABSOLUTE /end AXIS_DESCR
 /begin AXIS_DESCR COM_AXIS NO_INPUT_QUANTITY zyyxBpb_rEsnvtc_gktukCa_fR_5a0o 8 -1600 1599.951171875 AXIS_PTS_REF AXY_KF_PHA_H_E1 MONOTONY STRICT_INCREASE DEPOSIT ABSOLUTE /end AXIS_DESCR
/end CHARACTERISTIC
/begin CHARACTERISTIC KF_TA_IKSOLL "Target temperature for exhaust gas temperature in catalyst" MAP 0x80719E2C _REC_A1CUR_1_MBSE_S2_S1 6553.5 BMW_q0p1_degC -3276.8 3276.7 FORMAT "%6.1"
 /begin AXIS_DESCR COM_AXIS Nkw_atm caoddzd_oAjpfzb_cAcEEha_1nR_oa0 4 -32768 32767 AXIS_PTS_REF AXX_KF_TA_IKSOLL MONOTONY STRICT_INCREASE DEPOSIT ABSOLUTE /end AXIS_DESCR
 /begin AXIS_DESCR COM_AXIS Rf_atm CgkBooc_wkiDfEd_Czglhgc_fR_1a0o 4 -327.68 327.67 AXIS_PTS_REF AXY_KF_TA_IKSOLL MONOTONY STRICT_INCREASE DEPOSIT ABSOLUTE /end AXIS_DESCR
/end CHARACTERISTIC
/begin CHARACTERISTIC KF_TA_VKSOLL "Target temperature for exhaust gas temperature mixing section" MAP 0x80719E0C _REC_A1CUR_1_MBSE_S2_S1 6553.5 BMW_q0p1_degC -3276.8 3276.7 FORMAT "%6.1"
 /begin AXIS_DESCR COM_AXIS Nkw_atm caoddzd_oAjpfzb_cAcEEha_1nR_oa0 4 -32768 32767 AXIS_PTS_REF AXX_KF_TA_VKSOLL MONOTONY STRICT_INCREASE DEPOSIT ABSOLUTE /end AXIS_DESCR
 /begin AXIS_DESCR COM_AXIS Rf_atm CgkBooc_wkiDfEd_Czglhgc_fR_1a0o 4 -327.68 327.67 AXIS_PTS_REF AXY_KF_TA_VKSOLL MONOTONY STRICT_INCREASE DEPOSIT ABSOLUTE /end AXIS_DESCR
/end CHARACTERISTIC
/begin CHARACTERISTIC KF_ZW_PF1___MGF_CC_FF1_Slot0 "Base ignition angle path 1 (Slot 0, Flex Fuel 1)" MAP 0x807CCFBE _REC_A1CUR_1_MBSE_S1_S1 127.5 aAwkuzc_BFpgCmb_tmDukma_q__aa0o -64 63.5 FORMAT "%4.1"
 /begin AXIS_DESCR COM_AXIS Nkw caoddzd_oAjpfzb_cAcEEha_1nR_oa0 20 -32768 32767 AXIS_PTS_REF AXX_KF_ZW_PF1 FORMAT "%5.0" MONOTONY STRICT_INCREASE DEPOSIT ABSOLUTE /end AXIS_DESCR
 /begin AXIS_DESCR COM_AXIS NO_INPUT_QUANTITY CgkBooc_wkiDfEd_Czglhgc_fR_1a0o 20 -327.68 327.67 AXIS_PTS_REF AXY_KF_ZW_PF1 FORMAT "%9.2" MONOTONY STRICT_INCREASE DEPOSIT ABSOLUTE /end AXIS_DESCR
/end CHARACTERISTIC
/begin CHARACTERISTIC KF_ZW_PF2___MGF_CC_FF1_Slot0 "Base ignition angle path 2 (Slot 0, Flex Fuel 1)" MAP 0x807CD78E _REC_A1CUR_1_MBSE_S1_S1 127.5 aAwkuzc_BFpgCmb_tmDukma_q__aa0o -64 63.5 FORMAT "%4.1"
 /begin AXIS_DESCR COM_AXIS Nkw caoddzd_oAjpfzb_cAcEEha_1nR_oa0 20 -32768 32767 AXIS_PTS_REF AXX_KF_ZW_PF2 FORMAT "%5.0" MONOTONY STRICT_INCREASE DEPOSIT ABSOLUTE /end AXIS_DESCR
 /begin AXIS_DESCR COM_AXIS NO_INPUT_QUANTITY CgkBooc_wkiDfEd_Czglhgc_fR_1a0o 20 -327.68 327.67 AXIS_PTS_REF AXY_KF_ZW_PF2 FORMAT "%9.2" MONOTONY STRICT_INCREASE DEPOSIT ABSOLUTE /end AXIS_DESCR
/end CHARACTERISTIC
/begin CHARACTERISTIC KF_ZW_S_PF1___MGF_CC_FF1_Slot0 "Base ignition angle path 1 safe (Slot 0, Flex Fuel 1)" MAP 0x807CDF5E _REC_A1CUR_1_MBSE_S1_S1 127.5 aAwkuzc_BFpgCmb_tmDukma_q__aa0o -64 63.5 FORMAT "%4.1"
 /begin AXIS_DESCR COM_AXIS Nkw caoddzd_oAjpfzb_cAcEEha_1nR_oa0 20 -32768 32767 AXIS_PTS_REF AXX_KF_ZW_S_PF1 FORMAT "%5.0" MONOTONY STRICT_INCREASE DEPOSIT ABSOLUTE /end AXIS_DESCR
 /begin AXIS_DESCR COM_AXIS NO_INPUT_QUANTITY CgkBooc_wkiDfEd_Czglhgc_fR_1a0o 20 -327.68 327.67 AXIS_PTS_REF AXY_KF_ZW_S_PF1 FORMAT "%9.2" MONOTONY STRICT_INCREASE DEPOSIT ABSOLUTE /end AXIS_DESCR
/end CHARACTERISTIC
/begin CHARACTERISTIC KF_ZW_S_PF2___MGF_CC_FF1_Slot0 "Base ignition angle path 2 safe (Slot 0, Flex Fuel 1)" MAP 0x807CE72E _REC_A1CUR_1_MBSE_S1_S1 127.5 aAwkuzc_BFpgCmb_tmDukma_q__aa0o -64 63.5 FORMAT "%4.1"
 /begin AXIS_DESCR COM_AXIS Nkw caoddzd_oAjpfzb_cAcEEha_1nR_oa0 20 -32768 32767 AXIS_PTS_REF AXX_KF_ZW_S_PF2 FORMAT "%5.0" MONOTONY STRICT_INCREASE DEPOSIT ABSOLUTE /end AXIS_DESCR
 /begin AXIS_DESCR COM_AXIS NO_INPUT_QUANTITY CgkBooc_wkiDfEd_Czglhgc_fR_1a0o 20 -327.68 327.67 AXIS_PTS_REF AXY_KF_ZW_S_PF2 FORMAT "%9.2" MONOTONY STRICT_INCREASE DEPOSIT ABSOLUTE /end AXIS_DESCR
/end CHARACTERISTIC
/begin CHARACTERISTIC KF_ZW_UESP_PF1___MGF_CC_FF1_Slot0 "Base ignition angle scavenging path 1 (Slot 0, Flex Fuel 1)" MAP 0x807CEAEE _REC_A1CUR_1_MBSE_S1_S1 127.5 aAwkuzc_BFpgCmb_tmDukma_q__aa0o -64 63.5 FORMAT "%4.1"
 /begin AXIS_DESCR COM_AXIS Nkw caoddzd_oAjpfzb_cAcEEha_1nR_oa0 10 -32768 32767 AXIS_PTS_REF AXX_KF_ZW_UESP_PF1 FORMAT "%5.0" MONOTONY STRICT_INCREASE DEPOSIT ABSOLUTE /end AXIS_DESCR
 /begin AXIS_DESCR COM_AXIS NO_INPUT_QUANTITY CgkBooc_wkiDfEd_Czglhgc_fR_1a0o 14 -327.68 327.67 AXIS_PTS_REF AXY_KF_ZW_UESP_PF1 FORMAT "%9.2" MONOTONY STRICT_INCREASE DEPOSIT ABSOLUTE /end AXIS_DESCR
/end CHARACTERISTIC
/begin CHARACTERISTIC KF_ZW_UESP_PF2___MGF_CC_FF1_Slot0 "Base ignition angle scavenging path 2 (Slot 0, Flex Fuel 1)" MAP 0x807CEFDA _REC_A1CUR_1_MBSE_S1_S1 127.5 aAwkuzc_BFpgCmb_tmDukma_q__aa0o -64 63.5 FORMAT "%4.1"
 /begin AXIS_DESCR COM_AXIS Nkw caoddzd_oAjpfzb_cAcEEha_1nR_oa0 10 -32768 32767 AXIS_PTS_REF AXX_KF_ZW_UESP_PF2 FORMAT "%5.0" MONOTONY STRICT_INCREASE DEPOSIT ABSOLUTE /end AXIS_DESCR
 /begin AXIS_DESCR COM_AXIS NO_INPUT_QUANTITY CgkBooc_wkiDfEd_Czglhgc_fR_1a0o 14 -327.68 327.67 AXIS_PTS_REF AXY_KF_ZW_UESP_PF2 FORMAT "%9.2" MONOTONY STRICT_INCREASE DEPOSIT ABSOLUTE /end AXIS_DESCR
/end CHARACTERISTIC
/begin CHARACTERISTIC KF_ZW_VP_PF1___MGF_CC_FF1_Slot0 "Map for ignition angle with VANOS at stop F_basis=1 path 1 (Slot 0, Flex Fuel 1)" MAP 0x807CF796 _REC_A1CUR_1_MBSE_S1_S1 127.5 aAwkuzc_BFpgCmb_tmDukma_q__aa0o -64 63.5 FORMAT "%4.1"
 /begin AXIS_DESCR COM_AXIS Nkw caoddzd_oAjpfzb_cAcEEha_1nR_oa0 20 -32768 32767 AXIS_PTS_REF AXX_KF_ZW_VP_PF1 FORMAT "%5.0" MONOTONY STRICT_INCREASE DEPOSIT ABSOLUTE /end AXIS_DESCR
 /begin AXIS_DESCR COM_AXIS Rf_zwv CgkBooc_wkiDfEd_Czglhgc_fR_1a0o 16 -327.68 327.67 AXIS_PTS_REF AXY_KF_ZW_VP_PF1 FORMAT "%9.2" MONOTONY STRICT_INCREASE DEPOSIT ABSOLUTE /end AXIS_DESCR
/end CHARACTERISTIC
/begin CHARACTERISTIC KF_ZW_VP_PF2___MGF_CC_FF1_Slot0 "Map for ignition angle with VANOS at stop F_basis=1 path 2 (Slot 0, Flex Fuel 1)" MAP 0x807CFDD6 _REC_A1CUR_1_MBSE_S1_S1 127.5 aAwkuzc_BFpgCmb_tmDukma_q__aa0o -64 63.5 FORMAT "%4.1"
 /begin AXIS_DESCR COM_AXIS Nkw caoddzd_oAjpfzb_cAcEEha_1nR_oa0 20 -32768 32767 AXIS_PTS_REF AXX_KF_ZW_VP_PF2 FORMAT "%5.0" MONOTONY STRICT_INCREASE DEPOSIT ABSOLUTE /end AXIS_DESCR
 /begin AXIS_DESCR COM_AXIS Rf_zwv CgkBooc_wkiDfEd_Czglhgc_fR_1a0o 16 -327.68 327.67 AXIS_PTS_REF AXY_KF_ZW_VP_PF2 FORMAT "%9.2" MONOTONY STRICT_INCREASE DEPOSIT ABSOLUTE /end AXIS_DESCR
/end CHARACTERISTIC
/begin CHARACTERISTIC KF_ZWMIN_KSOT "Minimum ignition angle for sound tuning cold" MAP 0x8075E121 _REC_A1CUR_1_MBSE_S1_S1 127.5 aAwkuzc_BFpgCmb_tmDukma_q__aa0o -64 63.5
 /begin AXIS_DESCR COM_AXIS Nkw caoddzd_oAjpfzb_cAcEEha_1nR_oa0 8 -32768 32767 AXIS_PTS_REF AXX_KF_ZWMIN_KSOT FORMAT "%5.0" MONOTONY STRICT_INCREASE DEPOSIT ABSOLUTE /end AXIS_DESCR
 /begin AXIS_DESCR COM_AXIS NO_INPUT_QUANTITY CgkBooc_wkiDfEd_Czglhgc_fR_1a0o 8 -327.68 327.67 AXIS_PTS_REF AXY_KF_ZWMIN_KSOT FORMAT "%9.4" MONOTONY STRICT_INCREASE DEPOSIT ABSOLUTE /end AXIS_DESCR
/end CHARACTERISTIC
/begin CHARACTERISTIC KF_ZWMIN_KSOT___MGF_CC_PF_Slot0 "Minimum ignition angle for sound tuning cold (Slot 0, at 0 RPM, X-Axis and Y-Axis do not switch, OEM Address)" MAP 0x8075E121 _REC_A1CUR_1_MBSE_S1_S1 127.5 aAwkuzc_BFpgCmb_tmDukma_q__aa0o -64 63.5
 /begin AXIS_DESCR COM_AXIS Nkw caoddzd_oAjpfzb_cAcEEha_1nR_oa0 8 -32768 32767 AXIS_PTS_REF AXX_KF_ZWMIN_KSOT FORMAT "%5.0" MONOTONY STRICT_INCREASE DEPOSIT ABSOLUTE /end AXIS_DESCR
 /begin AXIS_DESCR COM_AXIS NO_INPUT_QUANTITY CgkBooc_wkiDfEd_Czglhgc_fR_1a0o 8 -327.68 327.67 AXIS_PTS_REF AXY_KF_ZWMIN_KSOT FORMAT "%9.4" MONOTONY STRICT_INCREASE DEPOSIT ABSOLUTE /end AXIS_DESCR
/end CHARACTERISTIC
/begin CHARACTERISTIC KF_ZWMIN_KSOT___MGF_CC_PF_Slot1 "Minimum ignition angle for sound tuning cold (Slot 1, at 1000 RPM, X-Axis and Y-Axis do not switch, Pump Fuel)" MAP 0x807C77A6 _REC_A1CUR_1_MBSE_S1_S1 127.5 aAwkuzc_BFpgCmb_tmDukma_q__aa0o -64 63.5
 /begin AXIS_DESCR COM_AXIS Nkw caoddzd_oAjpfzb_cAcEEha_1nR_oa0 8 -32768 32767 AXIS_PTS_REF AXX_KF_ZWMIN_KSOT FORMAT "%5.0" MONOTONY STRICT_INCREASE DEPOSIT ABSOLUTE /end AXIS_DESCR
 /begin AXIS_DESCR COM_AXIS NO_INPUT_QUANTITY CgkBooc_wkiDfEd_Czglhgc_fR_1a0o 8 -327.68 327.67 AXIS_PTS_REF AXY_KF_ZWMIN_KSOT FORMAT "%9.4" MONOTONY STRICT_INCREASE DEPOSIT ABSOLUTE /end AXIS_DESCR
/end CHARACTERISTIC
/begin CHARACTERISTIC KF_ZWMIN_KSOT___MGF_CC_PF_Slot2 "Minimum ignition angle for sound tuning cold (Slot 2, at 2000 RPM, X-Axis and Y-Axis do not switch, Pump Fuel)" MAP 0x807C77E6 _REC_A1CUR_1_MBSE_S1_S1 127.5 aAwkuzc_BFpgCmb_tmDukma_q__aa0o -64 63.5
 /begin AXIS_DESCR COM_AXIS Nkw caoddzd_oAjpfzb_cAcEEha_1nR_oa0 8 -32768 32767 AXIS_PTS_REF AXX_KF_ZWMIN_KSOT FORMAT "%5.0" MONOTONY STRICT_INCREASE DEPOSIT ABSOLUTE /end AXIS_DESCR
 /begin AXIS_DESCR COM_AXIS NO_INPUT_QUANTITY CgkBooc_wkiDfEd_Czglhgc_fR_1a0o 8 -327.68 327.67 AXIS_PTS_REF AXY_KF_ZWMIN_KSOT FORMAT "%9.4" MONOTONY STRICT_INCREASE DEPOSIT ABSOLUTE /end AXIS_DESCR
/end CHARACTERISTIC
/begin CHARACTERISTIC KF_ZWMIN_KSOT___MGF_CC_PF_Slot3 "Minimum ignition angle for sound tuning cold (Slot 3, at 3000 RPM, X-Axis and Y-Axis do not switch, Pump Fuel)" MAP 0x807C7826 _REC_A1CUR_1_MBSE_S1_S1 127.5 aAwkuzc_BFpgCmb_tmDukma_q__aa0o -64 63.5
 /begin AXIS_DESCR COM_AXIS Nkw caoddzd_oAjpfzb_cAcEEha_1nR_oa0 8 -32768 32767 AXIS_PTS_REF AXX_KF_ZWMIN_KSOT FORMAT "%5.0" MONOTONY STRICT_INCREASE DEPOSIT ABSOLUTE /end AXIS_DESCR
 /begin AXIS_DESCR COM_AXIS NO_INPUT_QUANTITY CgkBooc_wkiDfEd_Czglhgc_fR_1a0o 8 -327.68 327.67 AXIS_PTS_REF AXY_KF_ZWMIN_KSOT FORMAT "%9.4" MONOTONY STRICT_INCREASE DEPOSIT ABSOLUTE /end AXIS_DESCR
/end CHARACTERISTIC
/begin CHARACTERISTIC KF_ZWMIN_KSOT___MGF_CC_PF_Slot4 "Minimum ignition angle for sound tuning cold (Slot 4, at 4000 RPM, X-Axis and Y-Axis do not switch, Pump Fuel)" MAP 0x807C7866 _REC_A1CUR_1_MBSE_S1_S1 127.5 aAwkuzc_BFpgCmb_tmDukma_q__aa0o -64 63.5
 /begin AXIS_DESCR COM_AXIS Nkw caoddzd_oAjpfzb_cAcEEha_1nR_oa0 8 -32768 32767 AXIS_PTS_REF AXX_KF_ZWMIN_KSOT FORMAT "%5.0" MONOTONY STRICT_INCREASE DEPOSIT ABSOLUTE /end AXIS_DESCR
 /begin AXIS_DESCR COM_AXIS NO_INPUT_QUANTITY CgkBooc_wkiDfEd_Czglhgc_fR_1a0o 8 -327.68 327.67 AXIS_PTS_REF AXY_KF_ZWMIN_KSOT FORMAT "%9.4" MONOTONY STRICT_INCREASE DEPOSIT ABSOLUTE /end AXIS_DESCR
/end CHARACTERISTIC
/begin CHARACTERISTIC KF_ZWMIN_KSOT___MGF_CC_PF_Slot5 "Minimum ignition angle for sound tuning cold (Slot 5, at 5000 RPM, X-Axis and Y-Axis do not switch, Pump Fuel)" MAP 0x807C78A6 _REC_A1CUR_1_MBSE_S1_S1 127.5 aAwkuzc_BFpgCmb_tmDukma_q__aa0o -64 63.5
 /begin AXIS_DESCR COM_AXIS Nkw caoddzd_oAjpfzb_cAcEEha_1nR_oa0 8 -32768 32767 AXIS_PTS_REF AXX_KF_ZWMIN_KSOT FORMAT "%5.0" MONOTONY STRICT_INCREASE DEPOSIT ABSOLUTE /end AXIS_DESCR
 /begin AXIS_DESCR COM_AXIS NO_INPUT_QUANTITY CgkBooc_wkiDfEd_Czglhgc_fR_1a0o 8 -327.68 327.67 AXIS_PTS_REF AXY_KF_ZWMIN_KSOT FORMAT "%9.4" MONOTONY STRICT_INCREASE DEPOSIT ABSOLUTE /end AXIS_DESCR
/end CHARACTERISTIC
/begin CHARACTERISTIC KF_ZWMIN_WSOT "Minimum ignition angle for sound tuning warm" MAP 0x8075E0E1 _REC_A1CUR_1_MBSE_S1_S1 127.5 aAwkuzc_BFpgCmb_tmDukma_q__aa0o -64 63.5
 /begin AXIS_DESCR COM_AXIS Nkw caoddzd_oAjpfzb_cAcEEha_1nR_oa0 8 -32768 32767 AXIS_PTS_REF AXX_KF_ZWMIN_WSOT FORMAT "%5.0" MONOTONY STRICT_INCREASE DEPOSIT ABSOLUTE /end AXIS_DESCR
 /begin AXIS_DESCR COM_AXIS NO_INPUT_QUANTITY CgkBooc_wkiDfEd_Czglhgc_fR_1a0o 8 -327.68 327.67 AXIS_PTS_REF AXY_KF_ZWMIN_WSOT FORMAT "%9.4" MONOTONY STRICT_INCREASE DEPOSIT ABSOLUTE /end AXIS_DESCR
/end CHARACTERISTIC
/begin CHARACTERISTIC KF_ZWMIN_WSOT___MGF_CC_PF_Slot0 "Minimum ignition angle for sound tuning warm (Slot 0, at 0 RPM, X-Axis and Y-Axis do not switch, OEM Address)" MAP 0x8075E0E1 _REC_A1CUR_1_MBSE_S1_S1 127.5 aAwkuzc_BFpgCmb_tmDukma_q__aa0o -64 63.5
 /begin AXIS_DESCR COM_AXIS Nkw caoddzd_oAjpfzb_cAcEEha_1nR_oa0 8 -32768 32767 AXIS_PTS_REF AXX_KF_ZWMIN_WSOT FORMAT "%5.0" MONOTONY STRICT_INCREASE DEPOSIT ABSOLUTE /end AXIS_DESCR
 /begin AXIS_DESCR COM_AXIS NO_INPUT_QUANTITY CgkBooc_wkiDfEd_Czglhgc_fR_1a0o 8 -327.68 327.67 AXIS_PTS_REF AXY_KF_ZWMIN_WSOT FORMAT "%9.4" MONOTONY STRICT_INCREASE DEPOSIT ABSOLUTE /end AXIS_DESCR
/end CHARACTERISTIC
/begin CHARACTERISTIC KF_ZWMIN_WSOT___MGF_CC_PF_Slot1 "Minimum ignition angle for sound tuning warm (Slot 1, at 1000 RPM, X-Axis and Y-Axis do not switch, Pump Fuel)" MAP 0x807C78E6 _REC_A1CUR_1_MBSE_S1_S1 127.5 aAwkuzc_BFpgCmb_tmDukma_q__aa0o -64 63.5
 /begin AXIS_DESCR COM_AXIS Nkw caoddzd_oAjpfzb_cAcEEha_1nR_oa0 8 -32768 32767 AXIS_PTS_REF AXX_KF_ZWMIN_WSOT FORMAT "%5.0" MONOTONY STRICT_INCREASE DEPOSIT ABSOLUTE /end AXIS_DESCR
 /begin AXIS_DESCR COM_AXIS NO_INPUT_QUANTITY CgkBooc_wkiDfEd_Czglhgc_fR_1a0o 8 -327.68 327.67 AXIS_PTS_REF AXY_KF_ZWMIN_WSOT FORMAT "%9.4" MONOTONY STRICT_INCREASE DEPOSIT ABSOLUTE /end AXIS_DESCR
/end CHARACTERISTIC
/begin CHARACTERISTIC KF_ZWMIN_WSOT___MGF_CC_PF_Slot2 "Minimum ignition angle for sound tuning warm (Slot 2, at 2000 RPM, X-Axis and Y-Axis do not switch, Pump Fuel)" MAP 0x807C7926 _REC_A1CUR_1_MBSE_S1_S1 127.5 aAwkuzc_BFpgCmb_tmDukma_q__aa0o -64 63.5
 /begin AXIS_DESCR COM_AXIS Nkw caoddzd_oAjpfzb_cAcEEha_1nR_oa0 8 -32768 32767 AXIS_PTS_REF AXX_KF_ZWMIN_WSOT FORMAT "%5.0" MONOTONY STRICT_INCREASE DEPOSIT ABSOLUTE /end AXIS_DESCR
 /begin AXIS_DESCR COM_AXIS NO_INPUT_QUANTITY CgkBooc_wkiDfEd_Czglhgc_fR_1a0o 8 -327.68 327.67 AXIS_PTS_REF AXY_KF_ZWMIN_WSOT FORMAT "%9.4" MONOTONY STRICT_INCREASE DEPOSIT ABSOLUTE /end AXIS_DESCR
/end CHARACTERISTIC
/begin CHARACTERISTIC KF_ZWMIN_WSOT___MGF_CC_PF_Slot3 "Minimum ignition angle for sound tuning warm (Slot 3, at 3000 RPM, X-Axis and Y-Axis do not switch, Pump Fuel)" MAP 0x807C7966 _REC_A1CUR_1_MBSE_S1_S1 127.5 aAwkuzc_BFpgCmb_tmDukma_q__aa0o -64 63.5
 /begin AXIS_DESCR COM_AXIS Nkw caoddzd_oAjpfzb_cAcEEha_1nR_oa0 8 -32768 32767 AXIS_PTS_REF AXX_KF_ZWMIN_WSOT FORMAT "%5.0" MONOTONY STRICT_INCREASE DEPOSIT ABSOLUTE /end AXIS_DESCR
 /begin AXIS_DESCR COM_AXIS NO_INPUT_QUANTITY CgkBooc_wkiDfEd_Czglhgc_fR_1a0o 8 -327.68 327.67 AXIS_PTS_REF AXY_KF_ZWMIN_WSOT FORMAT "%9.4" MONOTONY STRICT_INCREASE DEPOSIT ABSOLUTE /end AXIS_DESCR
/end CHARACTERISTIC
/begin CHARACTERISTIC KF_ZWMIN_WSOT___MGF_CC_PF_Slot4 "Minimum ignition angle for sound tuning warm (Slot 4, at 4000 RPM, X-Axis and Y-Axis do not switch, Pump Fuel)" MAP 0x807C79A6 _REC_A1CUR_1_MBSE_S1_S1 127.5 aAwkuzc_BFpgCmb_tmDukma_q__aa0o -64 63.5
 /begin AXIS_DESCR COM_AXIS Nkw caoddzd_oAjpfzb_cAcEEha_1nR_oa0 8 -32768 32767 AXIS_PTS_REF AXX_KF_ZWMIN_WSOT FORMAT "%5.0" MONOTONY STRICT_INCREASE DEPOSIT ABSOLUTE /end AXIS_DESCR
 /begin AXIS_DESCR COM_AXIS NO_INPUT_QUANTITY CgkBooc_wkiDfEd_Czglhgc_fR_1a0o 8 -327.68 327.67 AXIS_PTS_REF AXY_KF_ZWMIN_WSOT FORMAT "%9.4" MONOTONY STRICT_INCREASE DEPOSIT ABSOLUTE /end AXIS_DESCR
/end CHARACTERISTIC
/begin CHARACTERISTIC KF_ZWMIN_WSOT___MGF_CC_PF_Slot5 "Minimum ignition angle for sound tuning warm (Slot 5, at 5000 RPM, X-Axis and Y-Axis do not switch, Pump Fuel)" MAP 0x807C79E6 _REC_A1CUR_1_MBSE_S1_S1 127.5 aAwkuzc_BFpgCmb_tmDukma_q__aa0o -64 63.5
 /begin AXIS_DESCR COM_AXIS Nkw caoddzd_oAjpfzb_cAcEEha_1nR_oa0 8 -32768 32767 AXIS_PTS_REF AXX_KF_ZWMIN_WSOT FORMAT "%5.0" MONOTONY STRICT_INCREASE DEPOSIT ABSOLUTE /end AXIS_DESCR
 /begin AXIS_DESCR COM_AXIS NO_INPUT_QUANTITY CgkBooc_wkiDfEd_Czglhgc_fR_1a0o 8 -327.68 327.67 AXIS_PTS_REF AXY_KF_ZWMIN_WSOT FORMAT "%9.4" MONOTONY STRICT_INCREASE DEPOSIT ABSOLUTE /end AXIS_DESCR
/end CHARACTERISTIC
/begin FUNCTION Antilag "Build boost before accelerating"
 /begin DEF_CHARACTERISTIC Antilag_Pedal___MGF_CC_PF Antilag_CutMethod___MGF_CC_PF Antilag_ActivationDelay___MGF_CC_PF Antilag_TargetNumberOfCylindersToSuppress___MGF_CC_PF /end DEF_CHARACTERISTIC
 /begin SUB_FUNCTION Antilag_Codewords Antilag_PIDs Antilag_Rolling Antilag_Safety Antilag_Standing /end SUB_FUNCTION
/end FUNCTION
/begin FUNCTION Antilag_Codewords "" /begin DEF_CHARACTERISTIC CW_Antilag___MGF_CC /end DEF_CHARACTERISTIC /end FUNCTION
/begin FUNCTION Antilag_PIDs ""
 /begin DEF_CHARACTERISTIC Antilag_BMWtchctr_pwr_PctlWideRng_M___MGF_CC_PF Antilag_BMWtchctr_p_DifCrtnPp_M___MGF_CC_PF Antilag_BMWtchctr_p_DifCrtnPpDyn_M___MGF_CC_PF Antilag_BMWtchctr_pwr_Dp_M___MGF_CC_PF /end DEF_CHARACTERISTIC
/end FUNCTION
/begin FUNCTION Antilag_Rolling ""
 /begin DEF_CHARACTERISTIC Antilag_RpmDelayUntilCutRoll___MGF_CC_PF Antilag_RollingSpeedThreshold___MGF_CC_PF Antilag_RollRpmMax___MGF_CC_PF Antilag_RollRpmMin___MGF_CC_PF Antilag_IgnRoll___MGF_CC_PF Antilag_LambdaRoll___MGF_CC_PF Antilag_TargetBoostRoll___MGF_CC_PF /end DEF_CHARACTERISTIC
/end FUNCTION
/begin FUNCTION Antilag_Safety ""
 /begin DEF_CHARACTERISTIC Antilag_CoolantTempMin___MGF_CC_PF Antilag_CoolantTempMax___MGF_CC_PF Antilag_EgtTempMax___MGF_CC_PF Antilag_OverBoostThreshold___MGF_CC_PF Antilag_IatTempMax___MGF_CC_PF Antilag_SafetyTorqueCap___MGF_CC_PF Antilag_MaxDuration___MGF_CC_PF /end DEF_CHARACTERISTIC
/end FUNCTION
/begin FUNCTION Antilag_Standing ""
 /begin DEF_CHARACTERISTIC Antilag_RpmSetpoint___MGF_CC_PF Antilag_RpmDelayUntilCutStand___MGF_CC_PF Antilag_IgnStand___MGF_CC_PF Antilag_LambdaStand___MGF_CC_PF Antilag_TargetBoostStand___MGF_CC_PF /end DEF_CHARACTERISTIC
/end FUNCTION
/begin FUNCTION Boost "Intake/exhaust pressure targets/limits"
 /begin DEF_CHARACTERISTIC K_PAK_MX BMWlpa_n_EfpEngStrtAmb_M KL_PSPVDK_SOLMAXGD K_MAX_PSSOLBER KL_RFTNLMX KF_DPLDSOLL_SPORT BMWtchob_p_DifEnd_C BMWtchob_fac_tq_Delt_T BMWtchob_p_DifGraTrigMin_C BMWtchsp_p_ReqMax_C BMWtchsp_p_OfsMax_C BMWtchsp_rat_p_CmprMax_M BMWtchsp_rat_p_CmprMaxRace_M BMWtchsp_rat_p_CmprPmp_T BMWtchsp_rat_p_CmprMaxTMax_T BMWtchsp_fac_FilPRatCmpr_T BMWtchsp_fac_mf_FilCmprNorm_T KF_DPLDS_PRED BMWtchctr_rat_p_ComprLimPctl_T BMWtchctr_fac_pwr_CompLimPctl_T KF_NEWP_LLK_TANS PVDMX /end DEF_CHARACTERISTIC
/end FUNCTION
/begin FUNCTION BoostByGear "" /begin SUB_FUNCTION BoostByGear_Codewords /end SUB_FUNCTION /end FUNCTION
/begin FUNCTION BoostByGear_Codewords "" /end FUNCTION
/begin FUNCTION Burbles "Pops and bangs"
 /begin SUB_FUNCTION Burbles_Codewords Burbles_Slot0 Burbles_Slot1 Burbles_Slot2 Burbles_Slot3 Burbles_Slot4 Burbles_Slot5 /end SUB_FUNCTION
/end FUNCTION
/begin FUNCTION Burbles_Codewords "" /begin DEF_CHARACTERISTIC CW_BurblesOnTheFly___MGF_CC /end DEF_CHARACTERISTIC /end FUNCTION
/begin FUNCTION Burbles_Slot0 ""
 /begin DEF_CHARACTERISTIC KF_ZWMIN_WSOT___MGF_CC_PF_Slot0 KF_ZWMIN_KSOT___MGF_CC_PF_Slot0 /end DEF_CHARACTERISTIC
/end FUNCTION
/begin FUNCTION Burbles_Slot1 ""
 /begin DEF_CHARACTERISTIC KF_ZWMIN_WSOT___MGF_CC_PF_Slot1 KF_ZWMIN_KSOT___MGF_CC_PF_Slot1 /end DEF_CHARACTERISTIC
/end FUNCTION
/begin FUNCTION Burbles_Slot2 ""
 /begin DEF_CHARACTERISTIC KF_ZWMIN_WSOT___MGF_CC_PF_Slot2 KF_ZWMIN_KSOT___MGF_CC_PF_Slot2 /end DEF_CHARACTERISTIC
/end FUNCTION
/begin FUNCTION Burbles_Slot3 ""
 /begin DEF_CHARACTERISTIC KF_ZWMIN_WSOT___MGF_CC_PF_Slot3 KF_ZWMIN_KSOT___MGF_CC_PF_Slot3 /end DEF_CHARACTERISTIC
/end FUNCTION
/begin FUNCTION Burbles_Slot4 ""
 /begin DEF_CHARACTERISTIC KF_ZWMIN_WSOT___MGF_CC_PF_Slot4 KF_ZWMIN_KSOT___MGF_CC_PF_Slot4 /end DEF_CHARACTERISTIC
/end FUNCTION
/begin FUNCTION Burbles_Slot5 ""
 /begin DEF_CHARACTERISTIC KF_ZWMIN_WSOT___MGF_CC_PF_Slot5 KF_ZWMIN_KSOT___MGF_CC_PF_Slot5 /end DEF_CHARACTERISTIC
/end FUNCTION
/begin FUNCTION Cooling "Engine cooling"
 /begin DEF_CHARACTERISTIC K_TKW_WA K_TKW_MX KL_TKW_NO KL_TKW_HI K_TDON_HEIZ_OPF K_TDOFF_HEIZ_OPF KL_NEL_I K_QS_ANF_KLIMA_MX KL_NEL_KLIMA_MX KL_NEWP_KLIMA_MX KF_KLIMA_KKS K_FK_NEL_VSKR KL_FK_TUMG_OPF KL_NEL_VSKR_TUMG KL_NEL_TABG_TUMG KL_NEL_V_MX KL_NEL_TMOT KL_NEL_TKA KL_NEL_TEGS KL_NEL_TDME KL_NEL_TANS_KLOPF KL_NEL_SPL KF_NEL_VSKR KF_NEL_TMOT_TKA KF_NEL_TGET KF_NEL_TANS KF_NEL_TABG KF_NEL_OPF_V KL_FLD_KKS /end DEF_CHARACTERISTIC
/end FUNCTION
/begin FUNCTION CustomCode ""
 /begin SUB_FUNCTION Antilag BoostByGear Burbles CustomCodeMenu ExhaustFlap FlexFuel MaxCooling RadiatorFlap SwitchableMaps TcuTorqueLimiter Valet /end SUB_FUNCTION
/end FUNCTION
/begin FUNCTION CustomCodeMenu "On-The-Fly access to custom features"
 /begin DEF_CHARACTERISTIC CcmEnterMenuDelay___MGF_CC_PF CcmTimeout___MGF_CC_PF UniRockerEnterDetectionDelay___MGF_CC_PF /end DEF_CHARACTERISTIC
 /begin SUB_FUNCTION CustomCodeMenu_Codewords CustomCodeMenu_CanBusIds /end SUB_FUNCTION
/end FUNCTION
/begin FUNCTION CustomCodeMenu_CanBusIds ""
 /begin DEF_CHARACTERISTIC CustomCanBusCruiseControlIdMap___MGF_CC_PF CustomCanBusEcaIdMap___MGF_CC_PF CustomCanBusMotivReflexOutputIdMap___MGF_CC_PF CustomCanBusTurnSignalIdMap___MGF_CC_PF /end DEF_CHARACTERISTIC
/end FUNCTION
/begin FUNCTION CustomCodeMenu_Codewords ""
 /begin DEF_CHARACTERISTIC CW_CustomCodeMenu___MGF_CC CW_CruiseControlConfig___MGF_CC CW_UseAllCruiseControlCanBusData___MGF_CC CW_LowPressureFuelPressureSensorInstalled___MGF_CC CW_MgfLimpModeProtectionEnabled___MGF_CC CW_MotivReflexInstalled___MGF_CC /end DEF_CHARACTERISTIC
/end FUNCTION
/begin FUNCTION DisplayCalibration "Sport gauge scales for power and torque"
 /begin DEF_CHARACTERISTIC BMWosd_tq_MaxSptDispNm_C BMWosd_pwr_MaxSptDispkW_C BMWshl_n_SpdMaxMt_T BMWshl_n_SpdMaxAt_T BMWshl_n_ThdSpdDispSegAlOn_C K_EDA_P_ANZ_SPORT_BS_SCAL_CODE3 K_EDA_P_ANZ_SPORT_BS_SCAL_CODE2 K_EDA_P_ANZ_SPORT_BS_SCAL_CODE1 K_EDA_P_ANZ_SPORT_BS_SCAL_CODE0 K_EDA_MD_ANZ_BS_SCAL_CODE4 K_EDA_MD_ANZ_BS_SCAL_CODE3 K_EDA_MD_ANZ_BS_SCAL_CODE2 K_EDA_MD_ANZ_BS_SCAL_CODE1 K_EDA_MD_ANZ_BS_SCAL_CODE0 BMWtchbpi_p_MaxTcSptDisp_C NWARNORINI /end DEF_CHARACTERISTIC
/end FUNCTION
/begin FUNCTION EngineSpeed "Engine Speed"
 /begin DEF_CHARACTERISTIC K_NADONNMX K_PAM_MODE_FUELLUNGSEG_NKW_HYS K_PAM_MODE_FUELLUNGSEG_NKW2 K_PAM_MODE_FUELLUNGSEG_NKW1 KF_N_GASSTOSS_UND_ANFAHR KF_N_GASSTOSS_ANFAHR_KUPP KF_NMAX_ANFAHR_MODE_2 KF_NMAX_ANFAHR_MODE_1 KF_NMAX_ANFAHR_MODE_0 K_NKW_MAX K_NMX_VM_FETRAWE K_NMX_VM_ABS K_N_GB1_IN_MAX_OSC BMWosc_n_Gb1Max_T BMWosc_n_Gb1Max_MT K_NMX_VM_OG_SPORTPLUS K_NMX_VM_OG_SPORT K_NMX_VM_OG_RENNSTART K_NMX_VM_OG_ECO K_NMX_VM_OG_COMFORT K_NMX_VM_BA_VVT K_NMX_VM_BA_GD BMWtqe_n_EngLhModEngDynSp_T BMWtqe_n_NMaxEngTqLimdMt_T BMWtqe_n_NMaxEngTqLimdDct_T BMWtqe_n_NMaxEngTqLimdAt_T EngPrt_nMax_CUR NMAX NMAXKR NMAXSWT NMAXTMM NMAXTO /end DEF_CHARACTERISTIC
/end FUNCTION
/begin FUNCTION Exhaust "Exhaust flap, burbles and noise"
 /begin DEF_CHARACTERISTIC K_V_SOT_MN BMWausy_p_DifCat_T BMWchst_t_CatMax_C BMWgpfheat_p_RailTstrPcg_C BMWgpfheat_p_RailInjSng_M BMWgpfheat_p_RailInjMpl_M BMWgpfheat_tq_ResExhFlpClsdHys_C BMWgpfheat_tq_ResExhFlpClsd_T KF_LA_EZA K_V_SOUND_MX K_V_SOUND_MN K_T_VL_SOUND_MX K_T_SOUND_MN K_T_NK_SOUND_MX KL_T_IKAT_SOUND_MX KL_NKW_SOUND_MX KL_NKW_SOUND_MN KL_TD_SOUND_MX_SPORT KL_TD_SOUND_MX_FREI KL_TD_SOUND_MX KF_MD_RES_NST_KEY BMWchas_v_MaxExhFlpClsd_C BMWchas_v_IdlGearAcvMin_C BMWchas_tq_ResExhFlpClsdHys_C BMWchas_tq_ResExhFlpClsd_T BMWgpfdiag_m_ThdAshSnsr_C K_F_SOT_RUECKBLICK_STAND K_F_SOT_RUECKBLICK_RS BMWgpfp_swi_PclFil_C BMWtchbas_cw_Noise_C BMWtqe_swi_NoiseWiDiDfco_C CW_SOUND BMWtqe_st_SptDet4NoiseAcvn_M BMWtqe_b_Clu4NoiseDeac_T KF_ZWMIN_WSOT KF_ZWMIN_KSOT KF_DZWMIN_SPORT_SOT KF_DZWMIN_NORMAL_SOT BMWchas_st_OpmBasLiOff_T BMWchas_st_OpmBasCatCold_T AKRGRCC AKRGRCCAT AKRGRCCATM AKRGRCCATM_VAR1 AKRGRCCATM_VAR2 AKRGRCCATM_VAR3 AKRGRCCAT_VAR1 AKRGRCCAT_VAR2 AKRGRCCAT_VAR3 AKRGRCCM AKRGRCCM_VAR1 AKRGRCCM_VAR2 AKRGRCCM_VAR3 AKRGRCC_VAR1 AKRGRCC_VAR2 AKRGRCC_VAR3 AKRGRCO AKRGRCOAT AKRGRCOATM AKRGRCOATM_VAR1 AKRGRCOAT_VAR1 AKRGRCOM AKRGRCOM_VAR1 AKRGRCO_VAR1 AKR_dmHFMThdMin_C AKR_stSpt_C CWAKR CWSTEGSPROGAKR TMOTAKR TVSTAKR VMINAKR PFlt_stActv_C PFlt_stPfilTyp_C CWVMAXCOD VMAXOVC /end DEF_CHARACTERISTIC
/end FUNCTION
/begin FUNCTION ExhaustFlap "Force exhaust flap controls" /begin DEF_CHARACTERISTIC ExhaustFlapClosedMaxLoad___MGF_CC_PF /end DEF_CHARACTERISTIC /begin SUB_FUNCTION ExhaustFlap_Codewords /end SUB_FUNCTION /end FUNCTION
/begin FUNCTION ExhaustFlap_Codewords "" /begin DEF_CHARACTERISTIC CW_ExhaustFlapOnTheFly___MGF_CC /end DEF_CHARACTERISTIC /end FUNCTION
/begin FUNCTION ExhaustGasTemperature "Target EGT"
 /begin DEF_CHARACTERISTIC KF_TA_VKSOLL KF_TA_IKSOLL BMWtchctr_t_ExGasMdl_M BMWtchctr_t_ExGasMdlScav_M /end DEF_CHARACTERISTIC
/end FUNCTION
/begin FUNCTION FlexFuel "Blend fuel maps with an ECA or hard-coded E%"
 /begin DEF_CHARACTERISTIC FlexFuelEthanolDisplayActivationDelay___MGF_CC_PF FlexFuel_StartupEnrichment___MGF_CC KL_RF_MAX_FlexFuelSensorFailure___MGF_CC_PF KL_RF_MAX_UESP_FlexFuelSensorFailure___MGF_CC_PF /end DEF_CHARACTERISTIC
 /begin SUB_FUNCTION FlexFuel_General_Codewords FlexFuel_Map_Codewords FlexFuel_Slot0 FlexFuel_Slot1 FlexFuel_Slot2 FlexFuel_Slot3 FlexFuel_Slot4 /end SUB_FUNCTION
/end FUNCTION
/begin FUNCTION FlexFuel_General_Codewords ""
 /begin DEF_CHARACTERISTIC CW_FlexFuelBlending___MGF_CC CW_FlexFuel___MGF_CC CW_SensorEthanol___MGF_CC CW_UseMultipleFlexFuelSlots___MGF_CC CW_UsePumpFuelMapWhenBlendFactorIsGreaterThan1___MGF_CC /end DEF_CHARACTERISTIC
/end FUNCTION
/begin FUNCTION FlexFuel_Map_Codewords ""
 /begin DEF_CHARACTERISTIC CW_FlexFuelBlending_BMWtchsp_p_ReqMax_C___MGF_CC CW_FlexFuelBlending_BMWtchctr_pwr_PctlWideRng_M___MGF_CC CW_FlexFuelBlending_BMWtchctr_pct_WgBasc_M___MGF_CC CW_FlexFuelBlending_KL_RF_MAX___MGF_CC CW_FlexFuelBlending_KL_RF_MAX_UESP___MGF_CC CW_FlexFuelBlending_KF_LABAS_1___MGF_CC CW_FlexFuelBlending_KF_LABAS_2___MGF_CC CW_FlexFuelBlending_KF_FRKKORRF_1___MGF_CC CW_FlexFuelBlending_BMWtchctr_p_DifCrtnPp_M___MGF_CC CW_FlexFuelBlending_BMWtchctr_pwr_Dp_M___MGF_CC CW_FlexFuelBlending_KF_ZW_PF1___MGF_CC CW_FlexFuelBlending_KF_ZW_PF2___MGF_CC CW_FlexFuelBlending_KF_ZW_S_PF1___MGF_CC CW_FlexFuelBlending_KF_ZW_S_PF2___MGF_CC CW_FlexFuelBlending_KF_ZW_VP_PF1___MGF_CC CW_FlexFuelBlending_KF_ZW_VP_PF2___MGF_CC CW_FlexFuelBlending_KF_FDZWT_PF1___MGF_CC CW_FlexFuelBlending_KF_FDZWT_PF2___MGF_CC CW_FlexFuelBlending_KF_PHA_H_B1_W___MGF_CC CW_FlexFuelBlending_KF_PHA_H_E1___MGF_CC CW_FlexFuelBlending_KF_ZW_UESP_PF1___MGF_CC CW_FlexFuelBlending_KF_ZW_UESP_PF2___MGF_CC CW_FlexFuelBlending_IKCtl_FacKnockDetThd0_GM___MGF_CC CW_FlexFuelBlending_IKCtl_FacKnockDetThd1_GM___MGF_CC CW_FlexFuelBlending_IKCtl_FacKnockDetThd2_GM___MGF_CC CW_FlexFuelBlending_IKCtl_FacKnockDetThd3_GM___MGF_CC CW_FlexFuelBlending_IKCtl_FacKnockDetThd4_GM___MGF_CC CW_FlexFuelBlending_IKCtl_FacKnockDetThd5_GM___MGF_CC /end DEF_CHARACTERISTIC
/end FUNCTION
/begin FUNCTION FlexFuel_Slot0 "Used for all slots if CW_UseMultipleFlexFuelSlots is disabled"
 /begin SUB_FUNCTION FlexFuel_Slot0_Codewords FlexFuel_Slot0_Blenders FlexFuel_Slot0_SensorlessValues FlexFuel_Slot0_FF1 FlexFuel_Slot0_FF2 /end SUB_FUNCTION
/end FUNCTION
/begin FUNCTION FlexFuel_Slot0_Blenders ""
 /begin DEF_CHARACTERISTIC FlexFuelBlendFactor___Boost_Slot_0___MGF_CC FlexFuelBlendFactor___FuelCorrection_Slot_0___MGF_CC FlexFuelBlendFactor___FuelTargets_Slot_0___MGF_CC FlexFuelBlendFactor___Ignition_Slot_0___MGF_CC FlexFuelBlendFactor___Knock_Slot_0___MGF_CC FlexFuelBlendFactor___LoadControl_Slot_0___MGF_CC FlexFuelBlendFactor___WastegateControl_Slot_0___MGF_CC /end DEF_CHARACTERISTIC
/end FUNCTION
/begin FUNCTION FlexFuel_Slot0_Codewords "" /begin DEF_CHARACTERISTIC CW_FlexFuelBlending_Slot0___MGF_CC /end DEF_CHARACTERISTIC /end FUNCTION
/begin FUNCTION FlexFuel_Slot0_FF1 ""
 /begin SUB_FUNCTION FlexFuel_Slot0_FF1_FuelTargets FlexFuel_Slot0_FF1_FuelCorrection FlexFuel_Slot0_FF1_LoadControl FlexFuel_Slot0_FF1_WastegateControl FlexFuel_Slot0_FF1_Boost FlexFuel_Slot0_FF1_Knock FlexFuel_Slot0_FF1_Ignition /end SUB_FUNCTION
/end FUNCTION
/begin FUNCTION FlexFuel_Slot0_FF1_Boost "Intake/exhaust pressure targets/limits" /begin DEF_CHARACTERISTIC BMWtchsp_p_ReqMax_C___MGF_CC_FF1_Slot0 /end DEF_CHARACTERISTIC /end FUNCTION
/begin FUNCTION FlexFuel_Slot0_FF1_FuelCorrection "Lambda modifiers"
 /begin DEF_CHARACTERISTIC KF_FRKKORRF_1___MGF_CC_FF1_Slot0 KF_PHA_H_B1_W___MGF_CC_FF1_Slot0 KF_PHA_H_E1___MGF_CC_FF1_Slot0 /end DEF_CHARACTERISTIC
/end FUNCTION
/begin FUNCTION FlexFuel_Slot0_FF1_FuelTargets "Lambda targets"
 /begin DEF_CHARACTERISTIC KF_LABAS_1___MGF_CC_FF1_Slot0 KF_LABAS_2___MGF_CC_FF1_Slot0 /end DEF_CHARACTERISTIC
/end FUNCTION
/begin FUNCTION FlexFuel_Slot0_FF1_Ignition "Timing targets"
 /begin DEF_CHARACTERISTIC KF_ZW_UESP_PF2___MGF_CC_FF1_Slot0 KF_ZW_UESP_PF1___MGF_CC_FF1_Slot0 KF_ZW_S_PF2___MGF_CC_FF1_Slot0 KF_ZW_S_PF1___MGF_CC_FF1_Slot0 KF_ZW_PF2___MGF_CC_FF1_Slot0 KF_ZW_PF1___MGF_CC_FF1_Slot0 KF_ZW_VP_PF2___MGF_CC_FF1_Slot0 KF_ZW_VP_PF1___MGF_CC_FF1_Slot0 /end DEF_CHARACTERISTIC
/end FUNCTION
/begin FUNCTION FlexFuel_Slot0_FF1_Knock "Knock factors and corrections"
 /begin DEF_CHARACTERISTIC KF_FDZWT_PF2___MGF_CC_FF1_Slot0 KF_FDZWT_PF1___MGF_CC_FF1_Slot0 IKCtl_FacKnockDetThd0_GM___MGF_CC_FF1_Slot0 IKCtl_FacKnockDetThd1_GM___MGF_CC_FF1_Slot0 IKCtl_FacKnockDetThd2_GM___MGF_CC_FF1_Slot0 IKCtl_FacKnockDetThd3_GM___MGF_CC_FF1_Slot0 IKCtl_FacKnockDetThd4_GM___MGF_CC_FF1_Slot0 IKCtl_FacKnockDetThd5_GM___MGF_CC_FF1_Slot0 /end DEF_CHARACTERISTIC
/end FUNCTION
/begin FUNCTION FlexFuel_Slot0_FF1_LoadControl "Load targets and limiters"
 /begin DEF_CHARACTERISTIC KL_RF_MAX_UESP___MGF_CC_FF1_Slot0 KL_RF_MAX___MGF_CC_FF1_Slot0 /end DEF_CHARACTERISTIC
/end FUNCTION
/begin FUNCTION FlexFuel_Slot0_FF1_WastegateControl "WGDC PIDs"
 /begin DEF_CHARACTERISTIC BMWtchctr_pwr_PctlWideRng_M___MGF_CC_FF1_Slot0 BMWtchctr_pwr_Dp_M___MGF_CC_FF1_Slot0 BMWtchctr_p_DifCrtnPp_M___MGF_CC_FF1_Slot0 BMWtchctr_pct_WgBasc_M___MGF_CC_FF1_Slot0 /end DEF_CHARACTERISTIC
/end FUNCTION
/begin FUNCTION FlexFuel_Slot0_FF2 ""
 /begin SUB_FUNCTION FlexFuel_Slot0_FF2_FuelTargets FlexFuel_Slot0_FF2_FuelCorrection FlexFuel_Slot0_FF2_LoadControl FlexFuel_Slot0_FF2_WastegateControl FlexFuel_Slot0_FF2_Boost FlexFuel_Slot0_FF2_Knock FlexFuel_Slot0_FF2_Ignition /end SUB_FUNCTION
/end FUNCTION
/begin FUNCTION FlexFuel_Slot0_FF2_Boost "Intake/exhaust pressure targets/limits" /begin DEF_CHARACTERISTIC BMWtchsp_p_ReqMax_C___MGF_CC_FF2_Slot0 /end DEF_CHARACTERISTIC /end FUNCTION
/begin FUNCTION FlexFuel_Slot0_FF2_FuelCorrection "Lambda modifiers"
 /begin DEF_CHARACTERISTIC KF_FRKKORRF_1___MGF_CC_FF2_Slot0 KF_PHA_H_B1_W___MGF_CC_FF2_Slot0 KF_PHA_H_E1___MGF_CC_FF2_Slot0 /end DEF_CHARACTERISTIC
/end FUNCTION
/begin FUNCTION FlexFuel_Slot0_FF2_FuelTargets "Lambda targets"
 /begin DEF_CHARACTERISTIC KF_LABAS_1___MGF_CC_FF2_Slot0 KF_LABAS_2___MGF_CC_FF2_Slot0 /end DEF_CHARACTERISTIC
/end FUNCTION
/begin COMPU_METHOD ___MGF_CC_EngineSpeedCutMethodCompuMethod "default compuMethod" TAB_VERB "%6.3" "-" COMPU_TAB_REF ___MGF_CC_EngineSpeedCutMethodCompuVTab /end COMPU_METHOD
/begin COMPU_METHOD ___MGF_CC_FlexFuel_StartupEnrichment_d100 "___MGF_CC_FlexFuel_StartupEnrichment_d100" RAT_FUNC "%8.3" "" COEFFS 0 100 0 0 0 1 /end COMPU_METHOD
/begin COMPU_METHOD ___MGF_CC_Fueling_d10 "default compuMethod" RAT_FUNC "%8.3" "°" COEFFS 0 4096 0 0 0 1 /end COMPU_METHOD
/begin COMPU_METHOD ___MGF_CC_IgnitionTiming_d10 "default compuMethod" RAT_FUNC "%8.3" "°" COEFFS 0 10 0 0 0 1 /end COMPU_METHOD
/begin COMPU_METHOD ___MGF_CC_Pedal_x100_d256 "default compuMethod" RAT_FUNC "%6.3" "%" COEFFS 0 256 0 0 0 100 /end COMPU_METHOD
/begin COMPU_METHOD ___MGF_CC_Speedkmh_d64 "default compuMethod" RAT_FUNC "%6.4" "km/h" COEFFS 0 64 0 0 0 1 /end COMPU_METHOD
/begin COMPU_METHOD ___MGF_CC_TemperatureCelsius_x3_d4_s48 "default compuMethod" RAT_FUNC "%6.2" "°C" COEFFS 0 1 48 0 0 0.75 /end COMPU_METHOD
/begin COMPU_METHOD aAwkuzc_BFpgCmb_tmDukma_q__aa0o "aAwkuzc_BFpgCmb_tmDukma_q__aa0o" RAT_FUNC "%6.3" "°" COEFFS 0 2 0 0 0 1 /end COMPU_METHOD
/begin COMPU_METHOD acriqBc_tfkBqod_ocgjxzc_nR_8oa0 "acriqBc_tfkBqod_ocgjxzc_nR_8oa0" RAT_FUNC "%6.3" "-" COEFFS 0 8192 0 0 0 1 /end COMPU_METHOD
/begin COMPU_METHOD aEmoCzd_erpwvfb_msfkhgc_qR_1a0o "aEmoCzd_erpwvfb_msfkhgc_qR_1a0o" RAT_FUNC "%6.3" "°" COEFFS 0 128 0 0 0 3 /end COMPU_METHOD
/begin COMPU_METHOD AFeDmkb_cAbjmcc_kAkskhd_k__0oa0 "AFeDmkb_cAbjmcc_kAkskhd_k__0oa0" RAT_FUNC "%6.3" "km/h" COEFFS 0 1 0 0 0 1 /end COMPU_METHOD
/begin COMPU_METHOD asfzqDd_xfCuqha_hliBAmd_k__0oa0 "asfzqDd_xfCuqha_hliBAmd_k__0oa0" RAT_FUNC "%6.3" "kg/h" COEFFS 0 10 0 0 0 1 /end COMPU_METHOD
/begin COMPU_METHOD Asyaixa_wdvtenb_FCefaCb_n__aa0o "Asyaixa_wdvtenb_FCefaCb_n__aa0o" RAT_FUNC "%6.3" "-" COEFFS 0 50 0 0 0 1 /end COMPU_METHOD
/begin COMPU_METHOD B_TRUE "" TAB_VERB "%6.3" "" COMPU_TAB_REF ACCLNTVLV_ASWTYPTWINFLWSTD_SY_Compu /end COMPU_METHOD
/begin COMPU_METHOD Bhvfwhc_bigEubd_BBEupBd_nR_3oa0 "Bhvfwhc_bigEubd_BBEupBd_nR_3oa0" RAT_FUNC "%6.3" "-" COEFFS 0 32768 0 0 0 1 /end COMPU_METHOD
/begin COMPU_METHOD BMW_ba_poel__ "" RAT_FUNC "%6.2" "-" COEFFS 0 1 0 0 0 1 /end COMPU_METHOD
/begin COMPU_METHOD BMW_dm_sw_q0p1_Nm "" RAT_FUNC "%6.3" "Nm" COEFFS 0 10 0 0 0 1 /end COMPU_METHOD
/begin COMPU_METHOD BMW_p_sw_q0p125_hPa "" RAT_FUNC "%6.3" "hPa" COEFFS 0 8 0 0 0 1 /end COMPU_METHOD
/begin COMPU_METHOD BMW_Powertrain_DxECompuMethods_Def_ub_b1_nounit "Def_ub_b1" RAT_FUNC "%6.3" "-" COEFFS 0 256 0 0 0 1 /end COMPU_METHOD
/begin COMPU_METHOD BMW_q0p1__ "" RAT_FUNC "%6.3" "-" COEFFS 0 10 0 0 0 1 /end COMPU_METHOD
/begin COMPU_METHOD BMW_q0p1_degC "" RAT_FUNC "%6.3" "°C" COEFFS 0 10 0 0 0 1 /end COMPU_METHOD
/begin COMPU_METHOD BMW_q0p1_kilometer_per_hour "" RAT_FUNC "%6.3" "km/h" COEFFS 0 10 0 0 0 1 /end COMPU_METHOD
/begin COMPU_METHOD BMW_q0p3906_PERC "" RAT_FUNC "%6.3" "%" COEFFS 0 64 0 0 0 25 /end COMPU_METHOD
/begin COMPU_METHOD bqonsub_DgsgbFa_Czglhgc_gR_1a0o "bqonsub_DgsgbFa_Czglhgc_gR_1a0o" RAT_FUNC "%6.3" "g" COEFFS 0 128 0 0 0 1 /end COMPU_METHOD
/begin COMPU_METHOD BufnDdb_jpjgsgc_jmDugsa_qCRoa0o "Def_q1" RAT_FUNC "%6.3" "°C" COEFFS 0 1 0 0 0 1 /end COMPU_METHOD
/begin COMPU_METHOD BumqDkc_mryszAa_EcglxAc_nR_4oa0 "BumqDkc_mryszAa_EcglxAc_nR_4oa0" RAT_FUNC "%6.3" "-" COEFFS 0 4096 0 0 0 1 /end COMPU_METHOD
/begin COMPU_METHOD camcxxd_bxlpdsa_Cshlhgc_sR_1a0o "Def_q0p01" RAT_FUNC "%6.3" "s" COEFFS 0 100 0 0 0 1 /end COMPU_METHOD
/begin COMPU_METHOD caoddzd_oAjpfzb_cAcEEha_1nR_oa0 "Def_q1" RAT_FUNC "%6.3" "1/min" COEFFS 0 1 0 0 0 1 /end COMPU_METHOD
/begin COMPU_METHOD CByjozc_eCmpBAb_pljBAmd_k__0oa0 "CByjozc_eCmpBAb_pljBAmd_k__0oa0" RAT_FUNC "%6.3" "kg/h" COEFFS 0 32 0 0 0 1 /end COMPU_METHOD
/begin COMPU_METHOD CgkBooc_wkiDfEd_Czglhgc_fR_1a0o "Def_q0p01" RAT_FUNC "%6.3" "%" COEFFS 0 100 0 0 0 1 /end COMPU_METHOD
/begin COMPU_METHOD cxdjuna_xpuCged_ocEpdua_MCRa2a0 "cxdjuna_xpuCged_ocEpdua_MCRa2a0" RAT_FUNC "%6.3" "MPa" COEFFS 0 8192 0 0 0 5 /end COMPU_METHOD
/begin COMPU_METHOD DchEpAd_DBCFgoa_Ckhahgc_q__aoa0 "DchEpAd_DBCFgoa_Ckhahgc_q__aoa0" RAT_FUNC "%6.3" "°C" COEFFS 0 100 0 0 0 1 /end COMPU_METHOD
/begin COMPU_METHOD DEZ "" RAT_FUNC "%6.2" "" COEFFS 0 1 0 0 0 1 /end COMPU_METHOD
/begin COMPU_METHOD ECeoxdb_wFseCtb_mEytEnb_k__o8a0 "ECeoxdb_wFseCtb_mEytEnb_k__o8a0" RAT_FUNC "%6.3" "kg/h" COEFFS 0 128 0 0 0 5 /end COMPU_METHOD
/begin COMPU_METHOD EngN "" RAT_FUNC "%6.3" "rpm" COEFFS 0 2 0 0 0 1 /end COMPU_METHOD
/begin COMPU_METHOD epDxoEa_vnwexaa_kAzmuka_q__14a0 "epDxoEa_vnwexaa_kAzmuka_q__14a0" RAT_FUNC "%6.3" "°C" COEFFS 0 16384 0 0 0 1 /end COMPU_METHOD
/begin COMPU_METHOD fak_ub_b16 "" RAT_FUNC "%6.4" "-" COEFFS 0 256 0 0 0 16 /end COMPU_METHOD
/begin COMPU_METHOD fgjpsvb_fDqjECa_acgrbDd_n_dae__ "Def_bool" TAB_VERB "%6.3" "-" COMPU_TAB_REF ADqnehd_cFCEtgc_vrrfDpc_ntd_1G2 /end COMPU_METHOD
/begin COMPU_METHOD FlexFuelEthanolContentValue_CompuMethod "FlexFuelEthanolContentValueCompuMethod" RAT_FUNC "%8.3" "%" COEFFS 0 1 0 0 0 1 /end COMPU_METHOD
/begin COMPU_METHOD fpBesqd_hAxmiba_AAwtged_u__0oa0 "fpBesqd_hAxmiba_AAwtged_u__0oa0" RAT_FUNC "%6.3" "ul/s" COEFFS 0 1 0 0 0 1 /end COMPU_METHOD
/begin COMPU_METHOD FzbmlAa_gCtylrb_ckCqxAc_nR_6oa0 "FzbmlAa_gCtylrb_ckCqxAc_nR_6oa0" RAT_FUNC "%6.3" "-" COEFFS 0 65536 0 0 0 1 /end COMPU_METHOD
/begin COMPU_METHOD ilxsavd_hkzmBfc_lAzCpAb_nR_1oa0 "ilxsavd_hkzmBfc_lAzCpAb_nR_1oa0" RAT_FUNC "%6.3" "-" COEFFS 0 16384 0 0 0 1 /end COMPU_METHOD
/begin COMPU_METHOD jgbhAma_smpAegb_hlEBAmd_k__0oa0 "jgbhAma_smpAegb_hlEBAmd_k__0oa0" RAT_FUNC "%6.3" "km/h" COEFFS 0 50 0 0 0 1 /end COMPU_METHOD
/begin COMPU_METHOD jucyrzb_bpFgwfd_uqrfhgc_k__aoa0 "jucyrzb_bpFgwfd_uqrfhgc_k__aoa0" RAT_FUNC "%6.3" "kW" COEFFS 0 512 0 0 0 1 /end COMPU_METHOD
/begin COMPU_METHOD lCylrsa_tioqzad_Csrxmdd_f__o0a0 "lCylrsa_tioqzad_Csrxmdd_f__o0a0" RAT_FUNC "%6.3" "%/Ks" COEFFS 0 100 0 0 0 1 /end COMPU_METHOD
/begin COMPU_METHOD lFwocba_tlxgpab_wmDuExd_NCRoa0o "lFwocba_tlxgpab_wmDuExd_NCRoa0o" RAT_FUNC "%6.3" "Nm" COEFFS 0 1 0 0 0 1 /end COMPU_METHOD
/begin COMPU_METHOD nmot_q40 "" RAT_FUNC "%6.1" "1/min" COEFFS 0 1 0 0 0 40 /end COMPU_METHOD
/begin COMPU_METHOD nmot_sw_q0p25 "" RAT_FUNC "%6.3" "1/min" COEFFS 0 1 0 0 0 0.25 /end COMPU_METHOD
/begin COMPU_METHOD nnxvdDd_vDnjvqd_FmDuEEa_f__aa0o "Def_q1" RAT_FUNC "%6.3" "%" COEFFS 0 1 0 0 0 1 /end COMPU_METHOD
/begin COMPU_METHOD p_uw_q0p078 "" RAT_FUNC "%6.4" "hPa" COEFFS 0 256 0 0 0 20 /end COMPU_METHOD
/begin COMPU_METHOD qDyjaAb_mviibsd_eCcdamc_bCRooa0 "qDyjaAb_mviibsd_eCcdamc_bCRooa0" RAT_FUNC "%6.3" "bar" COEFFS 0 20 0 0 0 1 /end COMPU_METHOD
/begin COMPU_METHOD raChrxc_kBtBrmb_FmDuEFa_n__aa0o "Def_q1" RAT_FUNC "%6.3" "-" COEFFS 0 1 0 0 0 1 /end COMPU_METHOD
/begin COMPU_METHOD rAdkuaa_wDllxja_BnDuEFa_n__aa0o "rAdkuaa_wDllxja_BnDuEFa_n__aa0o" RAT_FUNC "%6.3" "-" COEFFS 0 8 0 0 0 1 /end COMPU_METHOD
/begin COMPU_METHOD rel_q0p0234 "" RAT_FUNC "%6.4" "%" COEFFS 0 128 0 0 0 3 /end COMPU_METHOD
/begin COMPU_METHOD ridxkCa_Dxvxtdc_CChkhgc_nR_1a0o "ridxkCa_Dxvxtdc_CChkhgc_nR_1a0o" RAT_FUNC "%6.3" "-" COEFFS 0 128 0 0 0 3 /end COMPU_METHOD
/begin COMPU_METHOD t10msxs_ub_b2p55 "" RAT_FUNC "%6.4" "s" COEFFS 0 1 0 0 0 0.01 /end COMPU_METHOD
/begin COMPU_METHOD temp_q0p0234_o273 "" RAT_FUNC "%6.1" "Grad C" COEFFS 0 1 273.15 0 0 0.0234375 /end COMPU_METHOD
/begin COMPU_METHOD temp_ub_q0p75_o48 "" RAT_FUNC "%6.2" "Grad C" COEFFS 0 1 48 0 0 0.75 /end COMPU_METHOD
/begin COMPU_METHOD vfyBdwd_ftexgja_BcFdiDd_fR_1a0o "Def_q0p0244" RAT_FUNC "%6.3" "%" COEFFS 0 1024 0 0 0 25 /end COMPU_METHOD
/begin COMPU_METHOD vfzg_sw_q0p00781 "" RAT_FUNC "%6.4" "km/h" COEFFS 0 1 0 0 0 0.0078125 /end COMPU_METHOD
/begin COMPU_METHOD vfzg_ub_q1p25 "" RAT_FUNC "%6.2" "km/h" COEFFS 0 1 0 0 0 1.25 /end COMPU_METHOD
/begin COMPU_METHOD wDDoctd_cCDyaFa_AvCkvFb_nR_6o0o "wDDoctd_cCDyaFa_AvCkvFb_nR_6o0o" RAT_FUNC "%6.3" "-" COEFFS 0 16384 0 0 0 25 /end COMPU_METHOD
/begin COMPU_METHOD wDvwtyd_Bhgozed_DCekdfb_nsttFSS "wDvwtyd_Bhgozed_DCekdfb_nsttFSS" TAB_VERB "%6.3" "-" COMPU_TAB_REF ADqnehd_cFCEtgc_vrrfDpc_ntd_1G2 /end COMPU_METHOD
/begin COMPU_METHOD wpxDCba_sgbvDxb_FliBAmd_k__0oa0 "wpxDCba_sgbvDxb_FliBAmd_k__0oa0" RAT_FUNC "%6.3" "kg/h" COEFFS 0 16 0 0 0 1 /end COMPU_METHOD
/begin COMPU_METHOD zyyxBpb_rEsnvtc_gktukCa_fR_5a0o "zyyxBpb_rEsnvtc_gktukCa_fR_5a0o" RAT_FUNC "%6.3" "%" COEFFS 0 512 0 0 0 25 /end COMPU_METHOD
/begin COMPU_VTAB ___MGF_CC_EngineSpeedCutMethodCompuVTab "" TAB_VERB 3 0 "Fuel" 1 "Ignition" 3 "Factory" DEFAULT_VALUE "Not Defined, unexpected results" /end COMPU_VTAB
/begin COMPU_VTAB ACCLNTVLV_ASWTYPTWINFLWSTD_SY_Compu "" TAB_VERB 1 0 "" /end COMPU_VTAB
/begin COMPU_VTAB ADqnehd_cFCEtgc_vrrfDpc_ntd_1G2 "ADqnehd_cFCEtgc_vrrfDpc_ntd_1G2" TAB_VERB 1 0 "" DEFAULT_VALUE "Zustand nicht definiert" /end COMPU_VTAB
/begin RECORD_LAYOUT ___MGF_CC_Antilag_Ign_Roll_xAxis AXIS_PTS_X 0 SWORD INDEX_INCR PLONG /end RECORD_LAYOUT
/begin RECORD_LAYOUT ___MGF_CC_FlexFuelBlendFactorAxis21x1 AXIS_PTS_X 0 UWORD INDEX_INCR PLONG /end RECORD_LAYOUT
/begin RECORD_LAYOUT _REC_A1AXS_1_MBSE_S2 ALIGNMENT_BYTE 1 ALIGNMENT_WORD 2 ALIGNMENT_LONG 4 ALIGNMENT_FLOAT32_IEEE 4 ALIGNMENT_FLOAT64_IEEE 4 AXIS_PTS_X 1 SWORD INDEX_INCR DIRECT /end RECORD_LAYOUT
/begin RECORD_LAYOUT _REC_A1AXS_1_MBSE_U1 ALIGNMENT_BYTE 1 ALIGNMENT_WORD 2 ALIGNMENT_LONG 4 ALIGNMENT_FLOAT32_IEEE 4 ALIGNMENT_FLOAT64_IEEE 4 AXIS_PTS_X 1 UBYTE INDEX_INCR DIRECT /end RECORD_LAYOUT
/begin RECORD_LAYOUT _REC_A1AXS_1_MBSE_U2 ALIGNMENT_BYTE 1 ALIGNMENT_WORD 2 ALIGNMENT_LONG 4 ALIGNMENT_FLOAT32_IEEE 4 ALIGNMENT_FLOAT64_IEEE 4 AXIS_PTS_X 1 UWORD INDEX_INCR DIRECT /end RECORD_LAYOUT
/begin RECORD_LAYOUT _REC_A1CUR_1_MBSE_S1_S1 ALIGNMENT_BYTE 1 ALIGNMENT_WORD 2 ALIGNMENT_LONG 4 ALIGNMENT_FLOAT32_IEEE 4 ALIGNMENT_FLOAT64_IEEE 4 FNC_VALUES 1 SBYTE ROW_DIR DIRECT /end RECORD_LAYOUT
/begin RECORD_LAYOUT _REC_A1CUR_1_MBSE_S2_S1 ALIGNMENT_BYTE 1 ALIGNMENT_WORD 2 ALIGNMENT_LONG 4 ALIGNMENT_FLOAT32_IEEE 4 ALIGNMENT_FLOAT64_IEEE 4 FNC_VALUES 1 SWORD ROW_DIR DIRECT /end RECORD_LAYOUT
/begin RECORD_LAYOUT _REC_A1CUR_1_MBSE_U1_S1 ALIGNMENT_BYTE 1 ALIGNMENT_WORD 2 ALIGNMENT_LONG 4 ALIGNMENT_FLOAT32_IEEE 4 ALIGNMENT_FLOAT64_IEEE 4 FNC_VALUES 1 UBYTE ROW_DIR DIRECT /end RECORD_LAYOUT
/begin RECORD_LAYOUT _REC_A1CUR_1_MBSE_U2_S1 ALIGNMENT_BYTE 1 ALIGNMENT_WORD 2 ALIGNMENT_LONG 4 ALIGNMENT_FLOAT32_IEEE 4 ALIGNMENT_FLOAT64_IEEE 4 FNC_VALUES 1 UWORD ROW_DIR DIRECT /end RECORD_LAYOUT
/begin RECORD_LAYOUT Axis_Xs16 ALIGNMENT_BYTE 1 ALIGNMENT_WORD 2 ALIGNMENT_LONG 4 ALIGNMENT_FLOAT32_IEEE 4 ALIGNMENT_FLOAT64_IEEE 4 NO_AXIS_PTS_X 1 SWORD AXIS_PTS_X 2 SWORD INDEX_INCR DIRECT /end RECORD_LAYOUT
/begin RECORD_LAYOUT Axis_Xu16 ALIGNMENT_BYTE 1 ALIGNMENT_WORD 2 ALIGNMENT_LONG 4 ALIGNMENT_FLOAT32_IEEE 4 ALIGNMENT_FLOAT64_IEEE 4 NO_AXIS_PTS_X 1 UWORD AXIS_PTS_X 2 UWORD INDEX_INCR DIRECT /end RECORD_LAYOUT
/begin RECORD_LAYOUT CurG_Ws16 ALIGNMENT_BYTE 1 ALIGNMENT_WORD 2 ALIGNMENT_LONG 4 ALIGNMENT_FLOAT32_IEEE 4 ALIGNMENT_FLOAT64_IEEE 4 FNC_VALUES 1 SWORD COLUMN_DIR DIRECT /end RECORD_LAYOUT
/begin RECORD_LAYOUT FklWUb ALIGNMENT_BYTE 1 ALIGNMENT_WORD 2 ALIGNMENT_LONG 4 ALIGNMENT_FLOAT32_IEEE 4 ALIGNMENT_FLOAT64_IEEE 4 FNC_VALUES 1 UBYTE COLUMN_DIR DIRECT /end RECORD_LAYOUT
/begin RECORD_LAYOUT KlAUbSstUbWUw_Static ALIGNMENT_BYTE 1 ALIGNMENT_WORD 2 ALIGNMENT_LONG 4 ALIGNMENT_FLOAT32_IEEE 4 ALIGNMENT_FLOAT64_IEEE 4 NO_AXIS_PTS_X 1 UBYTE AXIS_PTS_X 2 UBYTE INDEX_INCR DIRECT FNC_VALUES 3 UWORD COLUMN_DIR DIRECT STATIC_RECORD_LAYOUT /end RECORD_LAYOUT
/begin RECORD_LAYOUT KlAxU8SstxU16WU16 ALIGNMENT_BYTE 1 ALIGNMENT_WORD 2 ALIGNMENT_LONG 4 ALIGNMENT_FLOAT32_IEEE 4 ALIGNMENT_FLOAT64_IEEE 4 NO_AXIS_PTS_X 1 UWORD AXIS_PTS_X 2 UWORD INDEX_INCR DIRECT FNC_VALUES 3 UWORD COLUMN_DIR DIRECT /end RECORD_LAYOUT
/begin RECORD_LAYOUT KwUw ALIGNMENT_BYTE 1 ALIGNMENT_WORD 2 ALIGNMENT_LONG 4 ALIGNMENT_FLOAT32_IEEE 4 ALIGNMENT_FLOAT64_IEEE 4 FNC_VALUES 1 UWORD COLUMN_DIR DIRECT /end RECORD_LAYOUT
/begin RECORD_LAYOUT Map_Xs16Ys16Ws16 ALIGNMENT_BYTE 1 ALIGNMENT_WORD 2 ALIGNMENT_LONG 4 ALIGNMENT_FLOAT32_IEEE 4 ALIGNMENT_FLOAT64_IEEE 4 NO_AXIS_PTS_X 1 SWORD NO_AXIS_PTS_Y 2 SWORD AXIS_PTS_X 3 SWORD INDEX_INCR DIRECT AXIS_PTS_Y 4 SWORD INDEX_INCR DIRECT FNC_VALUES 5 SWORD COLUMN_DIR DIRECT /end RECORD_LAYOUT
/begin RECORD_LAYOUT RB_Curve_S8_U16_Static ALIGNMENT_BYTE 1 ALIGNMENT_WORD 2 ALIGNMENT_LONG 4 ALIGNMENT_FLOAT32_IEEE 4 ALIGNMENT_FLOAT64_IEEE 4 NO_AXIS_PTS_X 1 SBYTE AXIS_PTS_X 2 SBYTE INDEX_INCR DIRECT FNC_VALUES 3 UWORD COLUMN_DIR DIRECT STATIC_RECORD_LAYOUT /end RECORD_LAYOUT
/end MODULE
/end PROJECT
