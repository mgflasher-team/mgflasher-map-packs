ASAP2_VERSION 1 60
/begin PROJECT MG1CS049_S58_F4C2L8Y8B "MG1CS049"
/begin HEADER "" VERSION "F4C2L8Y8B" PROJECT_NO MG1CS049_S58_F4C2L8Y8B /end HEADER
/begin MODULE DIM ""
/begin MOD_COMMON "" BYTE_ORDER MSB_LAST DEPOSIT ABSOLUTE ALIGNMENT_BYTE 1 ALIGNMENT_WORD 2 ALIGNMENT_LONG 4 ALIGNMENT_FLOAT32_IEEE 4 ALIGNMENT_FLOAT64_IEEE 4 /end MOD_COMMON
/begin AXIS_PTS AXX_KF_ASPR_NORM_UESP_PF1 "Nkw" 0x8071FD26 NO_INPUT_QUANTITY _REC_A1AXS_1_MBSE_S2 65535 caoddzd_oAjpfzb_cAcEEha_1nR_oa0 8 -32768 32767 FORMAT "%5.0" DEPOSIT ABSOLUTE /end AXIS_PTS
/begin AXIS_PTS AXX_KF_EDA_ANZ_SPORT_MDK_IST "KF_EDA_ANZ_SPORT_MDK_IST" 0x8070CE42 NO_INPUT_QUANTITY _REC_A1AXS_1_MBSE_S2 6553.5 BMW_dm_sw_q0p1_Nm 6 -3276.8 3276.7 FORMAT "%7.2" DEPOSIT ABSOLUTE /end AXIS_PTS
/begin AXIS_PTS AXX_KF_EHUB_MX "Nkw_ref" 0x807223BE NO_INPUT_QUANTITY _REC_A1AXS_1_MBSE_S2 65535 caoddzd_oAjpfzb_cAcEEha_1nR_oa0 6 -32768 32767 FORMAT "%5.0" DEPOSIT ABSOLUTE /end AXIS_PTS
/begin AXIS_PTS AXX_KF_ENA_NREG_GANG_SYN "X-axis for KF_ENA_NREG_GANG_SYN" 0x8075789A NO_INPUT_QUANTITY _REC_A1AXS_1_MBSE_U1 255 raChrxc_kBtBrmb_FmDuEFa_n__aa0o 9 0 255 FORMAT "%3.0" DEPOSIT ABSOLUTE /end AXIS_PTS
/begin AXIS_PTS AXX_KF_ESPR_NORM_UESP_PF1 "Nkw" 0x80720AF2 NO_INPUT_QUANTITY _REC_A1AXS_1_MBSE_S2 65535 caoddzd_oAjpfzb_cAcEEha_1nR_oa0 8 -32768 32767 FORMAT "%5.0" DEPOSIT ABSOLUTE /end AXIS_PTS
/begin AXIS_PTS AXX_KF_F_MDIMAX_KR "AXX_KF_F_MDIMAX_KR" 0x807312F8 Nkw_ref _REC_A1AXS_1_MBSE_S2 65535 caoddzd_oAjpfzb_cAcEEha_1nR_oa0 8 -32768 32767 DEPOSIT ABSOLUTE /end AXIS_PTS
/begin AXIS_PTS AXX_KF_FDZWT_PF1 "AXX_KF_FDZWT_PF1" 0x80737760 Tmot _REC_A1AXS_1_MBSE_S2 655.35 DchEpAd_DBCFgoa_Ckhahgc_q__aoa0 6 -327.68 327.67 FORMAT "%7.2" DEPOSIT ABSOLUTE /end AXIS_PTS
/begin AXIS_PTS AXX_KF_FDZWT_PF2 "AXX_KF_FDZWT_PF2" 0x80737754 Tmot _REC_A1AXS_1_MBSE_S2 655.35 DchEpAd_DBCFgoa_Ckhahgc_q__aoa0 6 -327.68 327.67 FORMAT "%7.2" DEPOSIT ABSOLUTE /end AXIS_PTS
/begin AXIS_PTS AXX_KF_FK_FTRANSVL "AXX_KF_FK_FTRANSVL" 0x807438E8 NO_INPUT_QUANTITY _REC_A1AXS_1_MBSE_S2 65535 caoddzd_oAjpfzb_cAcEEha_1nR_oa0 6 -32768 32767 FORMAT "%5.0" DEPOSIT ABSOLUTE /end AXIS_PTS
/begin AXIS_PTS AXX_KF_FRKKORRF_1 "AXX_KF_FRKKORRF_1" 0x80714FD0 Nkw _REC_A1AXS_1_MBSE_S2 65535 caoddzd_oAjpfzb_cAcEEha_1nR_oa0 16 -32768 32767 FORMAT "%5.0" DEPOSIT ABSOLUTE /end AXIS_PTS
/begin AXIS_PTS AXX_KF_FTRANSVL "AXX_KF_FTRANSVL" 0x807438C8 NO_INPUT_QUANTITY _REC_A1AXS_1_MBSE_S2 65535 caoddzd_oAjpfzb_cAcEEha_1nR_oa0 8 -32768 32767 FORMAT "%5.0" DEPOSIT ABSOLUTE /end AXIS_PTS
/begin AXIS_PTS AXX_KF_HUB_GRDMX "Nkw_bls" 0x807223B2 NO_INPUT_QUANTITY _REC_A1AXS_1_MBSE_S2 65535 caoddzd_oAjpfzb_cAcEEha_1nR_oa0 6 -32768 32767 FORMAT "%5.0" DEPOSIT ABSOLUTE /end AXIS_PTS
/begin AXIS_PTS AXX_KF_HUBESTM "Nkw_10ms" 0x80723FEC NO_INPUT_QUANTITY _REC_A1AXS_1_MBSE_S2 65535 caoddzd_oAjpfzb_cAcEEha_1nR_oa0 8 -32768 32767 FORMAT "%5.0" DEPOSIT ABSOLUTE /end AXIS_PTS
/begin AXIS_PTS AXX_KF_MDIMAX_FG "AXX_KF_MDIMAX_FG" 0x807312EC Nkw_ref _REC_A1AXS_1_MBSE_S2 65535 caoddzd_oAjpfzb_cAcEEha_1nR_oa0 6 -32768 32767 DEPOSIT ABSOLUTE /end AXIS_PTS
/begin AXIS_PTS AXX_KF_MDIMAX_SK "AXX_KF_MDIMAX_SK" 0x807312DC Nkw_ref _REC_A1AXS_1_MBSE_S2 65535 caoddzd_oAjpfzb_cAcEEha_1nR_oa0 8 -32768 32767 DEPOSIT ABSOLUTE /end AXIS_PTS
/begin AXIS_PTS AXX_KF_MDIMAX_TANS "AXX_KF_MDIMAX_TANS" 0x807312D0 Nkw_ref _REC_A1AXS_1_MBSE_S2 65535 caoddzd_oAjpfzb_cAcEEha_1nR_oa0 6 -32768 32767 DEPOSIT ABSOLUTE /end AXIS_PTS
/begin AXIS_PTS AXX_KF_MDIMAX_TVDK "AXX_KF_MDIMAX_TVDK" 0x807312C4 Nkw_ref _REC_A1AXS_1_MBSE_S2 65535 caoddzd_oAjpfzb_cAcEEha_1nR_oa0 6 -32768 32767 DEPOSIT ABSOLUTE /end AXIS_PTS
/begin AXIS_PTS AXX_KF_MDR_ABV_SPO "AXX_KF_MDR_ABV_SPO" 0x807332C2 NO_INPUT_QUANTITY _REC_A1AXS_1_MBSE_S2 1310.7 Asyaixa_wdvtenb_FCefaCb_n__aa0o 10 -655.36 655.34 DEPOSIT ABSOLUTE /end AXIS_PTS
/begin AXIS_PTS AXX_KF_MDR_ABV_SPO_HS "AXX_KF_MDR_ABV_SPO_HS" 0x80733286 NO_INPUT_QUANTITY _REC_A1AXS_1_MBSE_S2 1310.7 Asyaixa_wdvtenb_FCefaCb_n__aa0o 10 -655.36 655.34 DEPOSIT ABSOLUTE /end AXIS_PTS
/begin AXIS_PTS AXX_KF_MDR_ABV_SPO2 "AXX_KF_MDR_ABV_SPO2" 0x807332AE NO_INPUT_QUANTITY _REC_A1AXS_1_MBSE_S2 1310.7 Asyaixa_wdvtenb_FCefaCb_n__aa0o 10 -655.36 655.34 DEPOSIT ABSOLUTE /end AXIS_PTS
/begin AXIS_PTS AXX_KF_MDR_ABV_SPO2_HS "AXX_KF_MDR_ABV_SPO2_HS" 0x8073329A NO_INPUT_QUANTITY _REC_A1AXS_1_MBSE_S2 1310.7 Asyaixa_wdvtenb_FCefaCb_n__aa0o 10 -655.36 655.34 DEPOSIT ABSOLUTE /end AXIS_PTS
/begin AXIS_PTS AXX_KF_MDRED_T "AXX_KF_MDRED_T" 0x8074B40E Tmot_wm _REC_A1AXS_1_MBSE_S2 655.35 DchEpAd_DBCFgoa_Ckhahgc_q__aoa0 6 -327.68 327.67 DEPOSIT ABSOLUTE /end AXIS_PTS
/begin AXIS_PTS AXX_KF_PHA_H_E1 "AXX_KF_PHA_H_E1" 0x80718C14 Nkw _REC_A1AXS_1_MBSE_S2 65535 caoddzd_oAjpfzb_cAcEEha_1nR_oa0 8 -32768 32767 FORMAT "%5.0" DEPOSIT ABSOLUTE /end AXIS_PTS
/begin AXIS_PTS AXX_KF_ZW_PF1 "AXX_KF_ZW_PF1" 0x807375A2 Nkw _REC_A1AXS_1_MBSE_S2 65535 caoddzd_oAjpfzb_cAcEEha_1nR_oa0 20 -32768 32767 FORMAT "%5.0" DEPOSIT ABSOLUTE /end AXIS_PTS
/begin AXIS_PTS AXX_KF_ZW_PF2 "AXX_KF_ZW_PF2" 0x8073757A Nkw _REC_A1AXS_1_MBSE_S2 65535 caoddzd_oAjpfzb_cAcEEha_1nR_oa0 20 -32768 32767 FORMAT "%5.0" DEPOSIT ABSOLUTE /end AXIS_PTS
/begin AXIS_PTS AXX_KF_ZW_S_PF1 "AXX_KF_ZW_S_PF1" 0x80737552 Nkw _REC_A1AXS_1_MBSE_S2 65535 caoddzd_oAjpfzb_cAcEEha_1nR_oa0 20 -32768 32767 FORMAT "%5.0" DEPOSIT ABSOLUTE /end AXIS_PTS
/begin AXIS_PTS AXX_KF_ZW_S_PF2 "AXX_KF_ZW_S_PF2" 0x8073752A Nkw _REC_A1AXS_1_MBSE_S2 65535 caoddzd_oAjpfzb_cAcEEha_1nR_oa0 20 -32768 32767 FORMAT "%5.0" DEPOSIT ABSOLUTE /end AXIS_PTS
/begin AXIS_PTS AXX_KF_ZW_UESP_PF1 "AXX_KF_ZW_UESP_PF1" 0x80737516 Nkw _REC_A1AXS_1_MBSE_S2 65535 caoddzd_oAjpfzb_cAcEEha_1nR_oa0 10 -32768 32767 FORMAT "%5.0" DEPOSIT ABSOLUTE /end AXIS_PTS
/begin AXIS_PTS AXX_KF_ZW_UESP_PF2 "AXX_KF_ZW_UESP_PF2" 0x80737502 Nkw _REC_A1AXS_1_MBSE_S2 65535 caoddzd_oAjpfzb_cAcEEha_1nR_oa0 10 -32768 32767 FORMAT "%5.0" DEPOSIT ABSOLUTE /end AXIS_PTS
/begin AXIS_PTS AXX_KF_ZW_VP_PF1 "AXX_KF_ZW_VP_PF1" 0x8074F60A Nkw _REC_A1AXS_1_MBSE_S2 65535 caoddzd_oAjpfzb_cAcEEha_1nR_oa0 20 -32768 32767 FORMAT "%5.0" DEPOSIT ABSOLUTE /end AXIS_PTS
/begin AXIS_PTS AXX_KF_ZW_VP_PF2 "AXX_KF_ZW_VP_PF2" 0x8074F5E2 Nkw _REC_A1AXS_1_MBSE_S2 65535 caoddzd_oAjpfzb_cAcEEha_1nR_oa0 20 -32768 32767 FORMAT "%5.0" DEPOSIT ABSOLUTE /end AXIS_PTS
/begin AXIS_PTS AXX_KL_DKVL "AXX_KL_DKVL" 0x80743890 NO_INPUT_QUANTITY _REC_A1AXS_1_MBSE_S2 65535 caoddzd_oAjpfzb_cAcEEha_1nR_oa0 8 -32768 32767 FORMAT "%5.0" DEPOSIT ABSOLUTE /end AXIS_PTS
/begin AXIS_PTS AXX_KL_ENA_NREG_DSC "Axis for KL_ENA_NREG_KUPP_DSC" 0x80757894 NO_INPUT_QUANTITY _REC_A1AXS_1_MBSE_U1 255 raChrxc_kBtBrmb_FmDuEFa_n__aa0o 6 0 255 DEPOSIT ABSOLUTE /end AXIS_PTS
/begin AXIS_PTS AXX_KL_LAND_MDKMAX_VAR "X-axis for KL_LAND_MDKMAX_VAR1, KL_LAND_MDKMAX_VAR2, KL_LAND_MDKMAX_VAR3 and KL_LAND_MDKMAX_VAR4" 0x807314EE Nkw_ref _REC_A1AXS_1_MBSE_S2 65535 caoddzd_oAjpfzb_cAcEEha_1nR_oa0 18 -32768 32767 DEPOSIT ABSOLUTE /end AXIS_PTS
/begin AXIS_PTS AXX_KL_MD_K_MAX_BST "AXX_KL_MD_K_MAX_BST" 0x807324A8 Nkw_opt _REC_A1AXS_1_MBSE_S2 65535 caoddzd_oAjpfzb_cAcEEha_1nR_oa0 12 -32768 32767 FORMAT "%5.0" DEPOSIT ABSOLUTE /end AXIS_PTS
/begin AXIS_PTS AXX_KL_MD_K_MAX_BST_HS "AXX_KL_MD_K_MAX_BST_HS" 0x80732490 Nkw_opt _REC_A1AXS_1_MBSE_S2 65535 caoddzd_oAjpfzb_cAcEEha_1nR_oa0 12 -32768 32767 FORMAT "%5.0" DEPOSIT ABSOLUTE /end AXIS_PTS
/begin AXIS_PTS AXX_KL_MD_K_MAX_BST_STRG_AT "Breakpoint engine speed" 0x80748688 NO_INPUT_QUANTITY _REC_A1AXS_1_MBSE_S2 65535 raChrxc_kBtBrmb_FmDuEFa_n__aa0o 12 -32768 32767 FORMAT "%6.0" DEPOSIT ABSOLUTE /end AXIS_PTS
/begin AXIS_PTS AXX_KL_MD_K_MAX_BST_STRG_HS "Breakpoint engine speed" 0x80748670 NO_INPUT_QUANTITY _REC_A1AXS_1_MBSE_S2 65535 raChrxc_kBtBrmb_FmDuEFa_n__aa0o 12 -32768 32767 FORMAT "%6.0" DEPOSIT ABSOLUTE /end AXIS_PTS
/begin AXIS_PTS AXX_KL_MD_K_MAX_PB "AXX_KL_MD_K_MAX_PB" 0x80732478 Nkw_opt _REC_A1AXS_1_MBSE_S2 65535 caoddzd_oAjpfzb_cAcEEha_1nR_oa0 12 -32768 32767 FORMAT "%5.0" DEPOSIT ABSOLUTE /end AXIS_PTS
/begin AXIS_PTS AXX_KL_MD_K_MAX_PB_STRG_AT "Support point RPM" 0x80748658 NO_INPUT_QUANTITY _REC_A1AXS_1_MBSE_S2 65535 raChrxc_kBtBrmb_FmDuEFa_n__aa0o 12 -32768 32767 FORMAT "%6.0" DEPOSIT ABSOLUTE /end AXIS_PTS
/begin AXIS_PTS AXX_KL_MD_K_MAX_RNSTART_STRG_HS "Breakpoint engine speed" 0x80748640 NO_INPUT_QUANTITY _REC_A1AXS_1_MBSE_S2 65535 raChrxc_kBtBrmb_FmDuEFa_n__aa0o 12 -32768 32767 FORMAT "%6.0" DEPOSIT ABSOLUTE /end AXIS_PTS
/begin AXIS_PTS AXX_KL_MD_K_MAX_RST "AXX_KL_MD_K_MAX_RST" 0x80732460 Nkw_opt _REC_A1AXS_1_MBSE_S2 65535 caoddzd_oAjpfzb_cAcEEha_1nR_oa0 12 -32768 32767 FORMAT "%5.0" DEPOSIT ABSOLUTE /end AXIS_PTS
/begin AXIS_PTS AXX_KL_MD_K_MAX_RST_HS "AXX_KL_MD_K_MAX_RST_HS" 0x80732448 Nkw_opt _REC_A1AXS_1_MBSE_S2 65535 caoddzd_oAjpfzb_cAcEEha_1nR_oa0 12 -32768 32767 FORMAT "%5.0" DEPOSIT ABSOLUTE /end AXIS_PTS
/begin AXIS_PTS AXX_KL_MD_K_MAX_RST_STRG_AT "Support point RPM" 0x80748628 NO_INPUT_QUANTITY _REC_A1AXS_1_MBSE_S2 65535 raChrxc_kBtBrmb_FmDuEFa_n__aa0o 12 -32768 32767 FORMAT "%6.0" DEPOSIT ABSOLUTE /end AXIS_PTS
/begin AXIS_PTS AXX_KL_MD_K_MAX_SGASSE "AXX_KL_MD_K_MAX_SGASSE" 0x80732430 Nkw_opt _REC_A1AXS_1_MBSE_S2 65535 caoddzd_oAjpfzb_cAcEEha_1nR_oa0 12 -32768 32767 FORMAT "%5.0" DEPOSIT ABSOLUTE /end AXIS_PTS
/begin AXIS_PTS AXX_KL_MD_K_MAX_SGASSE_STRG_AT "Support point RPM" 0x80748610 NO_INPUT_QUANTITY _REC_A1AXS_1_MBSE_S2 65535 raChrxc_kBtBrmb_FmDuEFa_n__aa0o 12 -32768 32767 FORMAT "%6.0" DEPOSIT ABSOLUTE /end AXIS_PTS
/begin AXIS_PTS AXX_KL_MD_K_MAX_VL "AXX_KL_MD_K_MAX_VL" 0x80732418 Nkw_opt _REC_A1AXS_1_MBSE_S2 65535 caoddzd_oAjpfzb_cAcEEha_1nR_oa0 12 -32768 32767 FORMAT "%5.0" DEPOSIT ABSOLUTE /end AXIS_PTS
/begin AXIS_PTS AXX_KL_MD_K_MAX_VL_ECO_STRG_HS "Breakpoint engine speed" 0x807485F8 NO_INPUT_QUANTITY _REC_A1AXS_1_MBSE_S2 65535 raChrxc_kBtBrmb_FmDuEFa_n__aa0o 12 -32768 32767 FORMAT "%6.0" DEPOSIT ABSOLUTE /end AXIS_PTS
/begin AXIS_PTS AXX_KL_MD_K_MAX_VL_HS "AXX_KL_MD_K_MAX_VL_HS" 0x80732400 Nkw_opt _REC_A1AXS_1_MBSE_S2 65535 caoddzd_oAjpfzb_cAcEEha_1nR_oa0 12 -32768 32767 FORMAT "%5.0" DEPOSIT ABSOLUTE /end AXIS_PTS
/begin AXIS_PTS AXX_KL_MD_K_MAX_VL_STRG_AT "Support point RPM" 0x807485E0 NO_INPUT_QUANTITY _REC_A1AXS_1_MBSE_S2 65535 raChrxc_kBtBrmb_FmDuEFa_n__aa0o 12 -32768 32767 FORMAT "%6.0" DEPOSIT ABSOLUTE /end AXIS_PTS
/begin AXIS_PTS AXX_KL_MDG_MAX_GANG_AT "Actual gear of gearbox 1 (hybrid axis)" 0x8075F8DF NO_INPUT_QUANTITY _REC_A1AXS_1_MBSE_S1 255 raChrxc_kBtBrmb_FmDuEFa_n__aa0o 10 -128 127 FORMAT "%3.0" DEPOSIT ABSOLUTE /end AXIS_PTS
/begin AXIS_PTS AXX_KL_MDG_MAX_GANG_HS "Actual gear of gearbox 1 (hybrid axis)" 0x8075F8D5 NO_INPUT_QUANTITY _REC_A1AXS_1_MBSE_S1 255 raChrxc_kBtBrmb_FmDuEFa_n__aa0o 10 -128 127 FORMAT "%3.0" DEPOSIT ABSOLUTE /end AXIS_PTS
/begin AXIS_PTS AXX_KL_MDI_MAX_GRD_UP "AXX_KL_MDI_MAX_GRD_UP" 0x80731270 Mdi_max_diff _REC_A1AXS_1_MBSE_U2 6553.5 BMW_dm_sw_q0p1_Nm 6 0 6553.5 FORMAT "%6.1" DEPOSIT ABSOLUTE /end AXIS_PTS
/begin AXIS_PTS AXX_KL_MDIMX_F_TMOT "AXX_KL_MDIMX_F_TMOT" 0x807312B8 Tmot _REC_A1AXS_1_MBSE_S2 655.35 DchEpAd_DBCFgoa_Ckhahgc_q__aoa0 6 -327.68 327.67 FORMAT "%7.2" DEPOSIT ABSOLUTE /end AXIS_PTS
/begin AXIS_PTS AXX_KL_MDIMX_VL_APPLZ "AXX_KL_MDIMX_VL_APPLZ" 0x80731288 Nkw_ref _REC_A1AXS_1_MBSE_S2 65535 caoddzd_oAjpfzb_cAcEEha_1nR_oa0 18 -32768 32767 DEPOSIT ABSOLUTE /end AXIS_PTS
/begin AXIS_PTS AXX_KL_MDRED_NKW "AXX_KL_MDRED_NKW" 0x8074B42E Nkw_wm _REC_A1AXS_1_MBSE_S2 65535 caoddzd_oAjpfzb_cAcEEha_1nR_oa0 6 -32768 32767 DEPOSIT ABSOLUTE /end AXIS_PTS
/begin AXIS_PTS AXX_KL_RF_MAX "Nkw" 0x80721C38 NO_INPUT_QUANTITY _REC_A1AXS_1_MBSE_S2 65535 caoddzd_oAjpfzb_cAcEEha_1nR_oa0 12 -32768 32767 FORMAT "%5.0" DEPOSIT ABSOLUTE /end AXIS_PTS
/begin AXIS_PTS AXX_KL_RF_MAX_UESP "Nkw" 0x80721C20 NO_INPUT_QUANTITY _REC_A1AXS_1_MBSE_S2 65535 caoddzd_oAjpfzb_cAcEEha_1nR_oa0 12 -32768 32767 FORMAT "%5.0" DEPOSIT ABSOLUTE /end AXIS_PTS
/begin AXIS_PTS AXY_KF_ASPR_NORM_UESP_PF1 "Rfv_vns" 0x8071FD06 NO_INPUT_QUANTITY _REC_A1AXS_1_MBSE_S2 655.35 CgkBooc_wkiDfEd_Czglhgc_fR_1a0o 8 -327.68 327.67 FORMAT "%9.2" DEPOSIT ABSOLUTE /end AXIS_PTS
/begin AXIS_PTS AXY_KF_EDA_ANZ_SPORT_MDK_IST "KF_EDA_ANZ_SPORT_MDK_IST" 0x8070CE72 NO_INPUT_QUANTITY _REC_A1AXS_1_MBSE_S2 65535 caoddzd_oAjpfzb_cAcEEha_1nR_oa0 6 -32768 32767 FORMAT "%5.0" DEPOSIT ABSOLUTE /end AXIS_PTS
/begin AXIS_PTS AXY_KF_EHUB_MX "Rfv_hub" 0x8072239E NO_INPUT_QUANTITY _REC_A1AXS_1_MBSE_S2 655.35 CgkBooc_wkiDfEd_Czglhgc_fR_1a0o 6 -327.68 327.67 FORMAT "%9.2" DEPOSIT ABSOLUTE /end AXIS_PTS
/begin AXIS_PTS AXY_KF_ENA_NREG_GANG_SYN "Y-axis for KF_ENA_NREG_GANG_SYN" 0x80757869 NO_INPUT_QUANTITY _REC_A1AXS_1_MBSE_U1 255 raChrxc_kBtBrmb_FmDuEFa_n__aa0o 9 0 255 FORMAT "%3.0" DEPOSIT ABSOLUTE /end AXIS_PTS
/begin AXIS_PTS AXY_KF_ESPR_NORM_UESP_PF1 "Rfv_vns" 0x80720AD2 NO_INPUT_QUANTITY _REC_A1AXS_1_MBSE_S2 655.35 CgkBooc_wkiDfEd_Czglhgc_fR_1a0o 8 -327.68 327.67 FORMAT "%9.2" DEPOSIT ABSOLUTE /end AXIS_PTS
/begin AXIS_PTS AXY_KF_F_MDIMAX_KR "AXY_KF_F_MDIMAX_KR" 0x80731262 NO_INPUT_QUANTITY _REC_A1AXS_1_MBSE_S2 6553.5 BMW_dm_sw_q0p1_Nm 7 -3276.8 3276.7 DEPOSIT ABSOLUTE /end AXIS_PTS
/begin AXIS_PTS AXY_KF_FDZWT_PF1 "AXY_KF_FDZWT_PF1" 0x80737748 Tans _REC_A1AXS_1_MBSE_S2 6553.5 BMW_q0p1_degC 6 -3276.8 3276.7 FORMAT "%6.1" DEPOSIT ABSOLUTE /end AXIS_PTS
/begin AXIS_PTS AXY_KF_FDZWT_PF2 "AXY_KF_FDZWT_PF2" 0x8073773C Tans _REC_A1AXS_1_MBSE_S2 6553.5 BMW_q0p1_degC 6 -3276.8 3276.7 FORMAT "%6.1" DEPOSIT ABSOLUTE /end AXIS_PTS
/begin AXIS_PTS AXY_KF_FK_FTRANSVL "AXY_KF_FK_FTRANSVL" 0x80743824 NO_INPUT_QUANTITY _REC_A1AXS_1_MBSE_U2 3.99993896484375 ilxsavd_hkzmBfc_lAzCpAb_nR_1oa0 6 0 3.99993896484375 FORMAT "%14.5" DEPOSIT ABSOLUTE /end AXIS_PTS
/begin AXIS_PTS AXY_KF_FRKKORRF_1 "AXY_KF_FRKKORRF_1" 0x80714F98 Rf _REC_A1AXS_1_MBSE_S2 655.35 CgkBooc_wkiDfEd_Czglhgc_fR_1a0o 16 -327.68 327.67 FORMAT "%7.2" DEPOSIT ABSOLUTE /end AXIS_PTS
/begin AXIS_PTS AXY_KF_FTRANSVL "AXY_KF_FTRANSVL" 0x80743804 NO_INPUT_QUANTITY _REC_A1AXS_1_MBSE_U2 0.999984741210938 FzbmlAa_gCtylrb_ckCqxAc_nR_6oa0 8 0 0.999984741210938 FORMAT "%7.5" DEPOSIT ABSOLUTE /end AXIS_PTS
/begin AXIS_PTS AXY_KF_HUB_GRDMX "Hubev_soll_kf" 0x80722392 NO_INPUT_QUANTITY _REC_A1AXS_1_MBSE_U2 65.535 ohoxkpc_embkBlb_gscheBc_m__aoa0 6 0 65.535 DEPOSIT ABSOLUTE /end AXIS_PTS
/begin AXIS_PTS AXY_KF_HUBESTM "Tmot_start" 0x80723EE4 NO_INPUT_QUANTITY _REC_A1AXS_1_MBSE_S2 655.35 DchEpAd_DBCFgoa_Ckhahgc_q__aoa0 8 -327.68 327.67 FORMAT "%7.2" DEPOSIT ABSOLUTE /end AXIS_PTS
/begin AXIS_PTS AXY_KF_MDIMAX_FG "AXY_KF_MDIMAX_FG" 0x80731256 Frfmxbsld _REC_A1AXS_1_MBSE_U2 1 Bhvfwhc_bigEubd_BBEupBd_nR_3oa0 6 0 1 FORMAT "%14.5" DEPOSIT ABSOLUTE /end AXIS_PTS
/begin AXIS_PTS AXY_KF_MDIMAX_SK "AXY_KF_MDIMAX_SK" 0x8075BF19 BMWpim_fac_TqRedn_ub _REC_A1AXS_1_MBSE_U1 0.99609375 BMW_Powertrain_DxECompuMethods_Def_ub_b1_nounit 7 0 0.99609375 DEPOSIT ABSOLUTE /end AXIS_PTS
/begin AXIS_PTS AXY_KF_MDIMAX_TANS "AXY_KF_MDIMAX_TANS" 0x8073124A Tans _REC_A1AXS_1_MBSE_S2 6553.5 BMW_q0p1_degC 6 -3276.8 3276.7 FORMAT "%6.1" DEPOSIT ABSOLUTE /end AXIS_PTS
/begin AXIS_PTS AXY_KF_MDIMAX_TVDK "AXY_KF_MDIMAX_TVDK" 0x8073123E Tvdk _REC_A1AXS_1_MBSE_S2 6553.5 BMW_q0p1_degC 6 -3276.8 3276.7 FORMAT "%6.1" DEPOSIT ABSOLUTE /end AXIS_PTS
/begin AXIS_PTS AXY_KF_MDR_ABV_SPO "AXY_KF_MDR_ABV_SPO" 0x80733176 NO_INPUT_QUANTITY _REC_A1AXS_1_MBSE_S2 1599.9755859375 uvFxekd_wvexlbc_BcFdkDd_nR_1a0o 12 -800 799.9755859375 DEPOSIT ABSOLUTE /end AXIS_PTS
/begin AXIS_PTS AXY_KF_MDR_ABV_SPO_HS "AXY_KF_MDR_ABV_SPO_HS" 0x8073312E NO_INPUT_QUANTITY _REC_A1AXS_1_MBSE_S2 1599.9755859375 uvFxekd_wvexlbc_BcFdkDd_nR_1a0o 12 -800 799.9755859375 DEPOSIT ABSOLUTE /end AXIS_PTS
/begin AXIS_PTS AXY_KF_MDR_ABV_SPO2 "AXY_KF_MDR_ABV_SPO2" 0x8073315E NO_INPUT_QUANTITY _REC_A1AXS_1_MBSE_S2 1599.9755859375 uvFxekd_wvexlbc_BcFdkDd_nR_1a0o 12 -800 799.9755859375 DEPOSIT ABSOLUTE /end AXIS_PTS
/begin AXIS_PTS AXY_KF_MDR_ABV_SPO2_HS "AXY_KF_MDR_ABV_SPO2_HS" 0x80733146 NO_INPUT_QUANTITY _REC_A1AXS_1_MBSE_S2 1599.9755859375 uvFxekd_wvexlbc_BcFdkDd_nR_1a0o 12 -800 799.9755859375 DEPOSIT ABSOLUTE /end AXIS_PTS
/begin AXIS_PTS AXY_KF_MDRED_T "AXY_KF_MDRED_T" 0x8074B39E Toel_wm _REC_A1AXS_1_MBSE_S2 6553.5 BMW_q0p1_degC 6 -3276.8 3276.7 DEPOSIT ABSOLUTE /end AXIS_PTS
/begin AXIS_PTS AXY_KF_PHA_H_E1 "AXY_KF_PHA_H_E1" 0x80718B8C NO_INPUT_QUANTITY _REC_A1AXS_1_MBSE_S2 3199.951171875 zyyxBpb_rEsnvtc_gktukCa_fR_5a0o 8 -1600 1599.951171875 DEPOSIT ABSOLUTE /end AXIS_PTS
/begin AXIS_PTS AXY_KF_ZW_PF1 "AXY_KF_ZW_PF1" 0x807374DA NO_INPUT_QUANTITY _REC_A1AXS_1_MBSE_S2 655.35 CgkBooc_wkiDfEd_Czglhgc_fR_1a0o 20 -327.68 327.67 FORMAT "%9.2" DEPOSIT ABSOLUTE /end AXIS_PTS
/begin AXIS_PTS AXY_KF_ZW_PF2 "AXY_KF_ZW_PF2" 0x807374B2 NO_INPUT_QUANTITY _REC_A1AXS_1_MBSE_S2 655.35 CgkBooc_wkiDfEd_Czglhgc_fR_1a0o 20 -327.68 327.67 FORMAT "%9.2" DEPOSIT ABSOLUTE /end AXIS_PTS
/begin AXIS_PTS AXY_KF_ZW_S_PF1 "AXY_KF_ZW_S_PF1" 0x8073748A NO_INPUT_QUANTITY _REC_A1AXS_1_MBSE_S2 655.35 CgkBooc_wkiDfEd_Czglhgc_fR_1a0o 20 -327.68 327.67 FORMAT "%9.2" DEPOSIT ABSOLUTE /end AXIS_PTS
/begin AXIS_PTS AXY_KF_ZW_S_PF2 "AXY_KF_ZW_S_PF2" 0x80737462 NO_INPUT_QUANTITY _REC_A1AXS_1_MBSE_S2 655.35 CgkBooc_wkiDfEd_Czglhgc_fR_1a0o 20 -327.68 327.67 FORMAT "%9.2" DEPOSIT ABSOLUTE /end AXIS_PTS
/begin AXIS_PTS AXY_KF_ZW_UESP_PF1 "AXY_KF_ZW_UESP_PF1" 0x80737446 NO_INPUT_QUANTITY _REC_A1AXS_1_MBSE_S2 655.35 CgkBooc_wkiDfEd_Czglhgc_fR_1a0o 14 -327.68 327.67 FORMAT "%9.2" DEPOSIT ABSOLUTE /end AXIS_PTS
/begin AXIS_PTS AXY_KF_ZW_UESP_PF2 "AXY_KF_ZW_UESP_PF2" 0x8073742A NO_INPUT_QUANTITY _REC_A1AXS_1_MBSE_S2 655.35 CgkBooc_wkiDfEd_Czglhgc_fR_1a0o 14 -327.68 327.67 FORMAT "%9.2" DEPOSIT ABSOLUTE /end AXIS_PTS
/begin AXIS_PTS AXY_KF_ZW_VP_PF1 "AXY_KF_ZW_VP_PF1" 0x8074F5C2 Rf_zwv _REC_A1AXS_1_MBSE_S2 655.35 CgkBooc_wkiDfEd_Czglhgc_fR_1a0o 16 -327.68 327.67 FORMAT "%9.2" DEPOSIT ABSOLUTE /end AXIS_PTS
/begin AXIS_PTS AXY_KF_ZW_VP_PF2 "AXY_KF_ZW_VP_PF2" 0x8074F5A2 Rf_zwv _REC_A1AXS_1_MBSE_S2 655.35 CgkBooc_wkiDfEd_Czglhgc_fR_1a0o 16 -327.68 327.67 FORMAT "%9.2" DEPOSIT ABSOLUTE /end AXIS_PTS
/begin AXIS_PTS BMWtchco_fac_FadePl_Ax "AXX_KL_ATLVST_UEB" 0x80726E0C NO_INPUT_QUANTITY _REC_A1AXS_1_MBSE_U2 7.9998779296875 acriqBc_tfkBqod_ocgjxzc_nR_8oa0 6 0 7.9998779296875 FORMAT "%11.4" DEPOSIT ABSOLUTE /end AXIS_PTS
/begin AXIS_PTS BMWtchctr_fac_Dp_Ax "AXX_KL_FPATLR_D" 0x80727968 BMWtchctr_pwr_Pctl_uw _REC_A1AXS_1_MBSE_U2 127.998046875 jucyrzb_bpFgwfd_uqrfhgc_k__aoa0 6 0 127.998046875 FORMAT "%7.3" DEPOSIT ABSOLUTE /end AXIS_PTS
/begin AXIS_PTS BMWtchctr_fac_DpDyn_Ax "AXX_KL_FPATLR_D" 0x80727974 BMWtchctr_pwr_Pctl_uw _REC_A1AXS_1_MBSE_U2 127.998046875 jucyrzb_bpFgwfd_uqrfhgc_k__aoa0 6 0 127.998046875 FORMAT "%7.3" DEPOSIT ABSOLUTE /end AXIS_PTS
/begin AXIS_PTS BMWtchctr_p_DifCrtnPp_Ax "AXX_KF_PDIFF_ATLR_P" 0x807278D4 BMWtchbas_p_Dif_sw _REC_A1AXS_1_MBSE_S2 8191.875 BMW_p_sw_q0p125_hPa 12 -4096 4095.875 FORMAT "%10.3" DEPOSIT ABSOLUTE /end AXIS_PTS
/begin AXIS_PTS BMWtchctr_p_DifCrtnPp_Ay "AXY_KF_PDIFF_ATLR_P" 0x807278C8 BMWtchsp_mf_Ex_uw _REC_A1AXS_1_MBSE_U2 2047.96875 CByjozc_eCmpBAb_pljBAmd_k__0oa0 6 0 2047.96875 FORMAT "%10.3" DEPOSIT ABSOLUTE /end AXIS_PTS
/begin AXIS_PTS BMWtchctr_p_DifCrtnPp_Ay___MGF_CC_PF_Slot2 "AXY_KF_PDIFF_ATLR_P (Slot 2, Pump Fuel)" 0x807C0A24 BMWtchsp_mf_Ex_uw _REC_A1AXS_1_MBSE_U2 2047.96875 CByjozc_eCmpBAb_pljBAmd_k__0oa0 6 0 2047.96875 FORMAT "%10.3" DEPOSIT ABSOLUTE /end AXIS_PTS
/begin AXIS_PTS BMWtchctr_p_DifCrtnPp_Ay___MGF_CC_PF_Slot3 "AXY_KF_PDIFF_ATLR_P (Slot 3, Pump Fuel)" 0x807C0A30 BMWtchsp_mf_Ex_uw _REC_A1AXS_1_MBSE_U2 2047.96875 CByjozc_eCmpBAb_pljBAmd_k__0oa0 6 0 2047.96875 FORMAT "%10.3" DEPOSIT ABSOLUTE /end AXIS_PTS
/begin AXIS_PTS BMWtchctr_p_DifCrtnPp_Ay___MGF_CC_PF_Slot4 "AXY_KF_PDIFF_ATLR_P (Slot 4, Pump Fuel)" 0x807C0A3C BMWtchsp_mf_Ex_uw _REC_A1AXS_1_MBSE_U2 2047.96875 CByjozc_eCmpBAb_pljBAmd_k__0oa0 6 0 2047.96875 FORMAT "%10.3" DEPOSIT ABSOLUTE /end AXIS_PTS
/begin AXIS_PTS BMWtchctr_p_DifCrtnPpDyn_Ax "AXX_KF_PDIFF_ATLR_P" 0x807278F8 BMWtchbas_p_Dif_sw _REC_A1AXS_1_MBSE_S2 8191.875 BMW_p_sw_q0p125_hPa 12 -4096 4095.875 FORMAT "%10.3" DEPOSIT ABSOLUTE /end AXIS_PTS
/begin AXIS_PTS BMWtchctr_p_DifCrtnPpDyn_Ay "AXY_KF_PDIFF_ATLR_P" 0x807278EC BMWtchsp_mf_Ex_uw _REC_A1AXS_1_MBSE_U2 2047.96875 CByjozc_eCmpBAb_pljBAmd_k__0oa0 6 0 2047.96875 FORMAT "%10.3" DEPOSIT ABSOLUTE /end AXIS_PTS
/begin AXIS_PTS BMWtchctr_pct_WgBasc_Ax "AXX_KF_WGPOS_VST" 0x80747D14 NO_INPUT_QUANTITY _REC_A1AXS_1_MBSE_U2 3.99993896484375 ilxsavd_hkzmBfc_lAzCpAb_nR_1oa0 12 0 3.99993896484375 FORMAT "%14.5" DEPOSIT ABSOLUTE /end AXIS_PTS
/begin AXIS_PTS BMWtchctr_pct_WgBasc_Ay "AXY_KF_WGPOS_VST" 0x80747CFC NO_INPUT_QUANTITY _REC_A1AXS_1_MBSE_U2 2559.9609375 ECeoxdb_wFseCtb_mEytEnb_k__o8a0 12 0 2559.9609375 FORMAT "%10.3" DEPOSIT ABSOLUTE /end AXIS_PTS
/begin AXIS_PTS BMWtchctr_pwr_CmprGra_Ax "AXX_KF_PVERD_GRD" 0x807278B0 BMWtchsp_rat_p_CmprLim_uw _REC_A1AXS_1_MBSE_U2 7.9998779296875 acriqBc_tfkBqod_ocgjxzc_nR_8oa0 12 0 7.9998779296875 FORMAT "%11.4" DEPOSIT ABSOLUTE /end AXIS_PTS
/begin AXIS_PTS BMWtchctr_pwr_CmprGra_Ay "AXY_KF_PVERD_GRD" 0x80727898 BMWtchsp_mf_CmprNorm_uw _REC_A1AXS_1_MBSE_U2 4095.9375 wpxDCba_sgbvDxb_FliBAmd_k__0oa0 12 0 4095.9375 FORMAT "%10.3" DEPOSIT ABSOLUTE /end AXIS_PTS
/begin AXIS_PTS BMWtchctr_pwr_Dp_Ax "AXX_KF_PATLR_D" 0x8072787C BMWtchbas_p_Dif_sw _REC_A1AXS_1_MBSE_S2 8191.875 BMW_p_sw_q0p125_hPa 14 -4096 4095.875 FORMAT "%10.3" DEPOSIT ABSOLUTE /end AXIS_PTS
/begin AXIS_PTS BMWtchctr_pwr_Dp_Ay "AXY_KF_PATLR_D" 0x80727860 BMWtchbas_p_DifGra_sw _REC_A1AXS_1_MBSE_S2 8191.875 BMW_p_sw_q0p125_hPa 14 -4096 4095.875 FORMAT "%10.3" DEPOSIT ABSOLUTE /end AXIS_PTS
/begin AXIS_PTS BMWtchctr_pwr_Pctl_Ax "AXX_KF_ATL_PVERD" 0x80727818 BMWtchsp_rat_p_CmprLim_uw _REC_A1AXS_1_MBSE_U2 7.9998779296875 acriqBc_tfkBqod_ocgjxzc_nR_8oa0 20 0 7.9998779296875 FORMAT "%11.4" DEPOSIT ABSOLUTE /end AXIS_PTS
/begin AXIS_PTS BMWtchctr_pwr_Pctl_Ax___MGF_CC_PF_Slot2 "AXX_KF_ATL_PVERD (Slot 2, Pump Fuel)" 0x807C1750 BMWtchsp_rat_p_CmprLim_uw _REC_A1AXS_1_MBSE_U2 7.9998779296875 acriqBc_tfkBqod_ocgjxzc_nR_8oa0 20 0 7.9998779296875 FORMAT "%11.4" DEPOSIT ABSOLUTE /end AXIS_PTS
/begin AXIS_PTS BMWtchctr_pwr_Pctl_Ax___MGF_CC_PF_Slot3 "AXX_KF_ATL_PVERD (Slot 3, Pump Fuel)" 0x807C1778 BMWtchsp_rat_p_CmprLim_uw _REC_A1AXS_1_MBSE_U2 7.9998779296875 acriqBc_tfkBqod_ocgjxzc_nR_8oa0 20 0 7.9998779296875 FORMAT "%11.4" DEPOSIT ABSOLUTE /end AXIS_PTS
/begin AXIS_PTS BMWtchctr_pwr_Pctl_Ax___MGF_CC_PF_Slot4 "AXX_KF_ATL_PVERD (Slot 4, Pump Fuel)" 0x807C17A0 BMWtchsp_rat_p_CmprLim_uw _REC_A1AXS_1_MBSE_U2 7.9998779296875 acriqBc_tfkBqod_ocgjxzc_nR_8oa0 20 0 7.9998779296875 FORMAT "%11.4" DEPOSIT ABSOLUTE /end AXIS_PTS
/begin AXIS_PTS BMWtchctr_pwr_PctlWideRng_Ay "BMWtchctr_pwr_PctlWideRng_Ay" 0x80727840 BMWtchsp_mf_CmprNormWideRng_uw _REC_A1AXS_1_MBSE_U2 4095.9375 wpxDCba_sgbvDxb_FliBAmd_k__0oa0 16 0 4095.9375 FORMAT "%10.3" DEPOSIT ABSOLUTE /end AXIS_PTS
/begin AXIS_PTS BMWtchctr_pwr_PctlWideRng_Ay___MGF_CC_PF_Slot2 "BMWtchctr_pwr_PctlWideRng_Ay (Slot 2, Pump Fuel)" 0x807D8D02 BMWtchsp_mf_CmprNormWideRng_uw _REC_A1AXS_1_MBSE_U2 4095.9375 wpxDCba_sgbvDxb_FliBAmd_k__0oa0 16 0 4095.9375 FORMAT "%10.3" DEPOSIT ABSOLUTE /end AXIS_PTS
/begin AXIS_PTS BMWtchctr_pwr_PctlWideRng_Ay___MGF_CC_PF_Slot3 "BMWtchctr_pwr_PctlWideRng_Ay (Slot 3, Pump Fuel)" 0x807D8D22 BMWtchsp_mf_CmprNormWideRng_uw _REC_A1AXS_1_MBSE_U2 4095.9375 wpxDCba_sgbvDxb_FliBAmd_k__0oa0 16 0 4095.9375 FORMAT "%10.3" DEPOSIT ABSOLUTE /end AXIS_PTS
/begin AXIS_PTS BMWtchctr_pwr_PctlWideRng_Ay___MGF_CC_PF_Slot4 "BMWtchctr_pwr_PctlWideRng_Ay (Slot 4, Pump Fuel)" 0x807D8D42 BMWtchsp_mf_CmprNormWideRng_uw _REC_A1AXS_1_MBSE_U2 4095.9375 wpxDCba_sgbvDxb_FliBAmd_k__0oa0 16 0 4095.9375 FORMAT "%10.3" DEPOSIT ABSOLUTE /end AXIS_PTS
/begin AXIS_PTS BMWtchdiag_pct_WgPHi_Ax "AXX_KF_ATLRPID_MN" 0x80727B56 BMWtchbas_p_Dif_sw _REC_A1AXS_1_MBSE_S2 8191.875 BMW_p_sw_q0p125_hPa 5 -4096 4095.875 FORMAT "%10.3" DEPOSIT ABSOLUTE /end AXIS_PTS
/begin AXIS_PTS BMWtchdiag_pct_WgPHi_Ay "AXY_KF_ATLRPID_MN" 0x80727B4C BMWtchdiag_fac_pwr_TrbPctl_uw _REC_A1AXS_1_MBSE_U2 7.9998779296875 acriqBc_tfkBqod_ocgjxzc_nR_8oa0 5 0 7.9998779296875 FORMAT "%10.3" DEPOSIT ABSOLUTE /end AXIS_PTS
/begin AXIS_PTS BMWtchdiag_pct_WgPLo_Ax "AXX_KF_ATLRPID_MX" 0x80727B42 NO_INPUT_QUANTITY _REC_A1AXS_1_MBSE_S2 8191.875 BMW_p_sw_q0p125_hPa 5 -4096 4095.875 FORMAT "%10.3" DEPOSIT ABSOLUTE /end AXIS_PTS
/begin AXIS_PTS BMWtchdiag_pct_WgPLo_Ay "AXY_KF_ATLRPID_MX" 0x80727B38 BMWtchdiag_fac_pwr_TrbPctl_uw _REC_A1AXS_1_MBSE_U2 7.9998779296875 acriqBc_tfkBqod_ocgjxzc_nR_8oa0 5 0 7.9998779296875 FORMAT "%10.3" DEPOSIT ABSOLUTE /end AXIS_PTS
/begin AXIS_PTS BMWtchout_pct_WgBlwOff_Ax "axis" 0x8072809C Nkw _REC_A1AXS_1_MBSE_S2 65535 caoddzd_oAjpfzb_cAcEEha_1nR_oa0 4 -32768 32767 FORMAT "%5.0" DEPOSIT ABSOLUTE /end AXIS_PTS
/begin AXIS_PTS BMWtchsp_rat_p_CmprMax_Ax "AXX_KF_FPLDMAX" 0x807284AC BMWtchsp_mf_CmprNorm_uw _REC_A1AXS_1_MBSE_U2 4095.9375 wpxDCba_sgbvDxb_FliBAmd_k__0oa0 8 0 4095.9375 FORMAT "%10.3" DEPOSIT ABSOLUTE /end AXIS_PTS
/begin AXIS_PTS BMWtchsp_rat_p_CmprMax_Ay "AXY_KF_FPLDMAX" 0x807284A0 BMWtchtbc_t_BefCmpr_sw _REC_A1AXS_1_MBSE_S2 6553.5 BMW_q0p1_degC 6 -3276.8 3276.7 FORMAT "%6.1" DEPOSIT ABSOLUTE /end AXIS_PTS
/begin AXIS_PTS BMWtchsp_rat_p_CmprPmp_Ax "AXX_KL_FPLDPUMP" 0x80728490 BMWtchsp_mf_CmprNorm_uw _REC_A1AXS_1_MBSE_U2 4095.9375 wpxDCba_sgbvDxb_FliBAmd_k__0oa0 8 0 4095.9375 FORMAT "%10.3" DEPOSIT ABSOLUTE /end AXIS_PTS
/begin AXIS_PTS BMWtqe_tqc_FlApplStg_Ax "Torque engine, crankshaft torque full load application stage X-axis" 0x807314C0 Nkw_ref _REC_A1AXS_1_MBSE_S2 65535 caoddzd_oAjpfzb_cAcEEha_1nR_oa0 18 -32768 32767 DEPOSIT ABSOLUTE /end AXIS_PTS
/begin AXIS_PTS GAX_KF_ASPR_NORM_PF1 "Nkw" 0x8072091C NO_INPUT_QUANTITY _REC_A1AXS_1_MBSE_S2 65535 caoddzd_oAjpfzb_cAcEEha_1nR_oa0 16 -32768 32767 FORMAT "%5.0" DEPOSIT ABSOLUTE /end AXIS_PTS
/begin AXIS_PTS GAX_KF_ASPR_NORM_PF2 "Nkw" 0x807208FC NO_INPUT_QUANTITY _REC_A1AXS_1_MBSE_S2 65535 caoddzd_oAjpfzb_cAcEEha_1nR_oa0 16 -32768 32767 FORMAT "%5.0" DEPOSIT ABSOLUTE /end AXIS_PTS
/begin AXIS_PTS GAX_KF_EHUB_NORM_LAST "Nkw_bls" 0x80723EBC NO_INPUT_QUANTITY _REC_A1AXS_1_MBSE_S2 65535 caoddzd_oAjpfzb_cAcEEha_1nR_oa0 20 -32768 32767 FORMAT "%5.0" DEPOSIT ABSOLUTE /end AXIS_PTS
/begin AXIS_PTS GAX_KF_ESPR_NORM_PF1 "Nkw" 0x807216EE NO_INPUT_QUANTITY _REC_A1AXS_1_MBSE_S2 65535 caoddzd_oAjpfzb_cAcEEha_1nR_oa0 16 -32768 32767 FORMAT "%5.0" DEPOSIT ABSOLUTE /end AXIS_PTS
/begin AXIS_PTS GAX_KF_ESPR_NORM_PF2 "Nkw" 0x807216CE NO_INPUT_QUANTITY _REC_A1AXS_1_MBSE_S2 65535 caoddzd_oAjpfzb_cAcEEha_1nR_oa0 16 -32768 32767 FORMAT "%5.0" DEPOSIT ABSOLUTE /end AXIS_PTS
/begin AXIS_PTS GAY_KF_ASPR_NORM_PF1 "Rfv_vns" 0x807208DC NO_INPUT_QUANTITY _REC_A1AXS_1_MBSE_S2 655.35 CgkBooc_wkiDfEd_Czglhgc_fR_1a0o 16 -327.68 327.67 FORMAT "%9.2" DEPOSIT ABSOLUTE /end AXIS_PTS
/begin AXIS_PTS GAY_KF_ASPR_NORM_PF2 "Rfv_vns" 0x807208BC NO_INPUT_QUANTITY _REC_A1AXS_1_MBSE_S2 655.35 CgkBooc_wkiDfEd_Czglhgc_fR_1a0o 16 -327.68 327.67 FORMAT "%9.2" DEPOSIT ABSOLUTE /end AXIS_PTS
/begin AXIS_PTS GAY_KF_EHUB_NORM_LAST "Rfv_hub_kor" 0x80723E84 NO_INPUT_QUANTITY _REC_A1AXS_1_MBSE_S2 655.35 CgkBooc_wkiDfEd_Czglhgc_fR_1a0o 20 -327.68 327.67 FORMAT "%9.2" DEPOSIT ABSOLUTE /end AXIS_PTS
/begin AXIS_PTS GAY_KF_ESPR_NORM_PF1 "Rfv_vns" 0x807216AE NO_INPUT_QUANTITY _REC_A1AXS_1_MBSE_S2 655.35 CgkBooc_wkiDfEd_Czglhgc_fR_1a0o 16 -327.68 327.67 FORMAT "%9.2" DEPOSIT ABSOLUTE /end AXIS_PTS
/begin AXIS_PTS GAY_KF_ESPR_NORM_PF2 "Rfv_vns" 0x8072168E NO_INPUT_QUANTITY _REC_A1AXS_1_MBSE_S2 655.35 CgkBooc_wkiDfEd_Czglhgc_fR_1a0o 16 -327.68 327.67 FORMAT "%9.2" DEPOSIT ABSOLUTE /end AXIS_PTS
/begin AXIS_PTS GXX_KF_LABAS "Group X-axis for KF_LABASxxx and KF_LA_SK" 0x8074E59C Nkw _REC_A1AXS_1_MBSE_S2 65535 caoddzd_oAjpfzb_cAcEEha_1nR_oa0 18 -32768 32767 FORMAT "%5.0" DEPOSIT ABSOLUTE /end AXIS_PTS
/begin AXIS_PTS GXX_KF_PHA_H_B1_BAS "GXX_KF_PHA_H_B1_BAS" 0x80716BA8 Nkw _REC_A1AXS_1_MBSE_S2 65535 caoddzd_oAjpfzb_cAcEEha_1nR_oa0 10 -32768 32767 FORMAT "%5.0" DEPOSIT ABSOLUTE /end AXIS_PTS
/begin AXIS_PTS GXY_KF_LABAS "Group Y-axis for KF_LABASxxx and KF_LA_SK" 0x8074E57A Rf _REC_A1AXS_1_MBSE_S2 655.35 CgkBooc_wkiDfEd_Czglhgc_fR_1a0o 17 -327.68 327.67 FORMAT "%7.2" DEPOSIT ABSOLUTE /end AXIS_PTS
/begin AXIS_PTS GXY_KF_PHA_H_B1_BAS "GXY_KF_PHA_H_B1_BAS input Rk_soll_h_xlb" 0x80716B80 NO_INPUT_QUANTITY _REC_A1AXS_1_MBSE_S2 3199.951171875 zyyxBpb_rEsnvtc_gktukCa_fR_5a0o 12 -1600 1599.951171875 FORMAT "%8.3" DEPOSIT ABSOLUTE /end AXIS_PTS
/begin AXIS_PTS IKCtl_nEngB16_X_AX "KR: Breakpoint distribution engine speed of group B" 0x807A0A74 Epm_nEng Axis_Xs16 32767.5 EngN 16 -16384 16383.5 FORMAT "%8.2" DEPOSIT ABSOLUTE /end AXIS_PTS
/begin AXIS_PTS IKCtl_ratLoadAddl04_X_AX "Support point distribution relative filling, 4 support points" 0x807A0AB2 AirMod_ratChrgAirCyl Axis_Xu16 1535.977 rel_q0p0234 4 0 1535.977 FORMAT "%8.3" DEPOSIT ABSOLUTE /end AXIS_PTS
/begin CHARACTERISTIC BMWls_vli_MinGraUp_C "Gradientenbegrenzung für Überblendung auf " VALUE 0x807222C0 KwUw 65.535 ohoxkpc_embkBlb_gscheBc_m__aoa0 0 65.535 FORMAT "%7.3" /end CHARACTERISTIC
/begin CHARACTERISTIC BMWmondmf_swi_StallStru_C "Enable / disable engine stall detection" VALUE 0x8075F724 FklWUb 1 fgjpsvb_fDqjECa_acgrbDd_n_dae__ 0 1 /end CHARACTERISTIC
/begin CHARACTERISTIC BMWosc_tq_MaxIdlCtlGbx_C "Maximum torque of idle speed control for forming Mdg_fahrer_vm" VALUE 0x8070C97A CurG_Ws16 6553.5 BMW_dm_sw_q0p1_Nm -3276.8 3276.7 /end CHARACTERISTIC
/begin CHARACTERISTIC BMWtchctr_n_PpLimMax_C "Max RPM limit for activation of P-component limitation during gearbox shift" VALUE 0x80726FA0 CurG_Ws16 65535 caoddzd_oAjpfzb_cAcEEha_1nR_oa0 -32768 32767 FORMAT "%5.0" /end CHARACTERISTIC
/begin CHARACTERISTIC BMWtchctr_ti_ToutPpLim_C "Timeout for activation of P-component limitation during gearbox shift" VALUE 0x8075703D FklWUb 2.55 camcxxd_bxlpdsa_Cshlhgc_sR_1a0o 0 2.55 FORMAT "%5.2" /end CHARACTERISTIC
/begin CHARACTERISTIC BMWtchsp_p_ReqMax_C___MGF_CC_PF_Slot2 "Maximum target boost pressure due to boost pressure sensor diagnostics (Slot 2, Pump Fuel)" VALUE 0x807C224A KwUw 8191.875 BMW_p_sw_q0p125_hPa 0 8191.875 FORMAT "%10.3" /end CHARACTERISTIC
/begin CHARACTERISTIC BMWtchsp_p_ReqMax_C___MGF_CC_PF_Slot3 "Maximum target boost pressure due to boost pressure sensor diagnostics (Slot 3, Pump Fuel)" VALUE 0x807C224C KwUw 8191.875 BMW_p_sw_q0p125_hPa 0 8191.875 FORMAT "%10.3" /end CHARACTERISTIC
/begin CHARACTERISTIC BMWtchsp_p_ReqMax_C___MGF_CC_PF_Slot4 "Maximum target boost pressure due to boost pressure sensor diagnostics (Slot 4, Pump Fuel)" VALUE 0x807C224E KwUw 8191.875 BMW_p_sw_q0p125_hPa 0 8191.875 FORMAT "%10.3" /end CHARACTERISTIC
/begin CHARACTERISTIC BMWtqc_pct_MoPwrRelDifThd_C "Torque coordination, motor power relative difference threshold constant" VALUE 0x8070CCEA CurG_Ws16 6.553499999999999 oihanzc_gchDhzc_BADAFBb_nR_1oa0 -3.2768 3.2767 FORMAT "%7.4" /end CHARACTERISTIC
/begin CHARACTERISTIC BMWtqc_pct_MoTqRelDifThd_C "Torque coordination motor torque relative difference threshold constant" VALUE 0x8070CCE8 CurG_Ws16 6.553499999999999 oihanzc_gchDhzc_BADAFBb_nR_1oa0 -3.2768 3.2767 FORMAT "%7.4" /end CHARACTERISTIC
/begin CHARACTERISTIC BMWtqe_rf_StrTqMaxOfs_C "Torque engine, relative filling start torque maximum offset constant" VALUE 0x80731D3C CurG_Ws16 655.35 ubqeuic_jteCkzd_CDglhgc_nR_1a0o -327.68 327.67 /end CHARACTERISTIC
/begin CHARACTERISTIC CW_MapSwitch_Slot2___MGF_CC "Map Switch  Slot 2 Codeword: Set 1 (true) to enable PumpFuel (PF) map switching of this slot (for all maps) and 0 (false) to disable PF map switching of this slot (for all maps, effectively PF, FF1 and FF2 will all use their slot 0 maps)" VALUE 0x807DB090 FklWUb 1 B_TRUE 0 1 FORMAT "%13.11" /end CHARACTERISTIC
/begin CHARACTERISTIC CW_MapSwitch_Slot3___MGF_CC "Map Switch  Slot 3 Codeword: Set 1 (true) to enable PumpFuel (PF) map switching of this slot (for all maps) and 0 (false) to disable PF map switching of this slot (for all maps, effectively PF, FF1 and FF2 will all use their slot 0 maps)" VALUE 0x807DB091 FklWUb 1 B_TRUE 0 1 FORMAT "%13.11" /end CHARACTERISTIC
/begin CHARACTERISTIC CW_MapSwitch_Slot4___MGF_CC "Map Switch  Slot 4 Codeword: Set 1 (true) to enable PumpFuel (PF) map switching of this slot (for all maps) and 0 (false) to disable PF map switching of this slot (for all maps, effectively PF, FF1 and FF2 will all use their slot 0 maps)" VALUE 0x807DB092 FklWUb 1 B_TRUE 0 1 FORMAT "%13.11" /end CHARACTERISTIC
/begin CHARACTERISTIC CW_TcuTorqueLimiter___MGF_CC " ()" VALUE 0x807FF7D4 FklWUb 1 B_TRUE 0 1 FORMAT "%13.11" /end CHARACTERISTIC
/begin CHARACTERISTIC CW_Valet___MGF_CC "Valet Codeword: Set 1 (true) to enable function and 0 (false) to disable function" VALUE 0x807C246E FklWUb 1 B_TRUE 0 1 FORMAT "%13.11" /end CHARACTERISTIC
/begin CHARACTERISTIC EngDa_pwrCrksftMax_C "Maximum engine power at crankshaft level" VALUE 0x80799EE8 RB_Val_Wr32 16777215.99 DEZ 0.01 16777216 FORMAT "%20.5" /end CHARACTERISTIC
/begin CHARACTERISTIC EngDa_tqCrksftMax_C "Maximum engine torque at crankshaft level" VALUE 0x80799EEC RB_Val_Wr32 16777215.9 BMW_m_sw_q1p0_Nm 0.1 16777216 FORMAT "%16.5" /end CHARACTERISTIC
/begin CHARACTERISTIC EngDa_tqInnrMax_C "Maximum indicated engine torque" VALUE 0x80799EF0 RB_Val_Wr32 16777215.9 BMW_m_sw_q1p0_Nm 0.1 16777216 FORMAT "%16.5" /end CHARACTERISTIC
/begin CHARACTERISTIC K_EDA_P_MAX_MOT "Limitation of the calculated engine power" VALUE 0x8070CCF8 CurG_Ws16 3276.7 oDhhEAa_tuCuntc_ajhfaCa_k__aa0o 0 3276.7 FORMAT "%6.1" /end CHARACTERISTIC
/begin CHARACTERISTIC K_FMDK0_AKT "Maximum k0 torque for activation of k0 torque limitation addition" VALUE 0x8072C546 CurG_Ws16 3276.7 BMW_dm_sw_q0p1_Nm 0 3276.7 FORMAT "%4.1" /end CHARACTERISTIC
/begin CHARACTERISTIC K_KSU_INTREG_MX "Maximum value for integral component of PI controller" VALUE 0x80748D96 CurG_Ws16 6553.5 BMW_dm_sw_q0p1_Nm -3276.8 3276.7 /end CHARACTERISTIC
/begin CHARACTERISTIC K_KSU_MDEINGRIFF_MX "Maximum for CltPrt_MdDec" VALUE 0x80748D8E CurG_Ws16 3276.7 BMW_dm_sw_q0p1_Nm 0 3276.7 /end CHARACTERISTIC
/begin CHARACTERISTIC K_KSU_MDEINGRIFFPROP_MN "Minimum for CltPrt_MdDec_P" VALUE 0x80748D94 CurG_Ws16 6553.5 BMW_dm_sw_q0p1_Nm -3276.8 3276.7 /end CHARACTERISTIC
/begin CHARACTERISTIC K_KSU_MDEINGRIFFPROP_MX "Maximum for CltPrt_MdDec_P" VALUE 0x80748D92 CurG_Ws16 6553.5 BMW_dm_sw_q0p1_Nm -3276.8 3276.7 /end CHARACTERISTIC
/begin CHARACTERISTIC K_KSU_MDKBEGKUPDEFEKT "Maximum possible clutch torque with defective sensors or implausible rear axle" VALUE 0x80748D8C CurG_Ws16 3176.7 BMW_dm_sw_q0p1_Nm 100 3276.7 /end CHARACTERISTIC
/begin CHARACTERISTIC K_MDKIST_SOT_MX "Normalization for Mdk_ist_sot_mem_mx" VALUE 0x8070C92E CurG_Ws16 6553.5 BMW_q0p1__ -3276.8 3276.7 FORMAT "%7.1" /end CHARACTERISTIC
/begin CHARACTERISTIC K_NKW_PEMAX "Engine speed at which the engine reaches maximum power" VALUE 0x807297F0 CurG_Ws16 10000 caoddzd_oAjpfzb_cAcEEha_1nR_oa0 0 10000 FORMAT "%5.0" /end CHARACTERISTIC
/begin CHARACTERISTIC MoF_trqNorm1_C "Maximum indicated engine torque for torque normalization" VALUE 0x8076BE06 KwUw 32766 BMW_m_sw_q1p0_Nm 1 32767 FORMAT "%8.2" /end CHARACTERISTIC
/begin CHARACTERISTIC MoFTrqAct_nThd_C "RPM threshold above which MoFTrqAct_Eng is active" VALUE 0x8076BDBA CurG_Ws16 32767.5 n_sw_q0p5 -16384 16383.5 FORMAT "%8.2" /end CHARACTERISTIC
/begin CHARACTERISTIC MoFTrqAct_trqPtdInjActv_C "Maximum permitted actual torque, injections active" VALUE 0x8076BDFC CurG_Ws16 6553.5 BMW_dm_sw_q0p1_Nm -3276.8 3276.7 FORMAT "%8.3" /end CHARACTERISTIC
/begin CHARACTERISTIC MoFTrqPtd_pwrMax_C "Maximum combustion engine power in function monitoring" VALUE 0x8076B8FA KwUw 1023.984 leist_q0p015625_kW 0 1023.984 FORMAT "%8.3" /end CHARACTERISTIC
/begin CHARACTERISTIC MoFTrqPtd_tqCluMax_C "Maximum combustion engine torque at clutch in function monitoring" VALUE 0x8076B990 CurG_Ws16 6553.5 BMW_dm_sw_q0p1_Nm -3276.8 3276.7 FORMAT "%8.3" /end CHARACTERISTIC
/begin CHARACTERISTIC S_NMX_VM "Switch for determining N_vm_max (value = 0, 1 or 2)" VALUE 0x8075C001 FklWUb 255 raChrxc_kBtBrmb_FmDuEFa_n__aa0o 0 255 FORMAT "%3.0" /end CHARACTERISTIC
/begin CHARACTERISTIC ValetMaxPedal___MGF_CC_PF "Maximum allowable pedal which uses valet torque level 1, above which uses the more restrictive valet torque level 2" VALUE 0x807C246F FklWUb 255 ___MGF_CC_Pedal_x100_d256 0 100 FORMAT "%7.0" PHYS_UNIT "-" /end CHARACTERISTIC
/begin CHARACTERISTIC ValetMaxRpm___MGF_CC_PF "Maximum permissable engine speed, RPM" VALUE 0x807C241A KwUw 32767.5 ___MGF_CC_EngineSpeed_d4 0 15000 FORMAT "%8.2" /end CHARACTERISTIC
/begin CHARACTERISTIC ValetMaxSpeed___MGF_CC_PF "Maximum allowable vehicle speed which uses valet torque level 1, above which uses the more restrictive valet torque level 2" VALUE 0x807C241C KwUw 255 ___MGF_CC_Speedkmh_d64 0 327 FORMAT "%7.0" PHYS_UNIT "-" /end CHARACTERISTIC
/begin CHARACTERISTIC BMWtchco_fac_FadePl_T "Crossfade factor for boost pressure feedforward for part-load operation" CURVE 0x80757023 _REC_A1CUR_1_MBSE_U1_S1 0.99609375 BMW_Powertrain_DxECompuMethods_Def_ub_b1_nounit 0 0.99609375 FORMAT "%10.3"
 /begin AXIS_DESCR COM_AXIS NO_INPUT_QUANTITY acriqBc_tfkBqod_ocgjxzc_nR_8oa0 6 0 7.9998779296875 AXIS_PTS_REF BMWtchco_fac_FadePl_Ax FORMAT "%11.4" MONOTONY STRICT_INCREASE DEPOSIT ABSOLUTE /end AXIS_DESCR
/end CHARACTERISTIC
/begin CHARACTERISTIC BMWtchctr_fac_Dp_T "Correction factor for D-component of power-based boost pressure controller" CURVE 0x80727800 _REC_A1CUR_1_MBSE_U2_S1 15.999755859375 BumqDkc_mryszAa_EcglxAc_nR_4oa0 0 15.999755859375 FORMAT "%10.3"
 /begin AXIS_DESCR COM_AXIS BMWtchctr_pwr_Pctl_uw jucyrzb_bpFgwfd_uqrfhgc_k__aoa0 6 0 127.998046875 AXIS_PTS_REF BMWtchctr_fac_Dp_Ax FORMAT "%7.3" MONOTONY STRICT_INCREASE DEPOSIT ABSOLUTE /end AXIS_DESCR
/end CHARACTERISTIC
/begin CHARACTERISTIC BMWtchctr_fac_DpDyn_T "Correction factor for D-component of power-based boost pressure controller" CURVE 0x8072780C _REC_A1CUR_1_MBSE_U2_S1 15.999755859375 BumqDkc_mryszAa_EcglxAc_nR_4oa0 0 15.999755859375 FORMAT "%10.3"
 /begin AXIS_DESCR COM_AXIS BMWtchctr_pwr_Pctl_uw jucyrzb_bpFgwfd_uqrfhgc_k__aoa0 6 0 127.998046875 AXIS_PTS_REF BMWtchctr_fac_DpDyn_Ax FORMAT "%7.3" MONOTONY STRICT_INCREASE DEPOSIT ABSOLUTE /end AXIS_DESCR
/end CHARACTERISTIC
/begin CHARACTERISTIC BMWtchout_pct_WgBlwOff_T "Setpoint for wastegate position during blow-off valve active" CURVE 0x8072808C _REC_A1CUR_1_MBSE_U2_S1 99.9984741210938 Ejmqric_wgjqjja_AvCkvxb_fR_6o0o 0 99.9984741210938 FORMAT "%10.3"
 /begin AXIS_DESCR COM_AXIS Nkw caoddzd_oAjpfzb_cAcEEha_1nR_oa0 4 -32768 32767 AXIS_PTS_REF BMWtchout_pct_WgBlwOff_Ax FORMAT "%5.0" MONOTONY STRICT_INCREASE DEPOSIT ABSOLUTE /end AXIS_DESCR
/end CHARACTERISTIC
/begin CHARACTERISTIC BMWtchsp_rat_p_CmprPmp_T___MGF_CC_PF_Slot2 "KL_FPLDPUMP (Slot 2, Pump Fuel)" CURVE 0x807C23E0 _REC_A1CUR_1_MBSE_U2_S1 3.99993896484375 ilxsavd_hkzmBfc_lAzCpAb_nR_1oa0 0 3.99993896484375
 /begin AXIS_DESCR COM_AXIS BMWtchsp_mf_CmprNorm_uw wpxDCba_sgbvDxb_FliBAmd_k__0oa0 8 0 4095.9375 AXIS_PTS_REF BMWtchsp_rat_p_CmprPmp_Ax FORMAT "%10.3" MONOTONY STRICT_INCREASE DEPOSIT ABSOLUTE /end AXIS_DESCR
/end CHARACTERISTIC
/begin CHARACTERISTIC BMWtchsp_rat_p_CmprPmp_T___MGF_CC_PF_Slot3 "KL_FPLDPUMP (Slot 3, Pump Fuel)" CURVE 0x807C23F0 _REC_A1CUR_1_MBSE_U2_S1 3.99993896484375 ilxsavd_hkzmBfc_lAzCpAb_nR_1oa0 0 3.99993896484375
 /begin AXIS_DESCR COM_AXIS BMWtchsp_mf_CmprNorm_uw wpxDCba_sgbvDxb_FliBAmd_k__0oa0 8 0 4095.9375 AXIS_PTS_REF BMWtchsp_rat_p_CmprPmp_Ax FORMAT "%10.3" MONOTONY STRICT_INCREASE DEPOSIT ABSOLUTE /end AXIS_DESCR
/end CHARACTERISTIC
/begin CHARACTERISTIC BMWtchsp_rat_p_CmprPmp_T___MGF_CC_PF_Slot4 "KL_FPLDPUMP (Slot 4, Pump Fuel)" CURVE 0x807C2400 _REC_A1CUR_1_MBSE_U2_S1 3.99993896484375 ilxsavd_hkzmBfc_lAzCpAb_nR_1oa0 0 3.99993896484375
 /begin AXIS_DESCR COM_AXIS BMWtchsp_mf_CmprNorm_uw wpxDCba_sgbvDxb_FliBAmd_k__0oa0 8 0 4095.9375 AXIS_PTS_REF BMWtchsp_rat_p_CmprPmp_Ax FORMAT "%10.3" MONOTONY STRICT_INCREASE DEPOSIT ABSOLUTE /end AXIS_DESCR
/end CHARACTERISTIC
/begin CHARACTERISTIC BMWtqe_tqc_FlApplBol_T "Torque engine crankshaft torque full load application bottom limit characteristic curve" CURVE 0x8073149C _REC_A1CUR_1_MBSE_S2_S1 6553.5 BMW_dm_sw_q0p1_Nm -3276.8 3276.7 FORMAT "%6.1"
 /begin AXIS_DESCR COM_AXIS Nkw_ref caoddzd_oAjpfzb_cAcEEha_1nR_oa0 18 -32768 32767 AXIS_PTS_REF BMWtqe_tqc_FlApplStg_Ax MONOTONY STRICT_INCREASE DEPOSIT ABSOLUTE /end AXIS_DESCR
/end CHARACTERISTIC
/begin CHARACTERISTIC BMWtqe_tqc_FlApplBol_T___MGF_CC_PF_Slot2 "Torque engine crankshaft torque full load application bottom limit characteristic curve (Slot 2, Pump Fuel)" CURVE 0x807C6CDA _REC_A1CUR_1_MBSE_S2_S1 6553.5 BMW_dm_sw_q0p1_Nm -3276.8 3276.7 FORMAT "%6.1"
 /begin AXIS_DESCR COM_AXIS Nkw_ref caoddzd_oAjpfzb_cAcEEha_1nR_oa0 18 -32768 32767 AXIS_PTS_REF BMWtqe_tqc_FlApplStg_Ax MONOTONY STRICT_INCREASE DEPOSIT ABSOLUTE /end AXIS_DESCR
/end CHARACTERISTIC
/begin CHARACTERISTIC BMWtqe_tqc_FlApplBol_T___MGF_CC_PF_Slot3 "Torque engine crankshaft torque full load application bottom limit characteristic curve (Slot 3, Pump Fuel)" CURVE 0x807C6CFE _REC_A1CUR_1_MBSE_S2_S1 6553.5 BMW_dm_sw_q0p1_Nm -3276.8 3276.7 FORMAT "%6.1"
 /begin AXIS_DESCR COM_AXIS Nkw_ref caoddzd_oAjpfzb_cAcEEha_1nR_oa0 18 -32768 32767 AXIS_PTS_REF BMWtqe_tqc_FlApplStg_Ax MONOTONY STRICT_INCREASE DEPOSIT ABSOLUTE /end AXIS_DESCR
/end CHARACTERISTIC
/begin CHARACTERISTIC BMWtqe_tqc_FlApplBol_T___MGF_CC_PF_Slot4 "Torque engine crankshaft torque full load application bottom limit characteristic curve (Slot 4, Pump Fuel)" CURVE 0x807C6D22 _REC_A1CUR_1_MBSE_S2_S1 6553.5 BMW_dm_sw_q0p1_Nm -3276.8 3276.7 FORMAT "%6.1"
 /begin AXIS_DESCR COM_AXIS Nkw_ref caoddzd_oAjpfzb_cAcEEha_1nR_oa0 18 -32768 32767 AXIS_PTS_REF BMWtqe_tqc_FlApplStg_Ax MONOTONY STRICT_INCREASE DEPOSIT ABSOLUTE /end AXIS_DESCR
/end CHARACTERISTIC
/begin CHARACTERISTIC BMWtqe_tqc_FlApplStgNorm_T "Torque engine crankshaft full load application stage normal curve" CURVE 0x80731478 _REC_A1CUR_1_MBSE_S2_S1 6553.5 BMW_dm_sw_q0p1_Nm -3276.8 3276.7 FORMAT "%6.1"
 /begin AXIS_DESCR COM_AXIS Nkw_ref caoddzd_oAjpfzb_cAcEEha_1nR_oa0 18 -32768 32767 AXIS_PTS_REF BMWtqe_tqc_FlApplStg_Ax MONOTONY STRICT_INCREASE DEPOSIT ABSOLUTE /end AXIS_DESCR
/end CHARACTERISTIC
/begin CHARACTERISTIC BMWtqe_tqc_FlApplStgNorm_T___MGF_CC_PF_Slot2 "Torque engine crankshaft full load application stage normal curve (Slot 2, Pump Fuel)" CURVE 0x807C49D0 _REC_A1CUR_1_MBSE_S2_S1 6553.5 BMW_dm_sw_q0p1_Nm -3276.8 3276.7 FORMAT "%6.1"
 /begin AXIS_DESCR COM_AXIS Nkw_ref caoddzd_oAjpfzb_cAcEEha_1nR_oa0 18 -32768 32767 AXIS_PTS_REF BMWtqe_tqc_FlApplStg_Ax MONOTONY STRICT_INCREASE DEPOSIT ABSOLUTE /end AXIS_DESCR
/end CHARACTERISTIC
/begin CHARACTERISTIC BMWtqe_tqc_FlApplStgNorm_T___MGF_CC_PF_Slot3 "Torque engine crankshaft full load application stage normal curve (Slot 3, Pump Fuel)" CURVE 0x807C49F4 _REC_A1CUR_1_MBSE_S2_S1 6553.5 BMW_dm_sw_q0p1_Nm -3276.8 3276.7 FORMAT "%6.1"
 /begin AXIS_DESCR COM_AXIS Nkw_ref caoddzd_oAjpfzb_cAcEEha_1nR_oa0 18 -32768 32767 AXIS_PTS_REF BMWtqe_tqc_FlApplStg_Ax MONOTONY STRICT_INCREASE DEPOSIT ABSOLUTE /end AXIS_DESCR
/end CHARACTERISTIC
/begin CHARACTERISTIC BMWtqe_tqc_FlApplStgNorm_T___MGF_CC_PF_Slot4 "Torque engine crankshaft full load application stage normal curve (Slot 4, Pump Fuel)" CURVE 0x807C4A18 _REC_A1CUR_1_MBSE_S2_S1 6553.5 BMW_dm_sw_q0p1_Nm -3276.8 3276.7 FORMAT "%6.1"
 /begin AXIS_DESCR COM_AXIS Nkw_ref caoddzd_oAjpfzb_cAcEEha_1nR_oa0 18 -32768 32767 AXIS_PTS_REF BMWtqe_tqc_FlApplStg_Ax MONOTONY STRICT_INCREASE DEPOSIT ABSOLUTE /end AXIS_DESCR
/end CHARACTERISTIC
/begin CHARACTERISTIC BMWtqe_tqc_FlApplStgPwr1_T "Torque engine, crankshaft torque full load application stage power 1 curve" CURVE 0x80731454 _REC_A1CUR_1_MBSE_S2_S1 6553.5 BMW_dm_sw_q0p1_Nm -3276.8 3276.7 FORMAT "%6.1"
 /begin AXIS_DESCR COM_AXIS Nkw_ref caoddzd_oAjpfzb_cAcEEha_1nR_oa0 18 -32768 32767 AXIS_PTS_REF BMWtqe_tqc_FlApplStg_Ax MONOTONY STRICT_INCREASE DEPOSIT ABSOLUTE /end AXIS_DESCR
/end CHARACTERISTIC
/begin CHARACTERISTIC BMWtqe_tqc_FlApplStgPwr1_T___MGF_CC_PF_Slot2 "Torque engine, crankshaft torque full load application stage power 1 curve (Slot 2, Pump Fuel)" CURVE 0x807C6D6A _REC_A1CUR_1_MBSE_S2_S1 6553.5 BMW_dm_sw_q0p1_Nm -3276.8 3276.7 FORMAT "%6.1"
 /begin AXIS_DESCR COM_AXIS Nkw_ref caoddzd_oAjpfzb_cAcEEha_1nR_oa0 18 -32768 32767 AXIS_PTS_REF BMWtqe_tqc_FlApplStg_Ax MONOTONY STRICT_INCREASE DEPOSIT ABSOLUTE /end AXIS_DESCR
/end CHARACTERISTIC
/begin CHARACTERISTIC BMWtqe_tqc_FlApplStgPwr1_T___MGF_CC_PF_Slot3 "Torque engine, crankshaft torque full load application stage power 1 curve (Slot 3, Pump Fuel)" CURVE 0x807C882E _REC_A1CUR_1_MBSE_S2_S1 6553.5 BMW_dm_sw_q0p1_Nm -3276.8 3276.7 FORMAT "%6.1"
 /begin AXIS_DESCR COM_AXIS Nkw_ref caoddzd_oAjpfzb_cAcEEha_1nR_oa0 18 -32768 32767 AXIS_PTS_REF BMWtqe_tqc_FlApplStg_Ax MONOTONY STRICT_INCREASE DEPOSIT ABSOLUTE /end AXIS_DESCR
/end CHARACTERISTIC
/begin CHARACTERISTIC BMWtqe_tqc_FlApplStgPwr1_T___MGF_CC_PF_Slot4 "Torque engine, crankshaft torque full load application stage power 1 curve (Slot 4, Pump Fuel)" CURVE 0x807C8852 _REC_A1CUR_1_MBSE_S2_S1 6553.5 BMW_dm_sw_q0p1_Nm -3276.8 3276.7 FORMAT "%6.1"
 /begin AXIS_DESCR COM_AXIS Nkw_ref caoddzd_oAjpfzb_cAcEEha_1nR_oa0 18 -32768 32767 AXIS_PTS_REF BMWtqe_tqc_FlApplStg_Ax MONOTONY STRICT_INCREASE DEPOSIT ABSOLUTE /end AXIS_DESCR
/end CHARACTERISTIC
/begin CHARACTERISTIC BMWtqe_tqc_FlApplStgPwr2_T "Torque engine, crankshaft torque full load application stage power 2 curve" CURVE 0x80731430 _REC_A1CUR_1_MBSE_S2_S1 6553.5 BMW_dm_sw_q0p1_Nm -3276.8 3276.7 FORMAT "%6.1"
 /begin AXIS_DESCR COM_AXIS Nkw_ref caoddzd_oAjpfzb_cAcEEha_1nR_oa0 18 -32768 32767 AXIS_PTS_REF BMWtqe_tqc_FlApplStg_Ax MONOTONY STRICT_INCREASE DEPOSIT ABSOLUTE /end AXIS_DESCR
/end CHARACTERISTIC
/begin CHARACTERISTIC BMWtqe_tqc_FlApplStgPwr2_T___MGF_CC_PF_Slot2 "Torque engine, crankshaft torque full load application stage power 2 curve (Slot 2, Pump Fuel)" CURVE 0x807C889A _REC_A1CUR_1_MBSE_S2_S1 6553.5 BMW_dm_sw_q0p1_Nm -3276.8 3276.7 FORMAT "%6.1"
 /begin AXIS_DESCR COM_AXIS Nkw_ref caoddzd_oAjpfzb_cAcEEha_1nR_oa0 18 -32768 32767 AXIS_PTS_REF BMWtqe_tqc_FlApplStg_Ax MONOTONY STRICT_INCREASE DEPOSIT ABSOLUTE /end AXIS_DESCR
/end CHARACTERISTIC
/begin CHARACTERISTIC BMWtqe_tqc_FlApplStgPwr2_T___MGF_CC_PF_Slot3 "Torque engine, crankshaft torque full load application stage power 2 curve (Slot 3, Pump Fuel)" CURVE 0x807C88BE _REC_A1CUR_1_MBSE_S2_S1 6553.5 BMW_dm_sw_q0p1_Nm -3276.8 3276.7 FORMAT "%6.1"
 /begin AXIS_DESCR COM_AXIS Nkw_ref caoddzd_oAjpfzb_cAcEEha_1nR_oa0 18 -32768 32767 AXIS_PTS_REF BMWtqe_tqc_FlApplStg_Ax MONOTONY STRICT_INCREASE DEPOSIT ABSOLUTE /end AXIS_DESCR
/end CHARACTERISTIC
/begin CHARACTERISTIC BMWtqe_tqc_FlApplStgPwr2_T___MGF_CC_PF_Slot4 "Torque engine, crankshaft torque full load application stage power 2 curve (Slot 4, Pump Fuel)" CURVE 0x807C88E2 _REC_A1CUR_1_MBSE_S2_S1 6553.5 BMW_dm_sw_q0p1_Nm -3276.8 3276.7 FORMAT "%6.1"
 /begin AXIS_DESCR COM_AXIS Nkw_ref caoddzd_oAjpfzb_cAcEEha_1nR_oa0 18 -32768 32767 AXIS_PTS_REF BMWtqe_tqc_FlApplStg_Ax MONOTONY STRICT_INCREASE DEPOSIT ABSOLUTE /end AXIS_DESCR
/end CHARACTERISTIC
/begin CHARACTERISTIC BMWtqe_tqc_FlApplStgPwrHi_T "Torque engine crankshaft torque full load application stage power high characteristic curve" CURVE 0x8073140C _REC_A1CUR_1_MBSE_S2_S1 6553.5 BMW_dm_sw_q0p1_Nm -3276.8 3276.7 FORMAT "%6.1"
 /begin AXIS_DESCR COM_AXIS Nkw_ref caoddzd_oAjpfzb_cAcEEha_1nR_oa0 18 -32768 32767 AXIS_PTS_REF BMWtqe_tqc_FlApplStg_Ax MONOTONY STRICT_INCREASE DEPOSIT ABSOLUTE /end AXIS_DESCR
/end CHARACTERISTIC
/begin CHARACTERISTIC BMWtqe_tqc_FlApplStgPwrHi_T___MGF_CC_PF_Slot2 "Torque engine crankshaft torque full load application stage power high characteristic curve (Slot 2, Pump Fuel)" CURVE 0x807C892A _REC_A1CUR_1_MBSE_S2_S1 6553.5 BMW_dm_sw_q0p1_Nm -3276.8 3276.7 FORMAT "%6.1"
 /begin AXIS_DESCR COM_AXIS Nkw_ref caoddzd_oAjpfzb_cAcEEha_1nR_oa0 18 -32768 32767 AXIS_PTS_REF BMWtqe_tqc_FlApplStg_Ax MONOTONY STRICT_INCREASE DEPOSIT ABSOLUTE /end AXIS_DESCR
/end CHARACTERISTIC
/begin CHARACTERISTIC BMWtqe_tqc_FlApplStgPwrHi_T___MGF_CC_PF_Slot3 "Torque engine crankshaft torque full load application stage power high characteristic curve (Slot 3, Pump Fuel)" CURVE 0x807C894E _REC_A1CUR_1_MBSE_S2_S1 6553.5 BMW_dm_sw_q0p1_Nm -3276.8 3276.7 FORMAT "%6.1"
 /begin AXIS_DESCR COM_AXIS Nkw_ref caoddzd_oAjpfzb_cAcEEha_1nR_oa0 18 -32768 32767 AXIS_PTS_REF BMWtqe_tqc_FlApplStg_Ax MONOTONY STRICT_INCREASE DEPOSIT ABSOLUTE /end AXIS_DESCR
/end CHARACTERISTIC
/begin CHARACTERISTIC BMWtqe_tqc_FlApplStgPwrHi_T___MGF_CC_PF_Slot4 "Torque engine crankshaft torque full load application stage power high characteristic curve (Slot 4, Pump Fuel)" CURVE 0x807C8972 _REC_A1CUR_1_MBSE_S2_S1 6553.5 BMW_dm_sw_q0p1_Nm -3276.8 3276.7 FORMAT "%6.1"
 /begin AXIS_DESCR COM_AXIS Nkw_ref caoddzd_oAjpfzb_cAcEEha_1nR_oa0 18 -32768 32767 AXIS_PTS_REF BMWtqe_tqc_FlApplStg_Ax MONOTONY STRICT_INCREASE DEPOSIT ABSOLUTE /end AXIS_DESCR
/end CHARACTERISTIC
/begin CHARACTERISTIC KL_DKVL "Maximum value for throttle setpoint (only for S_WDKSVL_VAR=1)" CURVE 0x80743760 _REC_A1CUR_1_MBSE_U2_S1 100 vfyBdwd_ftexgja_BcFdiDd_fR_1a0o 0 100 FORMAT "%7.2"
 /begin AXIS_DESCR COM_AXIS NO_INPUT_QUANTITY caoddzd_oAjpfzb_cAcEEha_1nR_oa0 8 -32768 32767 AXIS_PTS_REF AXX_KL_DKVL FORMAT "%5.0" MONOTONY MON_INCREASE DEPOSIT ABSOLUTE /end AXIS_DESCR
/end CHARACTERISTIC
/begin CHARACTERISTIC KL_ENA_NREG_DSC "Curves DSC mode" CURVE 0x807577AA _REC_A1CUR_1_MBSE_U1_S1 255 raChrxc_kBtBrmb_FmDuEFa_n__aa0o 0 255
 /begin AXIS_DESCR COM_AXIS NO_INPUT_QUANTITY raChrxc_kBtBrmb_FmDuEFa_n__aa0o 6 0 255 AXIS_PTS_REF AXX_KL_ENA_NREG_DSC MONOTONY STRICT_INCREASE DEPOSIT ABSOLUTE /end AXIS_DESCR
/end CHARACTERISTIC
/begin CHARACTERISTIC KL_LAND_MDKMAX_VAR1 "Torque limitation for country variant 1" CURVE 0x807313E8 _REC_A1CUR_1_MBSE_S2_S1 6553.5 BMW_dm_sw_q0p1_Nm -3276.8 3276.7 FORMAT "%7.1"
 /begin AXIS_DESCR COM_AXIS Nkw_ref caoddzd_oAjpfzb_cAcEEha_1nR_oa0 18 -32768 32767 AXIS_PTS_REF AXX_KL_LAND_MDKMAX_VAR MONOTONY STRICT_INCREASE DEPOSIT ABSOLUTE /end AXIS_DESCR
/end CHARACTERISTIC
/begin CHARACTERISTIC KL_LAND_MDKMAX_VAR2 "Torque limitation for country variant 2" CURVE 0x807313C4 _REC_A1CUR_1_MBSE_S2_S1 6553.5 BMW_dm_sw_q0p1_Nm -3276.8 3276.7 FORMAT "%7.1"
 /begin AXIS_DESCR COM_AXIS Nkw_ref caoddzd_oAjpfzb_cAcEEha_1nR_oa0 18 -32768 32767 AXIS_PTS_REF AXX_KL_LAND_MDKMAX_VAR MONOTONY STRICT_INCREASE DEPOSIT ABSOLUTE /end AXIS_DESCR
/end CHARACTERISTIC
/begin CHARACTERISTIC KL_LAND_MDKMAX_VAR3 "Torque limitation for country variant 3" CURVE 0x807313A0 _REC_A1CUR_1_MBSE_S2_S1 6553.5 BMW_dm_sw_q0p1_Nm -3276.8 3276.7 FORMAT "%7.1"
 /begin AXIS_DESCR COM_AXIS Nkw_ref caoddzd_oAjpfzb_cAcEEha_1nR_oa0 18 -32768 32767 AXIS_PTS_REF AXX_KL_LAND_MDKMAX_VAR MONOTONY STRICT_INCREASE DEPOSIT ABSOLUTE /end AXIS_DESCR
/end CHARACTERISTIC
/begin CHARACTERISTIC KL_LAND_MDKMAX_VAR4 "Torque limitation for country variant 4" CURVE 0x8073137C _REC_A1CUR_1_MBSE_S2_S1 6553.5 BMW_dm_sw_q0p1_Nm -3276.8 3276.7 FORMAT "%7.1"
 /begin AXIS_DESCR COM_AXIS Nkw_ref caoddzd_oAjpfzb_cAcEEha_1nR_oa0 18 -32768 32767 AXIS_PTS_REF AXX_KL_LAND_MDKMAX_VAR MONOTONY STRICT_INCREASE DEPOSIT ABSOLUTE /end AXIS_DESCR
/end CHARACTERISTIC
/begin CHARACTERISTIC KL_LAND_MDKMAX_VAR5 "Torque limitation for country variant 5" CURVE 0x80731358 _REC_A1CUR_1_MBSE_S2_S1 6553.5 BMW_dm_sw_q0p1_Nm -3276.8 3276.7 FORMAT "%7.1"
 /begin AXIS_DESCR COM_AXIS Nkw_ref caoddzd_oAjpfzb_cAcEEha_1nR_oa0 18 -32768 32767 AXIS_PTS_REF AXX_KL_LAND_MDKMAX_VAR MONOTONY STRICT_INCREASE DEPOSIT ABSOLUTE /end AXIS_DESCR
/end CHARACTERISTIC
/begin CHARACTERISTIC KL_LAND_MDKMAX_VAR6 "Torque limitation for country variant 6" CURVE 0x80731334 _REC_A1CUR_1_MBSE_S2_S1 6553.5 BMW_dm_sw_q0p1_Nm -3276.8 3276.7 FORMAT "%7.1"
 /begin AXIS_DESCR COM_AXIS Nkw_ref caoddzd_oAjpfzb_cAcEEha_1nR_oa0 18 -32768 32767 AXIS_PTS_REF AXX_KL_LAND_MDKMAX_VAR MONOTONY STRICT_INCREASE DEPOSIT ABSOLUTE /end AXIS_DESCR
/end CHARACTERISTIC
/begin CHARACTERISTIC KL_LAND_MDKMAX_VAR7 "Torque limitation for country variant 7" CURVE 0x80731310 _REC_A1CUR_1_MBSE_S2_S1 6553.5 BMW_dm_sw_q0p1_Nm -3276.8 3276.7 FORMAT "%7.1"
 /begin AXIS_DESCR COM_AXIS Nkw_ref caoddzd_oAjpfzb_cAcEEha_1nR_oa0 18 -32768 32767 AXIS_PTS_REF AXX_KL_LAND_MDKMAX_VAR MONOTONY STRICT_INCREASE DEPOSIT ABSOLUTE /end AXIS_DESCR
/end CHARACTERISTIC
/begin CHARACTERISTIC KL_MD_K_MAX_BST "Speed-dependent boost curve of the combustion engine (Nkw_opt)" CURVE 0x80732390 _REC_A1CUR_1_MBSE_S2_S1 65535 lFwocba_tlxgpab_wmDuExd_NCRoa0o -32768 32767
 /begin AXIS_DESCR COM_AXIS Nkw_opt caoddzd_oAjpfzb_cAcEEha_1nR_oa0 12 -32768 32767 AXIS_PTS_REF AXX_KL_MD_K_MAX_BST FORMAT "%5.0" MONOTONY STRICT_INCREASE DEPOSIT ABSOLUTE /end AXIS_DESCR
/end CHARACTERISTIC
/begin CHARACTERISTIC KL_MD_K_MAX_BST_HS "Speed-dependent boost curve of the combustion engine (Nkw_opt) for manual transmission" CURVE 0x80732378 _REC_A1CUR_1_MBSE_S2_S1 65535 lFwocba_tlxgpab_wmDuExd_NCRoa0o -32768 32767
 /begin AXIS_DESCR COM_AXIS Nkw_opt caoddzd_oAjpfzb_cAcEEha_1nR_oa0 12 -32768 32767 AXIS_PTS_REF AXX_KL_MD_K_MAX_BST_HS FORMAT "%5.0" MONOTONY STRICT_INCREASE DEPOSIT ABSOLUTE /end AXIS_DESCR
/end CHARACTERISTIC
/begin CHARACTERISTIC KL_MD_K_MAX_BST_STRG_AT "Speed-dependent strategic gearbox input limit during boost for automatic transmission" CURVE 0x807485C8 _REC_A1CUR_1_MBSE_S2_S1 6553.5 BMW_dm_sw_q0p1_Nm -3276.8 3276.7 FORMAT "%4.1"
 /begin AXIS_DESCR COM_AXIS NO_INPUT_QUANTITY raChrxc_kBtBrmb_FmDuEFa_n__aa0o 12 -32768 32767 AXIS_PTS_REF AXX_KL_MD_K_MAX_BST_STRG_AT FORMAT "%6.0" MONOTONY STRICT_INCREASE DEPOSIT ABSOLUTE /end AXIS_DESCR
/end CHARACTERISTIC
/begin CHARACTERISTIC KL_MD_K_MAX_BST_STRG_AT_VAR "RPM-dependent strategic transmission input limitation during boost for automatic transmission" CURVE 0x807485B0 _REC_A1CUR_1_MBSE_S2_S1 6553.5 BMW_dm_sw_q0p1_Nm -3276.8 3276.7 FORMAT "%4.1"
 /begin AXIS_DESCR COM_AXIS NO_INPUT_QUANTITY raChrxc_kBtBrmb_FmDuEFa_n__aa0o 12 -32768 32767 AXIS_PTS_REF AXX_KL_MD_K_MAX_BST_STRG_AT FORMAT "%6.0" MONOTONY STRICT_INCREASE DEPOSIT ABSOLUTE /end AXIS_DESCR
/end CHARACTERISTIC
/begin CHARACTERISTIC KL_MD_K_MAX_BST_STRG_HS "Speed-dependent strategic gearbox input limit during boost for manual transmission" CURVE 0x80748598 _REC_A1CUR_1_MBSE_S2_S1 6553.5 BMW_dm_sw_q0p1_Nm -3276.8 3276.7 FORMAT "%4.1"
 /begin AXIS_DESCR COM_AXIS NO_INPUT_QUANTITY raChrxc_kBtBrmb_FmDuEFa_n__aa0o 12 -32768 32767 AXIS_PTS_REF AXX_KL_MD_K_MAX_BST_STRG_HS FORMAT "%6.0" MONOTONY STRICT_INCREASE DEPOSIT ABSOLUTE /end AXIS_DESCR
/end CHARACTERISTIC
/begin CHARACTERISTIC KL_MD_K_MAX_PB "RPM-dependent PowerBoost characteristic curve of the combustion engine (Nkw_opt)" CURVE 0x80732360 _REC_A1CUR_1_MBSE_S2_S1 65535 lFwocba_tlxgpab_wmDuExd_NCRoa0o -32768 32767
 /begin AXIS_DESCR COM_AXIS Nkw_opt caoddzd_oAjpfzb_cAcEEha_1nR_oa0 12 -32768 32767 AXIS_PTS_REF AXX_KL_MD_K_MAX_PB FORMAT "%5.0" MONOTONY STRICT_INCREASE DEPOSIT ABSOLUTE /end AXIS_DESCR
/end CHARACTERISTIC
/begin CHARACTERISTIC KL_MD_K_MAX_PB_STRG_AT "RPM-dependent strategic transmission input limitation during PowerBoost for automatic transmission" CURVE 0x80748580 _REC_A1CUR_1_MBSE_S2_S1 6553.5 BMW_dm_sw_q0p1_Nm -3276.8 3276.7 FORMAT "%4.1"
 /begin AXIS_DESCR COM_AXIS NO_INPUT_QUANTITY raChrxc_kBtBrmb_FmDuEFa_n__aa0o 12 -32768 32767 AXIS_PTS_REF AXX_KL_MD_K_MAX_PB_STRG_AT FORMAT "%6.0" MONOTONY STRICT_INCREASE DEPOSIT ABSOLUTE /end AXIS_DESCR
/end CHARACTERISTIC
/begin CHARACTERISTIC KL_MD_K_MAX_PB_STRG_AT_VAR "RPM-dependent strategic transmission input limitation during PowerBoost for automatic transmission" CURVE 0x80748568 _REC_A1CUR_1_MBSE_S2_S1 6553.5 BMW_dm_sw_q0p1_Nm -3276.8 3276.7 FORMAT "%4.1"
 /begin AXIS_DESCR COM_AXIS NO_INPUT_QUANTITY raChrxc_kBtBrmb_FmDuEFa_n__aa0o 12 -32768 32767 AXIS_PTS_REF AXX_KL_MD_K_MAX_PB_STRG_AT FORMAT "%6.0" MONOTONY STRICT_INCREASE DEPOSIT ABSOLUTE /end AXIS_DESCR
/end CHARACTERISTIC
/begin CHARACTERISTIC KL_MD_K_MAX_RNSTART_STRG_HS "Speed-dependent strategic gearbox input limit during launch control for manual transmission" CURVE 0x80748550 _REC_A1CUR_1_MBSE_S2_S1 6553.5 BMW_dm_sw_q0p1_Nm -3276.8 3276.7 FORMAT "%4.1"
 /begin AXIS_DESCR COM_AXIS NO_INPUT_QUANTITY raChrxc_kBtBrmb_FmDuEFa_n__aa0o 12 -32768 32767 AXIS_PTS_REF AXX_KL_MD_K_MAX_RNSTART_STRG_HS FORMAT "%6.0" MONOTONY STRICT_INCREASE DEPOSIT ABSOLUTE /end AXIS_DESCR
/end CHARACTERISTIC
/begin CHARACTERISTIC KL_MD_K_MAX_RST "Speed-dependent launch control curve of the combustion engine (Nkw_opt)" CURVE 0x80732348 _REC_A1CUR_1_MBSE_S2_S1 65535 lFwocba_tlxgpab_wmDuExd_NCRoa0o -32768 32767
 /begin AXIS_DESCR COM_AXIS Nkw_opt caoddzd_oAjpfzb_cAcEEha_1nR_oa0 12 -32768 32767 AXIS_PTS_REF AXX_KL_MD_K_MAX_RST FORMAT "%5.0" MONOTONY STRICT_INCREASE DEPOSIT ABSOLUTE /end AXIS_DESCR
/end CHARACTERISTIC
/begin CHARACTERISTIC KL_MD_K_MAX_RST_HS "Speed-dependent launch control curve of the combustion engine (Nkw_opt) for manual transmission" CURVE 0x80732330 _REC_A1CUR_1_MBSE_S2_S1 65535 lFwocba_tlxgpab_wmDuExd_NCRoa0o -32768 32767
 /begin AXIS_DESCR COM_AXIS Nkw_opt caoddzd_oAjpfzb_cAcEEha_1nR_oa0 12 -32768 32767 AXIS_PTS_REF AXX_KL_MD_K_MAX_RST_HS FORMAT "%5.0" MONOTONY STRICT_INCREASE DEPOSIT ABSOLUTE /end AXIS_DESCR
/end CHARACTERISTIC
/begin CHARACTERISTIC KL_MD_K_MAX_RST_STRG_AT "RPM-dependent strategic transmission input limitation during race start for automatic transmission" CURVE 0x80748538 _REC_A1CUR_1_MBSE_S2_S1 6553.5 BMW_dm_sw_q0p1_Nm -3276.8 3276.7 FORMAT "%4.1"
 /begin AXIS_DESCR COM_AXIS NO_INPUT_QUANTITY raChrxc_kBtBrmb_FmDuEFa_n__aa0o 12 -32768 32767 AXIS_PTS_REF AXX_KL_MD_K_MAX_RST_STRG_AT FORMAT "%6.0" MONOTONY STRICT_INCREASE DEPOSIT ABSOLUTE /end AXIS_DESCR
/end CHARACTERISTIC
/begin CHARACTERISTIC KL_MD_K_MAX_RST_STRG_AT_VAR "RPM-dependent strategic transmission input limitation during race start for automatic transmission" CURVE 0x80748520 _REC_A1CUR_1_MBSE_S2_S1 6553.5 BMW_dm_sw_q0p1_Nm -3276.8 3276.7 FORMAT "%4.1"
 /begin AXIS_DESCR COM_AXIS NO_INPUT_QUANTITY raChrxc_kBtBrmb_FmDuEFa_n__aa0o 12 -32768 32767 AXIS_PTS_REF AXX_KL_MD_K_MAX_RST_STRG_AT FORMAT "%6.0" MONOTONY STRICT_INCREASE DEPOSIT ABSOLUTE /end AXIS_DESCR
/end CHARACTERISTIC
/begin CHARACTERISTIC KL_MD_K_MAX_SGASSE "RPM-dependent PowerBoost characteristic curve of the combustion engine (Nkw_opt)" CURVE 0x80732318 _REC_A1CUR_1_MBSE_S2_S1 65535 lFwocba_tlxgpab_wmDuExd_NCRoa0o -32768 32767
 /begin AXIS_DESCR COM_AXIS Nkw_opt caoddzd_oAjpfzb_cAcEEha_1nR_oa0 12 -32768 32767 AXIS_PTS_REF AXX_KL_MD_K_MAX_SGASSE FORMAT "%5.0" MONOTONY STRICT_INCREASE DEPOSIT ABSOLUTE /end AXIS_DESCR
/end CHARACTERISTIC
/begin CHARACTERISTIC KL_MD_K_MAX_SGASSE_STRG_AT "RPM-dependent strategic transmission input limitation during S-gear for automatic transmission" CURVE 0x80748508 _REC_A1CUR_1_MBSE_S2_S1 6553.5 BMW_dm_sw_q0p1_Nm -3276.8 3276.7 FORMAT "%4.1"
 /begin AXIS_DESCR COM_AXIS NO_INPUT_QUANTITY raChrxc_kBtBrmb_FmDuEFa_n__aa0o 12 -32768 32767 AXIS_PTS_REF AXX_KL_MD_K_MAX_SGASSE_STRG_AT FORMAT "%6.0" MONOTONY STRICT_INCREASE DEPOSIT ABSOLUTE /end AXIS_DESCR
/end CHARACTERISTIC
/begin CHARACTERISTIC KL_MD_K_MAX_SGASSE_STRG_AT_VAR "RPM-dependent strategic transmission input limitation during S-gear for automatic transmission" CURVE 0x807484F0 _REC_A1CUR_1_MBSE_S2_S1 6553.5 BMW_dm_sw_q0p1_Nm -3276.8 3276.7 FORMAT "%4.1"
 /begin AXIS_DESCR COM_AXIS NO_INPUT_QUANTITY raChrxc_kBtBrmb_FmDuEFa_n__aa0o 12 -32768 32767 AXIS_PTS_REF AXX_KL_MD_K_MAX_SGASSE_STRG_AT FORMAT "%6.0" MONOTONY STRICT_INCREASE DEPOSIT ABSOLUTE /end AXIS_DESCR
/end CHARACTERISTIC
/begin CHARACTERISTIC KL_MD_K_MAX_VL "Speed-dependent full load curve of the combustion engine (Nkw_opt)" CURVE 0x80732300 _REC_A1CUR_1_MBSE_S2_S1 65535 lFwocba_tlxgpab_wmDuExd_NCRoa0o -32768 32767
 /begin AXIS_DESCR COM_AXIS Nkw_opt caoddzd_oAjpfzb_cAcEEha_1nR_oa0 12 -32768 32767 AXIS_PTS_REF AXX_KL_MD_K_MAX_VL FORMAT "%5.0" MONOTONY STRICT_INCREASE DEPOSIT ABSOLUTE /end AXIS_DESCR
/end CHARACTERISTIC
/begin CHARACTERISTIC KL_MD_K_MAX_VL_ECO_STRG_HS "Speed-dependent strategic gearbox input limit during eco for manual transmission" CURVE 0x807484D8 _REC_A1CUR_1_MBSE_S2_S1 6553.5 BMW_dm_sw_q0p1_Nm -3276.8 3276.7 FORMAT "%4.1"
 /begin AXIS_DESCR COM_AXIS NO_INPUT_QUANTITY raChrxc_kBtBrmb_FmDuEFa_n__aa0o 12 -32768 32767 AXIS_PTS_REF AXX_KL_MD_K_MAX_VL_ECO_STRG_HS FORMAT "%6.0" MONOTONY STRICT_INCREASE DEPOSIT ABSOLUTE /end AXIS_DESCR
/end CHARACTERISTIC
/begin CHARACTERISTIC KL_MD_K_MAX_VL_HS "Speed-dependent full load curve of the combustion engine (Nkw_opt) for manual transmission" CURVE 0x807322E8 _REC_A1CUR_1_MBSE_S2_S1 65535 lFwocba_tlxgpab_wmDuExd_NCRoa0o -32768 32767
 /begin AXIS_DESCR COM_AXIS Nkw_opt caoddzd_oAjpfzb_cAcEEha_1nR_oa0 12 -32768 32767 AXIS_PTS_REF AXX_KL_MD_K_MAX_VL_HS FORMAT "%5.0" MONOTONY STRICT_INCREASE DEPOSIT ABSOLUTE /end AXIS_DESCR
/end CHARACTERISTIC
/begin CHARACTERISTIC KL_MD_K_MAX_VL_STRG_AT "RPM-dependent strategic transmission input limitation during Eco for automatic transmission" CURVE 0x807484C0 _REC_A1CUR_1_MBSE_S2_S1 6553.5 BMW_dm_sw_q0p1_Nm -3276.8 3276.7 FORMAT "%4.1"
 /begin AXIS_DESCR COM_AXIS NO_INPUT_QUANTITY raChrxc_kBtBrmb_FmDuEFa_n__aa0o 12 -32768 32767 AXIS_PTS_REF AXX_KL_MD_K_MAX_VL_STRG_AT FORMAT "%6.0" MONOTONY STRICT_INCREASE DEPOSIT ABSOLUTE /end AXIS_DESCR
/end CHARACTERISTIC
/begin CHARACTERISTIC KL_MD_K_MAX_VL_STRG_AT_VAR "RPM-dependent strategic transmission input limitation during Eco for automatic transmission" CURVE 0x807484A8 _REC_A1CUR_1_MBSE_S2_S1 6553.5 BMW_dm_sw_q0p1_Nm -3276.8 3276.7 FORMAT "%4.1"
 /begin AXIS_DESCR COM_AXIS NO_INPUT_QUANTITY raChrxc_kBtBrmb_FmDuEFa_n__aa0o 12 -32768 32767 AXIS_PTS_REF AXX_KL_MD_K_MAX_VL_STRG_AT FORMAT "%6.0" MONOTONY STRICT_INCREASE DEPOSIT ABSOLUTE /end AXIS_DESCR
/end CHARACTERISTIC
/begin CHARACTERISTIC KL_MDG_MAX_GANG_AT "Gear-dependent gearbox input limit for automatic transmission" CURVE 0x807486D8 _REC_A1CUR_1_MBSE_S2_S1 6553.5 BMW_dm_sw_q0p1_Nm -3276.8 3276.7 FORMAT "%4.1"
 /begin AXIS_DESCR COM_AXIS NO_INPUT_QUANTITY raChrxc_kBtBrmb_FmDuEFa_n__aa0o 10 -128 127 AXIS_PTS_REF AXX_KL_MDG_MAX_GANG_AT FORMAT "%3.0" MONOTONY STRICT_INCREASE DEPOSIT ABSOLUTE /end AXIS_DESCR
/end CHARACTERISTIC
/begin CHARACTERISTIC KL_MDG_MAX_GANG_HS "Gear-dependent gearbox input limit for manual transmission" CURVE 0x807486C4 _REC_A1CUR_1_MBSE_S2_S1 6553.5 BMW_dm_sw_q0p1_Nm -3276.8 3276.7 FORMAT "%4.1"
 /begin AXIS_DESCR COM_AXIS NO_INPUT_QUANTITY raChrxc_kBtBrmb_FmDuEFa_n__aa0o 10 -128 127 AXIS_PTS_REF AXX_KL_MDG_MAX_GANG_HS FORMAT "%3.0" MONOTONY STRICT_INCREASE DEPOSIT ABSOLUTE /end AXIS_DESCR
/end CHARACTERISTIC
/begin CHARACTERISTIC KL_MDI_MAX_GRD_UP "Curve for the up-gradient of the rate limiter of Mdi_max" CURVE 0x807311C0 _REC_A1CUR_1_MBSE_U2_S1 6553.5 oFojrkc_kDqhmtb_jroomtd_N0__1o0 0 6553.5 FORMAT "%6.1"
 /begin AXIS_DESCR COM_AXIS Mdi_max_diff BMW_dm_sw_q0p1_Nm 6 0 6553.5 AXIS_PTS_REF AXX_KL_MDI_MAX_GRD_UP FORMAT "%6.1" MONOTONY STRICT_INCREASE DEPOSIT ABSOLUTE /end AXIS_DESCR
/end CHARACTERISTIC
/begin CHARACTERISTIC KL_MDIMX_F_TMOT "Factor for limiting Mdi_max depending on engine temperature" CURVE 0x80731208 _REC_A1CUR_1_MBSE_U2_S1 1 Bhvfwhc_bigEubd_BBEupBd_nR_3oa0 0 1 FORMAT "%7.4"
 /begin AXIS_DESCR COM_AXIS Tmot DchEpAd_DBCFgoa_Ckhahgc_q__aoa0 6 -327.68 327.67 AXIS_PTS_REF AXX_KL_MDIMX_F_TMOT FORMAT "%7.2" MONOTONY STRICT_INCREASE DEPOSIT ABSOLUTE /end AXIS_DESCR
/end CHARACTERISTIC
/begin CHARACTERISTIC KL_MDIMX_VL_APPLZ "KL_MDIMX_VL_APPLZ" CURVE 0x807311D8 _REC_A1CUR_1_MBSE_S2_S1 6553.5 BMW_dm_sw_q0p1_Nm -3276.8 3276.7 FORMAT "%6.1"
 /begin AXIS_DESCR COM_AXIS Nkw_ref caoddzd_oAjpfzb_cAcEEha_1nR_oa0 18 -32768 32767 AXIS_PTS_REF AXX_KL_MDIMX_VL_APPLZ MONOTONY STRICT_INCREASE DEPOSIT ABSOLUTE /end AXIS_DESCR
/end CHARACTERISTIC
/begin CHARACTERISTIC KL_MDRED_NKW "Factor for reducing engine target torque depending on engine speed" CURVE 0x80761C95 _REC_A1CUR_1_MBSE_U1_S1 1.9921875 BMW_Powertrain_DxECompuMethods_Def_ub_b2_nounit 0 1.9921875
 /begin AXIS_DESCR COM_AXIS Nkw_wm caoddzd_oAjpfzb_cAcEEha_1nR_oa0 6 -32768 32767 AXIS_PTS_REF AXX_KL_MDRED_NKW MONOTONY STRICT_INCREASE DEPOSIT ABSOLUTE /end AXIS_DESCR
/end CHARACTERISTIC
/begin CHARACTERISTIC KL_RF_MAX___MGF_CC_PF_Slot2 "Curve maximum permissible filling over engine speed (Slot 2, Pump Fuel)" CURVE 0x807C4900 _REC_A1CUR_1_MBSE_S2_S1 655.35 CgkBooc_wkiDfEd_Czglhgc_fR_1a0o -327.68 327.67 FORMAT "%7.2"
 /begin AXIS_DESCR COM_AXIS NO_INPUT_QUANTITY caoddzd_oAjpfzb_cAcEEha_1nR_oa0 12 -32768 32767 AXIS_PTS_REF AXX_KL_RF_MAX FORMAT "%5.0" MONOTONY MON_INCREASE DEPOSIT ABSOLUTE /end AXIS_DESCR
/end CHARACTERISTIC
/begin CHARACTERISTIC KL_RF_MAX___MGF_CC_PF_Slot3 "Curve maximum permissible filling over engine speed (Slot 3, Pump Fuel)" CURVE 0x807C4918 _REC_A1CUR_1_MBSE_S2_S1 655.35 CgkBooc_wkiDfEd_Czglhgc_fR_1a0o -327.68 327.67 FORMAT "%7.2"
 /begin AXIS_DESCR COM_AXIS NO_INPUT_QUANTITY caoddzd_oAjpfzb_cAcEEha_1nR_oa0 12 -32768 32767 AXIS_PTS_REF AXX_KL_RF_MAX FORMAT "%5.0" MONOTONY MON_INCREASE DEPOSIT ABSOLUTE /end AXIS_DESCR
/end CHARACTERISTIC
/begin CHARACTERISTIC KL_RF_MAX___MGF_CC_PF_Slot4 "Curve maximum permissible filling over engine speed (Slot 4, Pump Fuel)" CURVE 0x807C4930 _REC_A1CUR_1_MBSE_S2_S1 655.35 CgkBooc_wkiDfEd_Czglhgc_fR_1a0o -327.68 327.67 FORMAT "%7.2"
 /begin AXIS_DESCR COM_AXIS NO_INPUT_QUANTITY caoddzd_oAjpfzb_cAcEEha_1nR_oa0 12 -32768 32767 AXIS_PTS_REF AXX_KL_RF_MAX FORMAT "%5.0" MONOTONY MON_INCREASE DEPOSIT ABSOLUTE /end AXIS_DESCR
/end CHARACTERISTIC
/begin CHARACTERISTIC KL_RF_MAX_UESP___MGF_CC_PF_Slot2 "Curve maximum permissible filling over engine speed during scavenging (Slot 2, Pump Fuel)" CURVE 0x807C4960 _REC_A1CUR_1_MBSE_S2_S1 655.35 CgkBooc_wkiDfEd_Czglhgc_fR_1a0o -327.68 327.67 FORMAT "%7.2"
 /begin AXIS_DESCR COM_AXIS NO_INPUT_QUANTITY caoddzd_oAjpfzb_cAcEEha_1nR_oa0 12 -32768 32767 AXIS_PTS_REF AXX_KL_RF_MAX_UESP FORMAT "%5.0" MONOTONY MON_INCREASE DEPOSIT ABSOLUTE /end AXIS_DESCR
/end CHARACTERISTIC
/begin CHARACTERISTIC KL_RF_MAX_UESP___MGF_CC_PF_Slot3 "Curve maximum permissible filling over engine speed during scavenging (Slot 3, Pump Fuel)" CURVE 0x807C4978 _REC_A1CUR_1_MBSE_S2_S1 655.35 CgkBooc_wkiDfEd_Czglhgc_fR_1a0o -327.68 327.67 FORMAT "%7.2"
 /begin AXIS_DESCR COM_AXIS NO_INPUT_QUANTITY caoddzd_oAjpfzb_cAcEEha_1nR_oa0 12 -32768 32767 AXIS_PTS_REF AXX_KL_RF_MAX_UESP FORMAT "%5.0" MONOTONY MON_INCREASE DEPOSIT ABSOLUTE /end AXIS_DESCR
/end CHARACTERISTIC
/begin CHARACTERISTIC KL_RF_MAX_UESP___MGF_CC_PF_Slot4 "Curve maximum permissible filling over engine speed during scavenging (Slot 4, Pump Fuel)" CURVE 0x807C4990 _REC_A1CUR_1_MBSE_S2_S1 655.35 CgkBooc_wkiDfEd_Czglhgc_fR_1a0o -327.68 327.67 FORMAT "%7.2"
 /begin AXIS_DESCR COM_AXIS NO_INPUT_QUANTITY caoddzd_oAjpfzb_cAcEEha_1nR_oa0 12 -32768 32767 AXIS_PTS_REF AXX_KL_RF_MAX_UESP FORMAT "%5.0" MONOTONY MON_INCREASE DEPOSIT ABSOLUTE /end AXIS_DESCR
/end CHARACTERISTIC
/begin CHARACTERISTIC ValetTorqueMap___MGF_CC_PF_Slot1 "Target torque during valet in level [1] (Pump Fuel)" CURVE 0x807C241E _REC_A1CUR_1_MBSE_S2_S1 6553.5 BMW_dm_sw_q0p1_Nm -3276.8 3276.7 FORMAT "%6.1" MATRIX_DIM 18 1 1
 /begin AXIS_DESCR COM_AXIS Nkw_ref caoddzd_oAjpfzb_cAcEEha_1nR_oa0 18 -32768 32767 AXIS_PTS_REF BMWtqe_tqc_FlApplStg_Ax MONOTONY STRICT_INCREASE DEPOSIT ABSOLUTE /end AXIS_DESCR
/end CHARACTERISTIC
/begin CHARACTERISTIC ValetTorqueMap___MGF_CC_PF_Slot2 "Target torque during valet in level [2] (Pump Fuel)" CURVE 0x807C2442 _REC_A1CUR_1_MBSE_S2_S1 6553.5 BMW_dm_sw_q0p1_Nm -3276.8 3276.7 FORMAT "%6.1" MATRIX_DIM 18 1 1
 /begin AXIS_DESCR COM_AXIS Nkw_ref caoddzd_oAjpfzb_cAcEEha_1nR_oa0 18 -32768 32767 AXIS_PTS_REF BMWtqe_tqc_FlApplStg_Ax MONOTONY STRICT_INCREASE DEPOSIT ABSOLUTE /end AXIS_DESCR
/end CHARACTERISTIC
/begin CHARACTERISTIC BMWtchctr_p_DifCrtnPp_M "Pressure difference correction for P-component of power-based boost pressure controller" MAP 0x807274D8 _REC_A1CUR_1_MBSE_S2_S1 8191.875 BMW_p_sw_q0p125_hPa -4096 4095.875 FORMAT "%10.3"
 /begin AXIS_DESCR COM_AXIS BMWtchbas_p_Dif_sw BMW_p_sw_q0p125_hPa 12 -4096 4095.875 AXIS_PTS_REF BMWtchctr_p_DifCrtnPp_Ax FORMAT "%10.3" MONOTONY MON_INCREASE DEPOSIT ABSOLUTE /end AXIS_DESCR
 /begin AXIS_DESCR COM_AXIS BMWtchsp_mf_Ex_uw CByjozc_eCmpBAb_pljBAmd_k__0oa0 6 0 2047.96875 AXIS_PTS_REF BMWtchctr_p_DifCrtnPp_Ay FORMAT "%10.3" MONOTONY STRICT_INCREASE DEPOSIT ABSOLUTE /end AXIS_DESCR
/end CHARACTERISTIC
/begin CHARACTERISTIC BMWtchctr_p_DifCrtnPp_M___MGF_CC_PF_Slot2 "Pressure difference correction for P-component of power-based boost pressure controller (X-Axis does not switch, Slot 2, Pump Fuel)" MAP 0x807C0AD8 _REC_A1CUR_1_MBSE_S2_S1 8191.875 BMW_p_sw_q0p125_hPa -4096 4095.875 FORMAT "%10.3"
 /begin AXIS_DESCR COM_AXIS BMWtchbas_p_Dif_sw BMW_p_sw_q0p125_hPa 12 -1000 1000 AXIS_PTS_REF BMWtchctr_p_DifCrtnPp_Ax DEPOSIT ABSOLUTE /end AXIS_DESCR
 /begin AXIS_DESCR COM_AXIS BMWtchsp_mf_Ex_uw CByjozc_eCmpBAb_pljBAmd_k__0oa0 6 0 2000 AXIS_PTS_REF BMWtchctr_p_DifCrtnPp_Ay___MGF_CC_PF_Slot2 DEPOSIT ABSOLUTE /end AXIS_DESCR
/end CHARACTERISTIC
/begin CHARACTERISTIC BMWtchctr_p_DifCrtnPp_M___MGF_CC_PF_Slot3 "Pressure difference correction for P-component of power-based boost pressure controller (X-Axis does not switch, Slot 3, Pump Fuel)" MAP 0x807C0B68 _REC_A1CUR_1_MBSE_S2_S1 8191.875 BMW_p_sw_q0p125_hPa -4096 4095.875 FORMAT "%10.3"
 /begin AXIS_DESCR COM_AXIS BMWtchbas_p_Dif_sw BMW_p_sw_q0p125_hPa 12 -1000 1000 AXIS_PTS_REF BMWtchctr_p_DifCrtnPp_Ax DEPOSIT ABSOLUTE /end AXIS_DESCR
 /begin AXIS_DESCR COM_AXIS BMWtchsp_mf_Ex_uw CByjozc_eCmpBAb_pljBAmd_k__0oa0 6 0 2000 AXIS_PTS_REF BMWtchctr_p_DifCrtnPp_Ay___MGF_CC_PF_Slot3 DEPOSIT ABSOLUTE /end AXIS_DESCR
/end CHARACTERISTIC
/begin CHARACTERISTIC BMWtchctr_p_DifCrtnPp_M___MGF_CC_PF_Slot4 "Pressure difference correction for P-component of power-based boost pressure controller (X-Axis does not switch, Slot 4, Pump Fuel)" MAP 0x807C0BF8 _REC_A1CUR_1_MBSE_S2_S1 8191.875 BMW_p_sw_q0p125_hPa -4096 4095.875 FORMAT "%10.3"
 /begin AXIS_DESCR COM_AXIS BMWtchbas_p_Dif_sw BMW_p_sw_q0p125_hPa 12 -1000 1000 AXIS_PTS_REF BMWtchctr_p_DifCrtnPp_Ax DEPOSIT ABSOLUTE /end AXIS_DESCR
 /begin AXIS_DESCR COM_AXIS BMWtchsp_mf_Ex_uw CByjozc_eCmpBAb_pljBAmd_k__0oa0 6 0 2000 AXIS_PTS_REF BMWtchctr_p_DifCrtnPp_Ay___MGF_CC_PF_Slot4 DEPOSIT ABSOLUTE /end AXIS_DESCR
/end CHARACTERISTIC
/begin CHARACTERISTIC BMWtchctr_p_DifCrtnPpDyn_M "Pressure difference correction for P-component of power-based boost pressure controller" MAP 0x80727568 _REC_A1CUR_1_MBSE_S2_S1 8191.875 BMW_p_sw_q0p125_hPa -4096 4095.875 FORMAT "%10.3"
 /begin AXIS_DESCR COM_AXIS BMWtchbas_p_Dif_sw BMW_p_sw_q0p125_hPa 12 -4096 4095.875 AXIS_PTS_REF BMWtchctr_p_DifCrtnPpDyn_Ax FORMAT "%10.3" MONOTONY MON_INCREASE DEPOSIT ABSOLUTE /end AXIS_DESCR
 /begin AXIS_DESCR COM_AXIS BMWtchsp_mf_Ex_uw CByjozc_eCmpBAb_pljBAmd_k__0oa0 6 0 2047.96875 AXIS_PTS_REF BMWtchctr_p_DifCrtnPpDyn_Ay FORMAT "%10.3" MONOTONY STRICT_INCREASE DEPOSIT ABSOLUTE /end AXIS_DESCR
/end CHARACTERISTIC
/begin CHARACTERISTIC BMWtchctr_pct_WgBasc_M "Wastegate position - for feedforward control" MAP 0x807479C4 _REC_A1CUR_1_MBSE_U2_S1 99.9984741210938 wDDoctd_cCDyaFa_AvCkvFb_nR_6o0o 0 99.9984741210938 FORMAT "%10.3"
 /begin AXIS_DESCR COM_AXIS NO_INPUT_QUANTITY ilxsavd_hkzmBfc_lAzCpAb_nR_1oa0 12 0 3.99993896484375 AXIS_PTS_REF BMWtchctr_pct_WgBasc_Ax FORMAT "%14.5" MONOTONY STRICT_INCREASE DEPOSIT ABSOLUTE /end AXIS_DESCR
 /begin AXIS_DESCR COM_AXIS NO_INPUT_QUANTITY ECeoxdb_wFseCtb_mEytEnb_k__o8a0 12 0 2559.9609375 AXIS_PTS_REF BMWtchctr_pct_WgBasc_Ay FORMAT "%10.3" MONOTONY STRICT_INCREASE DEPOSIT ABSOLUTE /end AXIS_DESCR
/end CHARACTERISTIC
/begin CHARACTERISTIC BMWtchctr_pct_WgBasc_M___MGF_CC_PF_Slot2 "Wastegate position - for feedforward control (Slot 2, Pump Fuel)" MAP 0x807C0DA8 _REC_A1CUR_1_MBSE_U2_S1 99.9984741210938 wDDoctd_cCDyaFa_AvCkvFb_nR_6o0o 0 99.9984741210938 FORMAT "%10.3"
 /begin AXIS_DESCR COM_AXIS NO_INPUT_QUANTITY ilxsavd_hkzmBfc_lAzCpAb_nR_1oa0 12 0 3.99993896484375 AXIS_PTS_REF BMWtchctr_pct_WgBasc_Ax FORMAT "%14.5" MONOTONY STRICT_INCREASE DEPOSIT ABSOLUTE /end AXIS_DESCR
 /begin AXIS_DESCR COM_AXIS NO_INPUT_QUANTITY ECeoxdb_wFseCtb_mEytEnb_k__o8a0 12 0 2559.9609375 AXIS_PTS_REF BMWtchctr_pct_WgBasc_Ay FORMAT "%10.3" MONOTONY STRICT_INCREASE DEPOSIT ABSOLUTE /end AXIS_DESCR
/end CHARACTERISTIC
/begin CHARACTERISTIC BMWtchctr_pct_WgBasc_M___MGF_CC_PF_Slot3 "Wastegate position - for feedforward control (Slot 3, Pump Fuel)" MAP 0x807C0EC8 _REC_A1CUR_1_MBSE_U2_S1 99.9984741210938 wDDoctd_cCDyaFa_AvCkvFb_nR_6o0o 0 99.9984741210938 FORMAT "%10.3"
 /begin AXIS_DESCR COM_AXIS NO_INPUT_QUANTITY ilxsavd_hkzmBfc_lAzCpAb_nR_1oa0 12 0 3.99993896484375 AXIS_PTS_REF BMWtchctr_pct_WgBasc_Ax FORMAT "%14.5" MONOTONY STRICT_INCREASE DEPOSIT ABSOLUTE /end AXIS_DESCR
 /begin AXIS_DESCR COM_AXIS NO_INPUT_QUANTITY ECeoxdb_wFseCtb_mEytEnb_k__o8a0 12 0 2559.9609375 AXIS_PTS_REF BMWtchctr_pct_WgBasc_Ay FORMAT "%10.3" MONOTONY STRICT_INCREASE DEPOSIT ABSOLUTE /end AXIS_DESCR
/end CHARACTERISTIC
/begin CHARACTERISTIC BMWtchctr_pct_WgBasc_M___MGF_CC_PF_Slot4 "Wastegate position - for feedforward control (Slot 4, Pump Fuel)" MAP 0x807C0FE8 _REC_A1CUR_1_MBSE_U2_S1 99.9984741210938 wDDoctd_cCDyaFa_AvCkvFb_nR_6o0o 0 99.9984741210938 FORMAT "%10.3"
 /begin AXIS_DESCR COM_AXIS NO_INPUT_QUANTITY ilxsavd_hkzmBfc_lAzCpAb_nR_1oa0 12 0 3.99993896484375 AXIS_PTS_REF BMWtchctr_pct_WgBasc_Ax FORMAT "%14.5" MONOTONY STRICT_INCREASE DEPOSIT ABSOLUTE /end AXIS_DESCR
 /begin AXIS_DESCR COM_AXIS NO_INPUT_QUANTITY ECeoxdb_wFseCtb_mEytEnb_k__o8a0 12 0 2559.9609375 AXIS_PTS_REF BMWtchctr_pct_WgBasc_Ay FORMAT "%10.3" MONOTONY STRICT_INCREASE DEPOSIT ABSOLUTE /end AXIS_DESCR
/end CHARACTERISTIC
/begin CHARACTERISTIC BMWtchctr_pwr_CmprGra_M "P-component of power-based boost pressure controller. Compressor power gradient by pressure ratio." MAP 0x807273B8 _REC_A1CUR_1_MBSE_U2_S1 31.99951171875 lfnAAcd_rfigwsd_gtuuDBc_k__aoa0 0 31.99951171875 FORMAT "%11.4"
 /begin AXIS_DESCR COM_AXIS BMWtchsp_rat_p_CmprLim_uw acriqBc_tfkBqod_ocgjxzc_nR_8oa0 12 0 7.9998779296875 AXIS_PTS_REF BMWtchctr_pwr_CmprGra_Ax FORMAT "%11.4" MONOTONY STRICT_INCREASE DEPOSIT ABSOLUTE /end AXIS_DESCR
 /begin AXIS_DESCR COM_AXIS BMWtchsp_mf_CmprNorm_uw wpxDCba_sgbvDxb_FliBAmd_k__0oa0 12 0 4095.9375 AXIS_PTS_REF BMWtchctr_pwr_CmprGra_Ay FORMAT "%10.3" MONOTONY STRICT_INCREASE DEPOSIT ABSOLUTE /end AXIS_DESCR
/end CHARACTERISTIC
/begin CHARACTERISTIC BMWtchctr_pwr_Dp_M "D-component of the power-based boost pressure controller" MAP 0x80727230 _REC_A1CUR_1_MBSE_S2_S1 127.998046875 jucyrzb_bpFgwfd_uqrfhgc_k__aoa0 -64 63.998046875 FORMAT "%10.3"
 /begin AXIS_DESCR COM_AXIS BMWtchbas_p_Dif_sw BMW_p_sw_q0p125_hPa 14 -4096 4095.875 AXIS_PTS_REF BMWtchctr_pwr_Dp_Ax FORMAT "%10.3" MONOTONY STRICT_INCREASE DEPOSIT ABSOLUTE /end AXIS_DESCR
 /begin AXIS_DESCR COM_AXIS BMWtchbas_p_DifGra_sw BMW_p_sw_q0p125_hPa 14 -4096 4095.875 AXIS_PTS_REF BMWtchctr_pwr_Dp_Ay FORMAT "%10.3" MONOTONY STRICT_INCREASE DEPOSIT ABSOLUTE /end AXIS_DESCR
/end CHARACTERISTIC
/begin CHARACTERISTIC BMWtchctr_pwr_Dp_M___MGF_CC_PF_Slot2 "D-component of the power-based boost pressure controller (X-Axis and Y-Axis do not switch, Slot 2, Pump Fuel)" MAP 0x807C1290 _REC_A1CUR_1_MBSE_S2_S1 127.998046875 jucyrzb_bpFgwfd_uqrfhgc_k__aoa0 -64 63.998046875 FORMAT "%10.3"
 /begin AXIS_DESCR COM_AXIS BMWtchbas_p_Dif_sw BMW_p_sw_q0p125_hPa 14 -4096 4095.875 AXIS_PTS_REF BMWtchctr_pwr_Dp_Ax FORMAT "%10.3" MONOTONY STRICT_INCREASE DEPOSIT ABSOLUTE /end AXIS_DESCR
 /begin AXIS_DESCR COM_AXIS BMWtchbas_p_DifGra_sw BMW_p_sw_q0p125_hPa 14 -4096 4095.875 AXIS_PTS_REF BMWtchctr_pwr_Dp_Ay FORMAT "%10.3" MONOTONY STRICT_INCREASE DEPOSIT ABSOLUTE /end AXIS_DESCR
/end CHARACTERISTIC
/begin CHARACTERISTIC BMWtchctr_pwr_Dp_M___MGF_CC_PF_Slot3 "D-component of the power-based boost pressure controller (X-Axis and Y-Axis do not switch, Slot 3, Pump Fuel)" MAP 0x807C1418 _REC_A1CUR_1_MBSE_S2_S1 127.998046875 jucyrzb_bpFgwfd_uqrfhgc_k__aoa0 -64 63.998046875 FORMAT "%10.3"
 /begin AXIS_DESCR COM_AXIS BMWtchbas_p_Dif_sw BMW_p_sw_q0p125_hPa 14 -4096 4095.875 AXIS_PTS_REF BMWtchctr_pwr_Dp_Ax FORMAT "%10.3" MONOTONY STRICT_INCREASE DEPOSIT ABSOLUTE /end AXIS_DESCR
 /begin AXIS_DESCR COM_AXIS BMWtchbas_p_DifGra_sw BMW_p_sw_q0p125_hPa 14 -4096 4095.875 AXIS_PTS_REF BMWtchctr_pwr_Dp_Ay FORMAT "%10.3" MONOTONY STRICT_INCREASE DEPOSIT ABSOLUTE /end AXIS_DESCR
/end CHARACTERISTIC
/begin CHARACTERISTIC BMWtchctr_pwr_Dp_M___MGF_CC_PF_Slot4 "D-component of the power-based boost pressure controller (X-Axis and Y-Axis do not switch, Slot 4, Pump Fuel)" MAP 0x807C15A0 _REC_A1CUR_1_MBSE_S2_S1 127.998046875 jucyrzb_bpFgwfd_uqrfhgc_k__aoa0 -64 63.998046875 FORMAT "%10.3"
 /begin AXIS_DESCR COM_AXIS BMWtchbas_p_Dif_sw BMW_p_sw_q0p125_hPa 14 -4096 4095.875 AXIS_PTS_REF BMWtchctr_pwr_Dp_Ax FORMAT "%10.3" MONOTONY STRICT_INCREASE DEPOSIT ABSOLUTE /end AXIS_DESCR
 /begin AXIS_DESCR COM_AXIS BMWtchbas_p_DifGra_sw BMW_p_sw_q0p125_hPa 14 -4096 4095.875 AXIS_PTS_REF BMWtchctr_pwr_Dp_Ay FORMAT "%10.3" MONOTONY STRICT_INCREASE DEPOSIT ABSOLUTE /end AXIS_DESCR
/end CHARACTERISTIC
/begin CHARACTERISTIC BMWtchctr_pwr_PctlWideRng_M "Compressor map with required compressor / turbine power" MAP 0x80726FB0 _REC_A1CUR_1_MBSE_U2_S1 127.998046875 jucyrzb_bpFgwfd_uqrfhgc_k__aoa0 0 127.998046875 FORMAT "%11.4"
 /begin AXIS_DESCR COM_AXIS BMWtchsp_rat_p_CmprLim_uw acriqBc_tfkBqod_ocgjxzc_nR_8oa0 20 0 7.9998779296875 AXIS_PTS_REF BMWtchctr_pwr_Pctl_Ax FORMAT "%11.4" MONOTONY MON_INCREASE DEPOSIT ABSOLUTE /end AXIS_DESCR
 /begin AXIS_DESCR COM_AXIS BMWtchsp_mf_CmprNormWideRng_uw wpxDCba_sgbvDxb_FliBAmd_k__0oa0 16 0 4095.9375 AXIS_PTS_REF BMWtchctr_pwr_PctlWideRng_Ay FORMAT "%10.3" MONOTONY STRICT_INCREASE DEPOSIT ABSOLUTE /end AXIS_DESCR
/end CHARACTERISTIC
/begin CHARACTERISTIC BMWtchctr_pwr_PctlWideRng_M___MGF_CC_PF_Slot2 "Compressor map with required compressor / turbine power (X-Axis does not switch, Slot 2, Pump Fuel)" MAP 0x807DA8E2 _REC_A1CUR_1_MBSE_U2_S1 127.998046875 jucyrzb_bpFgwfd_uqrfhgc_k__aoa0 0 127.998046875 FORMAT "%11.4"
 /begin AXIS_DESCR COM_AXIS BMWtchsp_rat_p_CmprLim_uw acriqBc_tfkBqod_ocgjxzc_nR_8oa0 20 0 5 AXIS_PTS_REF BMWtchctr_pwr_Pctl_Ax___MGF_CC_PF_Slot2 DEPOSIT ABSOLUTE /end AXIS_DESCR
 /begin AXIS_DESCR COM_AXIS BMWtchsp_mf_CmprNormWideRng_uw wpxDCba_sgbvDxb_FliBAmd_k__0oa0 16 0 2000 AXIS_PTS_REF BMWtchctr_pwr_PctlWideRng_Ay___MGF_CC_PF_Slot2 DEPOSIT ABSOLUTE /end AXIS_DESCR
/end CHARACTERISTIC
/begin CHARACTERISTIC BMWtchctr_pwr_PctlWideRng_M___MGF_CC_PF_Slot3 "Compressor map with required compressor / turbine power (X-Axis does not switch, Slot 3, Pump Fuel)" MAP 0x807DAB62 _REC_A1CUR_1_MBSE_U2_S1 127.998046875 jucyrzb_bpFgwfd_uqrfhgc_k__aoa0 0 127.998046875 FORMAT "%11.4"
 /begin AXIS_DESCR COM_AXIS BMWtchsp_rat_p_CmprLim_uw acriqBc_tfkBqod_ocgjxzc_nR_8oa0 20 0 5 AXIS_PTS_REF BMWtchctr_pwr_Pctl_Ax___MGF_CC_PF_Slot3 DEPOSIT ABSOLUTE /end AXIS_DESCR
 /begin AXIS_DESCR COM_AXIS BMWtchsp_mf_CmprNormWideRng_uw wpxDCba_sgbvDxb_FliBAmd_k__0oa0 16 0 2000 AXIS_PTS_REF BMWtchctr_pwr_PctlWideRng_Ay___MGF_CC_PF_Slot3 DEPOSIT ABSOLUTE /end AXIS_DESCR
/end CHARACTERISTIC
/begin CHARACTERISTIC BMWtchctr_pwr_PctlWideRng_M___MGF_CC_PF_Slot4 "Compressor map with required compressor / turbine power (X-Axis does not switch, Slot 4, Pump Fuel)" MAP 0x807DADE2 _REC_A1CUR_1_MBSE_U2_S1 127.998046875 jucyrzb_bpFgwfd_uqrfhgc_k__aoa0 0 127.998046875 FORMAT "%11.4"
 /begin AXIS_DESCR COM_AXIS BMWtchsp_rat_p_CmprLim_uw acriqBc_tfkBqod_ocgjxzc_nR_8oa0 20 0 5 AXIS_PTS_REF BMWtchctr_pwr_Pctl_Ax___MGF_CC_PF_Slot4 DEPOSIT ABSOLUTE /end AXIS_DESCR
 /begin AXIS_DESCR COM_AXIS BMWtchsp_mf_CmprNormWideRng_uw wpxDCba_sgbvDxb_FliBAmd_k__0oa0 16 0 2000 AXIS_PTS_REF BMWtchctr_pwr_PctlWideRng_Ay___MGF_CC_PF_Slot4 DEPOSIT ABSOLUTE /end AXIS_DESCR
/end CHARACTERISTIC
/begin CHARACTERISTIC BMWtchdiag_pct_WgPHi_M "Controlled variable lower threshold" MAP 0x80727A36 _REC_A1CUR_1_MBSE_S2_S1 199.9969482421875 ucttBvd_Byeweeb_zcCvaDc_fR_8a0o -100 99.9969482421875 FORMAT "%10.3"
 /begin AXIS_DESCR COM_AXIS BMWtchbas_p_Dif_sw BMW_p_sw_q0p125_hPa 5 -4096 4095.875 AXIS_PTS_REF BMWtchdiag_pct_WgPHi_Ax FORMAT "%10.3" MONOTONY STRICT_INCREASE DEPOSIT ABSOLUTE /end AXIS_DESCR
 /begin AXIS_DESCR COM_AXIS BMWtchdiag_fac_pwr_TrbPctl_uw acriqBc_tfkBqod_ocgjxzc_nR_8oa0 5 0 7.9998779296875 AXIS_PTS_REF BMWtchdiag_pct_WgPHi_Ay FORMAT "%10.3" MONOTONY STRICT_INCREASE DEPOSIT ABSOLUTE /end AXIS_DESCR
/end CHARACTERISTIC
/begin CHARACTERISTIC BMWtchdiag_pct_WgPLo_M "Controlled variable upper threshold" MAP 0x80727A04 _REC_A1CUR_1_MBSE_S2_S1 199.9969482421875 ucttBvd_Byeweeb_zcCvaDc_fR_8a0o -100 99.9969482421875 FORMAT "%10.3"
 /begin AXIS_DESCR COM_AXIS NO_INPUT_QUANTITY BMW_p_sw_q0p125_hPa 5 -4096 4095.875 AXIS_PTS_REF BMWtchdiag_pct_WgPLo_Ax FORMAT "%10.3" MONOTONY STRICT_INCREASE DEPOSIT ABSOLUTE /end AXIS_DESCR
 /begin AXIS_DESCR COM_AXIS BMWtchdiag_fac_pwr_TrbPctl_uw acriqBc_tfkBqod_ocgjxzc_nR_8oa0 5 0 7.9998779296875 AXIS_PTS_REF BMWtchdiag_pct_WgPLo_Ay FORMAT "%10.3" MONOTONY STRICT_INCREASE DEPOSIT ABSOLUTE /end AXIS_DESCR
/end CHARACTERISTIC
/begin CHARACTERISTIC BMWtchsp_rat_p_CmprMax_M___MGF_CC_PF_Slot2 "Max allowed compressor pressure ratio (model-based) (Slot 2, Pump Fuel)" MAP 0x807C22B0 _REC_A1CUR_1_MBSE_U2_S1 3.99993896484375 ilxsavd_hkzmBfc_lAzCpAb_nR_1oa0 0 3.99993896484375
 /begin AXIS_DESCR COM_AXIS BMWtchsp_mf_CmprNorm_uw wpxDCba_sgbvDxb_FliBAmd_k__0oa0 8 0 4095.9375 AXIS_PTS_REF BMWtchsp_rat_p_CmprMax_Ax FORMAT "%10.3" MONOTONY STRICT_INCREASE DEPOSIT ABSOLUTE /end AXIS_DESCR
 /begin AXIS_DESCR COM_AXIS BMWtchtbc_t_BefCmpr_sw BMW_q0p1_degC 6 -3276.8 3276.7 AXIS_PTS_REF BMWtchsp_rat_p_CmprMax_Ay FORMAT "%6.1" MONOTONY STRICT_INCREASE DEPOSIT ABSOLUTE /end AXIS_DESCR
/end CHARACTERISTIC
/begin CHARACTERISTIC BMWtchsp_rat_p_CmprMax_M___MGF_CC_PF_Slot3 "Max allowed compressor pressure ratio (model-based) (Slot 3, Pump Fuel)" MAP 0x807C2310 _REC_A1CUR_1_MBSE_U2_S1 3.99993896484375 ilxsavd_hkzmBfc_lAzCpAb_nR_1oa0 0 3.99993896484375
 /begin AXIS_DESCR COM_AXIS BMWtchsp_mf_CmprNorm_uw wpxDCba_sgbvDxb_FliBAmd_k__0oa0 8 0 4095.9375 AXIS_PTS_REF BMWtchsp_rat_p_CmprMax_Ax FORMAT "%10.3" MONOTONY STRICT_INCREASE DEPOSIT ABSOLUTE /end AXIS_DESCR
 /begin AXIS_DESCR COM_AXIS BMWtchtbc_t_BefCmpr_sw BMW_q0p1_degC 6 -3276.8 3276.7 AXIS_PTS_REF BMWtchsp_rat_p_CmprMax_Ay FORMAT "%6.1" MONOTONY STRICT_INCREASE DEPOSIT ABSOLUTE /end AXIS_DESCR
/end CHARACTERISTIC
/begin CHARACTERISTIC BMWtchsp_rat_p_CmprMax_M___MGF_CC_PF_Slot4 "Max allowed compressor pressure ratio (model-based) (Slot 4, Pump Fuel)" MAP 0x807C2370 _REC_A1CUR_1_MBSE_U2_S1 3.99993896484375 ilxsavd_hkzmBfc_lAzCpAb_nR_1oa0 0 3.99993896484375
 /begin AXIS_DESCR COM_AXIS BMWtchsp_mf_CmprNorm_uw wpxDCba_sgbvDxb_FliBAmd_k__0oa0 8 0 4095.9375 AXIS_PTS_REF BMWtchsp_rat_p_CmprMax_Ax FORMAT "%10.3" MONOTONY STRICT_INCREASE DEPOSIT ABSOLUTE /end AXIS_DESCR
 /begin AXIS_DESCR COM_AXIS BMWtchtbc_t_BefCmpr_sw BMW_q0p1_degC 6 -3276.8 3276.7 AXIS_PTS_REF BMWtchsp_rat_p_CmprMax_Ay FORMAT "%6.1" MONOTONY STRICT_INCREASE DEPOSIT ABSOLUTE /end AXIS_DESCR
/end CHARACTERISTIC
/begin CHARACTERISTIC GKF_ASPR_NORM_KALT_PF1 "Map exhaust spread setpoint (normal operation, cold, path 1)" MAP 0x80720658 _REC_A1CUR_1_MBSE_U2_S1 204 BMW_q0p1_deg 0 204 FORMAT "%5.2"
 /begin AXIS_DESCR COM_AXIS NO_INPUT_QUANTITY caoddzd_oAjpfzb_cAcEEha_1nR_oa0 16 -32768 32767 AXIS_PTS_REF GAX_KF_ASPR_NORM_PF1 FORMAT "%5.0" MONOTONY MON_INCREASE DEPOSIT ABSOLUTE /end AXIS_DESCR
 /begin AXIS_DESCR COM_AXIS NO_INPUT_QUANTITY CgkBooc_wkiDfEd_Czglhgc_fR_1a0o 16 -327.68 327.67 AXIS_PTS_REF GAY_KF_ASPR_NORM_PF1 FORMAT "%9.2" MONOTONY MON_INCREASE DEPOSIT ABSOLUTE /end AXIS_DESCR
/end CHARACTERISTIC
/begin CHARACTERISTIC GKF_ASPR_NORM_KALT_PF2 "Map exhaust spread setpoint (normal operation, cold, load, path 2)" MAP 0x80720458 _REC_A1CUR_1_MBSE_U2_S1 204 BMW_q0p1_deg 0 204 FORMAT "%5.2"
 /begin AXIS_DESCR COM_AXIS NO_INPUT_QUANTITY caoddzd_oAjpfzb_cAcEEha_1nR_oa0 16 -32768 32767 AXIS_PTS_REF GAX_KF_ASPR_NORM_PF2 FORMAT "%5.0" MONOTONY MON_INCREASE DEPOSIT ABSOLUTE /end AXIS_DESCR
 /begin AXIS_DESCR COM_AXIS NO_INPUT_QUANTITY CgkBooc_wkiDfEd_Czglhgc_fR_1a0o 16 -327.68 327.67 AXIS_PTS_REF GAY_KF_ASPR_NORM_PF2 FORMAT "%9.2" MONOTONY MON_INCREASE DEPOSIT ABSOLUTE /end AXIS_DESCR
/end CHARACTERISTIC
/begin CHARACTERISTIC GKF_ASPR_NORM_WARM_PF1 "Map exhaust spread setpoint (normal operation, warm, path 1)" MAP 0x80720258 _REC_A1CUR_1_MBSE_U2_S1 204 BMW_q0p1_deg 0 204 FORMAT "%5.2"
 /begin AXIS_DESCR COM_AXIS NO_INPUT_QUANTITY caoddzd_oAjpfzb_cAcEEha_1nR_oa0 16 -32768 32767 AXIS_PTS_REF GAX_KF_ASPR_NORM_PF1 FORMAT "%5.0" MONOTONY MON_INCREASE DEPOSIT ABSOLUTE /end AXIS_DESCR
 /begin AXIS_DESCR COM_AXIS NO_INPUT_QUANTITY CgkBooc_wkiDfEd_Czglhgc_fR_1a0o 16 -327.68 327.67 AXIS_PTS_REF GAY_KF_ASPR_NORM_PF1 FORMAT "%9.2" MONOTONY MON_INCREASE DEPOSIT ABSOLUTE /end AXIS_DESCR
/end CHARACTERISTIC
/begin CHARACTERISTIC GKF_ASPR_NORM_WARM_PF2 "Map exhaust spread setpoint (normal operation, warm, path 2)" MAP 0x80720058 _REC_A1CUR_1_MBSE_U2_S1 204 BMW_q0p1_deg 0 204 FORMAT "%5.2"
 /begin AXIS_DESCR COM_AXIS NO_INPUT_QUANTITY caoddzd_oAjpfzb_cAcEEha_1nR_oa0 16 -32768 32767 AXIS_PTS_REF GAX_KF_ASPR_NORM_PF2 FORMAT "%5.0" MONOTONY MON_INCREASE DEPOSIT ABSOLUTE /end AXIS_DESCR
 /begin AXIS_DESCR COM_AXIS NO_INPUT_QUANTITY CgkBooc_wkiDfEd_Czglhgc_fR_1a0o 16 -327.68 327.67 AXIS_PTS_REF GAY_KF_ASPR_NORM_PF2 FORMAT "%9.2" MONOTONY MON_INCREASE DEPOSIT ABSOLUTE /end AXIS_DESCR
/end CHARACTERISTIC
/begin CHARACTERISTIC GKF_EHUB_NORM_WARM_LAST "Map intake valve lift setpoint in normal operation, warm, load" MAP 0x8072382C _REC_A1CUR_1_MBSE_U2_S1 65.535 owanCxd_goxcCAa_gsclFBc_nR_1oa0 0 65.535
 /begin AXIS_DESCR COM_AXIS NO_INPUT_QUANTITY caoddzd_oAjpfzb_cAcEEha_1nR_oa0 20 -32768 32767 AXIS_PTS_REF GAX_KF_EHUB_NORM_LAST FORMAT "%5.0" MONOTONY MON_INCREASE DEPOSIT ABSOLUTE /end AXIS_DESCR
 /begin AXIS_DESCR COM_AXIS NO_INPUT_QUANTITY CgkBooc_wkiDfEd_Czglhgc_fR_1a0o 20 -327.68 327.67 AXIS_PTS_REF GAY_KF_EHUB_NORM_LAST FORMAT "%9.2" MONOTONY MON_INCREASE DEPOSIT ABSOLUTE /end AXIS_DESCR
/end CHARACTERISTIC
/begin CHARACTERISTIC GKF_ESPR_NORM_KALT_PF1 "Map intake spread setpoint (normal operation, cold, load, path 1)" MAP 0x8072142A _REC_A1CUR_1_MBSE_U2_S1 204 BMW_q0p1_deg 0 204 FORMAT "%5.2"
 /begin AXIS_DESCR COM_AXIS NO_INPUT_QUANTITY caoddzd_oAjpfzb_cAcEEha_1nR_oa0 16 -32768 32767 AXIS_PTS_REF GAX_KF_ESPR_NORM_PF1 FORMAT "%5.0" MONOTONY STRICT_INCREASE DEPOSIT ABSOLUTE /end AXIS_DESCR
 /begin AXIS_DESCR COM_AXIS NO_INPUT_QUANTITY CgkBooc_wkiDfEd_Czglhgc_fR_1a0o 16 -327.68 327.67 AXIS_PTS_REF GAY_KF_ESPR_NORM_PF1 FORMAT "%9.2" MONOTONY STRICT_INCREASE DEPOSIT ABSOLUTE /end AXIS_DESCR
/end CHARACTERISTIC
/begin CHARACTERISTIC GKF_ESPR_NORM_KALT_PF2 "Map intake spread setpoint (normal operation, cold, load, path 2)" MAP 0x8072122A _REC_A1CUR_1_MBSE_U2_S1 204 BMW_q0p1_deg 0 204 FORMAT "%5.2"
 /begin AXIS_DESCR COM_AXIS NO_INPUT_QUANTITY caoddzd_oAjpfzb_cAcEEha_1nR_oa0 16 -32768 32767 AXIS_PTS_REF GAX_KF_ESPR_NORM_PF2 FORMAT "%5.0" MONOTONY STRICT_INCREASE DEPOSIT ABSOLUTE /end AXIS_DESCR
 /begin AXIS_DESCR COM_AXIS NO_INPUT_QUANTITY CgkBooc_wkiDfEd_Czglhgc_fR_1a0o 16 -327.68 327.67 AXIS_PTS_REF GAY_KF_ESPR_NORM_PF2 FORMAT "%9.2" MONOTONY STRICT_INCREASE DEPOSIT ABSOLUTE /end AXIS_DESCR
/end CHARACTERISTIC
/begin CHARACTERISTIC GKF_ESPR_NORM_WARM_PF1 "Map intake spread setpoint (normal operation, warm, load, path 1)" MAP 0x8072102A _REC_A1CUR_1_MBSE_U2_S1 204 BMW_q0p1_deg 0 204 FORMAT "%5.2"
 /begin AXIS_DESCR COM_AXIS NO_INPUT_QUANTITY caoddzd_oAjpfzb_cAcEEha_1nR_oa0 16 -32768 32767 AXIS_PTS_REF GAX_KF_ESPR_NORM_PF1 FORMAT "%5.0" MONOTONY STRICT_INCREASE DEPOSIT ABSOLUTE /end AXIS_DESCR
 /begin AXIS_DESCR COM_AXIS NO_INPUT_QUANTITY CgkBooc_wkiDfEd_Czglhgc_fR_1a0o 16 -327.68 327.67 AXIS_PTS_REF GAY_KF_ESPR_NORM_PF1 FORMAT "%9.2" MONOTONY STRICT_INCREASE DEPOSIT ABSOLUTE /end AXIS_DESCR
/end CHARACTERISTIC
/begin CHARACTERISTIC GKF_ESPR_NORM_WARM_PF2 "Map intake spread setpoint (normal operation, warm, load, path 2)" MAP 0x80720E2A _REC_A1CUR_1_MBSE_U2_S1 204 BMW_q0p1_deg 0 204 FORMAT "%5.2"
 /begin AXIS_DESCR COM_AXIS NO_INPUT_QUANTITY caoddzd_oAjpfzb_cAcEEha_1nR_oa0 16 -32768 32767 AXIS_PTS_REF GAX_KF_ESPR_NORM_PF2 FORMAT "%5.0" MONOTONY STRICT_INCREASE DEPOSIT ABSOLUTE /end AXIS_DESCR
 /begin AXIS_DESCR COM_AXIS NO_INPUT_QUANTITY CgkBooc_wkiDfEd_Czglhgc_fR_1a0o 16 -327.68 327.67 AXIS_PTS_REF GAY_KF_ESPR_NORM_PF2 FORMAT "%9.2" MONOTONY STRICT_INCREASE DEPOSIT ABSOLUTE /end AXIS_DESCR
/end CHARACTERISTIC
/begin CHARACTERISTIC IKCtl_FacKnockDetThd0_GM___MGF_CC_PF_Slot2 "Knock detection factor map cylinder counter 0 (Slot 2, Pump Fuel)" MAP 0x807CBD7E FklWUb 3.438 fak_ub_b16 0.0625 3.5 FORMAT "%5.3"
 /begin AXIS_DESCR COM_AXIS Epm_nEng EngN 16 -16384 16383.5 AXIS_PTS_REF IKCtl_nEngB16_X_AX FORMAT "%8.2" DEPOSIT ABSOLUTE /end AXIS_DESCR
 /begin AXIS_DESCR COM_AXIS AirMod_ratChrgAirCyl rel_q0p0234 4 0 1535.977 AXIS_PTS_REF IKCtl_ratLoadAddl04_X_AX FORMAT "%8.3" DEPOSIT ABSOLUTE /end AXIS_DESCR
/end CHARACTERISTIC
/begin CHARACTERISTIC IKCtl_FacKnockDetThd0_GM___MGF_CC_PF_Slot3 "Knock detection factor map cylinder counter 0 (Slot 3, Pump Fuel)" MAP 0x807CBDBE FklWUb 3.438 fak_ub_b16 0.0625 3.5 FORMAT "%5.3"
 /begin AXIS_DESCR COM_AXIS Epm_nEng EngN 16 -16384 16383.5 AXIS_PTS_REF IKCtl_nEngB16_X_AX FORMAT "%8.2" DEPOSIT ABSOLUTE /end AXIS_DESCR
 /begin AXIS_DESCR COM_AXIS AirMod_ratChrgAirCyl rel_q0p0234 4 0 1535.977 AXIS_PTS_REF IKCtl_ratLoadAddl04_X_AX FORMAT "%8.3" DEPOSIT ABSOLUTE /end AXIS_DESCR
/end CHARACTERISTIC
/begin CHARACTERISTIC IKCtl_FacKnockDetThd0_GM___MGF_CC_PF_Slot4 "Knock detection factor map cylinder counter 0 (Slot 4, Pump Fuel)" MAP 0x807CBDFE FklWUb 3.438 fak_ub_b16 0.0625 3.5 FORMAT "%5.3"
 /begin AXIS_DESCR COM_AXIS Epm_nEng EngN 16 -16384 16383.5 AXIS_PTS_REF IKCtl_nEngB16_X_AX FORMAT "%8.2" DEPOSIT ABSOLUTE /end AXIS_DESCR
 /begin AXIS_DESCR COM_AXIS AirMod_ratChrgAirCyl rel_q0p0234 4 0 1535.977 AXIS_PTS_REF IKCtl_ratLoadAddl04_X_AX FORMAT "%8.3" DEPOSIT ABSOLUTE /end AXIS_DESCR
/end CHARACTERISTIC
/begin CHARACTERISTIC IKCtl_FacKnockDetThd1_GM___MGF_CC_PF_Slot2 "Knock detection factor map cylinder counter 1 (Slot 2, Pump Fuel)" MAP 0x807CBFBE FklWUb 3.438 fak_ub_b16 0.0625 3.5 FORMAT "%5.3"
 /begin AXIS_DESCR COM_AXIS Epm_nEng EngN 16 -16384 16383.5 AXIS_PTS_REF IKCtl_nEngB16_X_AX FORMAT "%8.2" DEPOSIT ABSOLUTE /end AXIS_DESCR
 /begin AXIS_DESCR COM_AXIS AirMod_ratChrgAirCyl rel_q0p0234 4 0 1535.977 AXIS_PTS_REF IKCtl_ratLoadAddl04_X_AX FORMAT "%8.3" DEPOSIT ABSOLUTE /end AXIS_DESCR
/end CHARACTERISTIC
/begin CHARACTERISTIC IKCtl_FacKnockDetThd1_GM___MGF_CC_PF_Slot3 "Knock detection factor map cylinder counter 1 (Slot 3, Pump Fuel)" MAP 0x807CBFFE FklWUb 3.438 fak_ub_b16 0.0625 3.5 FORMAT "%5.3"
 /begin AXIS_DESCR COM_AXIS Epm_nEng EngN 16 -16384 16383.5 AXIS_PTS_REF IKCtl_nEngB16_X_AX FORMAT "%8.2" DEPOSIT ABSOLUTE /end AXIS_DESCR
 /begin AXIS_DESCR COM_AXIS AirMod_ratChrgAirCyl rel_q0p0234 4 0 1535.977 AXIS_PTS_REF IKCtl_ratLoadAddl04_X_AX FORMAT "%8.3" DEPOSIT ABSOLUTE /end AXIS_DESCR
/end CHARACTERISTIC
/begin CHARACTERISTIC IKCtl_FacKnockDetThd1_GM___MGF_CC_PF_Slot4 "Knock detection factor map cylinder counter 1 (Slot 4, Pump Fuel)" MAP 0x807CC03E FklWUb 3.438 fak_ub_b16 0.0625 3.5 FORMAT "%5.3"
 /begin AXIS_DESCR COM_AXIS Epm_nEng EngN 16 -16384 16383.5 AXIS_PTS_REF IKCtl_nEngB16_X_AX FORMAT "%8.2" DEPOSIT ABSOLUTE /end AXIS_DESCR
 /begin AXIS_DESCR COM_AXIS AirMod_ratChrgAirCyl rel_q0p0234 4 0 1535.977 AXIS_PTS_REF IKCtl_ratLoadAddl04_X_AX FORMAT "%8.3" DEPOSIT ABSOLUTE /end AXIS_DESCR
/end CHARACTERISTIC
/begin CHARACTERISTIC IKCtl_FacKnockDetThd2_GM___MGF_CC_PF_Slot2 "Knock detection factor map cylinder counter 2 (Slot 2, Pump Fuel)" MAP 0x807CC1FE FklWUb 3.438 fak_ub_b16 0.0625 3.5 FORMAT "%5.3"
 /begin AXIS_DESCR COM_AXIS Epm_nEng EngN 16 -16384 16383.5 AXIS_PTS_REF IKCtl_nEngB16_X_AX FORMAT "%8.2" DEPOSIT ABSOLUTE /end AXIS_DESCR
 /begin AXIS_DESCR COM_AXIS AirMod_ratChrgAirCyl rel_q0p0234 4 0 1535.977 AXIS_PTS_REF IKCtl_ratLoadAddl04_X_AX FORMAT "%8.3" DEPOSIT ABSOLUTE /end AXIS_DESCR
/end CHARACTERISTIC
/begin CHARACTERISTIC IKCtl_FacKnockDetThd2_GM___MGF_CC_PF_Slot3 "Knock detection factor map cylinder counter 2 (Slot 3, Pump Fuel)" MAP 0x807CC23E FklWUb 3.438 fak_ub_b16 0.0625 3.5 FORMAT "%5.3"
 /begin AXIS_DESCR COM_AXIS Epm_nEng EngN 16 -16384 16383.5 AXIS_PTS_REF IKCtl_nEngB16_X_AX FORMAT "%8.2" DEPOSIT ABSOLUTE /end AXIS_DESCR
 /begin AXIS_DESCR COM_AXIS AirMod_ratChrgAirCyl rel_q0p0234 4 0 1535.977 AXIS_PTS_REF IKCtl_ratLoadAddl04_X_AX FORMAT "%8.3" DEPOSIT ABSOLUTE /end AXIS_DESCR
/end CHARACTERISTIC
/begin CHARACTERISTIC IKCtl_FacKnockDetThd2_GM___MGF_CC_PF_Slot4 "Knock detection factor map cylinder counter 2 (Slot 4, Pump Fuel)" MAP 0x807CC27E FklWUb 3.438 fak_ub_b16 0.0625 3.5 FORMAT "%5.3"
 /begin AXIS_DESCR COM_AXIS Epm_nEng EngN 16 -16384 16383.5 AXIS_PTS_REF IKCtl_nEngB16_X_AX FORMAT "%8.2" DEPOSIT ABSOLUTE /end AXIS_DESCR
 /begin AXIS_DESCR COM_AXIS AirMod_ratChrgAirCyl rel_q0p0234 4 0 1535.977 AXIS_PTS_REF IKCtl_ratLoadAddl04_X_AX FORMAT "%8.3" DEPOSIT ABSOLUTE /end AXIS_DESCR
/end CHARACTERISTIC
/begin CHARACTERISTIC IKCtl_FacKnockDetThd3_GM___MGF_CC_PF_Slot2 "Knock detection factor map cylinder counter 3 (Slot 2, Pump Fuel)" MAP 0x807CC43E FklWUb 3.438 fak_ub_b16 0.0625 3.5 FORMAT "%5.3"
 /begin AXIS_DESCR COM_AXIS Epm_nEng EngN 16 -16384 16383.5 AXIS_PTS_REF IKCtl_nEngB16_X_AX FORMAT "%8.2" DEPOSIT ABSOLUTE /end AXIS_DESCR
 /begin AXIS_DESCR COM_AXIS AirMod_ratChrgAirCyl rel_q0p0234 4 0 1535.977 AXIS_PTS_REF IKCtl_ratLoadAddl04_X_AX FORMAT "%8.3" DEPOSIT ABSOLUTE /end AXIS_DESCR
/end CHARACTERISTIC
/begin CHARACTERISTIC IKCtl_FacKnockDetThd3_GM___MGF_CC_PF_Slot3 "Knock detection factor map cylinder counter 3 (Slot 3, Pump Fuel)" MAP 0x807CC47E FklWUb 3.438 fak_ub_b16 0.0625 3.5 FORMAT "%5.3"
 /begin AXIS_DESCR COM_AXIS Epm_nEng EngN 16 -16384 16383.5 AXIS_PTS_REF IKCtl_nEngB16_X_AX FORMAT "%8.2" DEPOSIT ABSOLUTE /end AXIS_DESCR
 /begin AXIS_DESCR COM_AXIS AirMod_ratChrgAirCyl rel_q0p0234 4 0 1535.977 AXIS_PTS_REF IKCtl_ratLoadAddl04_X_AX FORMAT "%8.3" DEPOSIT ABSOLUTE /end AXIS_DESCR
/end CHARACTERISTIC
/begin CHARACTERISTIC IKCtl_FacKnockDetThd3_GM___MGF_CC_PF_Slot4 "Knock detection factor map cylinder counter 3 (Slot 4, Pump Fuel)" MAP 0x807CC4BE FklWUb 3.438 fak_ub_b16 0.0625 3.5 FORMAT "%5.3"
 /begin AXIS_DESCR COM_AXIS Epm_nEng EngN 16 -16384 16383.5 AXIS_PTS_REF IKCtl_nEngB16_X_AX FORMAT "%8.2" DEPOSIT ABSOLUTE /end AXIS_DESCR
 /begin AXIS_DESCR COM_AXIS AirMod_ratChrgAirCyl rel_q0p0234 4 0 1535.977 AXIS_PTS_REF IKCtl_ratLoadAddl04_X_AX FORMAT "%8.3" DEPOSIT ABSOLUTE /end AXIS_DESCR
/end CHARACTERISTIC
/begin CHARACTERISTIC IKCtl_FacKnockDetThd4_GM___MGF_CC_PF_Slot2 "Knock detection factor map cylinder counter 4 (Slot 2, Pump Fuel)" MAP 0x807CC67E FklWUb 3.438 fak_ub_b16 0.0625 3.5 FORMAT "%5.3"
 /begin AXIS_DESCR COM_AXIS Epm_nEng EngN 16 -16384 16383.5 AXIS_PTS_REF IKCtl_nEngB16_X_AX FORMAT "%8.2" DEPOSIT ABSOLUTE /end AXIS_DESCR
 /begin AXIS_DESCR COM_AXIS AirMod_ratChrgAirCyl rel_q0p0234 4 0 1535.977 AXIS_PTS_REF IKCtl_ratLoadAddl04_X_AX FORMAT "%8.3" DEPOSIT ABSOLUTE /end AXIS_DESCR
/end CHARACTERISTIC
/begin CHARACTERISTIC IKCtl_FacKnockDetThd4_GM___MGF_CC_PF_Slot3 "Knock detection factor map cylinder counter 4 (Slot 3, Pump Fuel)" MAP 0x807CC6BE FklWUb 3.438 fak_ub_b16 0.0625 3.5 FORMAT "%5.3"
 /begin AXIS_DESCR COM_AXIS Epm_nEng EngN 16 -16384 16383.5 AXIS_PTS_REF IKCtl_nEngB16_X_AX FORMAT "%8.2" DEPOSIT ABSOLUTE /end AXIS_DESCR
 /begin AXIS_DESCR COM_AXIS AirMod_ratChrgAirCyl rel_q0p0234 4 0 1535.977 AXIS_PTS_REF IKCtl_ratLoadAddl04_X_AX FORMAT "%8.3" DEPOSIT ABSOLUTE /end AXIS_DESCR
/end CHARACTERISTIC
/begin CHARACTERISTIC IKCtl_FacKnockDetThd4_GM___MGF_CC_PF_Slot4 "Knock detection factor map cylinder counter 4 (Slot 4, Pump Fuel)" MAP 0x807CC6FE FklWUb 3.438 fak_ub_b16 0.0625 3.5 FORMAT "%5.3"
 /begin AXIS_DESCR COM_AXIS Epm_nEng EngN 16 -16384 16383.5 AXIS_PTS_REF IKCtl_nEngB16_X_AX FORMAT "%8.2" DEPOSIT ABSOLUTE /end AXIS_DESCR
 /begin AXIS_DESCR COM_AXIS AirMod_ratChrgAirCyl rel_q0p0234 4 0 1535.977 AXIS_PTS_REF IKCtl_ratLoadAddl04_X_AX FORMAT "%8.3" DEPOSIT ABSOLUTE /end AXIS_DESCR
/end CHARACTERISTIC
/begin CHARACTERISTIC IKCtl_FacKnockDetThd5_GM___MGF_CC_PF_Slot2 "Knock detection factor map cylinder counter 5 (Slot 2, Pump Fuel)" MAP 0x807CC8BE FklWUb 3.438 fak_ub_b16 0.0625 3.5 FORMAT "%5.3"
 /begin AXIS_DESCR COM_AXIS Epm_nEng EngN 16 -16384 16383.5 AXIS_PTS_REF IKCtl_nEngB16_X_AX FORMAT "%8.2" DEPOSIT ABSOLUTE /end AXIS_DESCR
 /begin AXIS_DESCR COM_AXIS AirMod_ratChrgAirCyl rel_q0p0234 4 0 1535.977 AXIS_PTS_REF IKCtl_ratLoadAddl04_X_AX FORMAT "%8.3" DEPOSIT ABSOLUTE /end AXIS_DESCR
/end CHARACTERISTIC
/begin CHARACTERISTIC IKCtl_FacKnockDetThd5_GM___MGF_CC_PF_Slot3 "Knock detection factor map cylinder counter 5 (Slot 3, Pump Fuel)" MAP 0x807CC8FE FklWUb 3.438 fak_ub_b16 0.0625 3.5 FORMAT "%5.3"
 /begin AXIS_DESCR COM_AXIS Epm_nEng EngN 16 -16384 16383.5 AXIS_PTS_REF IKCtl_nEngB16_X_AX FORMAT "%8.2" DEPOSIT ABSOLUTE /end AXIS_DESCR
 /begin AXIS_DESCR COM_AXIS AirMod_ratChrgAirCyl rel_q0p0234 4 0 1535.977 AXIS_PTS_REF IKCtl_ratLoadAddl04_X_AX FORMAT "%8.3" DEPOSIT ABSOLUTE /end AXIS_DESCR
/end CHARACTERISTIC
/begin CHARACTERISTIC IKCtl_FacKnockDetThd5_GM___MGF_CC_PF_Slot4 "Knock detection factor map cylinder counter 5 (Slot 4, Pump Fuel)" MAP 0x807CC93E FklWUb 3.438 fak_ub_b16 0.0625 3.5 FORMAT "%5.3"
 /begin AXIS_DESCR COM_AXIS Epm_nEng EngN 16 -16384 16383.5 AXIS_PTS_REF IKCtl_nEngB16_X_AX FORMAT "%8.2" DEPOSIT ABSOLUTE /end AXIS_DESCR
 /begin AXIS_DESCR COM_AXIS AirMod_ratChrgAirCyl rel_q0p0234 4 0 1535.977 AXIS_PTS_REF IKCtl_ratLoadAddl04_X_AX FORMAT "%8.3" DEPOSIT ABSOLUTE /end AXIS_DESCR
/end CHARACTERISTIC
/begin CHARACTERISTIC KF_ASPR_NORM_UESP_PF1 "Map exhaust spread setpoint (during scavenging, path 1)" MAP 0x8071FC76 _REC_A1CUR_1_MBSE_U2_S1 204 BMW_q0p1_deg 0 204 FORMAT "%5.2"
 /begin AXIS_DESCR COM_AXIS NO_INPUT_QUANTITY caoddzd_oAjpfzb_cAcEEha_1nR_oa0 8 -32768 32767 AXIS_PTS_REF AXX_KF_ASPR_NORM_UESP_PF1 FORMAT "%5.0" MONOTONY MON_INCREASE DEPOSIT ABSOLUTE /end AXIS_DESCR
 /begin AXIS_DESCR COM_AXIS NO_INPUT_QUANTITY CgkBooc_wkiDfEd_Czglhgc_fR_1a0o 8 -327.68 327.67 AXIS_PTS_REF AXY_KF_ASPR_NORM_UESP_PF1 FORMAT "%9.2" MONOTONY MON_INCREASE DEPOSIT ABSOLUTE /end AXIS_DESCR
/end CHARACTERISTIC
/begin CHARACTERISTIC KF_EDA_ANZ_SPORT_MDK_IST "Torque adjustment for the performance display" MAP 0x8070CDE2 _REC_A1CUR_1_MBSE_S2_S1 6553.5 BMW_dm_sw_q0p1_Nm -3276.8 3276.7 FORMAT "%7.2"
 /begin AXIS_DESCR COM_AXIS NO_INPUT_QUANTITY BMW_dm_sw_q0p1_Nm 6 -3276.8 3276.7 AXIS_PTS_REF AXX_KF_EDA_ANZ_SPORT_MDK_IST FORMAT "%7.2" MONOTONY MON_INCREASE DEPOSIT ABSOLUTE /end AXIS_DESCR
 /begin AXIS_DESCR COM_AXIS NO_INPUT_QUANTITY caoddzd_oAjpfzb_cAcEEha_1nR_oa0 6 -32768 32767 AXIS_PTS_REF AXY_KF_EDA_ANZ_SPORT_MDK_IST FORMAT "%5.0" MONOTONY MON_INCREASE DEPOSIT ABSOLUTE /end AXIS_DESCR
/end CHARACTERISTIC
/begin CHARACTERISTIC KF_EHUB_MX "Map maximum intake valve lift" MAP 0x80722312 _REC_A1CUR_1_MBSE_U2_S1 65.535 ohoxkpc_embkBlb_gscheBc_m__aoa0 0 65.535
 /begin AXIS_DESCR COM_AXIS NO_INPUT_QUANTITY caoddzd_oAjpfzb_cAcEEha_1nR_oa0 6 -32768 32767 AXIS_PTS_REF AXX_KF_EHUB_MX FORMAT "%5.0" MONOTONY MON_INCREASE DEPOSIT ABSOLUTE /end AXIS_DESCR
 /begin AXIS_DESCR COM_AXIS NO_INPUT_QUANTITY CgkBooc_wkiDfEd_Czglhgc_fR_1a0o 6 -327.68 327.67 AXIS_PTS_REF AXY_KF_EHUB_MX FORMAT "%9.2" MONOTONY MON_INCREASE DEPOSIT ABSOLUTE /end AXIS_DESCR
/end CHARACTERISTIC
/begin CHARACTERISTIC KF_ENA_NREG_GANG_SYN "Release depending on Gang_syn_engaged and Gang_alt" MAP 0x80757801 _REC_A1CUR_1_MBSE_U1_S1 1 raChrxc_kBtBrmb_FmDuEFa_n__aa0o 0 1
 /begin AXIS_DESCR COM_AXIS NO_INPUT_QUANTITY raChrxc_kBtBrmb_FmDuEFa_n__aa0o 9 0 255 AXIS_PTS_REF AXX_KF_ENA_NREG_GANG_SYN FORMAT "%3.0" MONOTONY STRICT_INCREASE DEPOSIT ABSOLUTE /end AXIS_DESCR
 /begin AXIS_DESCR COM_AXIS NO_INPUT_QUANTITY raChrxc_kBtBrmb_FmDuEFa_n__aa0o 9 0 255 AXIS_PTS_REF AXY_KF_ENA_NREG_GANG_SYN FORMAT "%3.0" MONOTONY STRICT_INCREASE DEPOSIT ABSOLUTE /end AXIS_DESCR
/end CHARACTERISTIC
/begin CHARACTERISTIC KF_ESPR_NORM_UESP_PF1 "Map intake spread setpoint (during scavenging, path 1)" MAP 0x80720A42 _REC_A1CUR_1_MBSE_U2_S1 204 BMW_q0p1_deg 0 204 FORMAT "%5.2"
 /begin AXIS_DESCR COM_AXIS NO_INPUT_QUANTITY caoddzd_oAjpfzb_cAcEEha_1nR_oa0 8 -32768 32767 AXIS_PTS_REF AXX_KF_ESPR_NORM_UESP_PF1 FORMAT "%5.0" MONOTONY MON_INCREASE DEPOSIT ABSOLUTE /end AXIS_DESCR
 /begin AXIS_DESCR COM_AXIS NO_INPUT_QUANTITY CgkBooc_wkiDfEd_Czglhgc_fR_1a0o 8 -327.68 327.67 AXIS_PTS_REF AXY_KF_ESPR_NORM_UESP_PF1 FORMAT "%9.2" MONOTONY MON_INCREASE DEPOSIT ABSOLUTE /end AXIS_DESCR
/end CHARACTERISTIC
/begin CHARACTERISTIC KF_F_MDIMAX_KR "Inner torque limitation factor from knock control (optimal ignition angle cannot be achieved)" MAP 0x807310A0 _REC_A1CUR_1_MBSE_U2_S1 1 Bhvfwhc_bigEubd_BBEupBd_nR_3oa0 0 1
 /begin AXIS_DESCR COM_AXIS Nkw_ref caoddzd_oAjpfzb_cAcEEha_1nR_oa0 8 -32768 32767 AXIS_PTS_REF AXX_KF_F_MDIMAX_KR MONOTONY STRICT_INCREASE DEPOSIT ABSOLUTE /end AXIS_DESCR
 /begin AXIS_DESCR COM_AXIS NO_INPUT_QUANTITY BMW_dm_sw_q0p1_Nm 7 -3276.8 3276.7 AXIS_PTS_REF AXY_KF_F_MDIMAX_KR MONOTONY STRICT_INCREASE DEPOSIT ABSOLUTE /end AXIS_DESCR
/end CHARACTERISTIC
/begin CHARACTERISTIC KF_FDZWT_PF1___MGF_CC_PF_Slot2 "Temperature correction factor for ignition angle knock limit path 1 (Slot 2, Pump Fuel)" MAP 0x807C2610 _REC_A1CUR_1_MBSE_S2_S1 3.9998779296875 ilxsavd_hkzmBfc_lAzCpAb_nR_1oa0 -2 1.9998779296875 FORMAT "%14.5"
 /begin AXIS_DESCR COM_AXIS Tmot DchEpAd_DBCFgoa_Ckhahgc_q__aoa0 6 -327.68 327.67 AXIS_PTS_REF AXX_KF_FDZWT_PF1 FORMAT "%7.2" MONOTONY STRICT_INCREASE DEPOSIT ABSOLUTE /end AXIS_DESCR
 /begin AXIS_DESCR COM_AXIS Tans BMW_q0p1_degC 6 -3276.8 3276.7 AXIS_PTS_REF AXY_KF_FDZWT_PF1 FORMAT "%6.1" MONOTONY STRICT_INCREASE DEPOSIT ABSOLUTE /end AXIS_DESCR
/end CHARACTERISTIC
/begin CHARACTERISTIC KF_FDZWT_PF1___MGF_CC_PF_Slot3 "Temperature correction factor for ignition angle knock limit path 1 (Slot 3, Pump Fuel)" MAP 0x807C2658 _REC_A1CUR_1_MBSE_S2_S1 3.9998779296875 ilxsavd_hkzmBfc_lAzCpAb_nR_1oa0 -2 1.9998779296875 FORMAT "%14.5"
 /begin AXIS_DESCR COM_AXIS Tmot DchEpAd_DBCFgoa_Ckhahgc_q__aoa0 6 -327.68 327.67 AXIS_PTS_REF AXX_KF_FDZWT_PF1 FORMAT "%7.2" MONOTONY STRICT_INCREASE DEPOSIT ABSOLUTE /end AXIS_DESCR
 /begin AXIS_DESCR COM_AXIS Tans BMW_q0p1_degC 6 -3276.8 3276.7 AXIS_PTS_REF AXY_KF_FDZWT_PF1 FORMAT "%6.1" MONOTONY STRICT_INCREASE DEPOSIT ABSOLUTE /end AXIS_DESCR
/end CHARACTERISTIC
/begin CHARACTERISTIC KF_FDZWT_PF1___MGF_CC_PF_Slot4 "Temperature correction factor for ignition angle knock limit path 1 (Slot 4, Pump Fuel)" MAP 0x807C26A0 _REC_A1CUR_1_MBSE_S2_S1 3.9998779296875 ilxsavd_hkzmBfc_lAzCpAb_nR_1oa0 -2 1.9998779296875 FORMAT "%14.5"
 /begin AXIS_DESCR COM_AXIS Tmot DchEpAd_DBCFgoa_Ckhahgc_q__aoa0 6 -327.68 327.67 AXIS_PTS_REF AXX_KF_FDZWT_PF1 FORMAT "%7.2" MONOTONY STRICT_INCREASE DEPOSIT ABSOLUTE /end AXIS_DESCR
 /begin AXIS_DESCR COM_AXIS Tans BMW_q0p1_degC 6 -3276.8 3276.7 AXIS_PTS_REF AXY_KF_FDZWT_PF1 FORMAT "%6.1" MONOTONY STRICT_INCREASE DEPOSIT ABSOLUTE /end AXIS_DESCR
/end CHARACTERISTIC
/begin CHARACTERISTIC KF_FDZWT_PF2___MGF_CC_PF_Slot2 "Temperature correction factor for ignition angle knock limit path 2 (Slot 2, Pump Fuel)" MAP 0x807C2730 _REC_A1CUR_1_MBSE_S2_S1 3.9998779296875 ilxsavd_hkzmBfc_lAzCpAb_nR_1oa0 -2 1.9998779296875 FORMAT "%14.5"
 /begin AXIS_DESCR COM_AXIS Tmot DchEpAd_DBCFgoa_Ckhahgc_q__aoa0 6 -327.68 327.67 AXIS_PTS_REF AXX_KF_FDZWT_PF2 FORMAT "%7.2" MONOTONY STRICT_INCREASE DEPOSIT ABSOLUTE /end AXIS_DESCR
 /begin AXIS_DESCR COM_AXIS Tans BMW_q0p1_degC 6 -3276.8 3276.7 AXIS_PTS_REF AXY_KF_FDZWT_PF2 FORMAT "%6.1" MONOTONY STRICT_INCREASE DEPOSIT ABSOLUTE /end AXIS_DESCR
/end CHARACTERISTIC
/begin CHARACTERISTIC KF_FDZWT_PF2___MGF_CC_PF_Slot3 "Temperature correction factor for ignition angle knock limit path 2 (Slot 3, Pump Fuel)" MAP 0x807C2778 _REC_A1CUR_1_MBSE_S2_S1 3.9998779296875 ilxsavd_hkzmBfc_lAzCpAb_nR_1oa0 -2 1.9998779296875 FORMAT "%14.5"
 /begin AXIS_DESCR COM_AXIS Tmot DchEpAd_DBCFgoa_Ckhahgc_q__aoa0 6 -327.68 327.67 AXIS_PTS_REF AXX_KF_FDZWT_PF2 FORMAT "%7.2" MONOTONY STRICT_INCREASE DEPOSIT ABSOLUTE /end AXIS_DESCR
 /begin AXIS_DESCR COM_AXIS Tans BMW_q0p1_degC 6 -3276.8 3276.7 AXIS_PTS_REF AXY_KF_FDZWT_PF2 FORMAT "%6.1" MONOTONY STRICT_INCREASE DEPOSIT ABSOLUTE /end AXIS_DESCR
/end CHARACTERISTIC
/begin CHARACTERISTIC KF_FDZWT_PF2___MGF_CC_PF_Slot4 "Temperature correction factor for ignition angle knock limit path 2 (Slot 4, Pump Fuel)" MAP 0x807C27C0 _REC_A1CUR_1_MBSE_S2_S1 3.9998779296875 ilxsavd_hkzmBfc_lAzCpAb_nR_1oa0 -2 1.9998779296875 FORMAT "%14.5"
 /begin AXIS_DESCR COM_AXIS Tmot DchEpAd_DBCFgoa_Ckhahgc_q__aoa0 6 -327.68 327.67 AXIS_PTS_REF AXX_KF_FDZWT_PF2 FORMAT "%7.2" MONOTONY STRICT_INCREASE DEPOSIT ABSOLUTE /end AXIS_DESCR
 /begin AXIS_DESCR COM_AXIS Tans BMW_q0p1_degC 6 -3276.8 3276.7 AXIS_PTS_REF AXY_KF_FDZWT_PF2 FORMAT "%6.1" MONOTONY STRICT_INCREASE DEPOSIT ABSOLUTE /end AXIS_DESCR
/end CHARACTERISTIC
/begin CHARACTERISTIC KF_FK_FTRANSVL "Map filter constant for F_transvl (= crossfade factor Wdk_soll to KL_DKVL)" MAP 0x8074337C _REC_A1CUR_1_MBSE_U2_S1 0.999984741210938 FzbmlAa_gCtylrb_ckCqxAc_nR_6oa0 0 0.999984741210938 FORMAT "%14.5"
 /begin AXIS_DESCR COM_AXIS NO_INPUT_QUANTITY caoddzd_oAjpfzb_cAcEEha_1nR_oa0 6 -32768 32767 AXIS_PTS_REF AXX_KF_FK_FTRANSVL FORMAT "%5.0" MONOTONY MON_INCREASE DEPOSIT ABSOLUTE /end AXIS_DESCR
 /begin AXIS_DESCR COM_AXIS NO_INPUT_QUANTITY ilxsavd_hkzmBfc_lAzCpAb_nR_1oa0 6 0 3.99993896484375 AXIS_PTS_REF AXY_KF_FK_FTRANSVL FORMAT "%14.5" MONOTONY MON_INCREASE DEPOSIT ABSOLUTE /end AXIS_DESCR
/end CHARACTERISTIC
/begin CHARACTERISTIC KF_FRKKORRF_1___MGF_CC_PF_Slot2 "Map feedforward correction bank 1 (Slot 2, Pump Fuel)" MAP 0x807C2A08 _REC_A1CUR_1_MBSE_U2_S1 1.99996948242188 Bhvfwhc_bigEubd_BBEupBd_nR_3oa0 0 1.99996948242188 FORMAT "%14.5"
 /begin AXIS_DESCR COM_AXIS Nkw caoddzd_oAjpfzb_cAcEEha_1nR_oa0 16 -32768 32767 AXIS_PTS_REF AXX_KF_FRKKORRF_1 FORMAT "%5.0" MONOTONY STRICT_INCREASE DEPOSIT ABSOLUTE /end AXIS_DESCR
 /begin AXIS_DESCR COM_AXIS Rf CgkBooc_wkiDfEd_Czglhgc_fR_1a0o 16 -327.68 327.67 AXIS_PTS_REF AXY_KF_FRKKORRF_1 FORMAT "%7.2" MONOTONY STRICT_INCREASE DEPOSIT ABSOLUTE /end AXIS_DESCR
/end CHARACTERISTIC
/begin CHARACTERISTIC KF_FRKKORRF_1___MGF_CC_PF_Slot3 "Map feedforward correction bank 1 (Slot 3, Pump Fuel)" MAP 0x807C2C08 _REC_A1CUR_1_MBSE_U2_S1 1.99996948242188 Bhvfwhc_bigEubd_BBEupBd_nR_3oa0 0 1.99996948242188 FORMAT "%14.5"
 /begin AXIS_DESCR COM_AXIS Nkw caoddzd_oAjpfzb_cAcEEha_1nR_oa0 16 -32768 32767 AXIS_PTS_REF AXX_KF_FRKKORRF_1 FORMAT "%5.0" MONOTONY STRICT_INCREASE DEPOSIT ABSOLUTE /end AXIS_DESCR
 /begin AXIS_DESCR COM_AXIS Rf CgkBooc_wkiDfEd_Czglhgc_fR_1a0o 16 -327.68 327.67 AXIS_PTS_REF AXY_KF_FRKKORRF_1 FORMAT "%7.2" MONOTONY STRICT_INCREASE DEPOSIT ABSOLUTE /end AXIS_DESCR
/end CHARACTERISTIC
/begin CHARACTERISTIC KF_FRKKORRF_1___MGF_CC_PF_Slot4 "Map feedforward correction bank 1 (Slot 4, Pump Fuel)" MAP 0x807C2E08 _REC_A1CUR_1_MBSE_U2_S1 1.99996948242188 Bhvfwhc_bigEubd_BBEupBd_nR_3oa0 0 1.99996948242188 FORMAT "%14.5"
 /begin AXIS_DESCR COM_AXIS Nkw caoddzd_oAjpfzb_cAcEEha_1nR_oa0 16 -32768 32767 AXIS_PTS_REF AXX_KF_FRKKORRF_1 FORMAT "%5.0" MONOTONY STRICT_INCREASE DEPOSIT ABSOLUTE /end AXIS_DESCR
 /begin AXIS_DESCR COM_AXIS Rf CgkBooc_wkiDfEd_Czglhgc_fR_1a0o 16 -327.68 327.67 AXIS_PTS_REF AXY_KF_FRKKORRF_1 FORMAT "%7.2" MONOTONY STRICT_INCREASE DEPOSIT ABSOLUTE /end AXIS_DESCR
/end CHARACTERISTIC
/begin CHARACTERISTIC KF_FTRANSVL "Map setpoint F_transvl (= crossfade factor Wdk_soll to KL_DKVL)" MAP 0x8074327C _REC_A1CUR_1_MBSE_U2_S1 0.999984741210938 FzbmlAa_gCtylrb_ckCqxAc_nR_6oa0 0 0.999984741210938 FORMAT "%7.5"
 /begin AXIS_DESCR COM_AXIS NO_INPUT_QUANTITY caoddzd_oAjpfzb_cAcEEha_1nR_oa0 8 -32768 32767 AXIS_PTS_REF AXX_KF_FTRANSVL FORMAT "%5.0" MONOTONY MON_INCREASE DEPOSIT ABSOLUTE /end AXIS_DESCR
 /begin AXIS_DESCR COM_AXIS NO_INPUT_QUANTITY FzbmlAa_gCtylrb_ckCqxAc_nR_6oa0 8 0 0.999984741210938 AXIS_PTS_REF AXY_KF_FTRANSVL FORMAT "%7.5" MONOTONY MON_INCREASE DEPOSIT ABSOLUTE /end AXIS_DESCR
/end CHARACTERISTIC
/begin CHARACTERISTIC KF_HUB_GRDMX "Map maximum intake valve lift increase per 10ms" MAP 0x807222CA _REC_A1CUR_1_MBSE_U2_S1 65.535 ohoxkpc_embkBlb_gscheBc_m__aoa0 0 65.535
 /begin AXIS_DESCR COM_AXIS NO_INPUT_QUANTITY caoddzd_oAjpfzb_cAcEEha_1nR_oa0 6 -32768 32767 AXIS_PTS_REF AXX_KF_HUB_GRDMX FORMAT "%5.0" MONOTONY MON_INCREASE DEPOSIT ABSOLUTE /end AXIS_DESCR
 /begin AXIS_DESCR COM_AXIS NO_INPUT_QUANTITY ohoxkpc_embkBlb_gscheBc_m__aoa0 6 0 65.535 AXIS_PTS_REF AXY_KF_HUB_GRDMX MONOTONY MON_INCREASE DEPOSIT ABSOLUTE /end AXIS_DESCR
/end CHARACTERISTIC
/begin CHARACTERISTIC KF_HUBESTM "Map intake valve lift setpoint during engine start" MAP 0x807226EC _REC_A1CUR_1_MBSE_U2_S1 65.535 ohoxkpc_embkBlb_gscheBc_m__aoa0 0 65.535
 /begin AXIS_DESCR COM_AXIS NO_INPUT_QUANTITY caoddzd_oAjpfzb_cAcEEha_1nR_oa0 8 -32768 32767 AXIS_PTS_REF AXX_KF_HUBESTM FORMAT "%5.0" MONOTONY MON_INCREASE DEPOSIT ABSOLUTE /end AXIS_DESCR
 /begin AXIS_DESCR COM_AXIS NO_INPUT_QUANTITY DchEpAd_DBCFgoa_Ckhahgc_q__aoa0 8 -327.68 327.67 AXIS_PTS_REF AXY_KF_HUBESTM FORMAT "%7.2" MONOTONY MON_INCREASE DEPOSIT ABSOLUTE /end AXIS_DESCR
/end CHARACTERISTIC
/begin CHARACTERISTIC KF_LABAS_1___MGF_CC_PF_Slot2 "Base lambda in homogeneous mode bank 1 (Slot 2, Pump Fuel)" MAP 0x807C326C _REC_A1CUR_1_MBSE_U2_S1 15.999755859375 BumqDkc_mryszAa_EcglxAc_nR_4oa0 0 15.999755859375 FORMAT "%9.4"
 /begin AXIS_DESCR COM_AXIS Nkw caoddzd_oAjpfzb_cAcEEha_1nR_oa0 18 -32768 32767 AXIS_PTS_REF GXX_KF_LABAS FORMAT "%5.0" MONOTONY STRICT_INCREASE DEPOSIT ABSOLUTE /end AXIS_DESCR
 /begin AXIS_DESCR COM_AXIS Rf CgkBooc_wkiDfEd_Czglhgc_fR_1a0o 17 -327.68 327.67 AXIS_PTS_REF GXY_KF_LABAS FORMAT "%7.2" MONOTONY STRICT_INCREASE DEPOSIT ABSOLUTE /end AXIS_DESCR
/end CHARACTERISTIC
/begin CHARACTERISTIC KF_LABAS_1___MGF_CC_PF_Slot3 "Base lambda in homogeneous mode bank 1 (Slot 3, Pump Fuel)" MAP 0x807C34D0 _REC_A1CUR_1_MBSE_U2_S1 15.999755859375 BumqDkc_mryszAa_EcglxAc_nR_4oa0 0 15.999755859375 FORMAT "%9.4"
 /begin AXIS_DESCR COM_AXIS Nkw caoddzd_oAjpfzb_cAcEEha_1nR_oa0 18 -32768 32767 AXIS_PTS_REF GXX_KF_LABAS FORMAT "%5.0" MONOTONY STRICT_INCREASE DEPOSIT ABSOLUTE /end AXIS_DESCR
 /begin AXIS_DESCR COM_AXIS Rf CgkBooc_wkiDfEd_Czglhgc_fR_1a0o 17 -327.68 327.67 AXIS_PTS_REF GXY_KF_LABAS FORMAT "%7.2" MONOTONY STRICT_INCREASE DEPOSIT ABSOLUTE /end AXIS_DESCR
/end CHARACTERISTIC
/begin CHARACTERISTIC KF_LABAS_1___MGF_CC_PF_Slot4 "Base lambda in homogeneous mode bank 1 (Slot 4, Pump Fuel)" MAP 0x807C3734 _REC_A1CUR_1_MBSE_U2_S1 15.999755859375 BumqDkc_mryszAa_EcglxAc_nR_4oa0 0 15.999755859375 FORMAT "%9.4"
 /begin AXIS_DESCR COM_AXIS Nkw caoddzd_oAjpfzb_cAcEEha_1nR_oa0 18 -32768 32767 AXIS_PTS_REF GXX_KF_LABAS FORMAT "%5.0" MONOTONY STRICT_INCREASE DEPOSIT ABSOLUTE /end AXIS_DESCR
 /begin AXIS_DESCR COM_AXIS Rf CgkBooc_wkiDfEd_Czglhgc_fR_1a0o 17 -327.68 327.67 AXIS_PTS_REF GXY_KF_LABAS FORMAT "%7.2" MONOTONY STRICT_INCREASE DEPOSIT ABSOLUTE /end AXIS_DESCR
/end CHARACTERISTIC
/begin CHARACTERISTIC KF_LABAS_2___MGF_CC_PF_Slot2 "Base lambda in homogeneous mode bank 2 (Slot 2, Pump Fuel)" MAP 0x807C3BFC _REC_A1CUR_1_MBSE_U2_S1 15.999755859375 BumqDkc_mryszAa_EcglxAc_nR_4oa0 0 15.999755859375 FORMAT "%9.4"
 /begin AXIS_DESCR COM_AXIS Nkw caoddzd_oAjpfzb_cAcEEha_1nR_oa0 18 -32768 32767 AXIS_PTS_REF GXX_KF_LABAS FORMAT "%5.0" MONOTONY STRICT_INCREASE DEPOSIT ABSOLUTE /end AXIS_DESCR
 /begin AXIS_DESCR COM_AXIS Rf CgkBooc_wkiDfEd_Czglhgc_fR_1a0o 17 -327.68 327.67 AXIS_PTS_REF GXY_KF_LABAS FORMAT "%7.2" MONOTONY STRICT_INCREASE DEPOSIT ABSOLUTE /end AXIS_DESCR
/end CHARACTERISTIC
/begin CHARACTERISTIC KF_LABAS_2___MGF_CC_PF_Slot3 "Base lambda in homogeneous mode bank 2 (Slot 3, Pump Fuel)" MAP 0x807C3E60 _REC_A1CUR_1_MBSE_U2_S1 15.999755859375 BumqDkc_mryszAa_EcglxAc_nR_4oa0 0 15.999755859375 FORMAT "%9.4"
 /begin AXIS_DESCR COM_AXIS Nkw caoddzd_oAjpfzb_cAcEEha_1nR_oa0 18 -32768 32767 AXIS_PTS_REF GXX_KF_LABAS FORMAT "%5.0" MONOTONY STRICT_INCREASE DEPOSIT ABSOLUTE /end AXIS_DESCR
 /begin AXIS_DESCR COM_AXIS Rf CgkBooc_wkiDfEd_Czglhgc_fR_1a0o 17 -327.68 327.67 AXIS_PTS_REF GXY_KF_LABAS FORMAT "%7.2" MONOTONY STRICT_INCREASE DEPOSIT ABSOLUTE /end AXIS_DESCR
/end CHARACTERISTIC
/begin CHARACTERISTIC KF_LABAS_2___MGF_CC_PF_Slot4 "Base lambda in homogeneous mode bank 2 (Slot 4, Pump Fuel)" MAP 0x807C40C4 _REC_A1CUR_1_MBSE_U2_S1 15.999755859375 BumqDkc_mryszAa_EcglxAc_nR_4oa0 0 15.999755859375 FORMAT "%9.4"
 /begin AXIS_DESCR COM_AXIS Nkw caoddzd_oAjpfzb_cAcEEha_1nR_oa0 18 -32768 32767 AXIS_PTS_REF GXX_KF_LABAS FORMAT "%5.0" MONOTONY STRICT_INCREASE DEPOSIT ABSOLUTE /end AXIS_DESCR
 /begin AXIS_DESCR COM_AXIS Rf CgkBooc_wkiDfEd_Czglhgc_fR_1a0o 17 -327.68 327.67 AXIS_PTS_REF GXY_KF_LABAS FORMAT "%7.2" MONOTONY STRICT_INCREASE DEPOSIT ABSOLUTE /end AXIS_DESCR
/end CHARACTERISTIC
/begin CHARACTERISTIC KF_MDIMAX_FG "Inner torque limitation due to component protection at rich running limit" MAP 0x80730FE8 _REC_A1CUR_1_MBSE_S2_S1 6553.5 BMW_dm_sw_q0p1_Nm -3276.8 3276.7 FORMAT "%6.1"
 /begin AXIS_DESCR COM_AXIS Nkw_ref caoddzd_oAjpfzb_cAcEEha_1nR_oa0 6 -32768 32767 AXIS_PTS_REF AXX_KF_MDIMAX_FG MONOTONY STRICT_INCREASE DEPOSIT ABSOLUTE /end AXIS_DESCR
 /begin AXIS_DESCR COM_AXIS Frfmxbsld Bhvfwhc_bigEubd_BBEupBd_nR_3oa0 6 0 1 AXIS_PTS_REF AXY_KF_MDIMAX_FG FORMAT "%14.5" MONOTONY STRICT_INCREASE DEPOSIT ABSOLUTE /end AXIS_DESCR
/end CHARACTERISTIC
/begin CHARACTERISTIC KF_MDIMAX_SK "Inner torque limitation after pre-ignition events (super-knock)" MAP 0x80730F78 _REC_A1CUR_1_MBSE_S2_S1 6553.5 BMW_dm_sw_q0p1_Nm -3276.8 3276.7 FORMAT "%6.1"
 /begin AXIS_DESCR COM_AXIS Nkw_ref caoddzd_oAjpfzb_cAcEEha_1nR_oa0 8 -32768 32767 AXIS_PTS_REF AXX_KF_MDIMAX_SK MONOTONY STRICT_INCREASE DEPOSIT ABSOLUTE /end AXIS_DESCR
 /begin AXIS_DESCR COM_AXIS BMWpim_fac_TqRedn_ub BMW_Powertrain_DxECompuMethods_Def_ub_b1_nounit 7 0 0.99609375 AXIS_PTS_REF AXY_KF_MDIMAX_SK MONOTONY STRICT_INCREASE DEPOSIT ABSOLUTE /end AXIS_DESCR
/end CHARACTERISTIC
/begin CHARACTERISTIC KF_MDIMAX_TANS "Max. inner torque limitation via intake air temperature" MAP 0x80730F30 _REC_A1CUR_1_MBSE_S2_S1 6553.5 BMW_dm_sw_q0p1_Nm -3276.8 3276.7 FORMAT "%6.1"
 /begin AXIS_DESCR COM_AXIS Nkw_ref caoddzd_oAjpfzb_cAcEEha_1nR_oa0 6 -32768 32767 AXIS_PTS_REF AXX_KF_MDIMAX_TANS MONOTONY STRICT_INCREASE DEPOSIT ABSOLUTE /end AXIS_DESCR
 /begin AXIS_DESCR COM_AXIS Tans BMW_q0p1_degC 6 -3276.8 3276.7 AXIS_PTS_REF AXY_KF_MDIMAX_TANS FORMAT "%6.1" MONOTONY STRICT_INCREASE DEPOSIT ABSOLUTE /end AXIS_DESCR
/end CHARACTERISTIC
/begin CHARACTERISTIC KF_MDIMAX_TVDK "Max. inner torque limitation via temperature before throttle" MAP 0x80730EE8 _REC_A1CUR_1_MBSE_S2_S1 6553.5 BMW_dm_sw_q0p1_Nm -3276.8 3276.7 FORMAT "%6.1"
 /begin AXIS_DESCR COM_AXIS Nkw_ref caoddzd_oAjpfzb_cAcEEha_1nR_oa0 6 -32768 32767 AXIS_PTS_REF AXX_KF_MDIMAX_TVDK MONOTONY STRICT_INCREASE DEPOSIT ABSOLUTE /end AXIS_DESCR
 /begin AXIS_DESCR COM_AXIS Tvdk BMW_q0p1_degC 6 -3276.8 3276.7 AXIS_PTS_REF AXY_KF_MDIMAX_TVDK FORMAT "%6.1" MONOTONY STRICT_INCREASE DEPOSIT ABSOLUTE /end AXIS_DESCR
/end CHARACTERISTIC
/begin CHARACTERISTIC KF_MDR_ABV_SPO "Relative desired torque for drivetrain in sport mode" MAP 0x807328FE _REC_A1CUR_1_MBSE_U2_S1 255.99609375 BMW_Powertrain_DxECompuMethods_Def_ub_b1_nounit 0 255.99609375
 /begin AXIS_DESCR COM_AXIS NO_INPUT_QUANTITY Asyaixa_wdvtenb_FCefaCb_n__aa0o 10 -655.36 655.34 AXIS_PTS_REF AXX_KF_MDR_ABV_SPO MONOTONY STRICT_INCREASE DEPOSIT ABSOLUTE /end AXIS_DESCR
 /begin AXIS_DESCR COM_AXIS NO_INPUT_QUANTITY uvFxekd_wvexlbc_BcFdkDd_nR_1a0o 12 -800 799.9755859375 AXIS_PTS_REF AXY_KF_MDR_ABV_SPO MONOTONY STRICT_INCREASE DEPOSIT ABSOLUTE /end AXIS_DESCR
/end CHARACTERISTIC
/begin CHARACTERISTIC KF_MDR_ABV_SPO_HS "Relative desired torque for drivetrain in sport mode (manual transmission)" MAP 0x8073262E _REC_A1CUR_1_MBSE_U2_S1 255.99609375 BMW_Powertrain_DxECompuMethods_Def_ub_b1_nounit 0 255.99609375
 /begin AXIS_DESCR COM_AXIS NO_INPUT_QUANTITY Asyaixa_wdvtenb_FCefaCb_n__aa0o 10 -655.36 655.34 AXIS_PTS_REF AXX_KF_MDR_ABV_SPO_HS MONOTONY STRICT_INCREASE DEPOSIT ABSOLUTE /end AXIS_DESCR
 /begin AXIS_DESCR COM_AXIS NO_INPUT_QUANTITY uvFxekd_wvexlbc_BcFdkDd_nR_1a0o 12 -800 799.9755859375 AXIS_PTS_REF AXY_KF_MDR_ABV_SPO_HS MONOTONY STRICT_INCREASE DEPOSIT ABSOLUTE /end AXIS_DESCR
/end CHARACTERISTIC
/begin CHARACTERISTIC KF_MDR_ABV_SPO2 "Relative desired torque for drivetrain in sport mode (2)" MAP 0x8073280E _REC_A1CUR_1_MBSE_U2_S1 255.99609375 BMW_Powertrain_DxECompuMethods_Def_ub_b1_nounit 0 255.99609375
 /begin AXIS_DESCR COM_AXIS NO_INPUT_QUANTITY Asyaixa_wdvtenb_FCefaCb_n__aa0o 10 -655.36 655.34 AXIS_PTS_REF AXX_KF_MDR_ABV_SPO2 MONOTONY STRICT_INCREASE DEPOSIT ABSOLUTE /end AXIS_DESCR
 /begin AXIS_DESCR COM_AXIS NO_INPUT_QUANTITY uvFxekd_wvexlbc_BcFdkDd_nR_1a0o 12 -800 799.9755859375 AXIS_PTS_REF AXY_KF_MDR_ABV_SPO2 MONOTONY STRICT_INCREASE DEPOSIT ABSOLUTE /end AXIS_DESCR
/end CHARACTERISTIC
/begin CHARACTERISTIC KF_MDR_ABV_SPO2_HS "Relative desired torque for drivetrain in sport mode (manual transmission)" MAP 0x8073271E _REC_A1CUR_1_MBSE_U2_S1 255.99609375 BMW_Powertrain_DxECompuMethods_Def_ub_b1_nounit 0 255.99609375
 /begin AXIS_DESCR COM_AXIS NO_INPUT_QUANTITY Asyaixa_wdvtenb_FCefaCb_n__aa0o 10 -655.36 655.34 AXIS_PTS_REF AXX_KF_MDR_ABV_SPO2_HS MONOTONY STRICT_INCREASE DEPOSIT ABSOLUTE /end AXIS_DESCR
 /begin AXIS_DESCR COM_AXIS NO_INPUT_QUANTITY uvFxekd_wvexlbc_BcFdkDd_nR_1a0o 12 -800 799.9755859375 AXIS_PTS_REF AXY_KF_MDR_ABV_SPO2_HS MONOTONY STRICT_INCREASE DEPOSIT ABSOLUTE /end AXIS_DESCR
/end CHARACTERISTIC
/begin CHARACTERISTIC KF_MDRED_T "Factor for reducing engine target torque depending on temperatures" MAP 0x80761C53 _REC_A1CUR_1_MBSE_U1_S1 0.99609375 BMW_Powertrain_DxECompuMethods_Def_ub_b1_nounit 0 0.99609375
 /begin AXIS_DESCR COM_AXIS Tmot_wm DchEpAd_DBCFgoa_Ckhahgc_q__aoa0 6 -327.68 327.67 AXIS_PTS_REF AXX_KF_MDRED_T MONOTONY STRICT_INCREASE DEPOSIT ABSOLUTE /end AXIS_DESCR
 /begin AXIS_DESCR COM_AXIS Toel_wm BMW_q0p1_degC 6 -3276.8 3276.7 AXIS_PTS_REF AXY_KF_MDRED_T MONOTONY STRICT_INCREASE DEPOSIT ABSOLUTE /end AXIS_DESCR
/end CHARACTERISTIC
/begin CHARACTERISTIC KF_PHA_H_B1_W___MGF_CC_PF_Slot2 "Map start angle injection event 1 warm (Slot 2, Pump Fuel)" MAP 0x807CB3EE _REC_A1CUR_1_MBSE_S2_S1 1535.9765625 aEmoCzd_erpwvfb_msfkhgc_qR_1a0o -768 767.9765625
 /begin AXIS_DESCR COM_AXIS Nkw caoddzd_oAjpfzb_cAcEEha_1nR_oa0 10 -32768 32767 AXIS_PTS_REF GXX_KF_PHA_H_B1_BAS FORMAT "%5.0" MONOTONY STRICT_INCREASE DEPOSIT ABSOLUTE /end AXIS_DESCR
 /begin AXIS_DESCR COM_AXIS NO_INPUT_QUANTITY zyyxBpb_rEsnvtc_gktukCa_fR_5a0o 12 -1600 1599.951171875 AXIS_PTS_REF GXY_KF_PHA_H_B1_BAS FORMAT "%8.3" MONOTONY STRICT_INCREASE DEPOSIT ABSOLUTE /end AXIS_DESCR
/end CHARACTERISTIC
/begin CHARACTERISTIC KF_PHA_H_B1_W___MGF_CC_PF_Slot3 "Map start angle injection event 1 warm (Slot 3, Pump Fuel)" MAP 0x807CB4DE _REC_A1CUR_1_MBSE_S2_S1 1535.9765625 aEmoCzd_erpwvfb_msfkhgc_qR_1a0o -768 767.9765625
 /begin AXIS_DESCR COM_AXIS Nkw caoddzd_oAjpfzb_cAcEEha_1nR_oa0 10 -32768 32767 AXIS_PTS_REF GXX_KF_PHA_H_B1_BAS FORMAT "%5.0" MONOTONY STRICT_INCREASE DEPOSIT ABSOLUTE /end AXIS_DESCR
 /begin AXIS_DESCR COM_AXIS NO_INPUT_QUANTITY zyyxBpb_rEsnvtc_gktukCa_fR_5a0o 12 -1600 1599.951171875 AXIS_PTS_REF GXY_KF_PHA_H_B1_BAS FORMAT "%8.3" MONOTONY STRICT_INCREASE DEPOSIT ABSOLUTE /end AXIS_DESCR
/end CHARACTERISTIC
/begin CHARACTERISTIC KF_PHA_H_B1_W___MGF_CC_PF_Slot4 "Map start angle injection event 1 warm (Slot 4, Pump Fuel)" MAP 0x807CB5CE _REC_A1CUR_1_MBSE_S2_S1 1535.9765625 aEmoCzd_erpwvfb_msfkhgc_qR_1a0o -768 767.9765625
 /begin AXIS_DESCR COM_AXIS Nkw caoddzd_oAjpfzb_cAcEEha_1nR_oa0 10 -32768 32767 AXIS_PTS_REF GXX_KF_PHA_H_B1_BAS FORMAT "%5.0" MONOTONY STRICT_INCREASE DEPOSIT ABSOLUTE /end AXIS_DESCR
 /begin AXIS_DESCR COM_AXIS NO_INPUT_QUANTITY zyyxBpb_rEsnvtc_gktukCa_fR_5a0o 12 -1600 1599.951171875 AXIS_PTS_REF GXY_KF_PHA_H_B1_BAS FORMAT "%8.3" MONOTONY STRICT_INCREASE DEPOSIT ABSOLUTE /end AXIS_DESCR
/end CHARACTERISTIC
/begin CHARACTERISTIC KF_PHA_H_E1___MGF_CC_PF_Slot2 "KF_PHA_H_E1 (Slot 2, Pump Fuel)" MAP 0x807CB9BE _REC_A1CUR_1_MBSE_S2_S1 1535.9765625 ridxkCa_Dxvxtdc_CChkhgc_nR_1a0o -768 767.9765625
 /begin AXIS_DESCR COM_AXIS Nkw caoddzd_oAjpfzb_cAcEEha_1nR_oa0 8 -32768 32767 AXIS_PTS_REF AXX_KF_PHA_H_E1 FORMAT "%5.0" MONOTONY STRICT_INCREASE DEPOSIT ABSOLUTE /end AXIS_DESCR
 /begin AXIS_DESCR COM_AXIS NO_INPUT_QUANTITY zyyxBpb_rEsnvtc_gktukCa_fR_5a0o 8 -1600 1599.951171875 AXIS_PTS_REF AXY_KF_PHA_H_E1 MONOTONY STRICT_INCREASE DEPOSIT ABSOLUTE /end AXIS_DESCR
/end CHARACTERISTIC
/begin CHARACTERISTIC KF_PHA_H_E1___MGF_CC_PF_Slot3 "KF_PHA_H_E1 (Slot 3, Pump Fuel)" MAP 0x807CBA3E _REC_A1CUR_1_MBSE_S2_S1 1535.9765625 ridxkCa_Dxvxtdc_CChkhgc_nR_1a0o -768 767.9765625
 /begin AXIS_DESCR COM_AXIS Nkw caoddzd_oAjpfzb_cAcEEha_1nR_oa0 8 -32768 32767 AXIS_PTS_REF AXX_KF_PHA_H_E1 FORMAT "%5.0" MONOTONY STRICT_INCREASE DEPOSIT ABSOLUTE /end AXIS_DESCR
 /begin AXIS_DESCR COM_AXIS NO_INPUT_QUANTITY zyyxBpb_rEsnvtc_gktukCa_fR_5a0o 8 -1600 1599.951171875 AXIS_PTS_REF AXY_KF_PHA_H_E1 MONOTONY STRICT_INCREASE DEPOSIT ABSOLUTE /end AXIS_DESCR
/end CHARACTERISTIC
/begin CHARACTERISTIC KF_PHA_H_E1___MGF_CC_PF_Slot4 "KF_PHA_H_E1 (Slot 4, Pump Fuel)" MAP 0x807CBABE _REC_A1CUR_1_MBSE_S2_S1 1535.9765625 ridxkCa_Dxvxtdc_CChkhgc_nR_1a0o -768 767.9765625
 /begin AXIS_DESCR COM_AXIS Nkw caoddzd_oAjpfzb_cAcEEha_1nR_oa0 8 -32768 32767 AXIS_PTS_REF AXX_KF_PHA_H_E1 FORMAT "%5.0" MONOTONY STRICT_INCREASE DEPOSIT ABSOLUTE /end AXIS_DESCR
 /begin AXIS_DESCR COM_AXIS NO_INPUT_QUANTITY zyyxBpb_rEsnvtc_gktukCa_fR_5a0o 8 -1600 1599.951171875 AXIS_PTS_REF AXY_KF_PHA_H_E1 MONOTONY STRICT_INCREASE DEPOSIT ABSOLUTE /end AXIS_DESCR
/end CHARACTERISTIC
/begin CHARACTERISTIC KF_ZW_PF1___MGF_CC_PF_Slot2 "Base ignition angle path 1 (Slot 2, Pump Fuel)" MAP 0x807C51D6 _REC_A1CUR_1_MBSE_S1_S1 127.5 aAwkuzc_BFpgCmb_tmDukma_q__aa0o -64 63.5 FORMAT "%4.1"
 /begin AXIS_DESCR COM_AXIS Nkw caoddzd_oAjpfzb_cAcEEha_1nR_oa0 20 -32768 32767 AXIS_PTS_REF AXX_KF_ZW_PF1 FORMAT "%5.0" MONOTONY STRICT_INCREASE DEPOSIT ABSOLUTE /end AXIS_DESCR
 /begin AXIS_DESCR COM_AXIS NO_INPUT_QUANTITY CgkBooc_wkiDfEd_Czglhgc_fR_1a0o 20 -327.68 327.67 AXIS_PTS_REF AXY_KF_ZW_PF1 FORMAT "%9.2" MONOTONY STRICT_INCREASE DEPOSIT ABSOLUTE /end AXIS_DESCR
/end CHARACTERISTIC
/begin CHARACTERISTIC KF_ZW_PF1___MGF_CC_PF_Slot3 "Base ignition angle path 1 (Slot 3, Pump Fuel)" MAP 0x807C5366 _REC_A1CUR_1_MBSE_S1_S1 127.5 aAwkuzc_BFpgCmb_tmDukma_q__aa0o -64 63.5 FORMAT "%4.1"
 /begin AXIS_DESCR COM_AXIS Nkw caoddzd_oAjpfzb_cAcEEha_1nR_oa0 20 -32768 32767 AXIS_PTS_REF AXX_KF_ZW_PF1 FORMAT "%5.0" MONOTONY STRICT_INCREASE DEPOSIT ABSOLUTE /end AXIS_DESCR
 /begin AXIS_DESCR COM_AXIS NO_INPUT_QUANTITY CgkBooc_wkiDfEd_Czglhgc_fR_1a0o 20 -327.68 327.67 AXIS_PTS_REF AXY_KF_ZW_PF1 FORMAT "%9.2" MONOTONY STRICT_INCREASE DEPOSIT ABSOLUTE /end AXIS_DESCR
/end CHARACTERISTIC
/begin CHARACTERISTIC KF_ZW_PF1___MGF_CC_PF_Slot4 "Base ignition angle path 1 (Slot 4, Pump Fuel)" MAP 0x807C54F6 _REC_A1CUR_1_MBSE_S1_S1 127.5 aAwkuzc_BFpgCmb_tmDukma_q__aa0o -64 63.5 FORMAT "%4.1"
 /begin AXIS_DESCR COM_AXIS Nkw caoddzd_oAjpfzb_cAcEEha_1nR_oa0 20 -32768 32767 AXIS_PTS_REF AXX_KF_ZW_PF1 FORMAT "%5.0" MONOTONY STRICT_INCREASE DEPOSIT ABSOLUTE /end AXIS_DESCR
 /begin AXIS_DESCR COM_AXIS NO_INPUT_QUANTITY CgkBooc_wkiDfEd_Czglhgc_fR_1a0o 20 -327.68 327.67 AXIS_PTS_REF AXY_KF_ZW_PF1 FORMAT "%9.2" MONOTONY STRICT_INCREASE DEPOSIT ABSOLUTE /end AXIS_DESCR
/end CHARACTERISTIC
/begin CHARACTERISTIC KF_ZW_PF2___MGF_CC_PF_Slot2 "Base ignition angle path 2 (Slot 2, Pump Fuel)" MAP 0x807C5816 _REC_A1CUR_1_MBSE_S1_S1 127.5 aAwkuzc_BFpgCmb_tmDukma_q__aa0o -64 63.5 FORMAT "%4.1"
 /begin AXIS_DESCR COM_AXIS Nkw caoddzd_oAjpfzb_cAcEEha_1nR_oa0 20 -32768 32767 AXIS_PTS_REF AXX_KF_ZW_PF2 FORMAT "%5.0" MONOTONY STRICT_INCREASE DEPOSIT ABSOLUTE /end AXIS_DESCR
 /begin AXIS_DESCR COM_AXIS NO_INPUT_QUANTITY CgkBooc_wkiDfEd_Czglhgc_fR_1a0o 20 -327.68 327.67 AXIS_PTS_REF AXY_KF_ZW_PF2 FORMAT "%9.2" MONOTONY STRICT_INCREASE DEPOSIT ABSOLUTE /end AXIS_DESCR
/end CHARACTERISTIC
/begin CHARACTERISTIC KF_ZW_PF2___MGF_CC_PF_Slot3 "Base ignition angle path 2 (Slot 3, Pump Fuel)" MAP 0x807C59A6 _REC_A1CUR_1_MBSE_S1_S1 127.5 aAwkuzc_BFpgCmb_tmDukma_q__aa0o -64 63.5 FORMAT "%4.1"
 /begin AXIS_DESCR COM_AXIS Nkw caoddzd_oAjpfzb_cAcEEha_1nR_oa0 20 -32768 32767 AXIS_PTS_REF AXX_KF_ZW_PF2 FORMAT "%5.0" MONOTONY STRICT_INCREASE DEPOSIT ABSOLUTE /end AXIS_DESCR
 /begin AXIS_DESCR COM_AXIS NO_INPUT_QUANTITY CgkBooc_wkiDfEd_Czglhgc_fR_1a0o 20 -327.68 327.67 AXIS_PTS_REF AXY_KF_ZW_PF2 FORMAT "%9.2" MONOTONY STRICT_INCREASE DEPOSIT ABSOLUTE /end AXIS_DESCR
/end CHARACTERISTIC
/begin CHARACTERISTIC KF_ZW_PF2___MGF_CC_PF_Slot4 "Base ignition angle path 2 (Slot 4, Pump Fuel)" MAP 0x807C5B36 _REC_A1CUR_1_MBSE_S1_S1 127.5 aAwkuzc_BFpgCmb_tmDukma_q__aa0o -64 63.5 FORMAT "%4.1"
 /begin AXIS_DESCR COM_AXIS Nkw caoddzd_oAjpfzb_cAcEEha_1nR_oa0 20 -32768 32767 AXIS_PTS_REF AXX_KF_ZW_PF2 FORMAT "%5.0" MONOTONY STRICT_INCREASE DEPOSIT ABSOLUTE /end AXIS_DESCR
 /begin AXIS_DESCR COM_AXIS NO_INPUT_QUANTITY CgkBooc_wkiDfEd_Czglhgc_fR_1a0o 20 -327.68 327.67 AXIS_PTS_REF AXY_KF_ZW_PF2 FORMAT "%9.2" MONOTONY STRICT_INCREASE DEPOSIT ABSOLUTE /end AXIS_DESCR
/end CHARACTERISTIC
/begin CHARACTERISTIC KF_ZW_S_PF1___MGF_CC_PF_Slot2 "Base ignition angle path 1 safe (Slot 2, Pump Fuel)" MAP 0x807C5E56 _REC_A1CUR_1_MBSE_S1_S1 127.5 aAwkuzc_BFpgCmb_tmDukma_q__aa0o -64 63.5 FORMAT "%4.1"
 /begin AXIS_DESCR COM_AXIS Nkw caoddzd_oAjpfzb_cAcEEha_1nR_oa0 20 -32768 32767 AXIS_PTS_REF AXX_KF_ZW_S_PF1 FORMAT "%5.0" MONOTONY STRICT_INCREASE DEPOSIT ABSOLUTE /end AXIS_DESCR
 /begin AXIS_DESCR COM_AXIS NO_INPUT_QUANTITY CgkBooc_wkiDfEd_Czglhgc_fR_1a0o 20 -327.68 327.67 AXIS_PTS_REF AXY_KF_ZW_S_PF1 FORMAT "%9.2" MONOTONY STRICT_INCREASE DEPOSIT ABSOLUTE /end AXIS_DESCR
/end CHARACTERISTIC
/begin CHARACTERISTIC KF_ZW_S_PF1___MGF_CC_PF_Slot3 "Base ignition angle path 1 safe (Slot 3, Pump Fuel)" MAP 0x807C5FE6 _REC_A1CUR_1_MBSE_S1_S1 127.5 aAwkuzc_BFpgCmb_tmDukma_q__aa0o -64 63.5 FORMAT "%4.1"
 /begin AXIS_DESCR COM_AXIS Nkw caoddzd_oAjpfzb_cAcEEha_1nR_oa0 20 -32768 32767 AXIS_PTS_REF AXX_KF_ZW_S_PF1 FORMAT "%5.0" MONOTONY STRICT_INCREASE DEPOSIT ABSOLUTE /end AXIS_DESCR
 /begin AXIS_DESCR COM_AXIS NO_INPUT_QUANTITY CgkBooc_wkiDfEd_Czglhgc_fR_1a0o 20 -327.68 327.67 AXIS_PTS_REF AXY_KF_ZW_S_PF1 FORMAT "%9.2" MONOTONY STRICT_INCREASE DEPOSIT ABSOLUTE /end AXIS_DESCR
/end CHARACTERISTIC
/begin CHARACTERISTIC KF_ZW_S_PF1___MGF_CC_PF_Slot4 "Base ignition angle path 1 safe (Slot 4, Pump Fuel)" MAP 0x807C6176 _REC_A1CUR_1_MBSE_S1_S1 127.5 aAwkuzc_BFpgCmb_tmDukma_q__aa0o -64 63.5 FORMAT "%4.1"
 /begin AXIS_DESCR COM_AXIS Nkw caoddzd_oAjpfzb_cAcEEha_1nR_oa0 20 -32768 32767 AXIS_PTS_REF AXX_KF_ZW_S_PF1 FORMAT "%5.0" MONOTONY STRICT_INCREASE DEPOSIT ABSOLUTE /end AXIS_DESCR
 /begin AXIS_DESCR COM_AXIS NO_INPUT_QUANTITY CgkBooc_wkiDfEd_Czglhgc_fR_1a0o 20 -327.68 327.67 AXIS_PTS_REF AXY_KF_ZW_S_PF1 FORMAT "%9.2" MONOTONY STRICT_INCREASE DEPOSIT ABSOLUTE /end AXIS_DESCR
/end CHARACTERISTIC
/begin CHARACTERISTIC KF_ZW_S_PF2___MGF_CC_PF_Slot2 "Base ignition angle path 2 safe (Slot 2, Pump Fuel)" MAP 0x807C6496 _REC_A1CUR_1_MBSE_S1_S1 127.5 aAwkuzc_BFpgCmb_tmDukma_q__aa0o -64 63.5 FORMAT "%4.1"
 /begin AXIS_DESCR COM_AXIS Nkw caoddzd_oAjpfzb_cAcEEha_1nR_oa0 20 -32768 32767 AXIS_PTS_REF AXX_KF_ZW_S_PF2 FORMAT "%5.0" MONOTONY STRICT_INCREASE DEPOSIT ABSOLUTE /end AXIS_DESCR
 /begin AXIS_DESCR COM_AXIS NO_INPUT_QUANTITY CgkBooc_wkiDfEd_Czglhgc_fR_1a0o 20 -327.68 327.67 AXIS_PTS_REF AXY_KF_ZW_S_PF2 FORMAT "%9.2" MONOTONY STRICT_INCREASE DEPOSIT ABSOLUTE /end AXIS_DESCR
/end CHARACTERISTIC
/begin CHARACTERISTIC KF_ZW_S_PF2___MGF_CC_PF_Slot3 "Base ignition angle path 2 safe (Slot 3, Pump Fuel)" MAP 0x807C6626 _REC_A1CUR_1_MBSE_S1_S1 127.5 aAwkuzc_BFpgCmb_tmDukma_q__aa0o -64 63.5 FORMAT "%4.1"
 /begin AXIS_DESCR COM_AXIS Nkw caoddzd_oAjpfzb_cAcEEha_1nR_oa0 20 -32768 32767 AXIS_PTS_REF AXX_KF_ZW_S_PF2 FORMAT "%5.0" MONOTONY STRICT_INCREASE DEPOSIT ABSOLUTE /end AXIS_DESCR
 /begin AXIS_DESCR COM_AXIS NO_INPUT_QUANTITY CgkBooc_wkiDfEd_Czglhgc_fR_1a0o 20 -327.68 327.67 AXIS_PTS_REF AXY_KF_ZW_S_PF2 FORMAT "%9.2" MONOTONY STRICT_INCREASE DEPOSIT ABSOLUTE /end AXIS_DESCR
/end CHARACTERISTIC
/begin CHARACTERISTIC KF_ZW_S_PF2___MGF_CC_PF_Slot4 "Base ignition angle path 2 safe (Slot 4, Pump Fuel)" MAP 0x807C67B6 _REC_A1CUR_1_MBSE_S1_S1 127.5 aAwkuzc_BFpgCmb_tmDukma_q__aa0o -64 63.5 FORMAT "%4.1"
 /begin AXIS_DESCR COM_AXIS Nkw caoddzd_oAjpfzb_cAcEEha_1nR_oa0 20 -32768 32767 AXIS_PTS_REF AXX_KF_ZW_S_PF2 FORMAT "%5.0" MONOTONY STRICT_INCREASE DEPOSIT ABSOLUTE /end AXIS_DESCR
 /begin AXIS_DESCR COM_AXIS NO_INPUT_QUANTITY CgkBooc_wkiDfEd_Czglhgc_fR_1a0o 20 -327.68 327.67 AXIS_PTS_REF AXY_KF_ZW_S_PF2 FORMAT "%9.2" MONOTONY STRICT_INCREASE DEPOSIT ABSOLUTE /end AXIS_DESCR
/end CHARACTERISTIC
/begin CHARACTERISTIC KF_ZW_UESP_PF1___MGF_CC_PF_Slot2 "Base ignition angle scavenging path 1 (Slot 2, Pump Fuel)" MAP 0x807CEC06 _REC_A1CUR_1_MBSE_S1_S1 127.5 aAwkuzc_BFpgCmb_tmDukma_q__aa0o -64 63.5 FORMAT "%4.1"
 /begin AXIS_DESCR COM_AXIS Nkw caoddzd_oAjpfzb_cAcEEha_1nR_oa0 10 -32768 32767 AXIS_PTS_REF AXX_KF_ZW_UESP_PF1 FORMAT "%5.0" MONOTONY STRICT_INCREASE DEPOSIT ABSOLUTE /end AXIS_DESCR
 /begin AXIS_DESCR COM_AXIS NO_INPUT_QUANTITY CgkBooc_wkiDfEd_Czglhgc_fR_1a0o 14 -327.68 327.67 AXIS_PTS_REF AXY_KF_ZW_UESP_PF1 FORMAT "%9.2" MONOTONY STRICT_INCREASE DEPOSIT ABSOLUTE /end AXIS_DESCR
/end CHARACTERISTIC
/begin CHARACTERISTIC KF_ZW_UESP_PF1___MGF_CC_PF_Slot3 "Base ignition angle scavenging path 1 (Slot 3, Pump Fuel)" MAP 0x807CEC92 _REC_A1CUR_1_MBSE_S1_S1 127.5 aAwkuzc_BFpgCmb_tmDukma_q__aa0o -64 63.5 FORMAT "%4.1"
 /begin AXIS_DESCR COM_AXIS Nkw caoddzd_oAjpfzb_cAcEEha_1nR_oa0 10 -32768 32767 AXIS_PTS_REF AXX_KF_ZW_UESP_PF1 FORMAT "%5.0" MONOTONY STRICT_INCREASE DEPOSIT ABSOLUTE /end AXIS_DESCR
 /begin AXIS_DESCR COM_AXIS NO_INPUT_QUANTITY CgkBooc_wkiDfEd_Czglhgc_fR_1a0o 14 -327.68 327.67 AXIS_PTS_REF AXY_KF_ZW_UESP_PF1 FORMAT "%9.2" MONOTONY STRICT_INCREASE DEPOSIT ABSOLUTE /end AXIS_DESCR
/end CHARACTERISTIC
/begin CHARACTERISTIC KF_ZW_UESP_PF1___MGF_CC_PF_Slot4 "Base ignition angle scavenging path 1 (Slot 4, Pump Fuel)" MAP 0x807CED1E _REC_A1CUR_1_MBSE_S1_S1 127.5 aAwkuzc_BFpgCmb_tmDukma_q__aa0o -64 63.5 FORMAT "%4.1"
 /begin AXIS_DESCR COM_AXIS Nkw caoddzd_oAjpfzb_cAcEEha_1nR_oa0 10 -32768 32767 AXIS_PTS_REF AXX_KF_ZW_UESP_PF1 FORMAT "%5.0" MONOTONY STRICT_INCREASE DEPOSIT ABSOLUTE /end AXIS_DESCR
 /begin AXIS_DESCR COM_AXIS NO_INPUT_QUANTITY CgkBooc_wkiDfEd_Czglhgc_fR_1a0o 14 -327.68 327.67 AXIS_PTS_REF AXY_KF_ZW_UESP_PF1 FORMAT "%9.2" MONOTONY STRICT_INCREASE DEPOSIT ABSOLUTE /end AXIS_DESCR
/end CHARACTERISTIC
/begin CHARACTERISTIC KF_ZW_UESP_PF2___MGF_CC_PF_Slot2 "Base ignition angle scavenging path 2 (Slot 2, Pump Fuel)" MAP 0x807CF0F2 _REC_A1CUR_1_MBSE_S1_S1 127.5 aAwkuzc_BFpgCmb_tmDukma_q__aa0o -64 63.5 FORMAT "%4.1"
 /begin AXIS_DESCR COM_AXIS Nkw caoddzd_oAjpfzb_cAcEEha_1nR_oa0 10 -32768 32767 AXIS_PTS_REF AXX_KF_ZW_UESP_PF2 FORMAT "%5.0" MONOTONY STRICT_INCREASE DEPOSIT ABSOLUTE /end AXIS_DESCR
 /begin AXIS_DESCR COM_AXIS NO_INPUT_QUANTITY CgkBooc_wkiDfEd_Czglhgc_fR_1a0o 14 -327.68 327.67 AXIS_PTS_REF AXY_KF_ZW_UESP_PF2 FORMAT "%9.2" MONOTONY STRICT_INCREASE DEPOSIT ABSOLUTE /end AXIS_DESCR
/end CHARACTERISTIC
/begin CHARACTERISTIC KF_ZW_UESP_PF2___MGF_CC_PF_Slot3 "Base ignition angle scavenging path 2 (Slot 3, Pump Fuel)" MAP 0x807CF17E _REC_A1CUR_1_MBSE_S1_S1 127.5 aAwkuzc_BFpgCmb_tmDukma_q__aa0o -64 63.5 FORMAT "%4.1"
 /begin AXIS_DESCR COM_AXIS Nkw caoddzd_oAjpfzb_cAcEEha_1nR_oa0 10 -32768 32767 AXIS_PTS_REF AXX_KF_ZW_UESP_PF2 FORMAT "%5.0" MONOTONY STRICT_INCREASE DEPOSIT ABSOLUTE /end AXIS_DESCR
 /begin AXIS_DESCR COM_AXIS NO_INPUT_QUANTITY CgkBooc_wkiDfEd_Czglhgc_fR_1a0o 14 -327.68 327.67 AXIS_PTS_REF AXY_KF_ZW_UESP_PF2 FORMAT "%9.2" MONOTONY STRICT_INCREASE DEPOSIT ABSOLUTE /end AXIS_DESCR
/end CHARACTERISTIC
/begin CHARACTERISTIC KF_ZW_UESP_PF2___MGF_CC_PF_Slot4 "Base ignition angle scavenging path 2 (Slot 4, Pump Fuel)" MAP 0x807CF20A _REC_A1CUR_1_MBSE_S1_S1 127.5 aAwkuzc_BFpgCmb_tmDukma_q__aa0o -64 63.5 FORMAT "%4.1"
 /begin AXIS_DESCR COM_AXIS Nkw caoddzd_oAjpfzb_cAcEEha_1nR_oa0 10 -32768 32767 AXIS_PTS_REF AXX_KF_ZW_UESP_PF2 FORMAT "%5.0" MONOTONY STRICT_INCREASE DEPOSIT ABSOLUTE /end AXIS_DESCR
 /begin AXIS_DESCR COM_AXIS NO_INPUT_QUANTITY CgkBooc_wkiDfEd_Czglhgc_fR_1a0o 14 -327.68 327.67 AXIS_PTS_REF AXY_KF_ZW_UESP_PF2 FORMAT "%9.2" MONOTONY STRICT_INCREASE DEPOSIT ABSOLUTE /end AXIS_DESCR
/end CHARACTERISTIC
/begin CHARACTERISTIC KF_ZW_VP_PF1___MGF_CC_PF_Slot2 "Map for ignition angle with VANOS at stop F_basis=1 path 1 (Slot 2, Pump Fuel)" MAP 0x807C6EE6 _REC_A1CUR_1_MBSE_S1_S1 127.5 aAwkuzc_BFpgCmb_tmDukma_q__aa0o -64 63.5 FORMAT "%4.1"
 /begin AXIS_DESCR COM_AXIS Nkw caoddzd_oAjpfzb_cAcEEha_1nR_oa0 20 -32768 32767 AXIS_PTS_REF AXX_KF_ZW_VP_PF1 FORMAT "%5.0" MONOTONY STRICT_INCREASE DEPOSIT ABSOLUTE /end AXIS_DESCR
 /begin AXIS_DESCR COM_AXIS Rf_zwv CgkBooc_wkiDfEd_Czglhgc_fR_1a0o 16 -327.68 327.67 AXIS_PTS_REF AXY_KF_ZW_VP_PF1 FORMAT "%9.2" MONOTONY STRICT_INCREASE DEPOSIT ABSOLUTE /end AXIS_DESCR
/end CHARACTERISTIC
/begin CHARACTERISTIC KF_ZW_VP_PF1___MGF_CC_PF_Slot3 "Map for ignition angle with VANOS at stop F_basis=1 path 1 (Slot 3, Pump Fuel)" MAP 0x807C7026 _REC_A1CUR_1_MBSE_S1_S1 127.5 aAwkuzc_BFpgCmb_tmDukma_q__aa0o -64 63.5 FORMAT "%4.1"
 /begin AXIS_DESCR COM_AXIS Nkw caoddzd_oAjpfzb_cAcEEha_1nR_oa0 20 -32768 32767 AXIS_PTS_REF AXX_KF_ZW_VP_PF1 FORMAT "%5.0" MONOTONY STRICT_INCREASE DEPOSIT ABSOLUTE /end AXIS_DESCR
 /begin AXIS_DESCR COM_AXIS Rf_zwv CgkBooc_wkiDfEd_Czglhgc_fR_1a0o 16 -327.68 327.67 AXIS_PTS_REF AXY_KF_ZW_VP_PF1 FORMAT "%9.2" MONOTONY STRICT_INCREASE DEPOSIT ABSOLUTE /end AXIS_DESCR
/end CHARACTERISTIC
/begin CHARACTERISTIC KF_ZW_VP_PF1___MGF_CC_PF_Slot4 "Map for ignition angle with VANOS at stop F_basis=1 path 1 (Slot 4, Pump Fuel)" MAP 0x807C7166 _REC_A1CUR_1_MBSE_S1_S1 127.5 aAwkuzc_BFpgCmb_tmDukma_q__aa0o -64 63.5 FORMAT "%4.1"
 /begin AXIS_DESCR COM_AXIS Nkw caoddzd_oAjpfzb_cAcEEha_1nR_oa0 20 -32768 32767 AXIS_PTS_REF AXX_KF_ZW_VP_PF1 FORMAT "%5.0" MONOTONY STRICT_INCREASE DEPOSIT ABSOLUTE /end AXIS_DESCR
 /begin AXIS_DESCR COM_AXIS Rf_zwv CgkBooc_wkiDfEd_Czglhgc_fR_1a0o 16 -327.68 327.67 AXIS_PTS_REF AXY_KF_ZW_VP_PF1 FORMAT "%9.2" MONOTONY STRICT_INCREASE DEPOSIT ABSOLUTE /end AXIS_DESCR
/end CHARACTERISTIC
/begin CHARACTERISTIC KF_ZW_VP_PF2___MGF_CC_PF_Slot2 "Map for ignition angle with VANOS at stop F_basis=1 path 2 (Slot 2, Pump Fuel)" MAP 0x807C73E6 _REC_A1CUR_1_MBSE_S1_S1 127.5 aAwkuzc_BFpgCmb_tmDukma_q__aa0o -64 63.5 FORMAT "%4.1"
 /begin AXIS_DESCR COM_AXIS Nkw caoddzd_oAjpfzb_cAcEEha_1nR_oa0 20 -32768 32767 AXIS_PTS_REF AXX_KF_ZW_VP_PF2 FORMAT "%5.0" MONOTONY STRICT_INCREASE DEPOSIT ABSOLUTE /end AXIS_DESCR
 /begin AXIS_DESCR COM_AXIS Rf_zwv CgkBooc_wkiDfEd_Czglhgc_fR_1a0o 16 -327.68 327.67 AXIS_PTS_REF AXY_KF_ZW_VP_PF2 FORMAT "%9.2" MONOTONY STRICT_INCREASE DEPOSIT ABSOLUTE /end AXIS_DESCR
/end CHARACTERISTIC
/begin CHARACTERISTIC KF_ZW_VP_PF2___MGF_CC_PF_Slot3 "Map for ignition angle with VANOS at stop F_basis=1 path 2 (Slot 3, Pump Fuel)" MAP 0x807C7526 _REC_A1CUR_1_MBSE_S1_S1 127.5 aAwkuzc_BFpgCmb_tmDukma_q__aa0o -64 63.5 FORMAT "%4.1"
 /begin AXIS_DESCR COM_AXIS Nkw caoddzd_oAjpfzb_cAcEEha_1nR_oa0 20 -32768 32767 AXIS_PTS_REF AXX_KF_ZW_VP_PF2 FORMAT "%5.0" MONOTONY STRICT_INCREASE DEPOSIT ABSOLUTE /end AXIS_DESCR
 /begin AXIS_DESCR COM_AXIS Rf_zwv CgkBooc_wkiDfEd_Czglhgc_fR_1a0o 16 -327.68 327.67 AXIS_PTS_REF AXY_KF_ZW_VP_PF2 FORMAT "%9.2" MONOTONY STRICT_INCREASE DEPOSIT ABSOLUTE /end AXIS_DESCR
/end CHARACTERISTIC
/begin CHARACTERISTIC KF_ZW_VP_PF2___MGF_CC_PF_Slot4 "Map for ignition angle with VANOS at stop F_basis=1 path 2 (Slot 4, Pump Fuel)" MAP 0x807C7666 _REC_A1CUR_1_MBSE_S1_S1 127.5 aAwkuzc_BFpgCmb_tmDukma_q__aa0o -64 63.5 FORMAT "%4.1"
 /begin AXIS_DESCR COM_AXIS Nkw caoddzd_oAjpfzb_cAcEEha_1nR_oa0 20 -32768 32767 AXIS_PTS_REF AXX_KF_ZW_VP_PF2 FORMAT "%5.0" MONOTONY STRICT_INCREASE DEPOSIT ABSOLUTE /end AXIS_DESCR
 /begin AXIS_DESCR COM_AXIS Rf_zwv CgkBooc_wkiDfEd_Czglhgc_fR_1a0o 16 -327.68 327.67 AXIS_PTS_REF AXY_KF_ZW_VP_PF2 FORMAT "%9.2" MONOTONY STRICT_INCREASE DEPOSIT ABSOLUTE /end AXIS_DESCR
/end CHARACTERISTIC
/begin MEASUREMENT AirMod_ratChrgAirCyl "Relative air charge in the cylinder" UWORD rel_q0p0234 1 100 0 1535.977 FORMAT "%8.3" ECU_ADDRESS 0x5002763A /end MEASUREMENT
/begin MEASUREMENT Anz_b_sound "Counter for activation of B_sound_bmw" UBYTE raChrxc_kBtBrmb_FmDuEFa_n__aa0o 1 100 0 255 FORMAT "%5.0" ECU_ADDRESS 0x6003A5C8 /end MEASUREMENT
/begin MEASUREMENT BMW_mod_EngDynSp "Mode engine dynamic setpoint: B0 = no dynamics optimized consumption, B1 = increased dynamics, B2 = max dynamics, B3 = full load increase without count limitation, B4 = full load increase with count limitation" UBYTE raChrxc_kBtBrmb_FmDuEFa_n__aa0o 1 100 0 255 FORMAT "%3.0" ECU_ADDRESS 0x5000702D /end MEASUREMENT
/begin MEASUREMENT BMWchst_t_Eng_sw "Engine temperature for use in the catalyst heating manager (switchable between coolant temperature Tmot and component temperature Tbt_mot)" SWORD DchEpAd_DBCFgoa_Ckhahgc_q__aoa0 1 100 -327.68 327.67 FORMAT "%6.2" ECU_ADDRESS 0x700020BA /end MEASUREMENT
/begin MEASUREMENT BMWinj_t_Eng_sw "Engine temperature injection" SWORD DchEpAd_DBCFgoa_Ckhahgc_q__aoa0 1 100 -327.68 327.67 FORMAT "%7.2" ECU_ADDRESS 0x60003610 /end MEASUREMENT
/begin MEASUREMENT BMWlpa_n_Efp_uw "Electric fuel pump speed setpoint" UWORD caoddzd_oAjpfzb_cAcEEha_1nR_oa0 1 100 0 65535 FORMAT "%5.0" ECU_ADDRESS 0x60001EF4 /end MEASUREMENT
/begin MEASUREMENT BMWlpi_p_HiPAbs "Absolute fuel high pressure" UWORD bukAcFc_hypjrAa_CBhougc_MCRooa0 1 100 0 131.07 ECU_ADDRESS 0x60001EFA /end MEASUREMENT
/begin MEASUREMENT BMWlpi_p_HiPAbsSp "Absolute fuel high pressure setpoint" UWORD bukAcFc_hypjrAa_CBhougc_MCRooa0 1 100 0 131.07 ECU_ADDRESS 0x60001EFC /end MEASUREMENT
/begin MEASUREMENT BMWlpi_t_Fu_sw "Fuel temperature low-pressure system before high-pressure pump" SWORD DchEpAd_DBCFgoa_Ckhahgc_q__aoa0 1 100 -327.68 327.67 FORMAT "%5.2" ECU_ADDRESS 0x50005E6E /end MEASUREMENT
/begin MEASUREMENT BMWlpi_volf_Fu_sw "Kraftstoffvolumenstrom" SWORD zBcBzad_vmoivka_mFzjCgc_lCRooa0 1 100 -327.68 327.67 FORMAT "%5.2" ECU_ADDRESS 0x50005E66 /end MEASUREMENT
/begin MEASUREMENT BMWlpsc_p_DeSp_sw "Low-pressure circuit pressure deviation from setpoint" SWORD rgduxyd_mlihaBb_gsCghzb_bCRa0a0 1 100 -32.768 32.767 FORMAT "%5.3" ECU_ADDRESS 0x60001F08 /end MEASUREMENT
/begin MEASUREMENT BMWlpsc_p_EfpSpCtld_uw "Electric fuel pump pressure value controlled" UWORD rgduxyd_mlihaBb_gsCghzb_bCRa0a0 1 100 0 65.535 FORMAT "%5.3" ECU_ADDRESS 0x60001F0A /end MEASUREMENT
/begin MEASUREMENT BMWlpsc_st_TankCod_ub "Tank coding" UBYTE raChrxc_kBtBrmb_FmDuEFa_n__aa0o 1 100 0 255 FORMAT "%3.0" ECU_ADDRESS 0x60003F81 /end MEASUREMENT
/begin MEASUREMENT BMWls_fac_rf_RedFil_uw "Filling reduction factor after filtering" UWORD FzbmlAa_gCtylrb_ckCqxAc_nR_6oa0 1 100 0 0.999984741210938 FORMAT "%7.5" ECU_ADDRESS 0x600019F6 /end MEASUREMENT
/begin MEASUREMENT BMWpim_fac_TqRedn_ub "Pre-ignition management, torque reduction factor" UBYTE BMW_Powertrain_DxECompuMethods_Def_ub_b1_nounit 1 100 0 0.99609375 ECU_ADDRESS 0x60003E1C /end MEASUREMENT
/begin MEASUREMENT BMWrail_p_RpsActVal "Rail pressure" UWORD bukAcFc_hypjrAa_CBhougc_MCRooa0 1 100 0 131.07 FORMAT "%8.3" ECU_ADDRESS 0x6000254C /end MEASUREMENT
/begin MEASUREMENT BMWrailco_rat_VabHom_sw "Input value for common-rail pressure maps (Rf_soll or Rk_soll_h). It can also consider predicted values (Rk_pre or Rf_pre_h)." SWORD zyyxBpb_rEsnvtc_gktukCa_fR_5a0o 1 100 -1600 1599.951171875 FORMAT "%8.3" ECU_ADDRESS 0x600020B6 /end MEASUREMENT
/begin MEASUREMENT BMWtchbas_p_Dif_sw "Pld_diff (Soll-Ladedruck minus Ist-Ladedruck)" SWORD BMW_p_sw_q0p125_hPa 1 100 -4096 4095.875 FORMAT "%10.3" ECU_ADDRESS 0x600021C0 /end MEASUREMENT
/begin MEASUREMENT BMWtchbas_p_DifGra_sw "Normalized control deviation gradient - bank-specific" SWORD BMW_p_sw_q0p125_hPa 1 100 -4096 4095.875 FORMAT "%10.3" ECU_ADDRESS 0x600021BC /end MEASUREMENT
/begin MEASUREMENT BMWtchctr_pwr_Pctl_uw "Turbine power from compressor map" UWORD jucyrzb_bpFgwfd_uqrfhgc_k__aoa0 1 100 0 127.998046875 FORMAT "%7.3" ECU_ADDRESS 0x60002216 /end MEASUREMENT
/begin MEASUREMENT BMWtchdiag_fac_pwr_TrbPctl_uw "AXY_KF_ATLRPID_MX" UWORD acriqBc_tfkBqod_ocgjxzc_nR_8oa0 1 100 0 7.9998779296875 FORMAT "%10.3" ECU_ADDRESS 0x50032242 /end MEASUREMENT
/begin MEASUREMENT BMWtchsp_mf_CmprNorm_uw "Target mass flow corrected for boost pressure control" UWORD wpxDCba_sgbvDxb_FliBAmd_k__0oa0 1 100 0 4095.9375 FORMAT "%10.3" ECU_ADDRESS 0x6000223C /end MEASUREMENT
/begin MEASUREMENT BMWtchsp_mf_CmprNormWideRng_uw "Target mass flow corrected for boost pressure control" UWORD wpxDCba_sgbvDxb_FliBAmd_k__0oa0 1 100 0 4095.9375 FORMAT "%10.3" ECU_ADDRESS 0x50006246 /end MEASUREMENT
/begin MEASUREMENT BMWtchsp_mf_Ex_uw "Target mass flow at exhaust manifold - inflow" UWORD CByjozc_eCmpBAb_pljBAmd_k__0oa0 1 100 0 2047.96875 FORMAT "%10.3" ECU_ADDRESS 0x6000223E /end MEASUREMENT
/begin MEASUREMENT BMWtchsp_rat_p_CmprLim_uw "Target charge factor - target boost pressure to pressure before compressor" UWORD acriqBc_tfkBqod_ocgjxzc_nR_8oa0 1 100 0 7.9998779296875 FORMAT "%11.4" ECU_ADDRESS 0x60002232 /end MEASUREMENT
/begin MEASUREMENT BMWtchtbc_t_BefCmpr_sw "Temperature before turbocharger - model or sensor value" SWORD BMW_q0p1_degC 1 100 -3276.8 3276.7 FORMAT "%6.1" ECU_ADDRESS 0x600274AC /end MEASUREMENT
/begin MEASUREMENT BMWtqe_fac_EngTqLimd "Reduction factor torque limitation combustion engine" UBYTE BMW_Powertrain_DxECompuMethods_Def_ub_b1_nounit 1 100 0 0.99609375 ECU_ADDRESS 0x600042D0 /end MEASUREMENT
/begin MEASUREMENT Drf_s2spred "Dynamic Rf_soll damping (Rf_soll_md_pred minus Rf_soll_md)" UWORD CgkBooc_wkiDfEd_Czglhgc_fR_1a0o 1 100 0 655.35 ECU_ADDRESS 0x600019C0 /end MEASUREMENT
/begin MEASUREMENT Dtans_tumg_wm "Difference between ambient temperature and intake air temperature in warm-up coordinator" SWORD BMW_q0p1_degC 1 100 -3276.8 3276.7 ECU_ADDRESS 0x500325A2 /end MEASUREMENT
/begin MEASUREMENT Dtkwsoll_tka_f "Filtered radiator outlet temperature difference actual-setpoint" SWORD DchEpAd_DBCFgoa_Ckhahgc_q__aoa0 1 100 -327.68 327.67 FORMAT "%6.2" ECU_ADDRESS 0x500325D4 /end MEASUREMENT
/begin MEASUREMENT Dtmot_tkwsoll_elue "Engine temperature difference: actual - setpoint for ElVma" SWORD DchEpAd_DBCFgoa_Ckhahgc_q__aoa0 1 100 -327.68 327.67 ECU_ADDRESS 0x500325D8 /end MEASUREMENT
/begin MEASUREMENT Dtmot_tkwsoll_f "Filtered coolant difference actual - setpoint" SWORD DchEpAd_DBCFgoa_Ckhahgc_q__aoa0 1 100 -327.68 327.67 FORMAT "%6.2" ECU_ADDRESS 0x500325D6 /end MEASUREMENT
/begin MEASUREMENT Dzw_annm "Reference value for B_kftkr" SWORD BMW_q0p1_deg 1 100 -3276.8 3276.7 FORMAT "%6.1" ECU_ADDRESS 0x500320B6 /end MEASUREMENT
/begin MEASUREMENT Dzw_tot_kr "Total retard angle from best ignition angle" SWORD BMW_q0p1_deg 1 100 -3276.8 3276.7 FORMAT "%6.1" ECU_ADDRESS 0x60003348 /end MEASUREMENT
/begin MEASUREMENT EngPrt_NMAXSgangsis_mp "MP: Current gear" SBYTE BMW_ba_poel__ 1 100 -128 127 FORMAT "%5.1" ECU_ADDRESS 0x700149AF /end MEASUREMENT
/begin MEASUREMENT EngPrt_t1_mp "MP: Coolant temperature at engine outlet" UBYTE temp_ub_q0p75_o48 1 100 -48 143.3 FORMAT "%5.1" ECU_ADDRESS 0x700149AE /end MEASUREMENT
/begin MEASUREMENT EngPrt_t2_mp "MP: Engine oil temperature, output in degrees C, internally in Kelvin" UWORD temp_q0p0234_o273 1 100 -273.15 1262.827 FORMAT "%8.3" ECU_ADDRESS 0x700149AC /end MEASUREMENT
/begin MEASUREMENT Epm_nEng "Average engine speed over one cylinder segment" SWORD EngN 1 100 -16384 16383.5 FORMAT "%8.2" ECU_ADDRESS 0x50002022 /end MEASUREMENT
/begin MEASUREMENT Epm_nEngLRes "Engine speed with low resolution" UBYTE EngN_LRes 1 100 0 10200 FORMAT "%5.0" ECU_ADDRESS 0x50002128 /end MEASUREMENT
/begin MEASUREMENT F_octan "Adapted fuel quality factor (0=RON98 / 1.0=RON91)" UBYTE BMW_Powertrain_DxECompuMethods_Def_ub_b1_nounit 1 100 0 0.99609375 FORMAT "%6.1" ECU_ADDRESS 0x6003A3AA /end MEASUREMENT
/begin MEASUREMENT F_pld_wm_f "Target charge factor - target boost pressure to pressure before compressor as filtered average in warm-up coordinator" UWORD acriqBc_tfkBqod_ocgjxzc_nR_8oa0 1 100 0 7.9998779296875 ECU_ADDRESS 0x500325FE /end MEASUREMENT
/begin MEASUREMENT FlexFuelEthanolContentValue___MGF_CC "Ethanol content percentage from Flex Fuel sensor or the overriding value" UWORD FlexFuelEthanolContentValue_CompuMethod 1 0 0 100 ECU_ADDRESS 0x60107F28 /end MEASUREMENT
/begin MEASUREMENT Frfmxbsld "Filling limitation factor due to component protection at rich running limit" UWORD Bhvfwhc_bigEubd_BBEupBd_nR_3oa0 1 100 0 1.99996948242188 FORMAT "%14.5" ECU_ADDRESS 0x50032428 /end MEASUREMENT
/begin MEASUREMENT FupHi_nEngLResHDR "Weighting factor PI controller parameter HDR; P-component" UBYTE nmot_q40 1 100 0 10200 FORMAT "%5.0" ECU_ADDRESS 0x60010CAE /end MEASUREMENT
/begin MEASUREMENT FuPHi_pHpRglnDeLoc "Temporary variable for FuPHi_pHpRglnDe" SWORD RBPtCel_p_0p002_1 1 100 -65.536 65.534 FORMAT "%8.5" ECU_ADDRESS 0x6000F198 /end MEASUREMENT
/begin MEASUREMENT Gang_gb1_ist "Actual gear gearbox 1" SBYTE raChrxc_kBtBrmb_FmDuEFa_n__aa0o 1 100 -128 127 FORMAT "%6.0" ECU_ADDRESS 0x60004626 /end MEASUREMENT
/begin MEASUREMENT gangakr "Local gear information, limited to positive values" UBYTE DEZ 1 100 0 127 FORMAT "%5.1" ECU_ADDRESS 0x7000DD41 /end MEASUREMENT
/begin MEASUREMENT Gangi "Current gear internal (incl. neutral and reverse)" UBYTE raChrxc_kBtBrmb_FmDuEFa_n__aa0o 1 100 0 255 FORMAT "%3.0" ECU_ADDRESS 0x5000454A /end MEASUREMENT
/begin MEASUREMENT IKCtl_facKnkInten_u8 "Integrator / reference level ratio for knock control" UBYTE fak_ub_b16 1 100 0 15.94 FORMAT "%5.2" ECU_ADDRESS 0x5002874A /end MEASUREMENT
/begin MEASUREMENT Mdi_max_diff "Absolute difference between Mdi_max before and after rate limiter" UWORD BMW_dm_sw_q0p1_Nm 1 100 0 3276.7 FORMAT "%6.1" ECU_ADDRESS 0x60002362 /end MEASUREMENT
/begin MEASUREMENT Mdi_poel_n "Normalized torque for oil pressure control" UWORD FzbmlAa_gCtylrb_ckCqxAc_nR_6oa0 1 100 0 0.999984741210938 ECU_ADDRESS 0x500057E2 /end MEASUREMENT
/begin MEASUREMENT Nelueft_klima_wm "Electric fan speed request from air conditioning in warm-up coordinator" UBYTE BMW_q0p3906_PERC 1 100 0 99.609375 ECU_ADDRESS 0x70013428 /end MEASUREMENT
/begin MEASUREMENT Nkw "Engine speed" SWORD caoddzd_oAjpfzb_cAcEEha_1nR_oa0 1 100 -32768 32767 ECU_ADDRESS 0x600038A2 /end MEASUREMENT
/begin MEASUREMENT Nkw_10ms "RPM in 10ms raster averaged over 1 cylinder segment" SWORD caoddzd_oAjpfzb_cAcEEha_1nR_oa0 1 100 -32768 32767 ECU_ADDRESS 0x600025F2 /end MEASUREMENT
/begin MEASUREMENT Nkw_atm "Crankshaft speed ATM" SWORD caoddzd_oAjpfzb_cAcEEha_1nR_oa0 1 100 -32768 32767 ECU_ADDRESS 0x60001C88 /end MEASUREMENT
/begin MEASUREMENT Nkw_opt "Engine speed for optimal gear ratio (Almo)" SWORD caoddzd_oAjpfzb_cAcEEha_1nR_oa0 1 100 -32768 32767 FORMAT "%5.0" ECU_ADDRESS 0x60002AD4 /end MEASUREMENT
/begin MEASUREMENT Nkw_plaus "Plausibility-checked crankshaft speed of the combustion engine" SWORD caoddzd_oAjpfzb_cAcEEha_1nR_oa0 1 100 -32768 32767 FORMAT "%6.0" ECU_ADDRESS 0x60002936 /end MEASUREMENT
/begin MEASUREMENT Nkw_ref "ASD. Calculated crankshaft speed reference." SWORD caoddzd_oAjpfzb_cAcEEha_1nR_oa0 1 100 -32768 32767 ECU_ADDRESS 0x60003666 /end MEASUREMENT
/begin MEASUREMENT Nkw_wm "Combustion engine speed in warm-up coordinator" SWORD caoddzd_oAjpfzb_cAcEEha_1nR_oa0 1 100 -32768 32767 ECU_ADDRESS 0x70012F00 /end MEASUREMENT
/begin MEASUREMENT Ps "Saugrohrdruck, modelliert" UWORD BMW_p_sw_q0p125_hPa 1 100 0 8191.875 FORMAT "%8.3" ECU_ADDRESS 0x600032E0 /end MEASUREMENT
/begin MEASUREMENT Pumg "Umgebungsdruck" UWORD BMW_p_sw_q0p125_hPa 1 100 0 8191.875 ECU_ADDRESS 0x600274EE /end MEASUREMENT
/begin MEASUREMENT Rf "Relative air filling" SWORD CgkBooc_wkiDfEd_Czglhgc_fR_1a0o 1 100 -327.68 327.67 FORMAT "%7.2" ECU_ADDRESS 0x600030CA /end MEASUREMENT
/begin MEASUREMENT Rf_atm "Relative air filling ATM" SWORD CgkBooc_wkiDfEd_Czglhgc_fR_1a0o 1 100 -327.68 327.67 ECU_ADDRESS 0x700020FA /end MEASUREMENT
/begin MEASUREMENT Rf_zwv "Relative actual filling or actual volume for ignition angle calculation" SWORD CgkBooc_wkiDfEd_Czglhgc_fR_1a0o 1 100 -327.68 327.67 FORMAT "%9.2" ECU_ADDRESS 0x60003358 /end MEASUREMENT
/begin MEASUREMENT St_dsc_can "St_dsc_can" UBYTE raChrxc_kBtBrmb_FmDuEFa_n__aa0o 1 100 0 255 FORMAT "%3.0" ECU_ADDRESS 0x600047E1 /end MEASUREMENT
/begin MEASUREMENT Status_usecase_antr "Status usecase drivetrain: ASM output for gb2; eBS; FP; EGS" UBYTE raChrxc_kBtBrmb_FmDuEFa_n__aa0o 1 100 0 255 ECU_ADDRESS 0x50004539 /end MEASUREMENT
/begin MEASUREMENT T_opf_in_wm "Exhaust gas temperature in the middle of the particulate filter" SWORD BMW_q0p1_degC 1 100 -3276.8 3276.7 ECU_ADDRESS 0x50032292 /end MEASUREMENT
/begin MEASUREMENT Tabg_vl_xab "Abgastemperatur vor Lader" SWORD BMW_q0p1_degC 1 100 -3276.8 3276.7 FORMAT "%6.1" ECU_ADDRESS 0x6002745E MATRIX_DIM 2 1 1 /end MEASUREMENT
/begin MEASUREMENT Tabg_wm "Plausibility-checked exhaust gas temperature in warm-up coordinator" SWORD BMW_q0p1_degC 1 100 -3276.8 3276.7 ECU_ADDRESS 0x70012EF0 /end MEASUREMENT
/begin MEASUREMENT Tans "Intake air temperature average" SWORD BMW_q0p1_degC 1 100 -3276.8 3276.7 ECU_ADDRESS 0x600274F6 /end MEASUREMENT
/begin MEASUREMENT Tdme_wm "DME ECU temperature in warm-up coordinator" SWORD DchEpAd_DBCFgoa_Ckhahgc_q__aoa0 1 100 -327.68 327.67 ECU_ADDRESS 0x50032298 /end MEASUREMENT
/begin MEASUREMENT Tegs_wm "EGS ECU temperature in warm-up coordinator" SWORD BufnDdb_jpjgsgc_jmDugsa_qCRoa0o 1 100 -32768 32767 ECU_ADDRESS 0x5003229C /end MEASUREMENT
/begin MEASUREMENT tfuelsq_msg "Kraftstofftemperatur (Sensor-, Modell o. fester Ersatzwert)" UBYTE temp_ub_q0p75_o48 1 100 -48 143.3 FORMAT "%5.1" ECU_ADDRESS 0x60011E09 /end MEASUREMENT
/begin MEASUREMENT Tget_wm "Transmission oil temperature in WMK" SWORD DchEpAd_DBCFgoa_Ckhahgc_q__aoa0 1 100 -327.68 327.67 ECU_ADDRESS 0x70012F08 /end MEASUREMENT
/begin MEASUREMENT Tka_wm "Plausibility-checked coolant radiator outlet temperature in warm-up coordinator" SWORD DchEpAd_DBCFgoa_Ckhahgc_q__aoa0 1 100 -327.68 327.67 ECU_ADDRESS 0x500325A0 /end MEASUREMENT
/begin MEASUREMENT Tmot "Coolant temperature" SWORD DchEpAd_DBCFgoa_Ckhahgc_q__aoa0 1 100 -327.68 327.67 ECU_ADDRESS 0x60002630 /end MEASUREMENT
/begin MEASUREMENT Tmot_wm "Combustion engine coolant temperature in warm-up coordinator" SWORD DchEpAd_DBCFgoa_Ckhahgc_q__aoa0 1 100 -327.68 327.67 ECU_ADDRESS 0x70012F0E /end MEASUREMENT
/begin MEASUREMENT Tn_start_10 "Time after start end in 10ms resolution" UWORD camcxxd_bxlpdsa_Cshlhgc_sR_1a0o 1 100 0 655.35 ECU_ADDRESS 0x600038E2 /end MEASUREMENT
/begin MEASUREMENT Toel "Ausgabewert Motoröltemperatur für LoCAN" SWORD BMW_q0p1_degC 1 100 -3276.8 3276.7 FORMAT "%6.1" ECU_ADDRESS 0x6002748A /end MEASUREMENT
/begin MEASUREMENT Toel_wm "Engine oil temperature in warm-up coordinator" SWORD BMW_q0p1_degC 1 100 -3276.8 3276.7 ECU_ADDRESS 0x70012F10 /end MEASUREMENT
/begin MEASUREMENT Tpoel_reg "Input temperature for Poel_reg" SWORD BMW_q0p1_degC 1 100 -3276.8 3276.7 FORMAT "%6.1" ECU_ADDRESS 0x6002FD26 /end MEASUREMENT
/begin MEASUREMENT Tumg "Umgebungstemperatur" SWORD BMW_q0p1_degC 1 100 -3276.8 3276.7 ECU_ADDRESS 0x600274FA /end MEASUREMENT
/begin MEASUREMENT Tumg_wm "Ambient temperature in warm-up coordinator (without considering internal fault reaction)" SWORD BMW_q0p1_degC 1 100 -3276.8 3276.7 ECU_ADDRESS 0x70012EFA /end MEASUREMENT
/begin MEASUREMENT Tvdk "Temperature before throttle average" SWORD BMW_q0p1_degC 1 100 -3276.8 3276.7 ECU_ADDRESS 0x600274FE /end MEASUREMENT
/begin MEASUREMENT Tw_r1 "Pipe wall temperature 1" SWORD BMW_q0p1_degC 1 100 -3276.8 3276.7 FORMAT "%6.1" ECU_ADDRESS 0x6002745C /end MEASUREMENT
/begin MEASUREMENT V "Fahrzeuggeschwindigkeit" UWORD AFeDmkb_cAbjmcc_kAkskhd_k__0oa0 1 100 0 65535 ECU_ADDRESS 0x600038E4 /end MEASUREMENT
/begin MEASUREMENT V_fzg_plaus "Plausibility-checked vehicle speed" SWORD jgbhAma_smpAegb_hlEBAmd_k__0oa0 1 100 -655.36 655.34 FORMAT "%6.2" ECU_ADDRESS 0x6000292C /end MEASUREMENT
/begin MEASUREMENT V_wm "Vehicle speed in warm-up coordinator" UWORD BMW_q0p1_kilometer_per_hour 1 100 0 6553.5 ECU_ADDRESS 0x70012EFC /end MEASUREMENT
/begin MEASUREMENT Vskr_mw_wm "Average fuel consumption in WMK" UWORD fpBesqd_hAxmiba_AAwtged_u__0oa0 1 100 0 65535 ECU_ADDRESS 0x70012EF4 /end MEASUREMENT
/begin FUNCTION SwitchableMaps_Slot2_Boost "Intake/exhaust pressure targets/limits"
 /begin DEF_CHARACTERISTIC BMWtchsp_p_ReqMax_C___MGF_CC_PF_Slot2 BMWtchsp_rat_p_CmprMax_M___MGF_CC_PF_Slot2 BMWtchsp_rat_p_CmprPmp_T___MGF_CC_PF_Slot2 /end DEF_CHARACTERISTIC
/end FUNCTION
/begin FUNCTION SwitchableMaps_Slot2_Codewords "" /begin DEF_CHARACTERISTIC CW_MapSwitch_Slot2___MGF_CC /end DEF_CHARACTERISTIC /end FUNCTION
/begin FUNCTION SwitchableMaps_Slot2_FuelCorrection "Lambda modifiers"
 /begin DEF_CHARACTERISTIC KF_FRKKORRF_1___MGF_CC_PF_Slot2 KF_PHA_H_B1_W___MGF_CC_PF_Slot2 KF_PHA_H_E1___MGF_CC_PF_Slot2 /end DEF_CHARACTERISTIC
/end FUNCTION
/begin FUNCTION SwitchableMaps_Slot2_FuelTargets "Lambda targets" /begin DEF_CHARACTERISTIC KF_LABAS_1___MGF_CC_PF_Slot2 KF_LABAS_2___MGF_CC_PF_Slot2 /end DEF_CHARACTERISTIC /end FUNCTION
/begin FUNCTION SwitchableMaps_Slot2_Ignition "Timing targets"
 /begin DEF_CHARACTERISTIC KF_ZW_UESP_PF2___MGF_CC_PF_Slot2 KF_ZW_UESP_PF1___MGF_CC_PF_Slot2 KF_ZW_S_PF2___MGF_CC_PF_Slot2 KF_ZW_S_PF1___MGF_CC_PF_Slot2 KF_ZW_PF2___MGF_CC_PF_Slot2 KF_ZW_PF1___MGF_CC_PF_Slot2 KF_ZW_VP_PF2___MGF_CC_PF_Slot2 KF_ZW_VP_PF1___MGF_CC_PF_Slot2 /end DEF_CHARACTERISTIC
/end FUNCTION
/begin FUNCTION SwitchableMaps_Slot2_Knock "Knock factors and corrections"
 /begin DEF_CHARACTERISTIC KF_FDZWT_PF2___MGF_CC_PF_Slot2 KF_FDZWT_PF1___MGF_CC_PF_Slot2 IKCtl_FacKnockDetThd0_GM___MGF_CC_PF_Slot2 IKCtl_FacKnockDetThd1_GM___MGF_CC_PF_Slot2 IKCtl_FacKnockDetThd2_GM___MGF_CC_PF_Slot2 IKCtl_FacKnockDetThd3_GM___MGF_CC_PF_Slot2 IKCtl_FacKnockDetThd4_GM___MGF_CC_PF_Slot2 IKCtl_FacKnockDetThd5_GM___MGF_CC_PF_Slot2 /end DEF_CHARACTERISTIC
/end FUNCTION
/begin FUNCTION SwitchableMaps_Slot2_LoadControl "Load targets and limiters"
 /begin DEF_CHARACTERISTIC KL_RF_MAX_UESP___MGF_CC_PF_Slot2 KL_RF_MAX___MGF_CC_PF_Slot2 /end DEF_CHARACTERISTIC
/end FUNCTION
/begin FUNCTION SwitchableMaps_Slot2_TorqueLimiters "Torque limits"
 /begin DEF_CHARACTERISTIC BMWtqe_tqc_FlApplStgPwrHi_T___MGF_CC_PF_Slot2 BMWtqe_tqc_FlApplStgPwr2_T___MGF_CC_PF_Slot2 BMWtqe_tqc_FlApplStgPwr1_T___MGF_CC_PF_Slot2 BMWtqe_tqc_FlApplStgNorm_T___MGF_CC_PF_Slot2 BMWtqe_tqc_FlApplBol_T___MGF_CC_PF_Slot2 /end DEF_CHARACTERISTIC
/end FUNCTION
/begin FUNCTION SwitchableMaps_Slot2_WastegateControl "WGDC PIDs"
 /begin DEF_CHARACTERISTIC BMWtchctr_pwr_PctlWideRng_M___MGF_CC_PF_Slot2 BMWtchctr_pwr_Dp_M___MGF_CC_PF_Slot2 BMWtchctr_p_DifCrtnPp_M___MGF_CC_PF_Slot2 BMWtchctr_pct_WgBasc_M___MGF_CC_PF_Slot2 /end DEF_CHARACTERISTIC
/end FUNCTION
/begin FUNCTION SwitchableMaps_Slot3 ""
 /begin SUB_FUNCTION SwitchableMaps_Slot3_Codewords SwitchableMaps_Slot3_FuelTargets SwitchableMaps_Slot3_FuelCorrection SwitchableMaps_Slot3_LoadControl SwitchableMaps_Slot3_WastegateControl SwitchableMaps_Slot3_Boost SwitchableMaps_Slot3_TorqueLimiters SwitchableMaps_Slot3_Knock SwitchableMaps_Slot3_Ignition /end SUB_FUNCTION
/end FUNCTION
/begin FUNCTION SwitchableMaps_Slot3_Boost "Intake/exhaust pressure targets/limits"
 /begin DEF_CHARACTERISTIC BMWtchsp_p_ReqMax_C___MGF_CC_PF_Slot3 BMWtchsp_rat_p_CmprMax_M___MGF_CC_PF_Slot3 BMWtchsp_rat_p_CmprPmp_T___MGF_CC_PF_Slot3 /end DEF_CHARACTERISTIC
/end FUNCTION
/begin FUNCTION SwitchableMaps_Slot3_Codewords "" /begin DEF_CHARACTERISTIC CW_MapSwitch_Slot3___MGF_CC /end DEF_CHARACTERISTIC /end FUNCTION
/begin FUNCTION SwitchableMaps_Slot3_FuelCorrection "Lambda modifiers"
 /begin DEF_CHARACTERISTIC KF_FRKKORRF_1___MGF_CC_PF_Slot3 KF_PHA_H_B1_W___MGF_CC_PF_Slot3 KF_PHA_H_E1___MGF_CC_PF_Slot3 /end DEF_CHARACTERISTIC
/end FUNCTION
/begin FUNCTION SwitchableMaps_Slot3_FuelTargets "Lambda targets" /begin DEF_CHARACTERISTIC KF_LABAS_1___MGF_CC_PF_Slot3 KF_LABAS_2___MGF_CC_PF_Slot3 /end DEF_CHARACTERISTIC /end FUNCTION
/begin FUNCTION SwitchableMaps_Slot3_Ignition "Timing targets"
 /begin DEF_CHARACTERISTIC KF_ZW_UESP_PF2___MGF_CC_PF_Slot3 KF_ZW_UESP_PF1___MGF_CC_PF_Slot3 KF_ZW_S_PF2___MGF_CC_PF_Slot3 KF_ZW_S_PF1___MGF_CC_PF_Slot3 KF_ZW_PF2___MGF_CC_PF_Slot3 KF_ZW_PF1___MGF_CC_PF_Slot3 KF_ZW_VP_PF2___MGF_CC_PF_Slot3 KF_ZW_VP_PF1___MGF_CC_PF_Slot3 /end DEF_CHARACTERISTIC
/end FUNCTION
/begin FUNCTION SwitchableMaps_Slot3_Knock "Knock factors and corrections"
 /begin DEF_CHARACTERISTIC KF_FDZWT_PF2___MGF_CC_PF_Slot3 KF_FDZWT_PF1___MGF_CC_PF_Slot3 IKCtl_FacKnockDetThd0_GM___MGF_CC_PF_Slot3 IKCtl_FacKnockDetThd1_GM___MGF_CC_PF_Slot3 IKCtl_FacKnockDetThd2_GM___MGF_CC_PF_Slot3 IKCtl_FacKnockDetThd3_GM___MGF_CC_PF_Slot3 IKCtl_FacKnockDetThd4_GM___MGF_CC_PF_Slot3 IKCtl_FacKnockDetThd5_GM___MGF_CC_PF_Slot3 /end DEF_CHARACTERISTIC
/end FUNCTION
/begin FUNCTION SwitchableMaps_Slot3_LoadControl "Load targets and limiters"
 /begin DEF_CHARACTERISTIC KL_RF_MAX_UESP___MGF_CC_PF_Slot3 KL_RF_MAX___MGF_CC_PF_Slot3 /end DEF_CHARACTERISTIC
/end FUNCTION
/begin FUNCTION SwitchableMaps_Slot3_TorqueLimiters "Torque limits"
 /begin DEF_CHARACTERISTIC BMWtqe_tqc_FlApplStgPwrHi_T___MGF_CC_PF_Slot3 BMWtqe_tqc_FlApplStgPwr2_T___MGF_CC_PF_Slot3 BMWtqe_tqc_FlApplStgPwr1_T___MGF_CC_PF_Slot3 BMWtqe_tqc_FlApplStgNorm_T___MGF_CC_PF_Slot3 BMWtqe_tqc_FlApplBol_T___MGF_CC_PF_Slot3 /end DEF_CHARACTERISTIC
/end FUNCTION
/begin FUNCTION SwitchableMaps_Slot3_WastegateControl "WGDC PIDs"
 /begin DEF_CHARACTERISTIC BMWtchctr_pwr_PctlWideRng_M___MGF_CC_PF_Slot3 BMWtchctr_pwr_Dp_M___MGF_CC_PF_Slot3 BMWtchctr_p_DifCrtnPp_M___MGF_CC_PF_Slot3 BMWtchctr_pct_WgBasc_M___MGF_CC_PF_Slot3 /end DEF_CHARACTERISTIC
/end FUNCTION
/begin FUNCTION SwitchableMaps_Slot4 ""
 /begin SUB_FUNCTION SwitchableMaps_Slot4_Codewords SwitchableMaps_Slot4_FuelTargets SwitchableMaps_Slot4_FuelCorrection SwitchableMaps_Slot4_LoadControl SwitchableMaps_Slot4_WastegateControl SwitchableMaps_Slot4_Boost SwitchableMaps_Slot4_TorqueLimiters SwitchableMaps_Slot4_Knock SwitchableMaps_Slot4_Ignition /end SUB_FUNCTION
/end FUNCTION
/begin FUNCTION SwitchableMaps_Slot4_Boost "Intake/exhaust pressure targets/limits"
 /begin DEF_CHARACTERISTIC BMWtchsp_p_ReqMax_C___MGF_CC_PF_Slot4 BMWtchsp_rat_p_CmprMax_M___MGF_CC_PF_Slot4 BMWtchsp_rat_p_CmprPmp_T___MGF_CC_PF_Slot4 /end DEF_CHARACTERISTIC
/end FUNCTION
/begin FUNCTION SwitchableMaps_Slot4_Codewords "" /begin DEF_CHARACTERISTIC CW_MapSwitch_Slot4___MGF_CC /end DEF_CHARACTERISTIC /end FUNCTION
/begin FUNCTION SwitchableMaps_Slot4_FuelCorrection "Lambda modifiers"
 /begin DEF_CHARACTERISTIC KF_FRKKORRF_1___MGF_CC_PF_Slot4 KF_PHA_H_B1_W___MGF_CC_PF_Slot4 KF_PHA_H_E1___MGF_CC_PF_Slot4 /end DEF_CHARACTERISTIC
/end FUNCTION
/begin FUNCTION SwitchableMaps_Slot4_FuelTargets "Lambda targets" /begin DEF_CHARACTERISTIC KF_LABAS_1___MGF_CC_PF_Slot4 KF_LABAS_2___MGF_CC_PF_Slot4 /end DEF_CHARACTERISTIC /end FUNCTION
/begin FUNCTION SwitchableMaps_Slot4_Ignition "Timing targets"
 /begin DEF_CHARACTERISTIC KF_ZW_UESP_PF2___MGF_CC_PF_Slot4 KF_ZW_UESP_PF1___MGF_CC_PF_Slot4 KF_ZW_S_PF2___MGF_CC_PF_Slot4 KF_ZW_S_PF1___MGF_CC_PF_Slot4 KF_ZW_PF2___MGF_CC_PF_Slot4 KF_ZW_PF1___MGF_CC_PF_Slot4 KF_ZW_VP_PF2___MGF_CC_PF_Slot4 KF_ZW_VP_PF1___MGF_CC_PF_Slot4 /end DEF_CHARACTERISTIC
/end FUNCTION
/begin FUNCTION SwitchableMaps_Slot4_Knock "Knock factors and corrections"
 /begin DEF_CHARACTERISTIC KF_FDZWT_PF2___MGF_CC_PF_Slot4 KF_FDZWT_PF1___MGF_CC_PF_Slot4 IKCtl_FacKnockDetThd0_GM___MGF_CC_PF_Slot4 IKCtl_FacKnockDetThd1_GM___MGF_CC_PF_Slot4 IKCtl_FacKnockDetThd2_GM___MGF_CC_PF_Slot4 IKCtl_FacKnockDetThd3_GM___MGF_CC_PF_Slot4 IKCtl_FacKnockDetThd4_GM___MGF_CC_PF_Slot4 IKCtl_FacKnockDetThd5_GM___MGF_CC_PF_Slot4 /end DEF_CHARACTERISTIC
/end FUNCTION
/begin FUNCTION SwitchableMaps_Slot4_LoadControl "Load targets and limiters"
 /begin DEF_CHARACTERISTIC KL_RF_MAX_UESP___MGF_CC_PF_Slot4 KL_RF_MAX___MGF_CC_PF_Slot4 /end DEF_CHARACTERISTIC
/end FUNCTION
/begin FUNCTION SwitchableMaps_Slot4_TorqueLimiters "Torque limits"
 /begin DEF_CHARACTERISTIC BMWtqe_tqc_FlApplStgPwrHi_T___MGF_CC_PF_Slot4 BMWtqe_tqc_FlApplStgPwr2_T___MGF_CC_PF_Slot4 BMWtqe_tqc_FlApplStgPwr1_T___MGF_CC_PF_Slot4 BMWtqe_tqc_FlApplStgNorm_T___MGF_CC_PF_Slot4 BMWtqe_tqc_FlApplBol_T___MGF_CC_PF_Slot4 /end DEF_CHARACTERISTIC
/end FUNCTION
/begin FUNCTION SwitchableMaps_Slot4_WastegateControl "WGDC PIDs"
 /begin DEF_CHARACTERISTIC BMWtchctr_pwr_PctlWideRng_M___MGF_CC_PF_Slot4 BMWtchctr_pwr_Dp_M___MGF_CC_PF_Slot4 BMWtchctr_p_DifCrtnPp_M___MGF_CC_PF_Slot4 BMWtchctr_pct_WgBasc_M___MGF_CC_PF_Slot4 /end DEF_CHARACTERISTIC
/end FUNCTION
/begin FUNCTION TcuTorqueLimiter "Bypass TCU torque limitations" /begin SUB_FUNCTION TcuTorqueLimiter_Codewords /end SUB_FUNCTION /end FUNCTION
/begin FUNCTION TcuTorqueLimiter_Codewords "" /begin DEF_CHARACTERISTIC CW_TcuTorqueLimiter___MGF_CC /end DEF_CHARACTERISTIC /end FUNCTION
/begin FUNCTION ThrottleControl "Throttle targets and limiters"
 /begin DEF_CHARACTERISTIC KF_MDR_ABV_SPO_HS KF_MDR_ABV_SPO2_HS KF_MDR_ABV_SPO2 KF_MDR_ABV_SPO KF_FTRANSVL KF_FK_FTRANSVL KL_DKVL KF_ENA_NREG_GANG_SYN /end DEF_CHARACTERISTIC
/end FUNCTION
/begin FUNCTION TorqueLimiters "Torque limits"
 /begin DEF_CHARACTERISTIC K_MDKIST_SOT_MX BMWosc_tq_MaxIdlCtlGbx_C BMWtqc_pct_MoTqRelDifThd_C BMWtqc_pct_MoPwrRelDifThd_C K_EDA_P_MAX_MOT KF_EDA_ANZ_SPORT_MDK_IST K_NKW_PEMAX K_FMDK0_AKT KF_MDIMAX_TVDK KF_MDIMAX_TANS KF_MDIMAX_SK KF_MDIMAX_FG KF_F_MDIMAX_KR KL_MDI_MAX_GRD_UP KL_MDIMX_VL_APPLZ KL_MDIMX_F_TMOT KL_LAND_MDKMAX_VAR7 KL_LAND_MDKMAX_VAR6 KL_LAND_MDKMAX_VAR5 KL_LAND_MDKMAX_VAR4 KL_LAND_MDKMAX_VAR3 KL_LAND_MDKMAX_VAR2 KL_LAND_MDKMAX_VAR1 BMWtqe_tqc_FlApplStgPwrHi_T BMWtqe_tqc_FlApplStgPwr2_T BMWtqe_tqc_FlApplStgPwr1_T BMWtqe_tqc_FlApplStgNorm_T BMWtqe_tqc_FlApplBol_T BMWtqe_rf_StrTqMaxOfs_C KL_MD_K_MAX_VL_HS KL_MD_K_MAX_VL KL_MD_K_MAX_SGASSE KL_MD_K_MAX_RST_HS KL_MD_K_MAX_RST KL_MD_K_MAX_PB KL_MD_K_MAX_BST_HS KL_MD_K_MAX_BST KL_MD_K_MAX_VL_STRG_AT_VAR KL_MD_K_MAX_VL_STRG_AT KL_MD_K_MAX_VL_ECO_STRG_HS KL_MD_K_MAX_SGASSE_STRG_AT_VAR KL_MD_K_MAX_SGASSE_STRG_AT KL_MD_K_MAX_RST_STRG_AT_VAR KL_MD_K_MAX_RST_STRG_AT KL_MD_K_MAX_RNSTART_STRG_HS KL_MD_K_MAX_PB_STRG_AT_VAR KL_MD_K_MAX_PB_STRG_AT KL_MD_K_MAX_BST_STRG_HS KL_MD_K_MAX_BST_STRG_AT_VAR KL_MD_K_MAX_BST_STRG_AT KL_MDG_MAX_GANG_HS KL_MDG_MAX_GANG_AT K_KSU_MDKBEGKUPDEFEKT K_KSU_MDEINGRIFF_MX K_KSU_MDEINGRIFFPROP_MX K_KSU_MDEINGRIFFPROP_MN K_KSU_INTREG_MX KL_ENA_NREG_DSC S_NMX_VM BMWmondmf_swi_StallStru_C KF_MDRED_T KL_MDRED_NKW MoF_trqNorm1_C EngDa_pwrCrksftMax_C EngDa_tqCrksftMax_C EngDa_tqInnrMax_C /end DEF_CHARACTERISTIC
/end FUNCTION
/begin FUNCTION TorqueMonitoring "Torque monitoring"
 /begin DEF_CHARACTERISTIC MoFTrqPtd_pwrMax_C MoFTrqPtd_tqCluMax_C MoFTrqAct_nThd_C MoFTrqAct_trqPtdInjActv_C /end DEF_CHARACTERISTIC
/end FUNCTION
/begin FUNCTION Valet "Limit vehicle performance"
 /begin DEF_CHARACTERISTIC ValetTorqueMap___MGF_CC_PF_Slot1 ValetTorqueMap___MGF_CC_PF_Slot2 ValetMaxRpm___MGF_CC_PF ValetMaxSpeed___MGF_CC_PF ValetMaxPedal___MGF_CC_PF /end DEF_CHARACTERISTIC
 /begin SUB_FUNCTION Valet_Codewords /end SUB_FUNCTION
/end FUNCTION
/begin FUNCTION Valet_Codewords "" /begin DEF_CHARACTERISTIC CW_Valet___MGF_CC /end DEF_CHARACTERISTIC /end FUNCTION
/begin FUNCTION Vanos "Vanos targets and limiters"
 /begin DEF_CHARACTERISTIC KF_ASPR_NORM_UESP_PF1 GKF_ASPR_NORM_WARM_PF2 GKF_ASPR_NORM_WARM_PF1 GKF_ASPR_NORM_KALT_PF2 GKF_ASPR_NORM_KALT_PF1 KF_ESPR_NORM_UESP_PF1 GKF_ESPR_NORM_WARM_PF2 GKF_ESPR_NORM_WARM_PF1 GKF_ESPR_NORM_KALT_PF2 GKF_ESPR_NORM_KALT_PF1 BMWls_vli_MinGraUp_C KF_HUB_GRDMX KF_EHUB_MX KF_HUBESTM GKF_EHUB_NORM_WARM_LAST /end DEF_CHARACTERISTIC
/end FUNCTION
/begin FUNCTION WastegateControl "WGDC PIDs"
 /begin DEF_CHARACTERISTIC BMWtchctr_n_PpLimMax_C BMWtchctr_pwr_PctlWideRng_M BMWtchctr_pwr_Dp_M BMWtchctr_pwr_CmprGra_M BMWtchctr_p_DifCrtnPp_M BMWtchctr_p_DifCrtnPpDyn_M BMWtchctr_fac_Dp_T BMWtchctr_fac_DpDyn_T BMWtchdiag_pct_WgPLo_M BMWtchdiag_pct_WgPHi_M BMWtchout_pct_WgBlwOff_T BMWtchctr_pct_WgBasc_M BMWtchco_fac_FadePl_T BMWtchctr_ti_ToutPpLim_C /end DEF_CHARACTERISTIC
/end FUNCTION
/begin COMPU_METHOD ___MGF_CC_EngineSpeed_d4 "default compuMethod" RAT_FUNC "%6.3" "RPM" COEFFS 0 4 0 0 0 1 /end COMPU_METHOD
/begin COMPU_METHOD ___MGF_CC_Pedal_x100_d256 "default compuMethod" RAT_FUNC "%6.3" "%" COEFFS 0 256 0 0 0 100 /end COMPU_METHOD
/begin COMPU_METHOD ___MGF_CC_Speedkmh_d64 "default compuMethod" RAT_FUNC "%6.4" "km/h" COEFFS 0 64 0 0 0 1 /end COMPU_METHOD
/begin COMPU_METHOD aAwkuzc_BFpgCmb_tmDukma_q__aa0o "aAwkuzc_BFpgCmb_tmDukma_q__aa0o" RAT_FUNC "%6.3" "°" COEFFS 0 2 0 0 0 1 /end COMPU_METHOD
/begin COMPU_METHOD acriqBc_tfkBqod_ocgjxzc_nR_8oa0 "acriqBc_tfkBqod_ocgjxzc_nR_8oa0" RAT_FUNC "%6.3" "-" COEFFS 0 8192 0 0 0 1 /end COMPU_METHOD
/begin COMPU_METHOD aEmoCzd_erpwvfb_msfkhgc_qR_1a0o "aEmoCzd_erpwvfb_msfkhgc_qR_1a0o" RAT_FUNC "%6.3" "°" COEFFS 0 128 0 0 0 3 /end COMPU_METHOD
/begin COMPU_METHOD AFeDmkb_cAbjmcc_kAkskhd_k__0oa0 "AFeDmkb_cAbjmcc_kAkskhd_k__0oa0" RAT_FUNC "%6.3" "km/h" COEFFS 0 1 0 0 0 1 /end COMPU_METHOD
/begin COMPU_METHOD Asyaixa_wdvtenb_FCefaCb_n__aa0o "Asyaixa_wdvtenb_FCefaCb_n__aa0o" RAT_FUNC "%6.3" "-" COEFFS 0 50 0 0 0 1 /end COMPU_METHOD
/begin COMPU_METHOD B_TRUE "" TAB_VERB "%6.3" "" COMPU_TAB_REF ACCLNTVLV_ASWTYPTWINFLWSTD_SY_Compu /end COMPU_METHOD
/begin COMPU_METHOD Bhvfwhc_bigEubd_BBEupBd_nR_3oa0 "Bhvfwhc_bigEubd_BBEupBd_nR_3oa0" RAT_FUNC "%6.3" "-" COEFFS 0 32768 0 0 0 1 /end COMPU_METHOD
/begin COMPU_METHOD BMW_ba_poel__ "" RAT_FUNC "%6.2" "-" COEFFS 0 1 0 0 0 1 /end COMPU_METHOD
/begin COMPU_METHOD BMW_dm_sw_q0p1_Nm "" RAT_FUNC "%6.3" "Nm" COEFFS 0 10 0 0 0 1 /end COMPU_METHOD
/begin COMPU_METHOD BMW_m_sw_q1p0_Nm "" RAT_FUNC "%6.2" "Nm" COEFFS 0 1 0 0 0 1 /end COMPU_METHOD
/begin COMPU_METHOD BMW_p_sw_q0p125_hPa "" RAT_FUNC "%6.3" "hPa" COEFFS 0 8 0 0 0 1 /end COMPU_METHOD
/begin COMPU_METHOD BMW_Powertrain_DxECompuMethods_Def_ub_b1_nounit "Def_ub_b1" RAT_FUNC "%6.3" "-" COEFFS 0 256 0 0 0 1 /end COMPU_METHOD
/begin COMPU_METHOD BMW_Powertrain_DxECompuMethods_Def_ub_b2_nounit "Def_ub_b2" RAT_FUNC "%6.3" "-" COEFFS 0 128 0 0 0 1 /end COMPU_METHOD
/begin COMPU_METHOD BMW_q0p1__ "" RAT_FUNC "%6.3" "-" COEFFS 0 10 0 0 0 1 /end COMPU_METHOD
/begin COMPU_METHOD BMW_q0p1_deg "" RAT_FUNC "%6.3" "°" COEFFS 0 10 0 0 0 1 /end COMPU_METHOD
/begin COMPU_METHOD BMW_q0p1_degC "" RAT_FUNC "%6.3" "°C" COEFFS 0 10 0 0 0 1 /end COMPU_METHOD
/begin COMPU_METHOD BMW_q0p1_kilometer_per_hour "" RAT_FUNC "%6.3" "km/h" COEFFS 0 10 0 0 0 1 /end COMPU_METHOD
/begin COMPU_METHOD BMW_q0p3906_PERC "" RAT_FUNC "%6.3" "%" COEFFS 0 64 0 0 0 25 /end COMPU_METHOD
/begin COMPU_METHOD BufnDdb_jpjgsgc_jmDugsa_qCRoa0o "Def_q1" RAT_FUNC "%6.3" "°C" COEFFS 0 1 0 0 0 1 /end COMPU_METHOD
/begin COMPU_METHOD bukAcFc_hypjrAa_CBhougc_MCRooa0 "bukAcFc_hypjrAa_CBhougc_MCRooa0" RAT_FUNC "%6.3" "MPa" COEFFS 0 500 0 0 0 1 /end COMPU_METHOD
/begin COMPU_METHOD BumqDkc_mryszAa_EcglxAc_nR_4oa0 "BumqDkc_mryszAa_EcglxAc_nR_4oa0" RAT_FUNC "%6.3" "-" COEFFS 0 4096 0 0 0 1 /end COMPU_METHOD
/begin COMPU_METHOD camcxxd_bxlpdsa_Cshlhgc_sR_1a0o "Def_q0p01" RAT_FUNC "%6.3" "s" COEFFS 0 100 0 0 0 1 /end COMPU_METHOD
/begin COMPU_METHOD caoddzd_oAjpfzb_cAcEEha_1nR_oa0 "Def_q1" RAT_FUNC "%6.3" "1/min" COEFFS 0 1 0 0 0 1 /end COMPU_METHOD
/begin COMPU_METHOD CByjozc_eCmpBAb_pljBAmd_k__0oa0 "CByjozc_eCmpBAb_pljBAmd_k__0oa0" RAT_FUNC "%6.3" "kg/h" COEFFS 0 32 0 0 0 1 /end COMPU_METHOD
/begin COMPU_METHOD CgkBooc_wkiDfEd_Czglhgc_fR_1a0o "Def_q0p01" RAT_FUNC "%6.3" "%" COEFFS 0 100 0 0 0 1 /end COMPU_METHOD
/begin COMPU_METHOD DchEpAd_DBCFgoa_Ckhahgc_q__aoa0 "DchEpAd_DBCFgoa_Ckhahgc_q__aoa0" RAT_FUNC "%6.3" "°C" COEFFS 0 100 0 0 0 1 /end COMPU_METHOD
/begin COMPU_METHOD DEZ "" RAT_FUNC "%6.2" "" COEFFS 0 1 0 0 0 1 /end COMPU_METHOD
/begin COMPU_METHOD ECeoxdb_wFseCtb_mEytEnb_k__o8a0 "ECeoxdb_wFseCtb_mEytEnb_k__o8a0" RAT_FUNC "%6.3" "kg/h" COEFFS 0 128 0 0 0 5 /end COMPU_METHOD
/begin COMPU_METHOD Ejmqric_wgjqjja_AvCkvxb_fR_6o0o "Ejmqric_wgjqjja_AvCkvxb_fR_6o0o" RAT_FUNC "%6.3" "%" COEFFS 0 16384 0 0 0 25 /end COMPU_METHOD
/begin COMPU_METHOD EngN "" RAT_FUNC "%6.3" "rpm" COEFFS 0 2 0 0 0 1 /end COMPU_METHOD
/begin COMPU_METHOD EngN_LRes "" RAT_FUNC "%6.1" "rpm" COEFFS 0 0.025 0 0 0 1 /end COMPU_METHOD
/begin COMPU_METHOD fak_ub_b16 "" RAT_FUNC "%6.4" "-" COEFFS 0 256 0 0 0 16 /end COMPU_METHOD
/begin COMPU_METHOD fgjpsvb_fDqjECa_acgrbDd_n_dae__ "Def_bool" TAB_VERB "%6.3" "-" COMPU_TAB_REF ADqnehd_cFCEtgc_vrrfDpc_ntd_1G2 /end COMPU_METHOD
/begin COMPU_METHOD FlexFuelEthanolContentValue_CompuMethod "FlexFuelEthanolContentValueCompuMethod" RAT_FUNC "%8.3" "%" COEFFS 0 1 0 0 0 1 /end COMPU_METHOD
/begin COMPU_METHOD fpBesqd_hAxmiba_AAwtged_u__0oa0 "fpBesqd_hAxmiba_AAwtged_u__0oa0" RAT_FUNC "%6.3" "ul/s" COEFFS 0 1 0 0 0 1 /end COMPU_METHOD
/begin COMPU_METHOD FzbmlAa_gCtylrb_ckCqxAc_nR_6oa0 "FzbmlAa_gCtylrb_ckCqxAc_nR_6oa0" RAT_FUNC "%6.3" "-" COEFFS 0 65536 0 0 0 1 /end COMPU_METHOD
/begin COMPU_METHOD ilxsavd_hkzmBfc_lAzCpAb_nR_1oa0 "ilxsavd_hkzmBfc_lAzCpAb_nR_1oa0" RAT_FUNC "%6.3" "-" COEFFS 0 16384 0 0 0 1 /end COMPU_METHOD
/begin COMPU_METHOD jgbhAma_smpAegb_hlEBAmd_k__0oa0 "jgbhAma_smpAegb_hlEBAmd_k__0oa0" RAT_FUNC "%6.3" "km/h" COEFFS 0 50 0 0 0 1 /end COMPU_METHOD
/begin COMPU_METHOD jucyrzb_bpFgwfd_uqrfhgc_k__aoa0 "jucyrzb_bpFgwfd_uqrfhgc_k__aoa0" RAT_FUNC "%6.3" "kW" COEFFS 0 512 0 0 0 1 /end COMPU_METHOD
/begin COMPU_METHOD leist_q0p015625_kW "" RAT_FUNC "%6.4" "kW" COEFFS 0 64 0 0 0 1 /end COMPU_METHOD
/begin COMPU_METHOD lfnAAcd_rfigwsd_gtuuDBc_k__aoa0 "lfnAAcd_rfigwsd_gtuuDBc_k__aoa0" RAT_FUNC "%6.3" "kW" COEFFS 0 2048 0 0 0 1 /end COMPU_METHOD
/begin COMPU_METHOD lFwocba_tlxgpab_wmDuExd_NCRoa0o "lFwocba_tlxgpab_wmDuExd_NCRoa0o" RAT_FUNC "%6.3" "Nm" COEFFS 0 1 0 0 0 1 /end COMPU_METHOD
/begin COMPU_METHOD n_sw_q0p5 "" RAT_FUNC "%6.3" "1/min" COEFFS 0 2 0 0 0 1 /end COMPU_METHOD
/begin COMPU_METHOD nmot_q40 "" RAT_FUNC "%6.1" "1/min" COEFFS 0 1 0 0 0 40 /end COMPU_METHOD
/begin COMPU_METHOD oDhhEAa_tuCuntc_ajhfaCa_k__aa0o "oDhhEAa_tuCuntc_ajhfaCa_k__aa0o" RAT_FUNC "%6.3" "kW" COEFFS 0 10 0 0 0 1 /end COMPU_METHOD
/begin COMPU_METHOD oFojrkc_kDqhmtb_jroomtd_N0__1o0 "oFojrkc_kDqhmtb_jroomtd_N0__1o0" RAT_FUNC "%6.3" "Nm/10ms" COEFFS 0 10 0 0 0 1 /end COMPU_METHOD
/begin COMPU_METHOD ohoxkpc_embkBlb_gscheBc_m__aoa0 "ohoxkpc_embkBlb_gscheBc_m__aoa0" RAT_FUNC "%6.3" "mm" COEFFS 0 1000 0 0 0 1 /end COMPU_METHOD
/begin COMPU_METHOD oihanzc_gchDhzc_BADAFBb_nR_1oa0 "Def_q0p0001" RAT_FUNC "%6.3" "-" COEFFS 0 10000 0 0 0 1 /end COMPU_METHOD
/begin COMPU_METHOD owanCxd_goxcCAa_gsclFBc_nR_1oa0 "Def_q0p001" RAT_FUNC "%6.3" "-" COEFFS 0 1000 0 0 0 1 /end COMPU_METHOD
/begin COMPU_METHOD raChrxc_kBtBrmb_FmDuEFa_n__aa0o "Def_q1" RAT_FUNC "%6.3" "-" COEFFS 0 1 0 0 0 1 /end COMPU_METHOD
/begin COMPU_METHOD RBPtCel_p_0p002_1 "" RAT_FUNC "%6.4" "MPa" COEFFS 0 1000 0 0 0 2 /end COMPU_METHOD
/begin COMPU_METHOD rel_q0p0234 "" RAT_FUNC "%6.4" "%" COEFFS 0 128 0 0 0 3 /end COMPU_METHOD
/begin COMPU_METHOD rgduxyd_mlihaBb_gsCghzb_bCRa0a0 "rgduxyd_mlihaBb_gsCghzb_bCRa0a0" RAT_FUNC "%6.3" "bar" COEFFS 0 1000 0 0 0 1 /end COMPU_METHOD
/begin COMPU_METHOD ridxkCa_Dxvxtdc_CChkhgc_nR_1a0o "ridxkCa_Dxvxtdc_CChkhgc_nR_1a0o" RAT_FUNC "%6.3" "-" COEFFS 0 128 0 0 0 3 /end COMPU_METHOD
/begin COMPU_METHOD temp_q0p0234_o273 "" RAT_FUNC "%6.1" "Grad C" COEFFS 0 1 273.15 0 0 0.0234375 /end COMPU_METHOD
/begin COMPU_METHOD temp_ub_q0p75_o48 "" RAT_FUNC "%6.2" "Grad C" COEFFS 0 1 48 0 0 0.75 /end COMPU_METHOD
/begin COMPU_METHOD ubqeuic_jteCkzd_CDglhgc_nR_1a0o "Def_q0p01" RAT_FUNC "%6.3" "-" COEFFS 0 100 0 0 0 1 /end COMPU_METHOD
/begin COMPU_METHOD ucttBvd_Byeweeb_zcCvaDc_fR_8a0o "ucttBvd_Byeweeb_zcCvaDc_fR_8a0o" RAT_FUNC "%6.3" "%" COEFFS 0 8192 0 0 0 25 /end COMPU_METHOD
/begin COMPU_METHOD uvFxekd_wvexlbc_BcFdkDd_nR_1a0o "uvFxekd_wvexlbc_BcFdkDd_nR_1a0o" RAT_FUNC "%6.3" "-" COEFFS 0 1024 0 0 0 25 /end COMPU_METHOD
/begin COMPU_METHOD vfyBdwd_ftexgja_BcFdiDd_fR_1a0o "Def_q0p0244" RAT_FUNC "%6.3" "%" COEFFS 0 1024 0 0 0 25 /end COMPU_METHOD
/begin COMPU_METHOD wDDoctd_cCDyaFa_AvCkvFb_nR_6o0o "wDDoctd_cCDyaFa_AvCkvFb_nR_6o0o" RAT_FUNC "%6.3" "-" COEFFS 0 16384 0 0 0 25 /end COMPU_METHOD
/begin COMPU_METHOD wpxDCba_sgbvDxb_FliBAmd_k__0oa0 "wpxDCba_sgbvDxb_FliBAmd_k__0oa0" RAT_FUNC "%6.3" "kg/h" COEFFS 0 16 0 0 0 1 /end COMPU_METHOD
/begin COMPU_METHOD zBcBzad_vmoivka_mFzjCgc_lCRooa0 "zBcBzad_vmoivka_mFzjCgc_lCRooa0" RAT_FUNC "%6.3" "l/h" COEFFS 0 100 0 0 0 1 /end COMPU_METHOD
/begin COMPU_METHOD zyyxBpb_rEsnvtc_gktukCa_fR_5a0o "zyyxBpb_rEsnvtc_gktukCa_fR_5a0o" RAT_FUNC "%6.3" "%" COEFFS 0 512 0 0 0 25 /end COMPU_METHOD
/begin COMPU_VTAB ACCLNTVLV_ASWTYPTWINFLWSTD_SY_Compu "" TAB_VERB 1 0 "" /end COMPU_VTAB
/begin COMPU_VTAB ADqnehd_cFCEtgc_vrrfDpc_ntd_1G2 "ADqnehd_cFCEtgc_vrrfDpc_ntd_1G2" TAB_VERB 1 0 "" DEFAULT_VALUE "Zustand nicht definiert" /end COMPU_VTAB
/begin RECORD_LAYOUT _REC_A1AXS_1_MBSE_S1 ALIGNMENT_BYTE 1 ALIGNMENT_WORD 2 ALIGNMENT_LONG 4 ALIGNMENT_FLOAT32_IEEE 4 ALIGNMENT_FLOAT64_IEEE 4 AXIS_PTS_X 1 SBYTE INDEX_INCR DIRECT /end RECORD_LAYOUT
/begin RECORD_LAYOUT _REC_A1AXS_1_MBSE_S2 ALIGNMENT_BYTE 1 ALIGNMENT_WORD 2 ALIGNMENT_LONG 4 ALIGNMENT_FLOAT32_IEEE 4 ALIGNMENT_FLOAT64_IEEE 4 AXIS_PTS_X 1 SWORD INDEX_INCR DIRECT /end RECORD_LAYOUT
/begin RECORD_LAYOUT _REC_A1AXS_1_MBSE_U1 ALIGNMENT_BYTE 1 ALIGNMENT_WORD 2 ALIGNMENT_LONG 4 ALIGNMENT_FLOAT32_IEEE 4 ALIGNMENT_FLOAT64_IEEE 4 AXIS_PTS_X 1 UBYTE INDEX_INCR DIRECT /end RECORD_LAYOUT
/begin RECORD_LAYOUT _REC_A1AXS_1_MBSE_U2 ALIGNMENT_BYTE 1 ALIGNMENT_WORD 2 ALIGNMENT_LONG 4 ALIGNMENT_FLOAT32_IEEE 4 ALIGNMENT_FLOAT64_IEEE 4 AXIS_PTS_X 1 UWORD INDEX_INCR DIRECT /end RECORD_LAYOUT
/begin RECORD_LAYOUT _REC_A1CUR_1_MBSE_S1_S1 ALIGNMENT_BYTE 1 ALIGNMENT_WORD 2 ALIGNMENT_LONG 4 ALIGNMENT_FLOAT32_IEEE 4 ALIGNMENT_FLOAT64_IEEE 4 FNC_VALUES 1 SBYTE ROW_DIR DIRECT /end RECORD_LAYOUT
/begin RECORD_LAYOUT _REC_A1CUR_1_MBSE_S2_S1 ALIGNMENT_BYTE 1 ALIGNMENT_WORD 2 ALIGNMENT_LONG 4 ALIGNMENT_FLOAT32_IEEE 4 ALIGNMENT_FLOAT64_IEEE 4 FNC_VALUES 1 SWORD ROW_DIR DIRECT /end RECORD_LAYOUT
/begin RECORD_LAYOUT _REC_A1CUR_1_MBSE_U1_S1 ALIGNMENT_BYTE 1 ALIGNMENT_WORD 2 ALIGNMENT_LONG 4 ALIGNMENT_FLOAT32_IEEE 4 ALIGNMENT_FLOAT64_IEEE 4 FNC_VALUES 1 UBYTE ROW_DIR DIRECT /end RECORD_LAYOUT
/begin RECORD_LAYOUT _REC_A1CUR_1_MBSE_U2_S1 ALIGNMENT_BYTE 1 ALIGNMENT_WORD 2 ALIGNMENT_LONG 4 ALIGNMENT_FLOAT32_IEEE 4 ALIGNMENT_FLOAT64_IEEE 4 FNC_VALUES 1 UWORD ROW_DIR DIRECT /end RECORD_LAYOUT
/begin RECORD_LAYOUT Axis_Xs16 ALIGNMENT_BYTE 1 ALIGNMENT_WORD 2 ALIGNMENT_LONG 4 ALIGNMENT_FLOAT32_IEEE 4 ALIGNMENT_FLOAT64_IEEE 4 NO_AXIS_PTS_X 1 SWORD AXIS_PTS_X 2 SWORD INDEX_INCR DIRECT /end RECORD_LAYOUT
/begin RECORD_LAYOUT Axis_Xu16 ALIGNMENT_BYTE 1 ALIGNMENT_WORD 2 ALIGNMENT_LONG 4 ALIGNMENT_FLOAT32_IEEE 4 ALIGNMENT_FLOAT64_IEEE 4 NO_AXIS_PTS_X 1 UWORD AXIS_PTS_X 2 UWORD INDEX_INCR DIRECT /end RECORD_LAYOUT
/begin RECORD_LAYOUT CurG_Ws16 ALIGNMENT_BYTE 1 ALIGNMENT_WORD 2 ALIGNMENT_LONG 4 ALIGNMENT_FLOAT32_IEEE 4 ALIGNMENT_FLOAT64_IEEE 4 FNC_VALUES 1 SWORD COLUMN_DIR DIRECT /end RECORD_LAYOUT
/begin RECORD_LAYOUT FklWUb ALIGNMENT_BYTE 1 ALIGNMENT_WORD 2 ALIGNMENT_LONG 4 ALIGNMENT_FLOAT32_IEEE 4 ALIGNMENT_FLOAT64_IEEE 4 FNC_VALUES 1 UBYTE COLUMN_DIR DIRECT /end RECORD_LAYOUT
/begin RECORD_LAYOUT KwUw ALIGNMENT_BYTE 1 ALIGNMENT_WORD 2 ALIGNMENT_LONG 4 ALIGNMENT_FLOAT32_IEEE 4 ALIGNMENT_FLOAT64_IEEE 4 FNC_VALUES 1 UWORD COLUMN_DIR DIRECT /end RECORD_LAYOUT
/begin RECORD_LAYOUT RB_Val_Wr32 ALIGNMENT_BYTE 1 ALIGNMENT_WORD 2 ALIGNMENT_LONG 4 ALIGNMENT_FLOAT32_IEEE 4 ALIGNMENT_FLOAT64_IEEE 4 FNC_VALUES 1 FLOAT32_IEEE COLUMN_DIR DIRECT /end RECORD_LAYOUT
/end MODULE
/end PROJECT
