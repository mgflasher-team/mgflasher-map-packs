/*
The MG Flasher Team
2/18/2025 Migrated from v7.2.2
Created with optimization mode
*/
ASAP2_VERSION 1 60
/begin PROJECT MG1CS003_BX8_R0C2J8B2B "MG1CS003"
/begin HEADER "" VERSION "R0C2J8B2B" PROJECT_NO MG1CS003_BX8_R0C2J8B2B /end HEADER
/begin MODULE DIM ""
/begin MOD_PAR "MG1CS003" VERSION "R0C2J8B2B" CUSTOMER_NO "11" USER "APPLICATOR" ECU "MG1CS003" CPU_TYPE "JDP" EPK "53/1/MG1CS003/11/MG1CS003_BX8_R0C2J8B2B//R0C2J8B2B///" ADDR_EPK 0x96C853C
 /begin MEMORY_SEGMENT Pst8FC0000 "" RESERVED FLASH INTERN 0x8FC0000 0x20 -1 -1 -1 -1 -1 /end MEMORY_SEGMENT
 /begin MEMORY_SEGMENT Pst8FC0020 "" RESERVED FLASH INTERN 0x8FC0020 0xBFE0 -1 -1 -1 -1 -1 /end MEMORY_SEGMENT
 /begin MEMORY_SEGMENT Pst8FD0000 "" RESERVED FLASH INTERN 0x8FD0000 0x8000 -1 -1 -1 -1 -1 /end MEMORY_SEGMENT
 /begin MEMORY_SEGMENT Pst9040000 "" CODE FLASH INTERN 0x9040000 0x63F7E0 -1 -1 -1 -1 -1
  /begin IF_DATA ETK_XETK
   /begin ETK_XETK_ACCESS SERIAL_INTERFACE /end ETK_XETK_ACCESS
  /end IF_DATA
  /begin IF_DATA XCPplus 0x0102
   /begin SEGMENT 0x0 0x1 0x0 0x0 0x0 /begin CHECKSUM XCP_CRC_32 /end CHECKSUM
    /begin PAGE 0x0 ECU_ACCESS_WITH_XCP_ONLY XCP_READ_ACCESS_WITH_ECU_ONLY XCP_WRITE_ACCESS_NOT_ALLOWED /end PAGE
   /end SEGMENT
  /end IF_DATA
 /end MEMORY_SEGMENT
 /begin MEMORY_SEGMENT Pst967F7E0 "" RESERVED FLASH INTERN 0x967F7E0 0x520 -1 -1 -1 -1 -1 /end MEMORY_SEGMENT
 /begin MEMORY_SEGMENT Pst9000000 "" CODE FLASH INTERN 0x9000000 0x3FD00 -1 -1 -1 -1 -1
  /begin IF_DATA ETK_XETK
   /begin ETK_XETK_ACCESS SERIAL_INTERFACE /end ETK_XETK_ACCESS
  /end IF_DATA
  /begin IF_DATA XCPplus 0x0102
   /begin SEGMENT 0x1 0x1 0x0 0x0 0x0 /begin CHECKSUM XCP_CRC_32 /end CHECKSUM
    /begin PAGE 0x0 ECU_ACCESS_WITH_XCP_ONLY XCP_READ_ACCESS_WITH_ECU_ONLY XCP_WRITE_ACCESS_NOT_ALLOWED /end PAGE
   /end SEGMENT
  /end IF_DATA
 /end MEMORY_SEGMENT
 /begin MEMORY_SEGMENT Pst977F7E0 "" RESERVED FLASH INTERN 0x977F7E0 0x520 -1 -1 -1 -1 -1 /begin IF_DATA ETK_XETK WRITE_AT_DATA_UPDATE USE_FILE ETK_XETK_REF 1 /end IF_DATA /end MEMORY_SEGMENT
 /begin MEMORY_SEGMENT Pst60C100 "" RESERVED FLASH INTERN 0x60C100 0x3F00 -1 -1 -1 -1 -1 /end MEMORY_SEGMENT
 /begin MEMORY_SEGMENT Pst610100 "" RESERVED FLASH INTERN 0x610100 0x1FF00 -1 -1 -1 -1 -1 /end MEMORY_SEGMENT
 /begin MEMORY_SEGMENT Pst60C000 "" RESERVED FLASH INTERN 0x60C000 0x100 -1 -1 -1 -1 -1 /end MEMORY_SEGMENT
 /begin MEMORY_SEGMENT Pst610000 "" RESERVED FLASH INTERN 0x610000 0x100 -1 -1 -1 -1 -1 /end MEMORY_SEGMENT
 /begin MEMORY_SEGMENT Pst8FD8000 "" RESERVED FLASH INTERN 0x8FD8000 0x8000 -1 -1 -1 -1 -1 /end MEMORY_SEGMENT
 /begin MEMORY_SEGMENT Pst903FD00 "" RESERVED FLASH INTERN 0x903FD00 0x300 -1 -1 -1 -1 -1 /end MEMORY_SEGMENT
 /begin MEMORY_SEGMENT Pst967FD00 "" RESERVED FLASH INTERN 0x967FD00 0x300 -1 -1 -1 -1 -1 /end MEMORY_SEGMENT
 /begin MEMORY_SEGMENT Pst977FD08 "" RESERVED FLASH INTERN 0x977FD08 0x104 -1 -1 -1 -1 -1 /end MEMORY_SEGMENT
 /begin MEMORY_SEGMENT Pst977FFDC "" RESERVED FLASH INTERN 0x977FFDC 0x24 -1 -1 -1 -1 -1 /end MEMORY_SEGMENT
 /begin MEMORY_SEGMENT Dst9680000 "" DATA FLASH INTERN 0x9680000 0xFF7E0 -1 -1 -1 -1 -1
  /begin IF_DATA ETK_XETK
   /begin ETK_XETK_ACCESS SERIAL_INTERFACE /end ETK_XETK_ACCESS
  /end IF_DATA
  /begin IF_DATA XCPplus 0x0102
   /begin SEGMENT 0x2 0x2 0x0 0x0 0x0 /begin CHECKSUM XCP_CRC_32 /end CHECKSUM
    /begin PAGE 0x0 ECU_ACCESS_DONT_CARE XCP_READ_ACCESS_DONT_CARE XCP_WRITE_ACCESS_NOT_ALLOWED /end PAGE
    /begin PAGE 0x1 ECU_ACCESS_DONT_CARE XCP_READ_ACCESS_DONT_CARE XCP_WRITE_ACCESS_WITH_ECU_ONLY /end PAGE
   /end SEGMENT
  /end IF_DATA
 /end MEMORY_SEGMENT
 /begin MEMORY_SEGMENT Dst977FD00 "" DATA FLASH INTERN 0x977FD00 0x8 -1 -1 -1 -1 -1
  /begin IF_DATA ETK_XETK
   /begin ETK_XETK_ACCESS SERIAL_INTERFACE /end ETK_XETK_ACCESS
  /end IF_DATA
  /begin IF_DATA XCPplus 0x0102
   /begin SEGMENT 0x3 0x2 0x0 0x0 0x0 /begin CHECKSUM XCP_CRC_32 /end CHECKSUM
    /begin PAGE 0x0 ECU_ACCESS_DONT_CARE XCP_READ_ACCESS_DONT_CARE XCP_WRITE_ACCESS_NOT_ALLOWED /end PAGE
    /begin PAGE 0x1 ECU_ACCESS_DONT_CARE XCP_READ_ACCESS_DONT_CARE XCP_WRITE_ACCESS_WITH_ECU_ONLY /end PAGE
   /end SEGMENT
  /end IF_DATA
 /end MEMORY_SEGMENT
 /begin MEMORY_SEGMENT Dst977FE0C "" DATA FLASH INTERN 0x977FE0C 0x1D0 -1 -1 -1 -1 -1
  /begin IF_DATA ETK_XETK
   /begin ETK_XETK_ACCESS SERIAL_INTERFACE /end ETK_XETK_ACCESS
  /end IF_DATA
  /begin IF_DATA XCPplus 0x0102
   /begin SEGMENT 0x4 0x2 0x0 0x0 0x0 /begin CHECKSUM XCP_CRC_32 /end CHECKSUM
    /begin PAGE 0x0 ECU_ACCESS_DONT_CARE XCP_READ_ACCESS_DONT_CARE XCP_WRITE_ACCESS_NOT_ALLOWED /end PAGE
    /begin PAGE 0x1 ECU_ACCESS_DONT_CARE XCP_READ_ACCESS_DONT_CARE XCP_WRITE_ACCESS_WITH_ECU_ONLY /end PAGE
   /end SEGMENT
  /end IF_DATA
 /end MEMORY_SEGMENT
 /begin MEMORY_SEGMENT Ram40000000 "" VARIABLES RAM INTERN 0x40000000 0x60000 -1 -1 -1 -1 -1
  /begin IF_DATA ETK_XETK
   /begin ETK_XETK_ACCESS SERIAL_INTERFACE /end ETK_XETK_ACCESS
  /end IF_DATA
  /begin IF_DATA XCPplus 0x0102
   /begin SEGMENT 0x5 0x0 0x0 0x0 0x0 /end SEGMENT
  /end IF_DATA
 /end MEMORY_SEGMENT
 /begin MEMORY_SEGMENT Ram50000000 "" VARIABLES RAM INTERN 0x50000000 0x4000 -1 -1 -1 -1 -1
  /begin IF_DATA ETK_XETK
   /begin ETK_XETK_ACCESS SERIAL_INTERFACE /end ETK_XETK_ACCESS
  /end IF_DATA
  /begin IF_DATA XCPplus 0x0102
   /begin SEGMENT 0x6 0x0 0x0 0x0 0x0 /end SEGMENT
  /end IF_DATA
 /end MEMORY_SEGMENT
 /begin MEMORY_SEGMENT Ram51000000 "" VARIABLES RAM INTERN 0x51000000 0x4000 -1 -1 -1 -1 -1
  /begin IF_DATA ETK_XETK
   /begin ETK_XETK_ACCESS SERIAL_INTERFACE /end ETK_XETK_ACCESS
  /end IF_DATA
  /begin IF_DATA XCPplus 0x0102
   /begin SEGMENT 0x7 0x0 0x0 0x0 0x0 /end SEGMENT
  /end IF_DATA
 /end MEMORY_SEGMENT
 /begin MEMORY_SEGMENT Ram52000000 "" VARIABLES RAM INTERN 0x52000000 0x4000 -1 -1 -1 -1 -1
  /begin IF_DATA ETK_XETK
   /begin ETK_XETK_ACCESS SERIAL_INTERFACE /end ETK_XETK_ACCESS
  /end IF_DATA
  /begin IF_DATA XCPplus 0x0102
   /begin SEGMENT 0x8 0x0 0x0 0x0 0x0 /end SEGMENT
  /end IF_DATA
 /end MEMORY_SEGMENT
 /begin MEMORY_SEGMENT Ram50800000 "" VARIABLES RAM INTERN 0x50800000 0x10000 -1 -1 -1 -1 -1
  /begin IF_DATA ETK_XETK
   /begin ETK_XETK_ACCESS SERIAL_INTERFACE /end ETK_XETK_ACCESS
  /end IF_DATA
  /begin IF_DATA XCPplus 0x0102
   /begin SEGMENT 0x9 0x0 0x0 0x0 0x0 /end SEGMENT
  /end IF_DATA
 /end MEMORY_SEGMENT
 /begin MEMORY_SEGMENT Ram51800000 "" VARIABLES RAM INTERN 0x51800000 0x10000 -1 -1 -1 -1 -1
  /begin IF_DATA ETK_XETK
   /begin ETK_XETK_ACCESS SERIAL_INTERFACE /end ETK_XETK_ACCESS
  /end IF_DATA
  /begin IF_DATA XCPplus 0x0102
   /begin SEGMENT 0xA 0x0 0x0 0x0 0x0 /end SEGMENT
  /end IF_DATA
 /end MEMORY_SEGMENT
 /begin MEMORY_SEGMENT Ram52800000 "" VARIABLES RAM INTERN 0x52800000 0xC000 -1 -1 -1 -1 -1
  /begin IF_DATA ETK_XETK
   /begin ETK_XETK_ACCESS SERIAL_INTERFACE /end ETK_XETK_ACCESS
  /end IF_DATA
  /begin IF_DATA XCPplus 0x0102
   /begin SEGMENT 0xB 0x0 0x0 0x0 0x0 /end SEGMENT
  /end IF_DATA
 /end MEMORY_SEGMENT
 /begin MEMORY_SEGMENT RamC1FB648 "" VARIABLES RAM INTERN 0xC1FB648 0x49B8 -1 -1 -1 -1 -1
  /begin IF_DATA ETK_XETK
   /begin ETK_XETK_ACCESS SERIAL_INTERFACE /end ETK_XETK_ACCESS
  /end IF_DATA
  /begin IF_DATA XCPplus 0x0102
   /begin SEGMENT 0xC 0x0 0x0 0x0 0x0 /end SEGMENT
  /end IF_DATA
 /end MEMORY_SEGMENT
 /begin MEMORY_SEGMENT RamC1E0000 "" CALIBRATION_VARIABLES RAM INTERN 0xC1E0000 0x1B648 -1 -1 -1 -1 -1
  /begin IF_DATA ETK_XETK
   /begin ETK_XETK_ACCESS SERIAL_INTERFACE /end ETK_XETK_ACCESS
  /end IF_DATA
  /begin IF_DATA XCPplus 0x0102
   /begin SEGMENT 0xD 0x0 0x0 0x0 0x0 /end SEGMENT
  /end IF_DATA
 /end MEMORY_SEGMENT
/end MOD_PAR
/begin MOD_COMMON "" BYTE_ORDER MSB_FIRST DEPOSIT ABSOLUTE ALIGNMENT_BYTE 1 ALIGNMENT_WORD 2 ALIGNMENT_LONG 4 ALIGNMENT_FLOAT32_IEEE 4 ALIGNMENT_FLOAT64_IEEE 4 /end MOD_COMMON
/begin AXIS_PTS Antilag_BMWtchctr_p_DifCrtnPp_Ax___MGF_CC_PF "AXX_KF_PDIFF_ATLR_P" 0x96B7F70 BMWtchbas_p_Dif_sw _REC_A1AXS_1_MBSE_S2 8191.875 ___MGF_CC_PressurehPa_d8 12 -4096 4095.875 FORMAT "%10.3" DEPOSIT ABSOLUTE /end AXIS_PTS
/begin AXIS_PTS Antilag_BMWtchctr_p_DifCrtnPp_Ay___MGF_CC_PF "AXY_KF_PDIFF_ATLR_P" 0x977566C BMWtchsp_mf_Ex_uw _REC_A1AXS_1_MBSE_U2 2047.96875 CByjozc_eCmpBAb_pljBAmd_k__0oa0 6 0 2047.96875 FORMAT "%10.3" DEPOSIT ABSOLUTE /end AXIS_PTS
/begin AXIS_PTS Antilag_BMWtchctr_p_DifCrtnPpDyn_Ax___MGF_CC_PF "AXX_KF_PDIFF_ATLR_P" 0x96B7F88 BMWtchbas_p_Dif_sw _REC_A1AXS_1_MBSE_S2 8191.875 ___MGF_CC_PressurehPa_d8 12 -4096 4095.875 FORMAT "%10.3" DEPOSIT ABSOLUTE /end AXIS_PTS
/begin AXIS_PTS Antilag_BMWtchctr_p_DifCrtnPpDyn_Ay___MGF_CC_PF "AXY_KF_PDIFF_ATLR_P" 0x9775708 BMWtchsp_mf_Ex_uw _REC_A1AXS_1_MBSE_U2 2047.96875 CByjozc_eCmpBAb_pljBAmd_k__0oa0 6 0 2047.96875 FORMAT "%10.3" DEPOSIT ABSOLUTE /end AXIS_PTS
/begin AXIS_PTS Antilag_BMWtchctr_pwr_Pctl_Ax___MGF_CC_PF "AXX_KF_ATL_PVERD" 0x9775592 BMWtchsp_rat_p_CmprLim_uw _REC_A1AXS_1_MBSE_U2 7.9998779296875 acriqBc_tfkBqod_ocgjxzc_nR_8oa0 20 0 7.9998779296875 FORMAT "%11.4" DEPOSIT ABSOLUTE /end AXIS_PTS
/begin AXIS_PTS Antilag_BMWtchctr_pwr_Pctl_Ay___MGF_CC_PF "AXY_KF_ATL_PVERD" 0x97755BA BMWtchsp_mf_CmprNorm_uw _REC_A1AXS_1_MBSE_U2 2047.96875 CByjozc_eCmpBAb_pljBAmd_k__0oa0 16 0 2047.96875 FORMAT "%10.3" DEPOSIT ABSOLUTE /end AXIS_PTS
/begin AXIS_PTS Antilag_IgnRoll_X_Axis___MGF_CC_PF "Ignition setpoint: Engine speed [Nkw] vs Boost actual [Ps]" 0x97750F2 Nkw ___MGF_CC_Antilag_Ign_Roll_xAxis 0 caoddzd_oAjpfzb_cAcEEha_1nR_oa0 10 0 15000 /end AXIS_PTS
/begin AXIS_PTS Antilag_IgnRoll_Y_Axis___MGF_CC_PF "Ignition setpoint: Engine speed [Nkw] vs Boost actual [Ps]" 0x97750DE Ps ___MGF_CC_Antilag_Ign_Roll_xAxis 0 ___MGF_CC_PressurehPa_d8 10 -3000 3000 /end AXIS_PTS
/begin AXIS_PTS Antilag_IgnStand_X_Axis___MGF_CC_PF "Ignition setpoint: Engine speed [Nkw] vs Boost actual [Ps]" 0x9775002 Nkw ___MGF_CC_Antilag_Ign_Roll_xAxis 0 caoddzd_oAjpfzb_cAcEEha_1nR_oa0 10 0 15000 /end AXIS_PTS
/begin AXIS_PTS Antilag_IgnStand_Y_Axis___MGF_CC_PF "Ignition setpoint: Engine speed [Nkw] vs Boost actual [Ps]" 0x9774FEE Ps ___MGF_CC_Antilag_Ign_Roll_xAxis 0 ___MGF_CC_PressurehPa_d8 10 -3000 3000 /end AXIS_PTS
/begin AXIS_PTS Antilag_LambdaRoll_X_Axis___MGF_CC_PF "Fueling setpoint: Engine speed [Nkw] vs Exhaust Gas Temperature [EGT] before turbine [Tabg_vl_xab]" 0x97752D2 Nkw ___MGF_CC_Antilag_Ign_Roll_xAxis 0 caoddzd_oAjpfzb_cAcEEha_1nR_oa0 10 0 15000 /end AXIS_PTS
/begin AXIS_PTS Antilag_LambdaRoll_Y_Axis___MGF_CC_PF "Fueling setpoint: Engine speed [Nkw] vs Exhaust Gas Temperature [EGT] before turbine [Tabg_vl_xab]" 0x97752BE Tabg_vl_xab ___MGF_CC_Antilag_Ign_Roll_xAxis 0 ___MGF_CC_TemperatureCelsius_d10 10 -3000 3000 /end AXIS_PTS
/begin AXIS_PTS Antilag_LambdaStand_X_Axis___MGF_CC_PF "Fueling setpoint: Engine speed [Nkw] vs Exhaust Gas Temperature [EGT] before turbine [Tabg_vl_xab]" 0x97751E2 Nkw ___MGF_CC_Antilag_Ign_Roll_xAxis 0 caoddzd_oAjpfzb_cAcEEha_1nR_oa0 10 0 15000 /end AXIS_PTS
/begin AXIS_PTS Antilag_LambdaStand_Y_Axis___MGF_CC_PF "Fueling setpoint: Engine speed [Nkw] vs Exhaust Gas Temperature [EGT] before turbine [Tabg_vl_xab]" 0x97751CE Tabg_vl_xab ___MGF_CC_Antilag_Ign_Roll_xAxis 0 ___MGF_CC_TemperatureCelsius_d10 10 -3000 3000 /end AXIS_PTS
/begin AXIS_PTS AXX_KF_BSLGF "AXX_KF_BSLGF" 0x96926D2 Nkw_atm _REC_A1AXS_1_MBSE_S2 65535 caoddzd_oAjpfzb_cAcEEha_1nR_oa0 4 -32768 32767 DEPOSIT ABSOLUTE /end AXIS_PTS
/begin AXIS_PTS AXX_KF_DLAMBSVST_TABG "AXX_KF_DLAMBSVST_TABG" 0x9692964 Nkw_atm _REC_A1AXS_1_MBSE_S2 65535 caoddzd_oAjpfzb_cAcEEha_1nR_oa0 8 -32768 32767 DEPOSIT ABSOLUTE /end AXIS_PTS
/begin AXIS_PTS AXX_KF_DPLDS_PRED "Nkw" 0x96B6F6C NO_INPUT_QUANTITY _REC_A1AXS_1_MBSE_S2 32767 caoddzd_oAjpfzb_cAcEEha_1nR_oa0 6 0 32767 FORMAT "%5.0" DEPOSIT ABSOLUTE /end AXIS_PTS
/begin AXIS_PTS AXX_KF_DPLDSOLL_SPORT "Nkw" 0x969C7AE NO_INPUT_QUANTITY _REC_A1AXS_1_MBSE_S2 32767 caoddzd_oAjpfzb_cAcEEha_1nR_oa0 6 0 32767 FORMAT "%5.0" DEPOSIT ABSOLUTE /end AXIS_PTS
/begin AXIS_PTS AXX_KF_DZW_DYN "AXX_KF_DZW_DYN" 0x96ACF92 Nkw _REC_A1AXS_1_MBSE_S2 65535 caoddzd_oAjpfzb_cAcEEha_1nR_oa0 4 -32768 32767 FORMAT "%5.0" DEPOSIT ABSOLUTE /end AXIS_PTS
/begin AXIS_PTS AXX_KF_DZWMIN_NORMAL_SOT "AXX_KF_DZWMIN_NORMAL_SOT" 0x96BA01E Nkw _REC_A1AXS_1_MBSE_S2 65535 caoddzd_oAjpfzb_cAcEEha_1nR_oa0 6 -32768 32767 FORMAT "%5.0" DEPOSIT ABSOLUTE /end AXIS_PTS
/begin AXIS_PTS AXX_KF_DZWMIN_SPORT_SOT "AXX_KF_DZWMIN_SPORT_SOT" 0x96BA002 Nkw _REC_A1AXS_1_MBSE_S2 65535 caoddzd_oAjpfzb_cAcEEha_1nR_oa0 6 -32768 32767 FORMAT "%5.0" DEPOSIT ABSOLUTE /end AXIS_PTS
/begin AXIS_PTS AXX_KF_DZWT_PF1 "AXX_KF_DZWT_PF1" 0x96B9C54 Nkw _REC_A1AXS_1_MBSE_S2 65535 caoddzd_oAjpfzb_cAcEEha_1nR_oa0 20 -32768 32767 FORMAT "%5.0" DEPOSIT ABSOLUTE /end AXIS_PTS
/begin AXIS_PTS AXX_KF_DZWT_PF2 "AXX_KF_DZWT_PF2" 0x96B9C2C Nkw _REC_A1AXS_1_MBSE_S2 65535 caoddzd_oAjpfzb_cAcEEha_1nR_oa0 20 -32768 32767 FORMAT "%5.0" DEPOSIT ABSOLUTE /end AXIS_PTS
/begin AXIS_PTS AXX_KF_DZWT_UESP_PF1 "AXX_KF_DZWT_UESP_PF1" 0x96B9C18 Nkw _REC_A1AXS_1_MBSE_S2 65535 caoddzd_oAjpfzb_cAcEEha_1nR_oa0 10 -32768 32767 FORMAT "%5.0" DEPOSIT ABSOLUTE /end AXIS_PTS
/begin AXIS_PTS AXX_KF_DZWT_UESP_PF2 "AXX_KF_DZWT_UESP_PF2" 0x96B9C04 Nkw _REC_A1AXS_1_MBSE_S2 65535 caoddzd_oAjpfzb_cAcEEha_1nR_oa0 10 -32768 32767 FORMAT "%5.0" DEPOSIT ABSOLUTE /end AXIS_PTS
/begin AXIS_PTS AXX_KF_EDA_ANZ_SPORT_MD_EM1_IST "KF_EDA_ANZ_SPORT_MD_EM1_IST" 0x9689E26 NO_INPUT_QUANTITY _REC_A1AXS_1_MBSE_S2 6553.5 Mo_trq_nm_q0p1 6 -3276.8 3276.7 FORMAT "%7.2" DEPOSIT ABSOLUTE /end AXIS_PTS
/begin AXIS_PTS AXX_KF_FDZW_DYN1 "AXX_KF_FDZW_DYN1" 0x96B9A6C Tans _REC_A1AXS_1_MBSE_S2 6553.5 ___MGF_CC_TemperatureCelsius_d10 4 -3276.8 3276.7 FORMAT "%6.1" DEPOSIT ABSOLUTE /end AXIS_PTS
/begin AXIS_PTS AXX_KF_FDZW_DYN2 "AXX_KF_FDZW_DYN2" 0x96C6DCC Gangi _REC_A1AXS_1_MBSE_U1 255 raChrxc_kBtBrmb_FmDuEFa_n__aa0o 10 0 255 FORMAT "%3.0" DEPOSIT ABSOLUTE /end AXIS_PTS
/begin AXIS_PTS AXX_KF_FDZW_DYN3 "AXX_KF_FDZW_DYN3" 0x96B9A64 Tans _REC_A1AXS_1_MBSE_S2 6553.5 ___MGF_CC_TemperatureCelsius_d10 4 -3276.8 3276.7 FORMAT "%6.1" DEPOSIT ABSOLUTE /end AXIS_PTS
/begin AXIS_PTS AXX_KF_FDZW_DYN4 "AXX_KF_FDZW_DYN4" 0x96C6DC0 Gangi _REC_A1AXS_1_MBSE_U1 255 raChrxc_kBtBrmb_FmDuEFa_n__aa0o 10 0 255 FORMAT "%3.0" DEPOSIT ABSOLUTE /end AXIS_PTS
/begin AXIS_PTS AXX_KF_FDZWT_BEST_PF1 "Factor temperature correction ZW-Best path 1" 0x96ACD86 Tmot _REC_A1AXS_1_MBSE_S2 655.35 DchEpAd_DBCFgoa_Ckhahgc_q__aoa0 6 -327.68 327.67 FORMAT "%7.2" DEPOSIT ABSOLUTE /end AXIS_PTS
/begin AXIS_PTS AXX_KF_FDZWT_BEST_PF2 "Factor temperature correction ZW-Best path 2" 0x96ACD7A Tmot _REC_A1AXS_1_MBSE_S2 655.35 DchEpAd_DBCFgoa_Ckhahgc_q__aoa0 6 -327.68 327.67 FORMAT "%7.2" DEPOSIT ABSOLUTE /end AXIS_PTS
/begin AXIS_PTS AXX_KF_FDZWT_PF1 "AXX_KF_FDZWT_PF1" 0x96ACE46 Tmot _REC_A1AXS_1_MBSE_S2 655.35 DchEpAd_DBCFgoa_Ckhahgc_q__aoa0 6 -327.68 327.67 FORMAT "%7.2" DEPOSIT ABSOLUTE /end AXIS_PTS
/begin AXIS_PTS AXX_KF_FDZWT_PF2 "AXX_KF_FDZWT_PF2" 0x96ACE3A Tmot _REC_A1AXS_1_MBSE_S2 655.35 DchEpAd_DBCFgoa_Ckhahgc_q__aoa0 6 -327.68 327.67 FORMAT "%7.2" DEPOSIT ABSOLUTE /end AXIS_PTS
/begin AXIS_PTS AXX_KF_FRKKORRF_1 "AXX_KF_FRKKORRF_1" 0x968F0F6 Nkw _REC_A1AXS_1_MBSE_S2 65535 caoddzd_oAjpfzb_cAcEEha_1nR_oa0 16 -32768 32767 FORMAT "%5.0" DEPOSIT ABSOLUTE /end AXIS_PTS
/begin AXIS_PTS AXX_KF_KOEFF_B_LA "AXX_KF_KOEFF_B_LA" 0x96AD1B6 Nkw _REC_A1AXS_1_MBSE_S2 65535 caoddzd_oAjpfzb_cAcEEha_1nR_oa0 6 -32768 32767 FORMAT "%5.0" DEPOSIT ABSOLUTE /end AXIS_PTS
/begin AXIS_PTS AXX_KF_LA_BEZ "AXX_KF_LA_BEZ" 0x96AD1AA Nkw _REC_A1AXS_1_MBSE_S2 65535 caoddzd_oAjpfzb_cAcEEha_1nR_oa0 6 -32768 32767 FORMAT "%5.0" DEPOSIT ABSOLUTE /end AXIS_PTS
/begin AXIS_PTS AXX_KF_LAMIN_H "AXX_KF_LAMIN_H" 0x9697964 Nkw _REC_A1AXS_1_MBSE_S2 65535 caoddzd_oAjpfzb_cAcEEha_1nR_oa0 6 -32768 32767 FORMAT "%5.0" DEPOSIT ABSOLUTE /end AXIS_PTS
/begin AXIS_PTS AXX_KF_MD_RES_NST_KEY "AXX_KF_MD_RES_NST_KEY" 0x96A7564 Tn_start_10 _REC_A1AXS_1_MBSE_U2 655.35 camcxxd_bxlpdsa_Cshlhgc_sR_1a0o 4 0 655.35 FORMAT "%7.2" DEPOSIT ABSOLUTE /end AXIS_PTS
/begin AXIS_PTS AXX_KF_MDIOP_1_TQE "AXX_KF_MDIOP_1_TQE" 0x96A3080 Rf_zh_ber _REC_A1AXS_1_MBSE_S2 655.35 CgkBooc_wkiDfEd_Czglhgc_fR_1a0o 18 -327.68 327.67 FORMAT "%6.2" DEPOSIT ABSOLUTE /end AXIS_PTS
/begin AXIS_PTS AXX_KF_MDK_MAX_GANG_NKW "x-axis (Gang_gb1_ist) for KF_MDK_MAX_GANG_NKW" 0x96C5534 Gang_gb1_ist _REC_A1AXS_1_MBSE_S1 255 raChrxc_kBtBrmb_FmDuEFa_n__aa0o 10 -128 127 FORMAT "%6.0" DEPOSIT ABSOLUTE /end AXIS_PTS
/begin AXIS_PTS AXX_KF_PHA_H_E1 "AXX_KF_PHA_H_E1" 0x9691CA4 Nkw _REC_A1AXS_1_MBSE_S2 65535 caoddzd_oAjpfzb_cAcEEha_1nR_oa0 8 -32768 32767 FORMAT "%5.0" DEPOSIT ABSOLUTE /end AXIS_PTS
/begin AXIS_PTS AXX_KF_PRAIL_H "AXX_KF_PRAIL_H" 0x969DA9A Nkw _REC_A1AXS_1_MBSE_S2 65535 caoddzd_oAjpfzb_cAcEEha_1nR_oa0 8 -32768 32767 FORMAT "%5.0" DEPOSIT ABSOLUTE /end AXIS_PTS
/begin AXIS_PTS AXX_KF_PRAIL_H_K "AXX_KF_PRAIL_H_K" 0x969DA5A Nkw _REC_A1AXS_1_MBSE_S2 65535 caoddzd_oAjpfzb_cAcEEha_1nR_oa0 8 -32768 32767 FORMAT "%5.0" DEPOSIT ABSOLUTE /end AXIS_PTS
/begin AXIS_PTS AXX_KF_PRAIL_HGD "axis" 0x969DA7A Nkw _REC_A1AXS_1_MBSE_S2 65535 caoddzd_oAjpfzb_cAcEEha_1nR_oa0 8 -32768 32767 FORMAT "%5.0" DEPOSIT ABSOLUTE /end AXIS_PTS
/begin AXIS_PTS AXX_KF_PRAIL_HGD_K "axis" 0x969DA6A Nkw _REC_A1AXS_1_MBSE_S2 65535 caoddzd_oAjpfzb_cAcEEha_1nR_oa0 8 -32768 32767 FORMAT "%5.0" DEPOSIT ABSOLUTE /end AXIS_PTS
/begin AXIS_PTS AXX_KF_ST_RKBAS_GD "AXX_KF_ST_RKBAS_GD" 0x96BA452 Nkw _REC_A1AXS_1_MBSE_S2 65535 caoddzd_oAjpfzb_cAcEEha_1nR_oa0 10 -32768 32767 FORMAT "%5.0" DEPOSIT ABSOLUTE /end AXIS_PTS
/begin AXIS_PTS AXX_KF_ST_RKBAS_VVT "AXX_KF_ST_RKBAS_VVT" 0x96BA2A0 Nkw _REC_A1AXS_1_MBSE_S2 65535 caoddzd_oAjpfzb_cAcEEha_1nR_oa0 12 -32768 32767 FORMAT "%5.0" DEPOSIT ABSOLUTE /end AXIS_PTS
/begin AXIS_PTS AXX_KF_TA_ATLSOLL "AXX_KF_TA_ATLSOLL" 0x969294C Nkw_atm _REC_A1AXS_1_MBSE_S2 65535 caoddzd_oAjpfzb_cAcEEha_1nR_oa0 4 -32768 32767 DEPOSIT ABSOLUTE /end AXIS_PTS
/begin AXIS_PTS AXX_KF_TA_IKSOLL "AXX_KF_TA_IKSOLL" 0x9692944 Nkw_atm _REC_A1AXS_1_MBSE_S2 65535 caoddzd_oAjpfzb_cAcEEha_1nR_oa0 4 -32768 32767 DEPOSIT ABSOLUTE /end AXIS_PTS
/begin AXIS_PTS AXX_KF_TA_VKSOLL "AXX_KF_TA_VKSOLL" 0x969293C Nkw_atm _REC_A1AXS_1_MBSE_S2 65535 caoddzd_oAjpfzb_cAcEEha_1nR_oa0 4 -32768 32767 DEPOSIT ABSOLUTE /end AXIS_PTS
/begin AXIS_PTS AXX_KF_TD_FETTDELAY_TABG "AXX_KF_TD_FETTDELAY_TABG" 0x96BAD02 Tw_r1 _REC_A1AXS_1_MBSE_S2 6553.5 ___MGF_CC_TemperatureCelsius_d10 6 -3276.8 3276.7 FORMAT "%6.1" DEPOSIT ABSOLUTE /end AXIS_PTS
/begin AXIS_PTS AXX_KF_ZW_PF1 "AXX_KF_ZW_PF1" 0x96ACC88 Nkw _REC_A1AXS_1_MBSE_S2 65535 caoddzd_oAjpfzb_cAcEEha_1nR_oa0 20 -32768 32767 FORMAT "%5.0" DEPOSIT ABSOLUTE /end AXIS_PTS
/begin AXIS_PTS AXX_KF_ZW_PF2 "AXX_KF_ZW_PF2" 0x96ACC60 Nkw _REC_A1AXS_1_MBSE_S2 65535 caoddzd_oAjpfzb_cAcEEha_1nR_oa0 20 -32768 32767 FORMAT "%5.0" DEPOSIT ABSOLUTE /end AXIS_PTS
/begin AXIS_PTS AXX_KF_ZW_S_PF1 "AXX_KF_ZW_S_PF1" 0x96ACC38 Nkw _REC_A1AXS_1_MBSE_S2 65535 caoddzd_oAjpfzb_cAcEEha_1nR_oa0 20 -32768 32767 FORMAT "%5.0" DEPOSIT ABSOLUTE /end AXIS_PTS
/begin AXIS_PTS AXX_KF_ZW_S_PF2 "AXX_KF_ZW_S_PF2" 0x96ACC10 Nkw _REC_A1AXS_1_MBSE_S2 65535 caoddzd_oAjpfzb_cAcEEha_1nR_oa0 20 -32768 32767 FORMAT "%5.0" DEPOSIT ABSOLUTE /end AXIS_PTS
/begin AXIS_PTS AXX_KF_ZW_UESP_PF1 "AXX_KF_ZW_UESP_PF1" 0x96ACBFC Nkw _REC_A1AXS_1_MBSE_S2 65535 caoddzd_oAjpfzb_cAcEEha_1nR_oa0 10 -32768 32767 FORMAT "%5.0" DEPOSIT ABSOLUTE /end AXIS_PTS
/begin AXIS_PTS AXX_KF_ZW_UESP_PF2 "AXX_KF_ZW_UESP_PF2" 0x96ACBE8 Nkw _REC_A1AXS_1_MBSE_S2 65535 caoddzd_oAjpfzb_cAcEEha_1nR_oa0 10 -32768 32767 FORMAT "%5.0" DEPOSIT ABSOLUTE /end AXIS_PTS
/begin AXIS_PTS AXX_KF_ZW_VP_PF1 "AXX_KF_ZW_VP_PF1" 0x96BAFF2 Nkw _REC_A1AXS_1_MBSE_S2 65535 caoddzd_oAjpfzb_cAcEEha_1nR_oa0 20 -32768 32767 FORMAT "%5.0" DEPOSIT ABSOLUTE /end AXIS_PTS
/begin AXIS_PTS AXX_KF_ZW_VP_PF2 "AXX_KF_ZW_VP_PF2" 0x96BAFCA Nkw _REC_A1AXS_1_MBSE_S2 65535 caoddzd_oAjpfzb_cAcEEha_1nR_oa0 20 -32768 32767 FORMAT "%5.0" DEPOSIT ABSOLUTE /end AXIS_PTS
/begin AXIS_PTS AXX_KF_ZWMIN_KSOT "AXX_KF_ZWMIN_KSOT" 0x96B9FF2 Nkw _REC_A1AXS_1_MBSE_S2 65535 caoddzd_oAjpfzb_cAcEEha_1nR_oa0 8 -32768 32767 FORMAT "%5.0" DEPOSIT ABSOLUTE /end AXIS_PTS
/begin AXIS_PTS AXX_KF_ZWMIN_WSOT "AXX_KF_ZWMIN_WSOT" 0x96B9FE2 Nkw _REC_A1AXS_1_MBSE_S2 65535 caoddzd_oAjpfzb_cAcEEha_1nR_oa0 8 -32768 32767 FORMAT "%5.0" DEPOSIT ABSOLUTE /end AXIS_PTS
/begin AXIS_PTS AXX_KL_FRFMXBS "AXX_KL_FRFMXBS" 0x9692664 NO_INPUT_QUANTITY _REC_A1AXS_1_MBSE_U2 1.99996948242188 Bhvfwhc_bigEubd_BBEupBd_nR_3oa0 4 0 1.99996948242188 FORMAT "%14.5" DEPOSIT ABSOLUTE /end AXIS_PTS
/begin AXIS_PTS AXX_KL_LA_SBL "AXX_KL_LA_SBL" 0x96BAD5C Nkw _REC_A1AXS_1_MBSE_S2 65535 caoddzd_oAjpfzb_cAcEEha_1nR_oa0 6 -32768 32767 FORMAT "%5.0" DEPOSIT ABSOLUTE /end AXIS_PTS
/begin AXIS_PTS AXX_KL_LAMX "Commercial vehicle * kl_taschen_aus" 0x969A356 NO_INPUT_QUANTITY _REC_A1AXS_1_MBSE_S2 65535 caoddzd_oAjpfzb_cAcEEha_1nR_oa0 18 -32768 32767 FORMAT "%5.0" DEPOSIT ABSOLUTE /end AXIS_PTS
/begin AXIS_PTS AXX_KL_NKW_SOUND_MNMX "AXX_KL_NKW_SOUND_MNMX" 0x96C08E0 Gangi _REC_A1AXS_1_MBSE_U1 255 raChrxc_kBtBrmb_FmDuEFa_n__aa0o 8 0 255 FORMAT "%3.0" DEPOSIT ABSOLUTE /end AXIS_PTS
/begin AXIS_PTS AXX_KL_RF_MAX "Nkw" 0x969A31A NO_INPUT_QUANTITY _REC_A1AXS_1_MBSE_S2 65535 caoddzd_oAjpfzb_cAcEEha_1nR_oa0 12 -32768 32767 FORMAT "%5.0" DEPOSIT ABSOLUTE /end AXIS_PTS
/begin AXIS_PTS AXX_KL_RF_MAX_UESP "Nkw" 0x969A302 NO_INPUT_QUANTITY _REC_A1AXS_1_MBSE_S2 65535 caoddzd_oAjpfzb_cAcEEha_1nR_oa0 12 -32768 32767 FORMAT "%5.0" DEPOSIT ABSOLUTE /end AXIS_PTS
/begin AXIS_PTS AXX_KL_RFMIN_KRSTSYS "x-axis for KL_RFMIN_KRSTSYS" 0x96B11C6 Nkw _REC_A1AXS_1_MBSE_S2 65535 caoddzd_oAjpfzb_cAcEEha_1nR_oa0 8 -32768 32767 FORMAT "%5.0" DEPOSIT ABSOLUTE /end AXIS_PTS
/begin AXIS_PTS AXX_KL_RFTNLMX "Nkw" 0x96980EE NO_INPUT_QUANTITY _REC_A1AXS_1_MBSE_S2 32767 caoddzd_oAjpfzb_cAcEEha_1nR_oa0 10 0 32767 FORMAT "%5.0" DEPOSIT ABSOLUTE /end AXIS_PTS
/begin AXIS_PTS AXX_KL_RFVHUBDYNKOR "Nkw" 0x96981B6 NO_INPUT_QUANTITY _REC_A1AXS_1_MBSE_S2 65535 caoddzd_oAjpfzb_cAcEEha_1nR_oa0 20 -32768 32767 FORMAT "%5.0" DEPOSIT ABSOLUTE /end AXIS_PTS
/begin AXIS_PTS AXX_KL_T_IKAT_SOUND_MX "AXX_KL_T_IKAT_SOUND_MX" 0x96C08DC Anz_b_sound _REC_A1AXS_1_MBSE_U1 255 raChrxc_kBtBrmb_FmDuEFa_n__aa0o 4 0 255 FORMAT "%5.0" DEPOSIT ABSOLUTE /end AXIS_PTS
/begin AXIS_PTS AXX_KL_TD_SOUND_MX "AXX_KL_TD_SOUND_MX" 0x96A3AB2 V_fzg_plaus _REC_A1AXS_1_MBSE_S2 1310.7 jgbhAma_smpAegb_hlEBAmd_k__0oa0 4 -655.36 655.34 FORMAT "%6.2" DEPOSIT ABSOLUTE /end AXIS_PTS
/begin AXIS_PTS AXX_KL_TD_SOUND_MX_FREI "AXX_KL_TD_SOUND_MX_FREE" 0x96A3AAA V_fzg_plaus _REC_A1AXS_1_MBSE_S2 1310.7 jgbhAma_smpAegb_hlEBAmd_k__0oa0 4 -655.36 655.34 FORMAT "%6.2" DEPOSIT ABSOLUTE /end AXIS_PTS
/begin AXIS_PTS AXX_KL_TD_SOUND_MX_SPORT "AXX_KL_TD_SOUND_MX_SPORT" 0x96A3AA2 V_fzg_plaus _REC_A1AXS_1_MBSE_S2 1310.7 jgbhAma_smpAegb_hlEBAmd_k__0oa0 4 -655.36 655.34 FORMAT "%6.2" DEPOSIT ABSOLUTE /end AXIS_PTS
/begin AXIS_PTS AXY_KF_BSLGF "AXY_KF_BSLGF" 0x969267C Rf_atm _REC_A1AXS_1_MBSE_S2 655.35 CgkBooc_wkiDfEd_Czglhgc_fR_1a0o 4 -327.68 327.67 DEPOSIT ABSOLUTE /end AXIS_PTS
/begin AXIS_PTS AXY_KF_DLAMBSVST_TABG "AXY_KF_DLAMBSVST_TABG" 0x96928F4 Rf_atm _REC_A1AXS_1_MBSE_S2 655.35 CgkBooc_wkiDfEd_Czglhgc_fR_1a0o 8 -327.68 327.67 DEPOSIT ABSOLUTE /end AXIS_PTS
/begin AXIS_PTS AXY_KF_DPLDS_PRED "Drf_s2spred" 0x96B6F60 NO_INPUT_QUANTITY _REC_A1AXS_1_MBSE_U2 655.35 CgkBooc_wkiDfEd_Czglhgc_fR_1a0o 6 0 655.35 DEPOSIT ABSOLUTE /end AXIS_PTS
/begin AXIS_PTS AXY_KF_DPLDSOLL_SPORT "F_psspu" 0x969C782 NO_INPUT_QUANTITY _REC_A1AXS_1_MBSE_U2 7.9998779296875 acriqBc_tfkBqod_ocgjxzc_nR_8oa0 6 0 7.9998779296875 FORMAT "%7.5" DEPOSIT ABSOLUTE /end AXIS_PTS
/begin AXIS_PTS AXY_KF_DZW_DYN "AXY_KF_DZW_MAN" 0x96ACF32 NO_INPUT_QUANTITY _REC_A1AXS_1_MBSE_S2 655.35 CgkBooc_wkiDfEd_Czglhgc_fR_1a0o 4 -327.68 327.67 FORMAT "%9.2" DEPOSIT ABSOLUTE /end AXIS_PTS
/begin AXIS_PTS AXY_KF_DZWMIN_NORMAL_SOT "AXY_KF_DZWMIN_NORMAL_SOT" 0x96B9FDA V _REC_A1AXS_1_MBSE_U2 65535 AFeDmkb_cAbjmcc_kAkskhd_k__0oa0 4 0 65535 FORMAT "%5.0" DEPOSIT ABSOLUTE /end AXIS_PTS
/begin AXIS_PTS AXY_KF_DZWMIN_SPORT_SOT "AXY_KF_DZWMIN_SPORT_JUMP" 0x96B9FD2 V _REC_A1AXS_1_MBSE_U2 65535 AFeDmkb_cAbjmcc_kAkskhd_k__0oa0 4 0 65535 FORMAT "%5.0" DEPOSIT ABSOLUTE /end AXIS_PTS
/begin AXIS_PTS AXY_KF_DZWT_PF1 "AXY_KF_DZWT_PF1" 0x96B9BB4 NO_INPUT_QUANTITY _REC_A1AXS_1_MBSE_S2 655.35 CgkBooc_wkiDfEd_Czglhgc_fR_1a0o 16 -327.68 327.67 FORMAT "%9.2" DEPOSIT ABSOLUTE /end AXIS_PTS
/begin AXIS_PTS AXY_KF_DZWT_PF2 "AXY_KF_DZWT_PF2" 0x96B9B94 NO_INPUT_QUANTITY _REC_A1AXS_1_MBSE_S2 655.35 CgkBooc_wkiDfEd_Czglhgc_fR_1a0o 16 -327.68 327.67 FORMAT "%9.2" DEPOSIT ABSOLUTE /end AXIS_PTS
/begin AXIS_PTS AXY_KF_DZWT_UESP_PF1 "AXY_KF_DZWT_UESP_PF1" 0x96B9B7C NO_INPUT_QUANTITY _REC_A1AXS_1_MBSE_S2 655.35 CgkBooc_wkiDfEd_Czglhgc_fR_1a0o 12 -327.68 327.67 FORMAT "%9.2" DEPOSIT ABSOLUTE /end AXIS_PTS
/begin AXIS_PTS AXY_KF_DZWT_UESP_PF2 "AXY_KF_DZWT_UESP_PF2" 0x96B9B64 NO_INPUT_QUANTITY _REC_A1AXS_1_MBSE_S2 655.35 CgkBooc_wkiDfEd_Czglhgc_fR_1a0o 12 -327.68 327.67 FORMAT "%9.2" DEPOSIT ABSOLUTE /end AXIS_PTS
/begin AXIS_PTS AXY_KF_EDA_ANZ_SPORT_MD_EM1_IST "KF_EDA_ANZ_SPORT_MD_EM1_IST" 0x9689E56 NO_INPUT_QUANTITY _REC_A1AXS_1_MBSE_S2 65535 caoddzd_oAjpfzb_cAcEEha_1nR_oa0 6 -32768 32767 FORMAT "%5.0" DEPOSIT ABSOLUTE /end AXIS_PTS
/begin AXIS_PTS AXY_KF_FDZW_DYN1 "AXY_KF_FDZW_DYN1" 0x96B9A5C Dzw_annm _REC_A1AXS_1_MBSE_S2 110 juwcFuc_Dtmczic_mCgfamd_q__aa0o 4 -50 60 FORMAT "%6.1" DEPOSIT ABSOLUTE /end AXIS_PTS
/begin AXIS_PTS AXY_KF_FDZW_DYN2 "AXY_KF_FDZW_DYN2" 0x96B9A7C V _REC_A1AXS_1_MBSE_U2 360 AFeDmkb_cAbjmcc_kAkskhd_k__0oa0 4 0 360 FORMAT "%5.0" DEPOSIT ABSOLUTE /end AXIS_PTS
/begin AXIS_PTS AXY_KF_FDZW_DYN3 "AXY_KF_FDZW_DYN3" 0x96B9A54 Dzw_annm _REC_A1AXS_1_MBSE_S2 110 juwcFuc_Dtmczic_mCgfamd_q__aa0o 4 -50 60 FORMAT "%6.1" DEPOSIT ABSOLUTE /end AXIS_PTS
/begin AXIS_PTS AXY_KF_FDZW_DYN4 "AXY_KF_FDZW_DYN4" 0x96B9A74 V _REC_A1AXS_1_MBSE_U2 360 AFeDmkb_cAbjmcc_kAkskhd_k__0oa0 4 0 360 FORMAT "%5.0" DEPOSIT ABSOLUTE /end AXIS_PTS
/begin AXIS_PTS AXY_KF_FDZWT_BEST_PF1 "Factor temperature correction ZW-Best path 1" 0x96ACD6E Tans _REC_A1AXS_1_MBSE_S2 6553.5 ___MGF_CC_TemperatureCelsius_d10 6 -3276.8 3276.7 FORMAT "%6.1" DEPOSIT ABSOLUTE /end AXIS_PTS
/begin AXIS_PTS AXY_KF_FDZWT_BEST_PF2 "Factor temperature correction ZW-Best path 2" 0x96ACD62 Tans _REC_A1AXS_1_MBSE_S2 6553.5 ___MGF_CC_TemperatureCelsius_d10 6 -3276.8 3276.7 FORMAT "%6.1" DEPOSIT ABSOLUTE /end AXIS_PTS
/begin AXIS_PTS AXY_KF_FDZWT_PF1 "AXY_KF_FDZWT_PF1" 0x96ACE2E Tans _REC_A1AXS_1_MBSE_S2 6553.5 ___MGF_CC_TemperatureCelsius_d10 6 -3276.8 3276.7 FORMAT "%6.1" DEPOSIT ABSOLUTE /end AXIS_PTS
/begin AXIS_PTS AXY_KF_FDZWT_PF2 "AXY_KF_FDZWT_PF2" 0x96ACE22 Tans _REC_A1AXS_1_MBSE_S2 6553.5 ___MGF_CC_TemperatureCelsius_d10 6 -3276.8 3276.7 FORMAT "%6.1" DEPOSIT ABSOLUTE /end AXIS_PTS
/begin AXIS_PTS AXY_KF_FRKKORRF_1 "AXY_KF_FRKKORRF_1" 0x968F0CA Rf _REC_A1AXS_1_MBSE_S2 655.35 CgkBooc_wkiDfEd_Czglhgc_fR_1a0o 16 -327.68 327.67 FORMAT "%7.2" DEPOSIT ABSOLUTE /end AXIS_PTS
/begin AXIS_PTS AXY_KF_KOEFF_B_LA "AXY_KF_KOEFF_B_LA" 0x96AD14A NO_INPUT_QUANTITY _REC_A1AXS_1_MBSE_S2 655.35 CgkBooc_wkiDfEd_Czglhgc_fR_1a0o 6 -327.68 327.67 FORMAT "%9.2" DEPOSIT ABSOLUTE /end AXIS_PTS
/begin AXIS_PTS AXY_KF_LA_BEZ "AXY_KF_LA_BEZ" 0x96AD13A NO_INPUT_QUANTITY _REC_A1AXS_1_MBSE_S2 655.35 CgkBooc_wkiDfEd_Czglhgc_fR_1a0o 8 -327.68 327.67 FORMAT "%9.2" DEPOSIT ABSOLUTE /end AXIS_PTS
/begin AXIS_PTS AXY_KF_LAMIN_H "AXY_KF_LAMIN_H" 0x9697958 Rf _REC_A1AXS_1_MBSE_S2 655.35 CgkBooc_wkiDfEd_Czglhgc_fR_1a0o 6 -327.68 327.67 FORMAT "%7.2" DEPOSIT ABSOLUTE /end AXIS_PTS
/begin AXIS_PTS AXY_KF_MD_RES_NST_KEY "AXY_KF_MD_RES_NST_KEY" 0x96A7574 Tmot _REC_A1AXS_1_MBSE_S2 655.35 DchEpAd_DBCFgoa_Ckhahgc_q__aoa0 4 -327.68 327.67 FORMAT "%7.2" DEPOSIT ABSOLUTE /end AXIS_PTS
/begin AXIS_PTS AXY_KF_MDIOP_1_TQE "AXY_KF_MDIOP_1_TQE" 0x96A30A4 Nkw _REC_A1AXS_1_MBSE_S2 65535 caoddzd_oAjpfzb_cAcEEha_1nR_oa0 20 -32768 32767 FORMAT "%5.0" DEPOSIT ABSOLUTE /end AXIS_PTS
/begin AXIS_PTS AXY_KF_MDK_MAX_GANG_NKW "x-axis (NKW_plaus) for KF_MDK_MAX_GANG_NKW" 0x96B8870 Nkw_plaus _REC_A1AXS_1_MBSE_S2 65535 caoddzd_oAjpfzb_cAcEEha_1nR_oa0 8 -32768 32767 FORMAT "%6.0" DEPOSIT ABSOLUTE /end AXIS_PTS
/begin AXIS_PTS AXY_KF_PHA_H_E1 "AXY_KF_PHA_H_E1" 0x9691BD0 NO_INPUT_QUANTITY _REC_A1AXS_1_MBSE_S2 3199.951171875 zyyxBpb_rEsnvtc_gktukCa_fR_5a0o 8 -1600 1599.951171875 DEPOSIT ABSOLUTE /end AXIS_PTS
/begin AXIS_PTS AXY_KF_PRAIL_H "AXY_KF_PRAIL_H" 0x969DA42 BMWrailco_rat_VabHom_sw _REC_A1AXS_1_MBSE_S2 3199.951171875 zyyxBpb_rEsnvtc_gktukCa_fR_5a0o 8 -1600 1599.951171875 FORMAT "%8.3" DEPOSIT ABSOLUTE /end AXIS_PTS
/begin AXIS_PTS AXY_KF_PRAIL_H_K "AXY_KF_PRAIL_H_K" 0x969DA02 BMWrailco_rat_VabHom_sw _REC_A1AXS_1_MBSE_S2 3199.951171875 zyyxBpb_rEsnvtc_gktukCa_fR_5a0o 8 -1600 1599.951171875 FORMAT "%8.3" DEPOSIT ABSOLUTE /end AXIS_PTS
/begin AXIS_PTS AXY_KF_PRAIL_HGD "axis" 0x969DA22 BMWrailco_rat_VabHom_sw _REC_A1AXS_1_MBSE_S2 3199.951171875 zyyxBpb_rEsnvtc_gktukCa_fR_5a0o 8 -1600 1599.951171875 FORMAT "%8.3" DEPOSIT ABSOLUTE /end AXIS_PTS
/begin AXIS_PTS AXY_KF_PRAIL_HGD_K "axis" 0x969DA12 BMWrailco_rat_VabHom_sw _REC_A1AXS_1_MBSE_S2 3199.951171875 zyyxBpb_rEsnvtc_gktukCa_fR_5a0o 8 -1600 1599.951171875 FORMAT "%8.3" DEPOSIT ABSOLUTE /end AXIS_PTS
/begin AXIS_PTS AXY_KF_ST_RKBAS_GD "AXY_KF_ST_RKBAS_GD" 0x96BA3C6 BMWinj_t_Eng_sw _REC_A1AXS_1_MBSE_S2 655.35 DchEpAd_DBCFgoa_Ckhahgc_q__aoa0 10 -327.68 327.67 FORMAT "%7.2" DEPOSIT ABSOLUTE /end AXIS_PTS
/begin AXIS_PTS AXY_KF_ST_RKBAS_VVT "AXY_KF_ST_RKBAS_VVT" 0x96BA25C BMWinj_t_Eng_sw _REC_A1AXS_1_MBSE_S2 655.35 DchEpAd_DBCFgoa_Ckhahgc_q__aoa0 12 -327.68 327.67 FORMAT "%7.2" DEPOSIT ABSOLUTE /end AXIS_PTS
/begin AXIS_PTS AXY_KF_TA_ATLSOLL "AXY_KF_TA_ATLSOLL" 0x96928DC Rf_atm _REC_A1AXS_1_MBSE_S2 655.35 CgkBooc_wkiDfEd_Czglhgc_fR_1a0o 4 -327.68 327.67 DEPOSIT ABSOLUTE /end AXIS_PTS
/begin AXIS_PTS AXY_KF_TA_IKSOLL "AXY_KF_EXIT" 0x96928D4 Rf_atm _REC_A1AXS_1_MBSE_S2 655.35 CgkBooc_wkiDfEd_Czglhgc_fR_1a0o 4 -327.68 327.67 DEPOSIT ABSOLUTE /end AXIS_PTS
/begin AXIS_PTS AXY_KF_TA_VKSOLL "AXY_KF_TA_VKSOLL" 0x96928CC Rf_atm _REC_A1AXS_1_MBSE_S2 655.35 CgkBooc_wkiDfEd_Czglhgc_fR_1a0o 4 -327.68 327.67 DEPOSIT ABSOLUTE /end AXIS_PTS
/begin AXIS_PTS AXY_KF_TD_FETTDELAY_TABG "AXY_KF_TD_FETTDELAY_TABG" 0x96BAD54 Nkw _REC_A1AXS_1_MBSE_S2 6554 caoddzd_oAjpfzb_cAcEEha_1nR_oa0 4 -3277 3277 FORMAT "%5.0" DEPOSIT ABSOLUTE /end AXIS_PTS
/begin AXIS_PTS AXY_KF_ZW_PF1 "AXY_KF_ZW_PF1" 0x96ACBC8 NO_INPUT_QUANTITY _REC_A1AXS_1_MBSE_S2 655.35 CgkBooc_wkiDfEd_Czglhgc_fR_1a0o 16 -327.68 327.67 FORMAT "%9.2" DEPOSIT ABSOLUTE /end AXIS_PTS
/begin AXIS_PTS AXY_KF_ZW_PF2 "AXY_KF_ZW_PF2" 0x96ACBA8 NO_INPUT_QUANTITY _REC_A1AXS_1_MBSE_S2 655.35 CgkBooc_wkiDfEd_Czglhgc_fR_1a0o 16 -327.68 327.67 FORMAT "%9.2" DEPOSIT ABSOLUTE /end AXIS_PTS
/begin AXIS_PTS AXY_KF_ZW_S_PF1 "AXY_KF_ZW_S_PF1" 0x96ACB88 NO_INPUT_QUANTITY _REC_A1AXS_1_MBSE_S2 655.35 CgkBooc_wkiDfEd_Czglhgc_fR_1a0o 16 -327.68 327.67 FORMAT "%9.2" DEPOSIT ABSOLUTE /end AXIS_PTS
/begin AXIS_PTS AXY_KF_ZW_S_PF2 "AXY_KF_ZW_S_PF2" 0x96ACB68 NO_INPUT_QUANTITY _REC_A1AXS_1_MBSE_S2 655.35 CgkBooc_wkiDfEd_Czglhgc_fR_1a0o 16 -327.68 327.67 FORMAT "%9.2" DEPOSIT ABSOLUTE /end AXIS_PTS
/begin AXIS_PTS AXY_KF_ZW_UESP_PF1 "AXY_KF_ZW_UESP_PF1" 0x96ACB4C NO_INPUT_QUANTITY _REC_A1AXS_1_MBSE_S2 655.35 CgkBooc_wkiDfEd_Czglhgc_fR_1a0o 14 -327.68 327.67 FORMAT "%9.2" DEPOSIT ABSOLUTE /end AXIS_PTS
/begin AXIS_PTS AXY_KF_ZW_UESP_PF2 "AXY_KF_ZW_UESP_PF2" 0x96ACB30 NO_INPUT_QUANTITY _REC_A1AXS_1_MBSE_S2 655.35 CgkBooc_wkiDfEd_Czglhgc_fR_1a0o 14 -327.68 327.67 FORMAT "%9.2" DEPOSIT ABSOLUTE /end AXIS_PTS
/begin AXIS_PTS AXY_KF_ZW_VP_PF1 "AXY_KF_ZW_VP_PF1" 0x96BAFAA Rf_zwv _REC_A1AXS_1_MBSE_S2 655.35 CgkBooc_wkiDfEd_Czglhgc_fR_1a0o 16 -327.68 327.67 FORMAT "%9.2" DEPOSIT ABSOLUTE /end AXIS_PTS
/begin AXIS_PTS AXY_KF_ZW_VP_PF2 "AXY_KF_ZW_VP_PF2" 0x96BAF8A Rf_zwv _REC_A1AXS_1_MBSE_S2 655.35 CgkBooc_wkiDfEd_Czglhgc_fR_1a0o 16 -327.68 327.67 FORMAT "%9.2" DEPOSIT ABSOLUTE /end AXIS_PTS
/begin AXIS_PTS AXY_KF_ZWMIN_KSOT "AXY_KF_ZWMIN_KSOT" 0x96B9FB2 NO_INPUT_QUANTITY _REC_A1AXS_1_MBSE_S2 655.35 CgkBooc_wkiDfEd_Czglhgc_fR_1a0o 8 -327.68 327.67 FORMAT "%9.4" DEPOSIT ABSOLUTE /end AXIS_PTS
/begin AXIS_PTS AXY_KF_ZWMIN_WSOT "AXY_KF_ZWMIN_WSOT" 0x96B9FA2 NO_INPUT_QUANTITY _REC_A1AXS_1_MBSE_S2 655.35 CgkBooc_wkiDfEd_Czglhgc_fR_1a0o 8 -327.68 327.67 FORMAT "%9.4" DEPOSIT ABSOLUTE /end AXIS_PTS
/begin AXIS_PTS BMWchas_lam_InjMpl_Ax "Catalyst heating after start() a/fratio (lambda)(lambda) injection multiple axis x direction " 0x96B0270 Nkw _REC_A1AXS_1_MBSE_S2 65535 caoddzd_oAjpfzb_cAcEEha_1nR_oa0 10 -32768 32767 FORMAT "%5.0" DEPOSIT ABSOLUTE /end AXIS_PTS
/begin AXIS_PTS BMWchas_lam_InjMpl_Ay "Catalyst heating after start() a/fratio (lambda)(lambda) injection(injection) multiple(multiple) axis y direction (Y-axis) " 0x96AFFDC BMWchas_tq_CmbEng_sw _REC_A1AXS_1_MBSE_S2 6553.5 Mo_trq_nm_q0p1 10 -3276.8 3276.7 FORMAT "%6.1" DEPOSIT ABSOLUTE /end AXIS_PTS
/begin AXIS_PTS BMWchas_lam_InjMplThr_Ax "Catalyst heating after start() a/fratio (lambda)(lambda) injection multiple throttle axis x direction " 0x96B0284 Nkw _REC_A1AXS_1_MBSE_S2 65535 caoddzd_oAjpfzb_cAcEEha_1nR_oa0 10 -32768 32767 FORMAT "%5.0" DEPOSIT ABSOLUTE /end AXIS_PTS
/begin AXIS_PTS BMWchas_lam_InjMplThr_Ay "Catalyst heating after start() a/fratio (lambda)(lambda) injection(injection) multiple(multiple) throttle(throttle, throttling) axis y direction (Y-axis) " 0x96AFFF0 BMWchas_tq_CmbEng_sw _REC_A1AXS_1_MBSE_S2 6553.5 Mo_trq_nm_q0p1 10 -3276.8 3276.7 FORMAT "%6.1" DEPOSIT ABSOLUTE /end AXIS_PTS
/begin AXIS_PTS BMWchas_lam_InjSng_Ax "Catalyst heating after start() a/fratio (lambda)(lambda) injection single axis x direction " 0x96B0238 Nkw _REC_A1AXS_1_MBSE_S2 65535 caoddzd_oAjpfzb_cAcEEha_1nR_oa0 10 -32768 32767 FORMAT "%5.0" DEPOSIT ABSOLUTE /end AXIS_PTS
/begin AXIS_PTS BMWchas_lam_InjSng_Ay "Catalyst heating after start() a/fratio (lambda)(lambda) injection(injection) single(single) axis y direction (Y-axis) " 0x96AFFA4 BMWchas_tq_CmbEng_sw _REC_A1AXS_1_MBSE_S2 6553.5 Mo_trq_nm_q0p1 10 -3276.8 3276.7 FORMAT "%6.1" DEPOSIT ABSOLUTE /end AXIS_PTS
/begin AXIS_PTS BMWchas_lam_InjSngThr_Ax "Catalyst heating after start() a/fratio (lambda)(lambda) injection single throttle axis x direction " 0x96B024C Nkw _REC_A1AXS_1_MBSE_S2 65535 caoddzd_oAjpfzb_cAcEEha_1nR_oa0 10 -32768 32767 FORMAT "%5.0" DEPOSIT ABSOLUTE /end AXIS_PTS
/begin AXIS_PTS BMWchas_lam_InjSngThr_Ay "Catalyst heating after start() a/fratio (lambda)(lambda) injection(injection) single(single) throttle(throttle, throttling) axis y direction (Y-axis) " 0x96AFFB8 BMWchas_tq_CmbEng_sw _REC_A1AXS_1_MBSE_S2 6553.5 Mo_trq_nm_q0p1 10 -3276.8 3276.7 FORMAT "%6.1" DEPOSIT ABSOLUTE /end AXIS_PTS
/begin AXIS_PTS BMWchas_p_RailInjMpl_Ax "Catalyst heating after start() pressure rail (rail, line; meant for common rail injection) injection multiple axis x direction (X-axis) " 0x96B022C Nkw _REC_A1AXS_1_MBSE_S2 65535 caoddzd_oAjpfzb_cAcEEha_1nR_oa0 6 -32768 32767 FORMAT "%5.0" DEPOSIT ABSOLUTE /end AXIS_PTS
/begin AXIS_PTS BMWchas_p_RailInjMpl_Ay "Catalyst heating after start() pressure(pressure) rail(rail, line; meant for the common rail injection) injection(injection) multiple(multiple) axis y direction (Y-axis) " 0x96AFE48 BMWrailco_rat_VabHom_sw _REC_A1AXS_1_MBSE_S2 3199.951171875 zyyxBpb_rEsnvtc_gktukCa_fR_5a0o 6 -1600 1599.951171875 FORMAT "%8.3" DEPOSIT ABSOLUTE /end AXIS_PTS
/begin AXIS_PTS BMWchas_p_RailInjSng_Ax "Catalyst heating after start() pressure rail (rail, line; meant for common rail injection) injection single axis x direction (X-axis) " 0x96B021C Nkw _REC_A1AXS_1_MBSE_S2 65535 caoddzd_oAjpfzb_cAcEEha_1nR_oa0 8 -32768 32767 FORMAT "%5.0" DEPOSIT ABSOLUTE /end AXIS_PTS
/begin AXIS_PTS BMWchas_p_RailInjSng_Ay "Catalyst heating after start() pressure(pressure) rail(rail, line; meant for the common rail injection) injection(injection) single(single) axis y direction (Y-axis) " 0x96AFE38 BMWrailco_rat_VabHom_sw _REC_A1AXS_1_MBSE_S2 3199.951171875 zyyxBpb_rEsnvtc_gktukCa_fR_5a0o 8 -1600 1599.951171875 FORMAT "%8.3" DEPOSIT ABSOLUTE /end AXIS_PTS
/begin AXIS_PTS BMWchas_st_OpmBasc_Ax "Catalyst heating after start() status, state(status, state, bit line) operating mode(operating mode) basic(basic) axis x direction (X-axis) " 0x968BCC6 BMWchas_ti_AftStrSca_uw _REC_A1AXS_1_MBSE_U2 255.99609375 noCyFga_rslwmfa_ecfnhgc_sR_2a0o 8 0 255.99609375 DEPOSIT ABSOLUTE /end AXIS_PTS
/begin AXIS_PTS BMWchas_st_OpmBasc_Ay "Catalyst heating after start() status, state(status, state, bit line) operating mode(operating mode) basic(basic) axis y direction (Y-axis) " 0x968BD42 BMWchas_t_EngStr_sw _REC_A1AXS_1_MBSE_S2 6553.5 ___MGF_CC_TemperatureCelsius_d10 8 -3276.8 3276.7 DEPOSIT ABSOLUTE /end AXIS_PTS
/begin AXIS_PTS BMWchas_tq_ResExhFlpClsd_Ax "Catalyst heating after start() torque result exhausted flap closed axis x direction" 0x96B013C Nkw _REC_A1AXS_1_MBSE_S2 65535 caoddzd_oAjpfzb_cAcEEha_1nR_oa0 8 -32768 32767 FORMAT "%5.0" DEPOSIT ABSOLUTE /end AXIS_PTS
/begin AXIS_PTS BMWext_lam_CptPronMinLeanTq_Ax "exhaust temperature model a/fratio (lambda)(Lambda) component protection minimum lean lean torque axis x direction" 0x96926B2 Nkw_atm _REC_A1AXS_1_MBSE_S2 65535 caoddzd_oAjpfzb_cAcEEha_1nR_oa0 8 -32768 32767 DEPOSIT ABSOLUTE /end AXIS_PTS
/begin AXIS_PTS BMWext_lam_CptPronMinLeanTq_Ay "exhaust temperature model(Exhaust temperature model) a/fratio (lambda)(Lambda) component(Component, Component) protection(Protection) minimum(Minimum, Min) lean(Lean, Tight) torque(Torque) axis y direction(Y-axis)" 0x969266C Rf_atm _REC_A1AXS_1_MBSE_S2 655.35 CgkBooc_wkiDfEd_Czglhgc_fR_1a0o 8 -327.68 327.67 DEPOSIT ABSOLUTE /end AXIS_PTS
/begin AXIS_PTS BMWgpfheat_p_RailInjMpl_Ax "Catalyst heating after start() pressure rail (rail, line; meant for common rail injection) injection multiple axis x direction (X-axis) " 0x9695208 Nkw _REC_A1AXS_1_MBSE_S2 65535 caoddzd_oAjpfzb_cAcEEha_1nR_oa0 6 -32768 32767 FORMAT "%5.0" DEPOSIT ABSOLUTE /end AXIS_PTS
/begin AXIS_PTS BMWgpfheat_p_RailInjMpl_Ay "Catalyst heating after start() pressure(pressure) rail(rail, line; meant for the common rail injection) injection(injection) multiple(multiple) axis y direction (Y-axis) " 0x9695118 BMWrailco_rat_VabHom_sw _REC_A1AXS_1_MBSE_S2 3199.951171875 zyyxBpb_rEsnvtc_gktukCa_fR_5a0o 6 -1600 1599.951171875 FORMAT "%8.3" DEPOSIT ABSOLUTE /end AXIS_PTS
/begin AXIS_PTS BMWgpfheat_p_RailInjSng_Ax "Catalyst heating after start() pressure rail (rail, line; meant for common rail injection) injection multiple axis x direction (X-axis) " 0x96951FC Nkw _REC_A1AXS_1_MBSE_S2 65535 caoddzd_oAjpfzb_cAcEEha_1nR_oa0 6 -32768 32767 FORMAT "%5.0" DEPOSIT ABSOLUTE /end AXIS_PTS
/begin AXIS_PTS BMWgpfheat_p_RailInjSng_Ay "Catalyst heating after start() pressure(pressure) rail(rail, line; meant for the common rail injection) injection(injection) multiple(multiple) axis y direction (Y-axis) " 0x969510C BMWrailco_rat_VabHom_sw _REC_A1AXS_1_MBSE_S2 3199.951171875 zyyxBpb_rEsnvtc_gktukCa_fR_5a0o 6 -1600 1599.951171875 FORMAT "%8.3" DEPOSIT ABSOLUTE /end AXIS_PTS
/begin AXIS_PTS BMWgpfheat_tq_ResExhFlpClsd_Ax "Catalyst heating after start() torque result exhausted flap closed axis x direction" 0x96951EC Nkw _REC_A1AXS_1_MBSE_S2 65535 caoddzd_oAjpfzb_cAcEEha_1nR_oa0 8 -32768 32767 FORMAT "%5.0" DEPOSIT ABSOLUTE /end AXIS_PTS
/begin AXIS_PTS BMWinjafs_fac_RatAirMax_Ax "Characteristic curve axis upper limit Rf for L-stoich adaptation" 0x968EE80 Nkw _REC_A1AXS_1_MBSE_S2 65535 caoddzd_oAjpfzb_cAcEEha_1nR_oa0 6 -32768 32767 FORMAT "%5.0" DEPOSIT ABSOLUTE /end AXIS_PTS
/begin AXIS_PTS BMWinjmon_fac_HppEff_Ax "Injection map factor efficiency high-pressure pump (X-axis)" 0x96B118E Nkw _REC_A1AXS_1_MBSE_S2 65535 caoddzd_oAjpfzb_cAcEEha_1nR_oa0 8 -32768 32767 FORMAT "%5.0" DEPOSIT ABSOLUTE /end AXIS_PTS
/begin AXIS_PTS BMWinjmon_fac_HppEff_Ay "Injection map factor efficiency high-pressure pump (Y-axis)" 0x96B116E Prail_ist _REC_A1AXS_1_MBSE_U2 39.9993896484375 cxdjuna_xpuCged_ocEpdua_MCRa2a0 4 0 39.9993896484375 FORMAT "%9.4" DEPOSIT ABSOLUTE /end AXIS_PTS
/begin AXIS_PTS BMWlpa_n_EfpEngStrtAmb_Ax "EKP Speed ??Default Start Environment X-Axis" 0x9694252 Tumg _REC_A1AXS_1_MBSE_S2 6553.5 ___MGF_CC_TemperatureCelsius_d10 4 -3276.8 3276.7 FORMAT "%6.1" DEPOSIT ABSOLUTE /end AXIS_PTS
/begin AXIS_PTS BMWlpa_n_EfpEngStrtAmb_Ay "EKP speed default start environment Y-axis" 0x969424A Pumg _REC_A1AXS_1_MBSE_U2 8191.875 ___MGF_CC_PressurehPa_d8 4 0 8191.875 FORMAT "%8.3" DEPOSIT ABSOLUTE /end AXIS_PTS
/begin AXIS_PTS BMWlpa_n_EfpEngStrtPRail_Ax "EKP speed default start rail pressure x-axis" 0x9694246 Prail_ist _REC_A1AXS_1_MBSE_U2 39.9993896484375 cxdjuna_xpuCged_ocEpdua_MCRa2a0 2 0 39.9993896484375 FORMAT "%9.4" DEPOSIT ABSOLUTE /end AXIS_PTS
/begin AXIS_PTS BMWlpa_n_EfpModSafe_Ax "EKP speed setting safe mode X-axis" 0x9694262 BMWlpi_t_Fu_sw _REC_A1AXS_1_MBSE_S2 655.35 DchEpAd_DBCFgoa_Ckhahgc_q__aoa0 4 -327.68 327.67 FORMAT "%5.2" DEPOSIT ABSOLUTE /end AXIS_PTS
/begin AXIS_PTS BMWlpa_n_EfpModSafe_Ay "EKP speed setting safe mode Y-axis" 0x969425A BMWlpi_volf_Fu_sw _REC_A1AXS_1_MBSE_S2 655.35 zBcBzad_vmoivka_mFzjCgc_lCRooa0 4 -327.68 327.67 FORMAT "%5.2" DEPOSIT ABSOLUTE /end AXIS_PTS
/begin AXIS_PTS BMWlpsc_p_HppMax_Ax "axis" 0x96B2408 BMWlpi_volf_Fu_sw _REC_A1AXS_1_MBSE_S2 655.35 zBcBzad_vmoivka_mFzjCgc_lCRooa0 4 -327.68 327.67 FORMAT "%5.2" DEPOSIT ABSOLUTE /end AXIS_PTS
/begin AXIS_PTS BMWlpsc_volf_FuEjrPmp_Ax "axis" 0x969476E BMWlpsc_p_EfpSpCtld_uw _REC_A1AXS_1_MBSE_U2 65.535 rgduxyd_mlihaBb_gsCghzb_bCRa0a0 8 0 65.535 FORMAT "%5.3" DEPOSIT ABSOLUTE /end AXIS_PTS
/begin AXIS_PTS BMWlpsc_volf_FuEjrPmp_Ay "axis" 0x96BDBC4 BMWlpsc_st_TankCod_ub _REC_A1AXS_1_MBSE_U1 255 raChrxc_kBtBrmb_FmDuEFa_n__aa0o 4 0 255 FORMAT "%3.0" DEPOSIT ABSOLUTE /end AXIS_PTS
/begin AXIS_PTS BMWlpsd_p_RailDifMax_Ax "axis" 0x96947FA Prail_ist _REC_A1AXS_1_MBSE_U2 39.9993896484375 cxdjuna_xpuCged_ocEpdua_MCRa2a0 4 0 39.9993896484375 FORMAT "%9.4" DEPOSIT ABSOLUTE /end AXIS_PTS
/begin AXIS_PTS BMWls_fac_rf_RednFuOctIntkT_Ax "Support points for filling reduction factor depending on fuel quality." 0x96BE4B8 F_octan _REC_A1AXS_1_MBSE_U1 0.99609375 BpaECzb_zweffod_enenhgc_nR_2a0o 6 0 0.99609375 FORMAT "%6.1" DEPOSIT ABSOLUTE /end AXIS_PTS
/begin AXIS_PTS BMWls_fac_rf_RednFuOctIntkT_Ay "Support points for filling reduction factor depending on the intake air temperature." 0x969A2CA Tans _REC_A1AXS_1_MBSE_S2 6553.5 ___MGF_CC_TemperatureCelsius_d10 6 -3276.8 3276.7 FORMAT "%6.1" DEPOSIT ABSOLUTE /end AXIS_PTS
/begin AXIS_PTS BMWls_pct_FiMaxIgOfs_Gx "Filling limitation characteristic curve depending on ignition angle retard" 0x969A2EE Nkw _REC_A1AXS_1_MBSE_S2 65535 caoddzd_oAjpfzb_cAcEEha_1nR_oa0 10 -32768 32767 FORMAT "%5.0" DEPOSIT ABSOLUTE /end AXIS_PTS
/begin AXIS_PTS BMWls_pct_FiMaxIgOfs_Gy "Filling limitation characteristic curve depending on ignition angle retard" 0x969A2BA Dzw_tot_kr _REC_A1AXS_1_MBSE_S2 6553.5 juwcFuc_Dtmczic_mCgfamd_q__aa0o 8 -3276.8 3276.7 FORMAT "%6.1" DEPOSIT ABSOLUTE /end AXIS_PTS
/begin AXIS_PTS BMWls_rf_MaxEgT_Ax "Nkw" 0x969A2E2 Nkw _REC_A1AXS_1_MBSE_S2 65535 caoddzd_oAjpfzb_cAcEEha_1nR_oa0 6 -32768 32767 FORMAT "%5.0" DEPOSIT ABSOLUTE /end AXIS_PTS
/begin AXIS_PTS BMWls_rf_MaxEgT_Ay "Nkw" 0x969A2D6 Frfmxbsld _REC_A1AXS_1_MBSE_U2 1.99996948242188 Bhvfwhc_bigEubd_BBEupBd_nR_3oa0 6 0 1.99996948242188 FORMAT "%14.5" DEPOSIT ABSOLUTE /end AXIS_PTS
/begin AXIS_PTS BMWls_rf_MaxFuOctIntkT_Gy "Group support point for filling reduction factor" 0x969A2AA BMWls_fac_rf_RedFil_uw _REC_A1AXS_1_MBSE_U2 0.999984741210938 FzbmlAa_gCtylrb_ckCqxAc_nR_6oa0 8 0 0.999984741210938 FORMAT "%7.5" DEPOSIT ABSOLUTE /end AXIS_PTS
/begin AXIS_PTS BMWtchctr_fac_pwr_CompLimPctl_Ax "AXX_KL_F_PTURBVST" 0x96B84CE BMWtchsp_mf_CmprNorm_uw _REC_A1AXS_1_MBSE_U2 2047.96875 CByjozc_eCmpBAb_pljBAmd_k__0oa0 6 0 2047.96875 FORMAT "%10.3" DEPOSIT ABSOLUTE /end AXIS_PTS
/begin AXIS_PTS BMWtchctr_pwr_Dp_Ax "AXX_KF_PATLR_D" 0x96B7F54 BMWtchbas_p_Dif_sw _REC_A1AXS_1_MBSE_S2 8191.875 ___MGF_CC_PressurehPa_d8 14 -4096 4095.875 FORMAT "%10.3" DEPOSIT ABSOLUTE /end AXIS_PTS
/begin AXIS_PTS BMWtchctr_pwr_Dp_Ay "AXY_KF_PATLR_D" 0x96B7F38 BMWtchbas_p_DifGra_sw _REC_A1AXS_1_MBSE_S2 8191.875 ___MGF_CC_PressurehPa_d8 14 -4096 4095.875 FORMAT "%10.3" DEPOSIT ABSOLUTE /end AXIS_PTS
/begin AXIS_PTS BMWtchctr_rat_p_ComprLimPctl_Ax "AXX_KL_FPLDSVLD_MN_DIS" 0x96B84B6 BMWtchsp_mf_CmprNorm_uw _REC_A1AXS_1_MBSE_U2 2047.96875 CByjozc_eCmpBAb_pljBAmd_k__0oa0 12 0 2047.96875 FORMAT "%10.3" DEPOSIT ABSOLUTE /end AXIS_PTS
/begin AXIS_PTS BMWtchctr_t_ExGasMdl_Ax "AXX_KF_TABGATL" 0x96B845A Nkw _REC_A1AXS_1_MBSE_S2 65535 caoddzd_oAjpfzb_cAcEEha_1nR_oa0 6 -32768 32767 FORMAT "%5.0" DEPOSIT ABSOLUTE /end AXIS_PTS
/begin AXIS_PTS BMWtchctr_t_ExGasMdl_Ay "AXY_KF_TABGATL" 0x96B83F2 Rf _REC_A1AXS_1_MBSE_S2 655.35 CgkBooc_wkiDfEd_Czglhgc_fR_1a0o 6 -327.68 327.67 FORMAT "%7.2" DEPOSIT ABSOLUTE /end AXIS_PTS
/begin AXIS_PTS BMWtchctr_t_ExGasMdlScav_Ax "AXX_KF_TABGATL" 0x96B8466 Nkw _REC_A1AXS_1_MBSE_S2 65535 caoddzd_oAjpfzb_cAcEEha_1nR_oa0 6 -32768 32767 FORMAT "%5.0" DEPOSIT ABSOLUTE /end AXIS_PTS
/begin AXIS_PTS BMWtchctr_t_ExGasMdlScav_Ay "AXY_KF_TABGATL" 0x96B83FE Rf _REC_A1AXS_1_MBSE_S2 655.35 CgkBooc_wkiDfEd_Czglhgc_fR_1a0o 6 -327.68 327.67 FORMAT "%7.2" DEPOSIT ABSOLUTE /end AXIS_PTS
/begin AXIS_PTS BMWtchob_fac_tq_Delt_Ax "AXX_KL_FDMDMX_OB" 0x969E000 Tans _REC_A1AXS_1_MBSE_S2 6553.5 ___MGF_CC_TemperatureCelsius_d10 4 -3276.8 3276.7 FORMAT "%6.1" DEPOSIT ABSOLUTE /end AXIS_PTS
/begin AXIS_PTS BMWtchsp_fac_FilPRatCmpr_Ax "AXX_KL_FK_PLDSVLD" 0x969E336 BMWtchsp_mf_CmprNorm_uw _REC_A1AXS_1_MBSE_U2 2047.96875 CByjozc_eCmpBAb_pljBAmd_k__0oa0 4 0 2047.96875 FORMAT "%10.3" DEPOSIT ABSOLUTE /end AXIS_PTS
/begin AXIS_PTS BMWtchsp_fac_mf_FilCmprNorm_Ax "AXX_KL_FK_MSSOLATL" 0x969E374 NO_INPUT_QUANTITY _REC_A1AXS_1_MBSE_U2 2047.96875 CByjozc_eCmpBAb_pljBAmd_k__0oa0 4 0 2047.96875 FORMAT "%10.3" DEPOSIT ABSOLUTE /end AXIS_PTS
/begin AXIS_PTS BMWtchsp_rat_p_CmprMax_Ax "AXX_KF_FPLDMAX" 0x969E316 BMWtchsp_mf_CmprNorm_uw _REC_A1AXS_1_MBSE_U2 2047.96875 CByjozc_eCmpBAb_pljBAmd_k__0oa0 8 0 2047.96875 FORMAT "%10.3" DEPOSIT ABSOLUTE /end AXIS_PTS
/begin AXIS_PTS BMWtchsp_rat_p_CmprMax_Ay "AXY_KF_FPLDMAX" 0x969E2FA BMWtchtbc_t_BefCmpr_sw _REC_A1AXS_1_MBSE_S2 6553.5 ___MGF_CC_TemperatureCelsius_d10 6 -3276.8 3276.7 FORMAT "%6.1" DEPOSIT ABSOLUTE /end AXIS_PTS
/begin AXIS_PTS BMWtchsp_rat_p_CmprPmp_Ax "AXX_KL_FPLDPUMP" 0x969E306 BMWtchsp_mf_CmprNorm_uw _REC_A1AXS_1_MBSE_U2 2047.96875 CByjozc_eCmpBAb_pljBAmd_k__0oa0 8 0 2047.96875 FORMAT "%10.3" DEPOSIT ABSOLUTE /end AXIS_PTS
/begin AXIS_PTS BMWtchsp_rf_Liho_Ax "AXX_KL_LAMX" 0x969E33E NO_INPUT_QUANTITY _REC_A1AXS_1_MBSE_S2 65535 caoddzd_oAjpfzb_cAcEEha_1nR_oa0 6 -32768 32767 FORMAT "%5.0" DEPOSIT ABSOLUTE /end AXIS_PTS
/begin AXIS_PTS BMWtqe_b_SptDet4NoiseAcvn_Ax "Torque Engine(torque combustion engine) bit, boolean, flag, binary message or variable(log. condition) sport(sport) detection(detection) four(four) noise(noise) activation(activation) axis x direction(X-axis)" 0x96C0928 Status_usecase_antr _REC_A1AXS_1_MBSE_U1 11 raChrxc_kBtBrmb_FmDuEFa_n__aa0o 12 0 11 FORMAT "%6.0" DEPOSIT ABSOLUTE /end AXIS_PTS
/begin AXIS_PTS BMWtqe_b_SptDet4NoiseAcvn_Ay "Torque Engine(Torque combustion engine) bit, boolean, flag, binary message or variable(log. condition) sport(Sport) detection(Detection) four(Four, 4) noise(Noise) activation(Activation) axis y direction(Y-axis)" 0x96C0924 St_dsc_can _REC_A1AXS_1_MBSE_U1 11 raChrxc_kBtBrmb_FmDuEFa_n__aa0o 4 0 11 FORMAT "%3.0" DEPOSIT ABSOLUTE /end AXIS_PTS
/begin AXIS_PTS BMWtqe_tqc_FlApplStg_Ax "Torque Engine torque crank shaft fulload application Stage axis x direction" 0x96A6F16 Nkw_ref _REC_A1AXS_1_MBSE_S2 65535 caoddzd_oAjpfzb_cAcEEha_1nR_oa0 18 -32768 32767 DEPOSIT ABSOLUTE /end AXIS_PTS
/begin AXIS_PTS GXX_KF_LABAS "X axis groups for KF_LABASxxx and KF_LA_SK" 0x96BAD30 Nkw _REC_A1AXS_1_MBSE_S2 65535 caoddzd_oAjpfzb_cAcEEha_1nR_oa0 18 -32768 32767 FORMAT "%5.0" DEPOSIT ABSOLUTE /end AXIS_PTS
/begin AXIS_PTS GXX_KF_PHA_H_B1_BAS "GXX_KF_PHA_H_B1_BAS" 0x9690808 Nkw _REC_A1AXS_1_MBSE_S2 65535 caoddzd_oAjpfzb_cAcEEha_1nR_oa0 10 -32768 32767 FORMAT "%5.0" DEPOSIT ABSOLUTE /end AXIS_PTS
/begin AXIS_PTS GXY_KF_LABAS "Groups Y axis for KF_LABASxxx and KF_LA_SK" 0x96BAD0E Rf _REC_A1AXS_1_MBSE_S2 655.35 CgkBooc_wkiDfEd_Czglhgc_fR_1a0o 17 -327.68 327.67 FORMAT "%7.2" DEPOSIT ABSOLUTE /end AXIS_PTS
/begin AXIS_PTS GXY_KF_PHA_H_B1_BAS "GXY_KF_PHA_H_B1_BAS Input Rk_soll_h_xlb" 0x96907D0 NO_INPUT_QUANTITY _REC_A1AXS_1_MBSE_S2 3199.951171875 zyyxBpb_rEsnvtc_gktukCa_fR_5a0o 12 -1600 1599.951171875 FORMAT "%8.3" DEPOSIT ABSOLUTE /end AXIS_PTS
/begin AXIS_PTS IKCtl_LoadAdd04_X_AX "Support point distribution relative filling, 4 Sst." 0x96EFD13 rl_msg Axis_Xu8 191.3 rel_ub_q0p75 4 0 191.3 FORMAT "%5.1" DEPOSIT ABSOLUTE /end AXIS_PTS
/begin AXIS_PTS IKCtl_nEngB16_X_AX "KR: Support point distribution speed of group B" 0x96EFD54 Epm_nEng Axis_Xs16 32767.5 EngN 16 -16384 16383.5 FORMAT "%8.2" DEPOSIT ABSOLUTE /end AXIS_PTS
/begin AXIS_PTS SNM08HDUW "SST distribution for engine speed" 0x96F75A2 NO_INPUT_QUANTITY Axis_Xu16 16383.75 nmot_sw_q0p25 8 0 16383.75 FORMAT "%8.2" DEPOSIT ABSOLUTE /end AXIS_PTS
/begin AXIS_PTS SPD06HDSW "SST distribution for control difference rail pressure" 0x96EF6B2 FuPHi_pHpRglnDeLoc Axis_Xs16 131.07 RBPtCel_p_0p002_1 6 -65.536 65.534 FORMAT "%8.5" DEPOSIT ABSOLUTE /end AXIS_PTS
/begin CHARACTERISTIC AKR_dmHFMThdMin_C "Minimum threshold for HFM value to close exhaust flap" VALUE 0x96E501E GkfWU16 6553.5 asfzqDd_xfCuqha_hliBAmd_k__0oa0 0 6553.5 FORMAT "%8.3" /end CHARACTERISTIC
/begin CHARACTERISTIC AKR_stSpt_C "Status Sports mode" VALUE 0x96E524C FklWUb 255 DEZ 0 255 FORMAT "%5.1" /end CHARACTERISTIC
/begin CHARACTERISTIC Antilag_ActivationDelay___MGF_CC_PF "Activation delay" VALUE 0x9774F24 GkfWU16 655.35 camcxxd_bxlpdsa_Cshlhgc_sR_1a0o 0 60 /end CHARACTERISTIC
/begin CHARACTERISTIC Antilag_CoolantTempMax___MGF_CC_PF "Maximum coolant temperature" VALUE 0x9774F1C GkfWU16 255 DchEpAd_DBCFgoa_Ckhahgc_q__aoa0 -300 300 FORMAT "%7.0" PHYS_UNIT "-" /end CHARACTERISTIC
/begin CHARACTERISTIC Antilag_CoolantTempMin___MGF_CC_PF "Minimum coolant temperature" VALUE 0x9774F1A GkfWU16 255 DchEpAd_DBCFgoa_Ckhahgc_q__aoa0 -300 300 FORMAT "%7.0" PHYS_UNIT "-" /end CHARACTERISTIC
/begin CHARACTERISTIC Antilag_CutMethod___MGF_CC_PF "Method used to hold engine speed: 0 = fuel cut (bit of stuttering but safe), 1 = ignition cut (flame mode, very aggressive), 3 = factory rpm limiter (default, smoothest and safest)" VALUE 0x9774F23 FklWUb 255 ___MGF_CC_EngineSpeedCutMethodCompuMethod 0 3 FORMAT "%7.0" /end CHARACTERISTIC
/begin CHARACTERISTIC Antilag_EgtTempMax___MGF_CC_PF "Maximum exhaust gas temperature [EGT]" VALUE 0x9774F1E GkfWU16 255 ___MGF_CC_TemperatureCelsius_d10 -1000 2000 FORMAT "%7.0" PHYS_UNIT "-" /end CHARACTERISTIC
/begin CHARACTERISTIC Antilag_IatTempMax___MGF_CC_PF "Maximum intake air temperature [IAT]" VALUE 0x9774F22 FklWUb 255 ___MGF_CC_TemperatureCelsius_x3_d4_s48 -300 300 FORMAT "%7.0" PHYS_UNIT "-" /end CHARACTERISTIC
/begin CHARACTERISTIC Antilag_MaxDuration___MGF_CC_PF "Maximum usage duration" VALUE 0x97755DA GkfWU16 655.35 camcxxd_bxlpdsa_Cshlhgc_sR_1a0o 0 5000 /end CHARACTERISTIC
/begin CHARACTERISTIC Antilag_OverBoostThreshold___MGF_CC_PF "Maximum over boost" VALUE 0x9774F20 GkfWU16 255 ___MGF_CC_PressurehPa_d8 0 5000 FORMAT "%7.0" PHYS_UNIT "-" /end CHARACTERISTIC
/begin CHARACTERISTIC Antilag_Pedal___MGF_CC_PF "Pedal threshold for activation" VALUE 0x9774E82 FklWUb 255 ___MGF_CC_Pedal_x100_d256 0 100 FORMAT "%7.0" PHYS_UNIT "-" /end CHARACTERISTIC
/begin CHARACTERISTIC Antilag_RollingSpeedThreshold___MGF_CC_PF "Speed threshold to detect rolling" VALUE 0x9774F14 GkfWU16 255 ___MGF_CC_Speedkmh_d64 0 300 FORMAT "%7.0" PHYS_UNIT "-" /end CHARACTERISTIC
/begin CHARACTERISTIC Antilag_RollRpmMax___MGF_CC_PF "RPM maximum engagement" VALUE 0x9774F16 GkfWU16 32767.5 EngN 0 15000 FORMAT "%8.2" /end CHARACTERISTIC
/begin CHARACTERISTIC Antilag_RollRpmMin___MGF_CC_PF "RPM minimum engagement" VALUE 0x9774F18 GkfWU16 32767.5 EngN 0 15000 FORMAT "%8.2" /end CHARACTERISTIC
/begin CHARACTERISTIC Antilag_RpmDelayUntilCutRoll___MGF_CC_PF "RPM delay until cut" VALUE 0x9774E80 GkfWU16 32767.5 EngN 0 20000 FORMAT "%8.2" /end CHARACTERISTIC
/begin CHARACTERISTIC Antilag_RpmDelayUntilCutStand___MGF_CC_PF "RPM delay until cut" VALUE 0x9774E7E GkfWU16 32767.5 EngN 0 20000 FORMAT "%8.2" /end CHARACTERISTIC
/begin CHARACTERISTIC Antilag_RpmSetpoint___MGF_CC_PF "RPM setpoint" VALUE 0x9774E7C CurG_Ws16 32767.5 EngN 0 15000 FORMAT "%8.2" /end CHARACTERISTIC
/begin CHARACTERISTIC Antilag_TargetBoostRoll___MGF_CC_PF "Boost pressure setpoint" VALUE 0x977530E GkfWU16 255 ___MGF_CC_PressurehPa_d8 0 3000 FORMAT "%7.0" PHYS_UNIT "-" /end CHARACTERISTIC
/begin CHARACTERISTIC Antilag_TargetBoostStand___MGF_CC_PF "Boost pressure setpoint" VALUE 0x977530A GkfWU16 255 ___MGF_CC_PressurehPa_d8 0 3000 FORMAT "%7.0" PHYS_UNIT "-" /end CHARACTERISTIC
/begin CHARACTERISTIC Antilag_TargetNumberOfCylindersToSuppress___MGF_CC_PF "Target number of cylinders to suppress during antilag" VALUE 0x97758ED FklWUb 8 raChrxc_kBtBrmb_FmDuEFa_n__aa0o 0 8 FORMAT "%3.0" /end CHARACTERISTIC
/begin CHARACTERISTIC BMWchas_tq_ResExhFlpClsdHys_C "Hysteresis for closing the exhaust flap" VALUE 0x96AF184 CurG_Ws16 6553.5 Mo_trq_nm_q0p1 -3276.8 3276.7 FORMAT "%6.1" /end CHARACTERISTIC
/begin CHARACTERISTIC BMWchas_v_IdlGearAcvMin_C "threshold vehicle velocity for setting the gear engaged for manual transmission vehicles." VALUE 0x96AF180 CurG_Ws16 1310.7 jgbhAma_smpAegb_hlEBAmd_k__0oa0 -655.36 655.34 FORMAT "%6.2" /end CHARACTERISTIC
/begin CHARACTERISTIC BMWchas_v_MaxExhFlpClsd_C "Maximum speed up to which the exhaust flap should remain closed." VALUE 0x96AF17E CurG_Ws16 1310.7 jgbhAma_smpAegb_hlEBAmd_k__0oa0 -655.36 655.34 FORMAT "%6.2" /end CHARACTERISTIC
/begin CHARACTERISTIC BMWgpfheat_p_RailTstrPcg_C "Rail pressure setpoint for preconditioning" VALUE 0x9694AB4 GkfWU16 39.9993896484375 cxdjuna_xpuCged_ocEpdua_MCRa2a0 0 39.9993896484375 /end CHARACTERISTIC
/begin CHARACTERISTIC BMWgpfheat_tq_ResExhFlpClsdHys_C "Hysteresis for closing the exhaust flap" VALUE 0x9694ACA CurG_Ws16 6553.5 Mo_trq_nm_q0p1 -3276.8 3276.7 FORMAT "%6.1" /end CHARACTERISTIC
/begin CHARACTERISTIC BMWgpfp_swi_PclFil_C "Manual switch to activate the OPF functionality in the Gpf_Cluster. ATTENTION: The switch is only evaluated in the INI function. This means that changes to the switch must be flashed and the SG must go to sleep." VALUE 0x96BDCE5 FklWUb 1 fgjpsvb_fDqjECa_acgrbDd_n_dae__ 0 1 /end CHARACTERISTIC
/begin CHARACTERISTIC BMWinjmon_vol_HppCmpn_C "Injection delivery volume HDP for delivery performance calculation of the HDP" VALUE 0x96B10BE GkfWU16 65535 kEEdlBb_gsrEhkd_rmDuAhc_uCRoa0o 0 65535 FORMAT "%6.1" /end CHARACTERISTIC
/begin CHARACTERISTIC BMWlpa_n_EfpModMax_C "EKP speed specification Max-Mode" VALUE 0x9694158 GkfWU16 65535 caoddzd_oAjpfzb_cAcEEha_1nR_oa0 0 65535 FORMAT "%5.0" /end CHARACTERISTIC
/begin CHARACTERISTIC BMWlpa_volf_FuFpcOvrT_C "LoPAsst filling limitation due to EKP overtemperature, maximum volume flow" VALUE 0x96B21BC CurG_Ws16 655.35 zBcBzad_vmoivka_mFzjCgc_lCRooa0 -327.68 327.67 /end CHARACTERISTIC
/begin CHARACTERISTIC BMWtchbas_cw_Noise_C "Configuration wastegate opening for acoustic reasons" VALUE 0x96BEC16 FklWUb 255 raChrxc_kBtBrmb_FmDuEFa_n__aa0o 0 255 FORMAT "%5.0" /end CHARACTERISTIC
/begin CHARACTERISTIC BMWtchdiag_n_EngMin_C "Lower speed threshold for leakage detection" VALUE 0x969DDC4 CurG_Ws16 65535 caoddzd_oAjpfzb_cAcEEha_1nR_oa0 -32768 32767 FORMAT "%5.0" /end CHARACTERISTIC
/begin CHARACTERISTIC BMWtchdiag_rf_SpMin_C "Desired filling (from Rf_soll_md, limited between Rf_max and Rf_min)" VALUE 0x969DDBC CurG_Ws16 655.35 CgkBooc_wkiDfEd_Czglhgc_fR_1a0o -327.68 327.67 FORMAT "%6.4" /end CHARACTERISTIC
/begin CHARACTERISTIC BMWtchob_p_DifEnd_C "Control difference for overboost end" VALUE 0x969DF2E CurG_Ws16 8191.875 ___MGF_CC_PressurehPa_d8 -4096 4095.875 FORMAT "%10.3" /end CHARACTERISTIC
/begin CHARACTERISTIC BMWtchob_p_DifGraTrigMin_C "Gradient of the control difference to trigger overboost" VALUE 0x969E01E CurG_Ws16 8191.875 ___MGF_CC_PressurehPa_d8 -4096 4095.875 FORMAT "%10.3" /end CHARACTERISTIC
/begin CHARACTERISTIC BMWtchsp_p_OfsMax_C "Offset on the Pld_soll_max. This is subtracted from Pld_soll_max. If the actual pressure Pvdkds rises above this threshold, the Rf_max_pldmax calculation is switched on (load is high enough so that Fups and Pirg can be used for an Rfmax calculation" VALUE 0x969E21C GkfWU16 8191.875 ___MGF_CC_PressurehPa_d8 0 8191.875 FORMAT "%10.3" /end CHARACTERISTIC
/begin CHARACTERISTIC BMWtchsp_p_ReqMax_C "Maximum target boost pressure due to boost pressure sensor diagnosis" VALUE 0x969E218 GkfWU16 8191.875 ___MGF_CC_PressurehPa_d8 0 8191.875 FORMAT "%10.3" /end CHARACTERISTIC
/begin CHARACTERISTIC CcmEnterMenuDelay___MGF_CC_PF "Delay to enter Custom Code Menu, CCM" VALUE 0x9774670 GkfWU16 655.35 camcxxd_bxlpdsa_Cshlhgc_sR_1a0o 0 5000 /end CHARACTERISTIC
/begin CHARACTERISTIC CcmTimeout___MGF_CC_PF "Timeout until automatic exit of Custom Code Menu, CCM" VALUE 0x9774672 GkfWU16 655.35 camcxxd_bxlpdsa_Cshlhgc_sR_1a0o 0 5000 /end CHARACTERISTIC
/begin CHARACTERISTIC CoEng_ratChrgAirCylMaxDesLim_C "Upper limit for the filling value requested by the hybrid coordinator." VALUE 0x96E3CEA GkfWU16 1535.977 rel_q0p0234 0 1535.977 FORMAT "%8.3" /end CHARACTERISTIC
/begin CHARACTERISTIC CustomCanBusCruiseControlIdMap___MGF_CC_PF "CAN bus ID for cruise control module (Default = 0x189)" VALUE 0x97094A8 GkfWU16 255 raChrxc_kBtBrmb_FmDuEFa_n__aa0o 0 4095 FORMAT "%7.0" /end CHARACTERISTIC
/begin CHARACTERISTIC CustomCanBusEcaIdMap___MGF_CC_PF "CAN bus ID for Ethanol Content Analyzer (ECA) module (Commonly 0x0EC, 0x0EB, or 0x4CB)" VALUE 0x97094B8 GkfWU16 255 raChrxc_kBtBrmb_FmDuEFa_n__aa0o 0 4095 FORMAT "%7.0" /end CHARACTERISTIC
/begin CHARACTERISTIC CustomCanBusMotivReflexOutputIdMap___MGF_CC_PF "CAN bus ID for Motiv's Re|Flex module (Commonly 0x0EC, 0x0EB, 0x4CB, or 0x334)" VALUE 0x97094BC GkfWU16 255 raChrxc_kBtBrmb_FmDuEFa_n__aa0o 0 4095 FORMAT "%7.0" /end CHARACTERISTIC
/begin CHARACTERISTIC CustomCanBusTurnSignalIdMap___MGF_CC_PF "CAN bus ID for turn signal module (Default = 0x1EE)" VALUE 0x97094C0 GkfWU16 255 raChrxc_kBtBrmb_FmDuEFa_n__aa0o 0 4095 FORMAT "%7.0" /end CHARACTERISTIC
/begin CHARACTERISTIC CW_Antilag___MGF_CC "Antilag Codeword: Set 1 (true) to enable function and 0 (false) to disable function" VALUE 0x9774E78 FklWUb 1 B_TRUE 0 1 FORMAT "%13.11" /end CHARACTERISTIC
/begin CHARACTERISTIC CW_ATMOD "" VALUE 0x96BD9AC FklWUb 1 B_TRUE 0 1 FORMAT "%13.11" /end CHARACTERISTIC
/begin CHARACTERISTIC CW_BurblesOnTheFly___MGF_CC "Burbles On-The-Fly Codeword: Set 1 (true) to enable function and 0 (false) to disable function" VALUE 0x9770140 FklWUb 1 B_TRUE 0 1 FORMAT "%13.11" /end CHARACTERISTIC
/begin CHARACTERISTIC CW_CruiseControlConfig___MGF_CC "Cruise Control Config Codeword: Set 1 (true) if using RockerCombo and 0 (false) if using UniRocker" VALUE 0x97758E4 FklWUb 1 B_TRUE 0 1 FORMAT "%13.11" /end CHARACTERISTIC
/begin CHARACTERISTIC CW_CustomCodeMenu___MGF_CC "Custom Code Menu Codeword: Set 1 (true) to enable function and 0 (false) to disable function" VALUE 0x9774E83 FklWUb 1 B_TRUE 0 1 FORMAT "%13.11" /end CHARACTERISTIC
/begin CHARACTERISTIC CW_ExhaustFlapOnTheFly___MGF_CC "Exhaust Flap On-The-Fly Codeword: Set 1 (true) to enable function and 0 (false) to disable function" VALUE 0x97758E5 FklWUb 1 B_TRUE 0 1 FORMAT "%13.11" /end CHARACTERISTIC
/begin CHARACTERISTIC CW_FlexFuel___MGF_CC "Flex Fuel Codeword: Set 1 (true) to enable function and 0 (false) to disable function" VALUE 0x97758E6 FklWUb 1 B_TRUE 0 1 FORMAT "%13.11" /end CHARACTERISTIC
/begin CHARACTERISTIC CW_FlexFuelBlending___MGF_CC "Flex Fuel Blending Codeword: Set 1 (true) to enable function and 0 (false) to disable function" VALUE 0x97758E7 FklWUb 1 B_TRUE 0 1 FORMAT "%13.11" /end CHARACTERISTIC
/begin CHARACTERISTIC CW_LowPressureFuelPressureSensorInstalled___MGF_CC "Low Pressure Fuel Pressure Sensor Installed Codeword: Set 1 (true) if (Motiv or Fuel-It) low pressure fuel pressure sensor is installed and 0 (false) if not installed" VALUE 0x97091AE FklWUb 1 B_TRUE 0 1 FORMAT "%13.11" /end CHARACTERISTIC
/begin CHARACTERISTIC CW_MgfLimpModeProtectionEnabled___MGF_CC "Mgf Limp Mode Protection Enabled Codeword: Set 1 (true) if MG Flasher's protective limp mode should be enabled and 0 (false) if disabled" VALUE 0x97091AF FklWUb 1 B_TRUE 0 1 FORMAT "%13.11" /end CHARACTERISTIC
/begin CHARACTERISTIC CW_MotivReflexInstalled___MGF_CC "Motiv Reflex Installed Codeword: Set 1 (true) if Motiv Re|Flex is installed and 0 (false) if not installed" VALUE 0x97091C0 FklWUb 1 B_TRUE 0 1 FORMAT "%13.11" /end CHARACTERISTIC
/begin CHARACTERISTIC CW_SensorEthanol___MGF_CC "Sensor Ethanol Codeword: Set 1 (true) if flex fuel sensor is installed on PT-CAN2 and 0 (false) if not installed " VALUE 0x97758E9 FklWUb 1 B_TRUE 0 1 FORMAT "%13.11" /end CHARACTERISTIC
/begin CHARACTERISTIC CW_SOUND "CW_SOUND" VALUE 0x96C08DB FklWUb 255 raChrxc_kBtBrmb_FmDuEFa_n__aa0o 0 255 FORMAT "%7.0" /end CHARACTERISTIC
/begin CHARACTERISTIC CW_UseAllCruiseControlCanBusData___MGF_CC "Use All Cruise Control Can Bus Data Codeword: Set 1 (true) to use all cruise control CAN bus data and 0 (false) to use only Rocker data" VALUE 0x97758EA FklWUb 1 B_TRUE 0 1 FORMAT "%13.11" /end CHARACTERISTIC
/begin CHARACTERISTIC CWAKR "Code word for exhaust flap control" VALUE 0x96E528D FklWUb 255 DEZ 0 255 FORMAT "%5.1" /end CHARACTERISTIC
/begin CHARACTERISTIC CWSTEGSPROGAKR "Code word for exhaust flap control via stegsprog" VALUE 0x96E5291 FklWUb 255 DEZ 0 255 FORMAT "%5.1" /end CHARACTERISTIC
/begin CHARACTERISTIC CWVMAXCOD "Codeword VMAX coding active" VALUE 0x96F744D FklWUb 255 DEZ 0 255 FORMAT "%5.1" /end CHARACTERISTIC
/begin CHARACTERISTIC Exh_swtSensCfgPPFlt_C "Switch for configuring/adjusting the pressure sensor" VALUE 0x96FCAC2 FklWUb 255 BMW_q1 0 255 FORMAT "%5.1" /end CHARACTERISTIC
/begin CHARACTERISTIC ExhaustFlapClosedMaxLoad___MGF_CC_PF "Maximum load before overriding user selection and opening exhaust flaps" VALUE 0x9774674 CurG_Ws16 255 CgkBooc_wkiDfEd_Czglhgc_fR_1a0o -327 327 FORMAT "%7.0" PHYS_UNIT "-" /end CHARACTERISTIC
/begin CHARACTERISTIC FlexFuelEthanolDisplayActivationDelay___MGF_CC_PF "Delay to display flex fuel ethanol content on the dash" VALUE 0x9774676 GkfWU16 655.35 camcxxd_bxlpdsa_Cshlhgc_sR_1a0o 0 5000 /end CHARACTERISTIC
/begin CHARACTERISTIC K_BS_MN "Lambda minimum value for component protection" VALUE 0x9692982 GkfWU16 15.999755859375 BumqDkc_mryszAa_EcglxAc_nR_4oa0 0 15.999755859375 /end CHARACTERISTIC
/begin CHARACTERISTIC K_EDA_MD_ANZ_BS_SCAL_CODE0 "Base scaling per area in the display" VALUE 0x96BCFA5 FklWUb 255 raChrxc_kBtBrmb_FmDuEFa_n__aa0o 0 255 /end CHARACTERISTIC
/begin CHARACTERISTIC K_EDA_MD_ANZ_BS_SCAL_CODE1 "Base scaling per area in the display" VALUE 0x96BCFA4 FklWUb 255 raChrxc_kBtBrmb_FmDuEFa_n__aa0o 0 255 /end CHARACTERISTIC
/begin CHARACTERISTIC K_EDA_MD_ANZ_BS_SCAL_CODE2 "Base scaling per area in the display" VALUE 0x96BCFA3 FklWUb 255 raChrxc_kBtBrmb_FmDuEFa_n__aa0o 0 255 /end CHARACTERISTIC
/begin CHARACTERISTIC K_EDA_MD_ANZ_BS_SCAL_CODE3 "Base scaling per area in the display" VALUE 0x96BCFA2 FklWUb 255 raChrxc_kBtBrmb_FmDuEFa_n__aa0o 0 255 /end CHARACTERISTIC
/begin CHARACTERISTIC K_EDA_MD_ANZ_BS_SCAL_CODE4 "Base scaling per area in the display" VALUE 0x96BCFA1 FklWUb 255 raChrxc_kBtBrmb_FmDuEFa_n__aa0o 0 255 /end CHARACTERISTIC
/begin CHARACTERISTIC K_EDA_P_ANZ_SPORT_BS_SCAL_CODE0 "Base scaling per area in the display" VALUE 0x96BCFA0 FklWUb 255 raChrxc_kBtBrmb_FmDuEFa_n__aa0o 0 255 /end CHARACTERISTIC
/begin CHARACTERISTIC K_EDA_P_ANZ_SPORT_BS_SCAL_CODE1 "Base scaling per area in the display" VALUE 0x96BCF9F FklWUb 255 raChrxc_kBtBrmb_FmDuEFa_n__aa0o 0 255 /end CHARACTERISTIC
/begin CHARACTERISTIC K_EDA_P_ANZ_SPORT_BS_SCAL_CODE2 "Base scaling per area in the display" VALUE 0x96BCF9E FklWUb 255 raChrxc_kBtBrmb_FmDuEFa_n__aa0o 0 255 /end CHARACTERISTIC
/begin CHARACTERISTIC K_EDA_P_ANZ_SPORT_BS_SCAL_CODE3 "Base scaling per area in the display" VALUE 0x96BCF9D FklWUb 255 raChrxc_kBtBrmb_FmDuEFa_n__aa0o 0 255 /end CHARACTERISTIC
/begin CHARACTERISTIC K_F_SOT_RUECKBLICK_RS "Offset for factor for thrust bubbling when downshifting" VALUE 0x96BC958 FklWUb 0.99609375 BpaECzb_zweffod_enenhgc_nR_2a0o 0 0.99609375 FORMAT "%6.4" /end CHARACTERISTIC
/begin CHARACTERISTIC K_F_SOT_RUECKBLICK_STAND "Factor for thrust bubbling when stationary" VALUE 0x96BC957 FklWUb 0.99609375 BpaECzb_zweffod_enenhgc_nR_2a0o 0 0.99609375 FORMAT "%6.4" /end CHARACTERISTIC
/begin CHARACTERISTIC K_FRFMXBS_MN "Limiting factor filling intervention at BS at grease running limit" VALUE 0x9692518 GkfWU16 1.99996948242188 Bhvfwhc_bigEubd_BBEupBd_nR_3oa0 0 1.99996948242188 FORMAT "%14.5" /end CHARACTERISTIC
/begin CHARACTERISTIC K_LA_FETTDELAY "Lambda threshold from which a rich request from KF_LABAS_XXX is suppressed" VALUE 0x96BA5C8 GkfWU16 15.999755859375 BumqDkc_mryszAa_EcglxAc_nR_4oa0 0 15.999755859375 FORMAT "%9.4" /end CHARACTERISTIC
/begin CHARACTERISTIC K_MAX_PSSOLBER "Maximum Ps_soll_offs (when calculating Ps_soll_sm_nl)" VALUE 0x9697F04 CurG_Ws16 8191.875 ___MGF_CC_PressurehPa_d8 -4096 4095.875 FORMAT "%8.3" /end CHARACTERISTIC
/begin CHARACTERISTIC K_MSVANST_DIFFPRAIL "Constant monitoring HDP activation minimum rail pressure undershoot" VALUE 0x96B10B8 GkfWU16 39.9993896484375 cxdjuna_xpuCged_ocEpdua_MCRa2a0 0 39.9993896484375 FORMAT "%6.2" /end CHARACTERISTIC
/begin CHARACTERISTIC K_PAK_MX "Maximum exhaust manifold pressure" VALUE 0x968B770 GkfWU16 8191.875 ___MGF_CC_PressurehPa_d8 0 8191.875 FORMAT "%7.1" /end CHARACTERISTIC
/begin CHARACTERISTIC K_PRAIL_ST_MAX "Maximum rail pressure setpoint for engine start" VALUE 0x96B71C8 GkfWU16 39.9993896484375 cxdjuna_xpuCged_ocEpdua_MCRa2a0 0 39.9993896484375 FORMAT "%9.4" /end CHARACTERISTIC
/begin CHARACTERISTIC K_RFVIST_MX "MAX limit Rfv_ist from NN" VALUE 0x968DD6C CurG_Ws16 655.35 CgkBooc_wkiDfEd_Czglhgc_fR_1a0o -327.68 327.67 FORMAT "%7.2" /end CHARACTERISTIC
/begin CHARACTERISTIC K_T_FETTDELAY_SPERR "Time during which a renewed suppression of enrichment is blocked" VALUE 0x96C790E FklWUb 255 hcpywvc_dcqzDlc_FmDugua_s__aa0o 0 255 FORMAT "%5.2" /end CHARACTERISTIC
/begin CHARACTERISTIC K_T_NK_SOUND_MX "K_T_NK_SOUND_MX" VALUE 0x96A3A50 CurG_Ws16 6553.5 ___MGF_CC_TemperatureCelsius_d10 -3276.8 3276.7 /end CHARACTERISTIC
/begin CHARACTERISTIC K_T_SOUND_MN "K_T_SOUND_MN" VALUE 0x96A3A56 CurG_Ws16 655.35 DchEpAd_DBCFgoa_Ckhahgc_q__aoa0 -327.68 327.67 /end CHARACTERISTIC
/begin CHARACTERISTIC K_T_VL_SOUND_MX "K_T_VL_SOUND_MX" VALUE 0x96A3A4E CurG_Ws16 6553.5 ___MGF_CC_TemperatureCelsius_d10 -3276.8 3276.7 /end CHARACTERISTIC
/begin CHARACTERISTIC K_TKW_MX "Coolant set temperature in MAX mode" VALUE 0x96ACAF4 CurG_Ws16 655.35 DchEpAd_DBCFgoa_Ckhahgc_q__aoa0 -327.68 327.67 /end CHARACTERISTIC
/begin CHARACTERISTIC K_TKW_WA "Target coolant temperature in warm-up mode" VALUE 0x96ACAE8 CurG_Ws16 655.35 DchEpAd_DBCFgoa_Ckhahgc_q__aoa0 -327.68 327.67 /end CHARACTERISTIC
/begin CHARACTERISTIC K_V_SOT_MN "Min. driving speed for thrust bubbling" VALUE 0x968945A CurG_Ws16 1310.7 Asyaixa_wdvtenb_FCefaCb_n__aa0o -655.36 655.34 FORMAT "%7.1" /end CHARACTERISTIC
/begin CHARACTERISTIC K_V_SOUND_MN "K_V_SOUND_MN" VALUE 0x96A3A4C GkfWU16 1310.7 jgbhAma_smpAegb_hlEBAmd_k__0oa0 0 1310.7 /end CHARACTERISTIC
/begin CHARACTERISTIC K_V_SOUND_MX "K_V_SOUND_MX" VALUE 0x96A3A4A GkfWU16 1310.7 jgbhAma_smpAegb_hlEBAmd_k__0oa0 0 1310.7 /end CHARACTERISTIC
/begin CHARACTERISTIC MK2TE "Conversion factor mass to injection time" VALUE 0x96FAFD8 GkfWU16 0.68266 InjDDGdi_mkte_q0p10416Em4 0 0.68266 FORMAT "%7.5" /end CHARACTERISTIC
/begin CHARACTERISTIC NMXHDR "RPM limit on HDR error" VALUE 0x96F1EE4 CurG_Ws16 16383.5 n_sw_q0p5 0 16383.5 FORMAT "%8.2" /end CHARACTERISTIC
/begin CHARACTERISTIC PFlt_stActv_C "Activation of the particle filter functionality" VALUE 0x96F3AEC FklWUb 255 BMW_q1 0 255 FORMAT "%5.1" /end CHARACTERISTIC
/begin CHARACTERISTIC PFlt_stPfilTyp_C "Bit coded type of particle filter" VALUE 0x96F3AED FklWUb 255 BMW_q1 0 255 FORMAT "%5.1" /end CHARACTERISTIC
/begin CHARACTERISTIC PVDMX "Upper pressure threshold for range check" VALUE 0x96E88C6 GkfWU16 5119.922 p_uw_q0p078 0 5119.922 FORMAT "%8.3" /end CHARACTERISTIC
/begin CHARACTERISTIC S_AUSWAHL_FETTDELAY "Switch for switching the lambda setpoint during enrichment suppression. Either Lamda=1 or max selection between La_main and K_LA_FETTDELAY is output." VALUE 0x96C790D FklWUb 1 raChrxc_kBtBrmb_FmDuEFa_n__aa0o 0 1 FORMAT "%3.0" /end CHARACTERISTIC
/begin CHARACTERISTIC S_BSRFMX "Filling limitation switch for component protection at the rich running limit" VALUE 0x96BD995 FklWUb 1 raChrxc_kBtBrmb_FmDuEFa_n__aa0o 0 1 FORMAT "%3.0" /end CHARACTERISTIC
/begin CHARACTERISTIC S_PRAIL_GL_LA1 "Switch for activating the target rail pressure from the basic map in CILCN operating mode " VALUE 0x96BE9FD FklWUb 255 raChrxc_kBtBrmb_FmDuEFa_n__aa0o 0 255 FORMAT "%3.0" /end CHARACTERISTIC
/begin CHARACTERISTIC TMOTAKR "Temperature threshold for engine temperature-dependent exhaust flap control" VALUE 0x96E5298 FklWUb 191.3 temp_ub_q0p75_o48 -48 143.3 FORMAT "%5.1" /end CHARACTERISTIC
/begin CHARACTERISTIC TVSTAKR "Delay time for triggering the exhaust flap after start" VALUE 0x96E529A GkfWU16 655.35 t10msxs_ub_b2p55 0 655.35 FORMAT "%8.4" /end CHARACTERISTIC
/begin CHARACTERISTIC UniRockerEnterDetectionDelay___MGF_CC_PF "Delay for 'enter' button detection with UniRocker button configuration in Custom Code Menu, CCM" VALUE 0x9774E7A GkfWU16 655.35 camcxxd_bxlpdsa_Cshlhgc_sR_1a0o 0 5000 /end CHARACTERISTIC
/begin CHARACTERISTIC VMAXOVC "Vmax limit value, variant coded" VALUE 0x96F74C8 GkfWU16 511.9922 vfzg_sw_q0p00781 0 511.9922 FORMAT "%8.4" /end CHARACTERISTIC
/begin CHARACTERISTIC VMINAKR "minimum vehicle speed for pulse output" VALUE 0x96E529C FklWUb 318.8 vfzg_ub_q1p25 0 318.8 FORMAT "%5.1" /end CHARACTERISTIC
/begin CHARACTERISTIC VROHMAX "maximum allowed raw speed for signal range check" VALUE 0x96E90E2 GkfWU16 511.9922 vfzg_uw_b512 0 511.9922 FORMAT "%8.4" /end CHARACTERISTIC
/begin CHARACTERISTIC Antilag_SafetyTorqueCap___MGF_CC_PF "Target torque during antilag safety shutdown" CURVE 0x97752E6 _REC_A1CUR_1_MBSE_S2_S1 6553.5 Mo_trq_nm_q0p1 -3000 3000 MATRIX_DIM 18 1 1
 /begin AXIS_DESCR COM_AXIS Nkw_ref caoddzd_oAjpfzb_cAcEEha_1nR_oa0 18 -32768 32767 AXIS_PTS_REF BMWtqe_tqc_FlApplStg_Ax MONOTONY STRICT_INCREASE DEPOSIT ABSOLUTE /end AXIS_DESCR
/end CHARACTERISTIC
/begin CHARACTERISTIC BMWchas_tq_ResExhFlpClsd_T "Torque reserve from which the exhaust flap should be closed for acoustic reasons." CURVE 0x96AF78C _REC_A1CUR_1_MBSE_S2_S1 6553.5 Mo_trq_nm_q0p1 -3276.8 3276.7 FORMAT "%6.1"
 /begin AXIS_DESCR COM_AXIS Nkw caoddzd_oAjpfzb_cAcEEha_1nR_oa0 8 -32768 32767 AXIS_PTS_REF BMWchas_tq_ResExhFlpClsd_Ax FORMAT "%5.0" MONOTONY STRICT_INCREASE DEPOSIT ABSOLUTE /end AXIS_DESCR
/end CHARACTERISTIC
/begin CHARACTERISTIC BMWgpfheat_tq_ResExhFlpClsd_T "Torque reserve from which the exhaust flap should be closed for acoustic reasons." CURVE 0x96950FC _REC_A1CUR_1_MBSE_S2_S1 6553.5 Mo_trq_nm_q0p1 -3276.8 3276.7 FORMAT "%6.1"
 /begin AXIS_DESCR COM_AXIS Nkw caoddzd_oAjpfzb_cAcEEha_1nR_oa0 8 -32768 32767 AXIS_PTS_REF BMWgpfheat_tq_ResExhFlpClsd_Ax FORMAT "%5.0" MONOTONY STRICT_INCREASE DEPOSIT ABSOLUTE /end AXIS_DESCR
/end CHARACTERISTIC
/begin CHARACTERISTIC BMWinjafs_fac_RatAirMax_T "Characteristic curve upper limit Rf for L-stoich adaptation" CURVE 0x968EE68 _REC_A1CUR_1_MBSE_S2_S1 655.35 ubqeuic_jteCkzd_CDglhgc_nR_1a0o -327.68 327.67
 /begin AXIS_DESCR COM_AXIS Nkw caoddzd_oAjpfzb_cAcEEha_1nR_oa0 6 -32768 32767 AXIS_PTS_REF BMWinjafs_fac_RatAirMax_Ax FORMAT "%5.0" MONOTONY STRICT_INCREASE DEPOSIT ABSOLUTE /end AXIS_DESCR
/end CHARACTERISTIC
/begin CHARACTERISTIC BMWlpa_n_EfpEngStrtPRail_T "EKP speed specification start rail pressure" CURVE 0x9694222 _REC_A1CUR_1_MBSE_U2_S2 65535 caoddzd_oAjpfzb_cAcEEha_1nR_oa0 0 65535 FORMAT "%5.0"
 /begin AXIS_DESCR COM_AXIS Prail_ist cxdjuna_xpuCged_ocEpdua_MCRa2a0 2 0 39.9993896484375 AXIS_PTS_REF BMWlpa_n_EfpEngStrtPRail_Ax FORMAT "%9.4" MONOTONY STRICT_INCREASE DEPOSIT ABSOLUTE /end AXIS_DESCR
/end CHARACTERISTIC
/begin CHARACTERISTIC BMWlpsc_p_HppMax_T "Characteristic curve Maximum pressure before HDP depending on flow" CURVE 0x96B234C _REC_A1CUR_1_MBSE_U2_S2 65.535 rgduxyd_mlihaBb_gsCghzb_bCRa0a0 0 65.535 FORMAT "%5.3"
 /begin AXIS_DESCR COM_AXIS BMWlpi_volf_Fu_sw zBcBzad_vmoivka_mFzjCgc_lCRooa0 4 -327.68 327.67 AXIS_PTS_REF BMWlpsc_p_HppMax_Ax FORMAT "%5.2" MONOTONY STRICT_INCREASE DEPOSIT ABSOLUTE /end AXIS_DESCR
/end CHARACTERISTIC
/begin CHARACTERISTIC BMWlpsd_p_RailDifMax_T "Rail pressure deviation threshold" CURVE 0x96947F2 _REC_A1CUR_1_MBSE_U2_S2 39.9993896484375 cxdjuna_xpuCged_ocEpdua_MCRa2a0 0 39.9993896484375 FORMAT "%9.4"
 /begin AXIS_DESCR COM_AXIS Prail_ist cxdjuna_xpuCged_ocEpdua_MCRa2a0 4 0 39.9993896484375 AXIS_PTS_REF BMWlpsd_p_RailDifMax_Ax FORMAT "%9.4" MONOTONY STRICT_INCREASE DEPOSIT ABSOLUTE /end AXIS_DESCR
/end CHARACTERISTIC
/begin CHARACTERISTIC BMWtchctr_fac_pwr_CompLimPctl_T "Factor for pre-control up to which the controller with the P and D component can increase the compressor output during operation via pre-control" CURVE 0x96B8492 _REC_A1CUR_1_MBSE_U2_S2 1.99996948242188 Bhvfwhc_bigEubd_BBEupBd_nR_3oa0 0 1.99996948242188 FORMAT "%11.4"
 /begin AXIS_DESCR COM_AXIS BMWtchsp_mf_CmprNorm_uw CByjozc_eCmpBAb_pljBAmd_k__0oa0 6 0 2047.96875 AXIS_PTS_REF BMWtchctr_fac_pwr_CompLimPctl_Ax FORMAT "%10.3" MONOTONY STRICT_INCREASE DEPOSIT ABSOLUTE /end AXIS_DESCR
/end CHARACTERISTIC
/begin CHARACTERISTIC BMWtchctr_rat_p_ComprLimPctl_T "Minimum limit of the target boost factor for aborting boost pressure control when the target pressure setting drops" CURVE 0x96B849E _REC_A1CUR_1_MBSE_U2_S2 7.9998779296875 acriqBc_tfkBqod_ocgjxzc_nR_8oa0 0 7.9998779296875 FORMAT "%10.3"
 /begin AXIS_DESCR COM_AXIS BMWtchsp_mf_CmprNorm_uw CByjozc_eCmpBAb_pljBAmd_k__0oa0 12 0 2047.96875 AXIS_PTS_REF BMWtchctr_rat_p_ComprLimPctl_Ax FORMAT "%10.3" MONOTONY STRICT_INCREASE DEPOSIT ABSOLUTE /end AXIS_DESCR
/end CHARACTERISTIC
/begin CHARACTERISTIC BMWtchob_fac_tq_Delt_T "Reduction factor overboost torque via TANS" CURVE 0x969DF58 _REC_A1CUR_1_MBSE_U2_S2 0.999984741210938 FzbmlAa_gCtylrb_ckCqxAc_nR_6oa0 0 0.999984741210938 FORMAT "%6.4"
 /begin AXIS_DESCR COM_AXIS Tans ___MGF_CC_TemperatureCelsius_d10 4 -3276.8 3276.7 AXIS_PTS_REF BMWtchob_fac_tq_Delt_Ax FORMAT "%6.1" MONOTONY STRICT_INCREASE DEPOSIT ABSOLUTE /end AXIS_DESCR
/end CHARACTERISTIC
/begin CHARACTERISTIC BMWtchsp_fac_FilPRatCmpr_T "Filter constant for target pressure ratio" CURVE 0x969E292 _REC_A1CUR_1_MBSE_U2_S2 0.999984741210938 FzbmlAa_gCtylrb_ckCqxAc_nR_6oa0 0 0.999984741210938 FORMAT "%14.5"
 /begin AXIS_DESCR COM_AXIS BMWtchsp_mf_CmprNorm_uw CByjozc_eCmpBAb_pljBAmd_k__0oa0 4 0 2047.96875 AXIS_PTS_REF BMWtchsp_fac_FilPRatCmpr_Ax FORMAT "%10.3" MONOTONY STRICT_INCREASE DEPOSIT ABSOLUTE /end AXIS_DESCR
/end CHARACTERISTIC
/begin CHARACTERISTIC BMWtchsp_fac_mf_FilCmprNorm_T "Filter constant for corrected target mass flow" CURVE 0x969E34C _REC_A1CUR_1_MBSE_U2_S2 0.999984741210938 FzbmlAa_gCtylrb_ckCqxAc_nR_6oa0 0 0.999984741210938 FORMAT "%14.5"
 /begin AXIS_DESCR COM_AXIS NO_INPUT_QUANTITY CByjozc_eCmpBAb_pljBAmd_k__0oa0 4 0 2047.96875 AXIS_PTS_REF BMWtchsp_fac_mf_FilCmprNorm_Ax FORMAT "%10.3" MONOTONY STRICT_INCREASE DEPOSIT ABSOLUTE /end AXIS_DESCR
/end CHARACTERISTIC
/begin CHARACTERISTIC BMWtchsp_rat_p_CmprPmp_T "KL_FPLDPUMP" CURVE 0x969E222 _REC_A1CUR_1_MBSE_U2_S2 3.99993896484375 ilxsavd_hkzmBfc_lAzCpAb_nR_1oa0 0 3.99993896484375
 /begin AXIS_DESCR COM_AXIS BMWtchsp_mf_CmprNorm_uw CByjozc_eCmpBAb_pljBAmd_k__0oa0 8 0 2047.96875 AXIS_PTS_REF BMWtchsp_rat_p_CmprPmp_Ax FORMAT "%10.3" MONOTONY STRICT_INCREASE DEPOSIT ABSOLUTE /end AXIS_DESCR
/end CHARACTERISTIC
/begin CHARACTERISTIC BMWtchsp_rf_Liho_T "Limitation Rf for Atl variants in case of error (b_atlerr_md)" CURVE 0x969E2DA _REC_A1CUR_1_MBSE_S2_S1 655.35 CgkBooc_wkiDfEd_Czglhgc_fR_1a0o -327.68 327.67
 /begin AXIS_DESCR COM_AXIS NO_INPUT_QUANTITY caoddzd_oAjpfzb_cAcEEha_1nR_oa0 6 -32768 32767 AXIS_PTS_REF BMWtchsp_rf_Liho_Ax FORMAT "%5.0" MONOTONY STRICT_INCREASE DEPOSIT ABSOLUTE /end AXIS_DESCR
/end CHARACTERISTIC
/begin CHARACTERISTIC BMWtqe_b_Clu4NoiseDeac_T "Torque Engine(torque combustion engine) bit, boolean, flag, binary message or variable(log. condition) clutch(clutch) four(four) noise(noise) deactivation(deactivation) curve, table(characteristic curve)" CURVE 0x96C0918 _REC_A1CUR_1_MBSE_U1_S1 1 fgjpsvb_fDqjECa_acgrbDd_n_dae__ 0 1
 /begin AXIS_DESCR COM_AXIS Status_usecase_antr raChrxc_kBtBrmb_FmDuEFa_n__aa0o 12 0 11 AXIS_PTS_REF BMWtqe_b_SptDet4NoiseAcvn_Ax FORMAT "%6.0" MONOTONY STRICT_INCREASE DEPOSIT ABSOLUTE /end AXIS_DESCR
/end CHARACTERISTIC
/begin CHARACTERISTIC FWIHDR "Weighting factor PI controller parameter HDR; I-part" CURVE 0x96EF66A Cur_Xu8Wu8 1.992188 fak_ub_b2 0 1.992188 FORMAT "%8.6"
 /begin AXIS_DESCR STD_AXIS Epm_nEngLRes nmot_q40 8 0 10200 FORMAT "%5.0" PHYS_UNIT "1/min" DEPOSIT ABSOLUTE /end AXIS_DESCR
/end CHARACTERISTIC
/begin CHARACTERISTIC FWPHDR "Weighting factor PI controller parameter HDR; P-part" CURVE 0x96EF67B Cur_Xu8Wu8 1.992188 fak_ub_b2 0 1.992188 FORMAT "%8.6"
 /begin AXIS_DESCR STD_AXIS Epm_nEngLRes nmot_q40 8 0 10200 FORMAT "%5.0" PHYS_UNIT "1/min" DEPOSIT ABSOLUTE /end AXIS_DESCR
/end CHARACTERISTIC
/begin CHARACTERISTIC KL_FLD_KKS "Requirement to switch the KKS as a function of the filtered mean value of the throttle valve pressure" CURVE 0x9687324 _REC_S4CUR_52_KL_U1_1_U2 10 raChrxc_kBtBrmb_FmDuEFa_n__aa0o 0 10
 /begin AXIS_DESCR STD_AXIS F_pld_wm_f acriqBc_tfkBqod_ocgjxzc_nR_8oa0 6 0 7.9998779296875 MONOTONY STRICT_INCREASE DEPOSIT ABSOLUTE /end AXIS_DESCR
/end CHARACTERISTIC
/begin CHARACTERISTIC KL_FRFMXBS "Characteristic curve factor filling intervention at BS at grease running limit" CURVE 0x969255E _REC_A1CUR_1_MBSE_U2_S2 1.99996948242188 Bhvfwhc_bigEubd_BBEupBd_nR_3oa0 0 1.99996948242188 FORMAT "%14.5"
 /begin AXIS_DESCR COM_AXIS NO_INPUT_QUANTITY Bhvfwhc_bigEubd_BBEupBd_nR_3oa0 4 0 1.99996948242188 AXIS_PTS_REF AXX_KL_FRFMXBS FORMAT "%14.5" MONOTONY STRICT_INCREASE DEPOSIT ABSOLUTE /end AXIS_DESCR
/end CHARACTERISTIC
/begin CHARACTERISTIC KL_LA_SBL "Characteristic Lambda specification thrust bubbling" CURVE 0x96BA5CA _REC_A1CUR_1_MBSE_U2_S2 15.999755859375 BumqDkc_mryszAa_EcglxAc_nR_4oa0 0 15.999755859375 FORMAT "%9.4"
 /begin AXIS_DESCR COM_AXIS Nkw caoddzd_oAjpfzb_cAcEEha_1nR_oa0 6 -32768 32767 AXIS_PTS_REF AXX_KL_LA_SBL FORMAT "%5.0" MONOTONY STRICT_INCREASE DEPOSIT ABSOLUTE /end AXIS_DESCR
/end CHARACTERISTIC
/begin CHARACTERISTIC KL_LAMX "maximum relative filling" CURVE 0x969A332 _REC_A1CUR_1_MBSE_S2_S1 327.67 CgkBooc_wkiDfEd_Czglhgc_fR_1a0o 0 327.67 FORMAT "%7.2"
 /begin AXIS_DESCR COM_AXIS NO_INPUT_QUANTITY caoddzd_oAjpfzb_cAcEEha_1nR_oa0 18 -32768 32767 AXIS_PTS_REF AXX_KL_LAMX FORMAT "%5.0" MONOTONY MON_INCREASE DEPOSIT ABSOLUTE /end AXIS_DESCR
/end CHARACTERISTIC
/begin CHARACTERISTIC KL_NEL_TMOT "E-fan speed requirement by the motor temperature" CURVE 0x9684CCE _REC_S4CUR_52_KL_U1_1_S2 99.609375 qtfFcac_cfbwAaa_Cbeysaa_fR_60oa 0 99.609375
 /begin AXIS_DESCR STD_AXIS Dtmot_tkwsoll_f DchEpAd_DBCFgoa_Ckhahgc_q__aoa0 12 -327.68 327.67 MONOTONY STRICT_INCREASE DEPOSIT ABSOLUTE /end AXIS_DESCR
/end CHARACTERISTIC
/begin CHARACTERISTIC KL_NKW_SOUND_MN "Min. speed threshold for activating BMWtqe_b_NoisePre_bo depending on the gear" CURVE 0x96A3A72 _REC_A1CUR_1_MBSE_S2_S1 65535 caoddzd_oAjpfzb_cAcEEha_1nR_oa0 -32768 32767
 /begin AXIS_DESCR COM_AXIS Gangi raChrxc_kBtBrmb_FmDuEFa_n__aa0o 8 0 255 AXIS_PTS_REF AXX_KL_NKW_SOUND_MNMX FORMAT "%3.0" MONOTONY STRICT_INCREASE DEPOSIT ABSOLUTE /end AXIS_DESCR
/end CHARACTERISTIC
/begin CHARACTERISTIC KL_NKW_SOUND_MX "Max. speed threshold for activating BMWtqe_b_NoisePre_bo depending on the gear" CURVE 0x96A3A62 _REC_A1CUR_1_MBSE_S2_S1 65535 caoddzd_oAjpfzb_cAcEEha_1nR_oa0 -32768 32767
 /begin AXIS_DESCR COM_AXIS Gangi raChrxc_kBtBrmb_FmDuEFa_n__aa0o 8 0 255 AXIS_PTS_REF AXX_KL_NKW_SOUND_MNMX FORMAT "%3.0" MONOTONY STRICT_INCREASE DEPOSIT ABSOLUTE /end AXIS_DESCR
/end CHARACTERISTIC
/begin CHARACTERISTIC KL_RF_MAX "Characteristic maximum permissible filling over speed" CURVE 0x9699F2A _REC_A1CUR_1_MBSE_S2_S1 655.35 CgkBooc_wkiDfEd_Czglhgc_fR_1a0o -327.68 327.67 FORMAT "%7.2"
 /begin AXIS_DESCR COM_AXIS NO_INPUT_QUANTITY caoddzd_oAjpfzb_cAcEEha_1nR_oa0 12 -32768 32767 AXIS_PTS_REF AXX_KL_RF_MAX FORMAT "%5.0" MONOTONY MON_INCREASE DEPOSIT ABSOLUTE /end AXIS_DESCR
/end CHARACTERISTIC
/begin CHARACTERISTIC KL_RF_MAX_UESP "Characteristic of the maximum permissible filling over the speed when flushing" CURVE 0x9699F12 _REC_A1CUR_1_MBSE_S2_S1 655.35 CgkBooc_wkiDfEd_Czglhgc_fR_1a0o -327.68 327.67 FORMAT "%7.2"
 /begin AXIS_DESCR COM_AXIS NO_INPUT_QUANTITY caoddzd_oAjpfzb_cAcEEha_1nR_oa0 12 -32768 32767 AXIS_PTS_REF AXX_KL_RF_MAX_UESP FORMAT "%5.0" MONOTONY MON_INCREASE DEPOSIT ABSOLUTE /end AXIS_DESCR
/end CHARACTERISTIC
/begin CHARACTERISTIC KL_RFMIN_KRSTSYS "Minimum charge for charge limitation from injection monitoring" CURVE 0x96B11B6 _REC_A1CUR_1_MBSE_S2_S1 655.35 CgkBooc_wkiDfEd_Czglhgc_fR_1a0o -327.68 327.67 FORMAT "%6.2"
 /begin AXIS_DESCR COM_AXIS Nkw caoddzd_oAjpfzb_cAcEEha_1nR_oa0 8 -32768 32767 AXIS_PTS_REF AXX_KL_RFMIN_KRSTSYS FORMAT "%5.0" MONOTONY STRICT_INCREASE DEPOSIT ABSOLUTE /end AXIS_DESCR
/end CHARACTERISTIC
/begin CHARACTERISTIC KL_RFTNLMX "Maximum nonlinear Drf when calculating Ps_soll_sm_nl" CURVE 0x9698054 _REC_A1CUR_1_MBSE_S2_S1 327.67 CgkBooc_wkiDfEd_Czglhgc_fR_1a0o 0 327.67 FORMAT "%7.2"
 /begin AXIS_DESCR COM_AXIS NO_INPUT_QUANTITY caoddzd_oAjpfzb_cAcEEha_1nR_oa0 10 0 32767 AXIS_PTS_REF AXX_KL_RFTNLMX FORMAT "%5.0" MONOTONY MON_INCREASE DEPOSIT ABSOLUTE /end AXIS_DESCR
/end CHARACTERISTIC
/begin CHARACTERISTIC KL_RFVHUBDYNKOR "Characteristic curve Rfv_hub specification at F_rfv_dyn=0" CURVE 0x969815E _REC_A1CUR_1_MBSE_S2_S1 327.67 CgkBooc_wkiDfEd_Czglhgc_fR_1a0o 0 327.67 FORMAT "%7.2"
 /begin AXIS_DESCR COM_AXIS NO_INPUT_QUANTITY caoddzd_oAjpfzb_cAcEEha_1nR_oa0 20 -32768 32767 AXIS_PTS_REF AXX_KL_RFVHUBDYNKOR FORMAT "%5.0" MONOTONY MON_INCREASE DEPOSIT ABSOLUTE /end AXIS_DESCR
/end CHARACTERISTIC
/begin CHARACTERISTIC KL_T_IKAT_SOUND_MX "Temperature threshold cat for thrust bubble release " CURVE 0x96A3A5A _REC_A1CUR_1_MBSE_S2_S1 6553.5 ___MGF_CC_TemperatureCelsius_d10 -3276.8 3276.7
 /begin AXIS_DESCR COM_AXIS Anz_b_sound raChrxc_kBtBrmb_FmDuEFa_n__aa0o 4 0 255 AXIS_PTS_REF AXX_KL_T_IKAT_SOUND_MX FORMAT "%5.0" MONOTONY STRICT_INCREASE DEPOSIT ABSOLUTE /end AXIS_DESCR
/end CHARACTERISTIC
/begin CHARACTERISTIC KL_TD_SOUND_MX "KL_TD_SOUND_MX" CURVE 0x96A3A9A _REC_A1CUR_1_MBSE_U2_S2 655.35 camcxxd_bxlpdsa_Cshlhgc_sR_1a0o 0 655.35
 /begin AXIS_DESCR COM_AXIS V_fzg_plaus jgbhAma_smpAegb_hlEBAmd_k__0oa0 4 -655.36 655.34 AXIS_PTS_REF AXX_KL_TD_SOUND_MX FORMAT "%6.2" MONOTONY STRICT_INCREASE DEPOSIT ABSOLUTE /end AXIS_DESCR
/end CHARACTERISTIC
/begin CHARACTERISTIC KL_TD_SOUND_MX_FREI "Sound duration freely applicable" CURVE 0x96A3A92 _REC_A1CUR_1_MBSE_U2_S2 655.35 camcxxd_bxlpdsa_Cshlhgc_sR_1a0o 0 655.35
 /begin AXIS_DESCR COM_AXIS V_fzg_plaus jgbhAma_smpAegb_hlEBAmd_k__0oa0 4 -655.36 655.34 AXIS_PTS_REF AXX_KL_TD_SOUND_MX_FREI FORMAT "%6.2" MONOTONY STRICT_INCREASE DEPOSIT ABSOLUTE /end AXIS_DESCR
/end CHARACTERISTIC
/begin CHARACTERISTIC KL_TD_SOUND_MX_SPORT "KL_TD_SOUND_MX_SPORT" CURVE 0x96A3A8A _REC_A1CUR_1_MBSE_U2_S2 655.35 camcxxd_bxlpdsa_Cshlhgc_sR_1a0o 0 655.35
 /begin AXIS_DESCR COM_AXIS V_fzg_plaus jgbhAma_smpAegb_hlEBAmd_k__0oa0 4 -655.36 655.34 AXIS_PTS_REF AXX_KL_TD_SOUND_MX_SPORT FORMAT "%6.2" MONOTONY STRICT_INCREASE DEPOSIT ABSOLUTE /end AXIS_DESCR
/end CHARACTERISTIC
/begin CHARACTERISTIC KL_TKW_HI "Coolant target temperature in High operating mode depending on the ambient temperature" CURVE 0x9685552 _REC_S4CUR_52_KL_S2_1_S2 655.35 DchEpAd_DBCFgoa_Ckhahgc_q__aoa0 -327.68 327.67
 /begin AXIS_DESCR STD_AXIS Tumg_wm ___MGF_CC_TemperatureCelsius_d10 4 -3276.8 3276.7 MONOTONY STRICT_INCREASE DEPOSIT ABSOLUTE /end AXIS_DESCR
/end CHARACTERISTIC
/begin CHARACTERISTIC KL_TKW_NO "Target coolant temperature in normal operating mode depending on the ambient temperature" CURVE 0x9685540 _REC_S4CUR_52_KL_S2_1_S2 655.35 DchEpAd_DBCFgoa_Ckhahgc_q__aoa0 -327.68 327.67
 /begin AXIS_DESCR STD_AXIS Tumg_wm ___MGF_CC_TemperatureCelsius_d10 4 -3276.8 3276.7 MONOTONY STRICT_INCREASE DEPOSIT ABSOLUTE /end AXIS_DESCR
/end CHARACTERISTIC
/begin CHARACTERISTIC KLFVSTOTF "Offset correction of the pre-control MSV depending on fuel temperature" CURVE 0x96F758B Cur_Xu8Wu8 1.992188 fak_ub_b2 0 1.992188 FORMAT "%8.6"
 /begin AXIS_DESCR STD_AXIS tfuelsq_msg temp_ub_q0p75_o48 3 -48 143.3 FORMAT "%5.1" DEPOSIT ABSOLUTE /end AXIS_DESCR
/end CHARACTERISTIC
/begin CHARACTERISTIC KLIHDR "I-component of the rail pressure regulator" CURVE 0x96EF690 GkfWU16 7.999878 fak_sw_b4 0 7.999878 FORMAT "%8.6"
 /begin AXIS_DESCR COM_AXIS FuPHi_pHpRglnDeLoc RBPtCel_p_0p002_1 6 -65.536 65.534 AXIS_PTS_REF SPD06HDSW FORMAT "%8.5" DEPOSIT ABSOLUTE /end AXIS_DESCR
/end CHARACTERISTIC
/begin CHARACTERISTIC KLPHDR "P-component of the rail pressure regulator" CURVE 0x96EF69C GkfWU16 7.999878 fak_sw_b4 0 7.999878 FORMAT "%8.6"
 /begin AXIS_DESCR COM_AXIS FuPHi_pHpRglnDeLoc RBPtCel_p_0p002_1 6 -65.536 65.534 AXIS_PTS_REF SPD06HDSW FORMAT "%8.5" DEPOSIT ABSOLUTE /end AXIS_DESCR
/end CHARACTERISTIC
/begin CHARACTERISTIC KLPHDRTF "Factor P-component HDR as a function of temperature" CURVE 0x96EF6A8 Cur_Xu8Wu8 1.992188 fak_ub_b2 0 1.992188 FORMAT "%8.6"
 /begin AXIS_DESCR STD_AXIS tfuelsq_msg temp_ub_q0p75_o48 4 -48 143.3 FORMAT "%5.1" DEPOSIT ABSOLUTE /end AXIS_DESCR
/end CHARACTERISTIC
/begin CHARACTERISTIC KLVSTMSVG "Gain factor feedforward control MSV" CURVE 0x96F7592 GkfWU16 3.999939 fak_q6p1035Em5 0 3.999939 FORMAT "%8.6"
 /begin AXIS_DESCR COM_AXIS NO_INPUT_QUANTITY nmot_sw_q0p25 8 0 16383.75 AXIS_PTS_REF SNM08HDUW FORMAT "%8.2" DEPOSIT ABSOLUTE /end AXIS_DESCR
/end CHARACTERISTIC
/begin CHARACTERISTIC VSEKPMXN "Characteristic curve of fuel target volume flow at full load depending on the speed" CURVE 0x96E6EED Cur_Xu8Wu8 255 RBPtCel_vol_1p0_1 0 255 FORMAT "%5.1"
 /begin AXIS_DESCR STD_AXIS NO_INPUT_QUANTITY nmot_q40 5 0 10200 FORMAT "%5.0" PHYS_UNIT "1/min" DEPOSIT ABSOLUTE /end AXIS_DESCR
/end CHARACTERISTIC
/begin CHARACTERISTIC AKRGRCC "Characteristic map for exhaust flap control depending on the gangsist and nmot, with the convertible top closed" MAP 0x96E470E KfAxU8AyU8SstxU8SstyU8WU8 99.61 ___MGF_CC_Pedal_x100_d256 0 99.61 FORMAT "%5.2"
 /begin AXIS_DESCR STD_AXIS gangakr DEZ 10 0 127 FORMAT "%5.1" DEPOSIT ABSOLUTE /end AXIS_DESCR
 /begin AXIS_DESCR STD_AXIS Epm_nEngLRes nmot_q40 12 0 10000 FORMAT "%5.0" PHYS_UNIT "1/min" DEPOSIT ABSOLUTE /end AXIS_DESCR
/end CHARACTERISTIC
/begin CHARACTERISTIC AKRGRCC_VAR1 "Map for exhaust flap control depending on the gangsist and nmot, with the convertible top closed and the sports button activated" MAP 0x96E4BFA KfAxU8AyU8SstxU8SstyU8WU8 99.61 ___MGF_CC_Pedal_x100_d256 0 99.61 FORMAT "%5.2"
 /begin AXIS_DESCR STD_AXIS gangakr DEZ 6 0 127 FORMAT "%5.1" DEPOSIT ABSOLUTE /end AXIS_DESCR
 /begin AXIS_DESCR STD_AXIS Epm_nEngLRes nmot_q40 8 0 10000 FORMAT "%5.0" PHYS_UNIT "1/min" DEPOSIT ABSOLUTE /end AXIS_DESCR
/end CHARACTERISTIC
/begin CHARACTERISTIC AKRGRCC_VAR2 "Map for exhaust flap control depending on the gangsist and nmot, with the convertible top closed and the sports button activated" MAP 0x96E4C3A KfAxU8AyU8SstxU8SstyU8WU8 99.61 ___MGF_CC_Pedal_x100_d256 0 99.61 FORMAT "%5.2"
 /begin AXIS_DESCR STD_AXIS gangakr DEZ 6 0 127 FORMAT "%5.1" DEPOSIT ABSOLUTE /end AXIS_DESCR
 /begin AXIS_DESCR STD_AXIS Epm_nEngLRes nmot_q40 8 0 10000 FORMAT "%5.0" PHYS_UNIT "1/min" DEPOSIT ABSOLUTE /end AXIS_DESCR
/end CHARACTERISTIC
/begin CHARACTERISTIC AKRGRCC_VAR3 "Map for exhaust flap control depending on the gangsist and nmot, with the convertible top closed and the sports button activated" MAP 0x96E4C7A KfAxU8AyU8SstxU8SstyU8WU8 99.61 ___MGF_CC_Pedal_x100_d256 0 99.61 FORMAT "%5.2"
 /begin AXIS_DESCR STD_AXIS gangakr DEZ 6 0 127 FORMAT "%5.1" DEPOSIT ABSOLUTE /end AXIS_DESCR
 /begin AXIS_DESCR STD_AXIS Epm_nEngLRes nmot_q40 8 0 10000 FORMAT "%5.0" PHYS_UNIT "1/min" DEPOSIT ABSOLUTE /end AXIS_DESCR
/end CHARACTERISTIC
/begin CHARACTERISTIC AKRGRCCAT "Characteristic map for exhaust flap control depending on the gangsist and nmot (DKG or AT transmission), with the convertible top closed" MAP 0x96E479E KfAxU8AyU8SstxU8SstyU8WU8 99.61 ___MGF_CC_Pedal_x100_d256 0 99.61 FORMAT "%5.2"
 /begin AXIS_DESCR STD_AXIS gangakr DEZ 10 0 127 FORMAT "%5.1" DEPOSIT ABSOLUTE /end AXIS_DESCR
 /begin AXIS_DESCR STD_AXIS Epm_nEngLRes nmot_q40 12 0 10000 FORMAT "%5.0" PHYS_UNIT "1/min" DEPOSIT ABSOLUTE /end AXIS_DESCR
/end CHARACTERISTIC
/begin CHARACTERISTIC AKRGRCCAT_VAR1 "Characteristic map for exhaust flap control depending on the gangsist and nmot (DKG or AT transmission), with the convertible top closed" MAP 0x96E49B4 KfAxU8AyU8SstxU8SstyU8WU8 99.61 ___MGF_CC_Pedal_x100_d256 0 99.61 FORMAT "%5.2"
 /begin AXIS_DESCR STD_AXIS gangakr DEZ 8 0 127 FORMAT "%5.1" DEPOSIT ABSOLUTE /end AXIS_DESCR
 /begin AXIS_DESCR STD_AXIS Epm_nEngLRes nmot_q40 8 0 10000 FORMAT "%5.0" PHYS_UNIT "1/min" DEPOSIT ABSOLUTE /end AXIS_DESCR
/end CHARACTERISTIC
/begin CHARACTERISTIC AKRGRCCAT_VAR2 "Characteristic map for exhaust flap control depending on the gangsist and nmot (DKG or AT transmission), with the convertible top closed" MAP 0x96E4A06 KfAxU8AyU8SstxU8SstyU8WU8 99.61 ___MGF_CC_Pedal_x100_d256 0 99.61 FORMAT "%5.2"
 /begin AXIS_DESCR STD_AXIS gangakr DEZ 8 0 127 FORMAT "%5.1" DEPOSIT ABSOLUTE /end AXIS_DESCR
 /begin AXIS_DESCR STD_AXIS Epm_nEngLRes nmot_q40 8 0 10000 FORMAT "%5.0" PHYS_UNIT "1/min" DEPOSIT ABSOLUTE /end AXIS_DESCR
/end CHARACTERISTIC
/begin CHARACTERISTIC AKRGRCCAT_VAR3 "Characteristic map for exhaust flap control depending on the gangsist and nmot (DKG or AT transmission), with the convertible top closed" MAP 0x96E4A58 KfAxU8AyU8SstxU8SstyU8WU8 99.61 ___MGF_CC_Pedal_x100_d256 0 99.61 FORMAT "%5.2"
 /begin AXIS_DESCR STD_AXIS gangakr DEZ 8 0 127 FORMAT "%5.1" DEPOSIT ABSOLUTE /end AXIS_DESCR
 /begin AXIS_DESCR STD_AXIS Epm_nEngLRes nmot_q40 8 0 10000 FORMAT "%5.0" PHYS_UNIT "1/min" DEPOSIT ABSOLUTE /end AXIS_DESCR
/end CHARACTERISTIC
/begin CHARACTERISTIC AKRGRCCATM "Map for exhaust flap control depending on the gangsist and nmot (DKG or AT transmission), with the convertible top closed and the sports button activated" MAP 0x96E482E KfAxU8AyU8SstxU8SstyU8WU8 99.61 ___MGF_CC_Pedal_x100_d256 0 99.61 FORMAT "%5.2"
 /begin AXIS_DESCR STD_AXIS gangakr DEZ 10 0 127 FORMAT "%5.1" DEPOSIT ABSOLUTE /end AXIS_DESCR
 /begin AXIS_DESCR STD_AXIS Epm_nEngLRes nmot_q40 12 0 10000 FORMAT "%5.0" PHYS_UNIT "1/min" DEPOSIT ABSOLUTE /end AXIS_DESCR
/end CHARACTERISTIC
/begin CHARACTERISTIC AKRGRCCATM_VAR1 "Map for exhaust flap control depending on the gangsist and nmot (DKG or AT transmission), with the convertible top closed and the sports button activated" MAP 0x96E48BE KfAxU8AyU8SstxU8SstyU8WU8 99.61 ___MGF_CC_Pedal_x100_d256 0 99.61 FORMAT "%5.2"
 /begin AXIS_DESCR STD_AXIS gangakr DEZ 8 0 127 FORMAT "%5.1" DEPOSIT ABSOLUTE /end AXIS_DESCR
 /begin AXIS_DESCR STD_AXIS Epm_nEngLRes nmot_q40 8 0 10000 FORMAT "%5.0" PHYS_UNIT "1/min" DEPOSIT ABSOLUTE /end AXIS_DESCR
/end CHARACTERISTIC
/begin CHARACTERISTIC AKRGRCCATM_VAR2 "Map for exhaust flap control depending on the gangsist and nmot (DKG or AT transmission), with the convertible top closed and the sports button activated" MAP 0x96E4910 KfAxU8AyU8SstxU8SstyU8WU8 99.61 ___MGF_CC_Pedal_x100_d256 0 99.61 FORMAT "%5.2"
 /begin AXIS_DESCR STD_AXIS gangakr DEZ 8 0 127 FORMAT "%5.1" DEPOSIT ABSOLUTE /end AXIS_DESCR
 /begin AXIS_DESCR STD_AXIS Epm_nEngLRes nmot_q40 8 0 10000 FORMAT "%5.0" PHYS_UNIT "1/min" DEPOSIT ABSOLUTE /end AXIS_DESCR
/end CHARACTERISTIC
/begin CHARACTERISTIC AKRGRCCATM_VAR3 "Map for exhaust flap control depending on the gangsist and nmot (DKG or AT transmission), with the convertible top closed and the sports button activated" MAP 0x96E4962 KfAxU8AyU8SstxU8SstyU8WU8 99.61 ___MGF_CC_Pedal_x100_d256 0 99.61 FORMAT "%5.2"
 /begin AXIS_DESCR STD_AXIS gangakr DEZ 8 0 127 FORMAT "%5.1" DEPOSIT ABSOLUTE /end AXIS_DESCR
 /begin AXIS_DESCR STD_AXIS Epm_nEngLRes nmot_q40 8 0 10000 FORMAT "%5.0" PHYS_UNIT "1/min" DEPOSIT ABSOLUTE /end AXIS_DESCR
/end CHARACTERISTIC
/begin CHARACTERISTIC AKRGRCCM "Map for exhaust flap control depending on the gangsist and nmot, with the convertible top closed and the sports button activated" MAP 0x96E4AAA KfAxU8AyU8SstxU8SstyU8WU8 99.61 ___MGF_CC_Pedal_x100_d256 0 99.61 FORMAT "%5.2"
 /begin AXIS_DESCR STD_AXIS gangakr DEZ 10 0 127 FORMAT "%5.1" DEPOSIT ABSOLUTE /end AXIS_DESCR
 /begin AXIS_DESCR STD_AXIS Epm_nEngLRes nmot_q40 12 0 10000 FORMAT "%5.0" PHYS_UNIT "1/min" DEPOSIT ABSOLUTE /end AXIS_DESCR
/end CHARACTERISTIC
/begin CHARACTERISTIC AKRGRCCM_VAR1 "Map for exhaust flap control depending on the gangsist and nmot, with the convertible top closed and the sports button activated" MAP 0x96E4B3A KfAxU8AyU8SstxU8SstyU8WU8 99.61 ___MGF_CC_Pedal_x100_d256 0 99.61 FORMAT "%5.2"
 /begin AXIS_DESCR STD_AXIS gangakr DEZ 6 0 127 FORMAT "%5.1" DEPOSIT ABSOLUTE /end AXIS_DESCR
 /begin AXIS_DESCR STD_AXIS Epm_nEngLRes nmot_q40 8 0 10000 FORMAT "%5.0" PHYS_UNIT "1/min" DEPOSIT ABSOLUTE /end AXIS_DESCR
/end CHARACTERISTIC
/begin CHARACTERISTIC AKRGRCCM_VAR2 "Map for exhaust flap control depending on the gangsist and nmot, with the convertible top closed and the sports button activated" MAP 0x96E4B7A KfAxU8AyU8SstxU8SstyU8WU8 99.61 ___MGF_CC_Pedal_x100_d256 0 99.61 FORMAT "%5.2"
 /begin AXIS_DESCR STD_AXIS gangakr DEZ 6 0 127 FORMAT "%5.1" DEPOSIT ABSOLUTE /end AXIS_DESCR
 /begin AXIS_DESCR STD_AXIS Epm_nEngLRes nmot_q40 8 0 10000 FORMAT "%5.0" PHYS_UNIT "1/min" DEPOSIT ABSOLUTE /end AXIS_DESCR
/end CHARACTERISTIC
/begin CHARACTERISTIC AKRGRCCM_VAR3 "Map for exhaust flap control depending on the gangsist and nmot, with the convertible top closed and the sports button activated" MAP 0x96E4BBA KfAxU8AyU8SstxU8SstyU8WU8 99.61 ___MGF_CC_Pedal_x100_d256 0 99.61 FORMAT "%5.2"
 /begin AXIS_DESCR STD_AXIS gangakr DEZ 6 0 127 FORMAT "%5.1" DEPOSIT ABSOLUTE /end AXIS_DESCR
 /begin AXIS_DESCR STD_AXIS Epm_nEngLRes nmot_q40 8 0 10000 FORMAT "%5.0" PHYS_UNIT "1/min" DEPOSIT ABSOLUTE /end AXIS_DESCR
/end CHARACTERISTIC
/begin CHARACTERISTIC AKRGRCO "Characteristic map for exhaust flap control depending on the gangsist and nmot, with the convertible top open" MAP 0x96E4CBA KfAxU8AyU8SstxU8SstyU8WU8 99.61 ___MGF_CC_Pedal_x100_d256 0 99.61 FORMAT "%5.2"
 /begin AXIS_DESCR STD_AXIS gangakr DEZ 10 0 127 FORMAT "%5.1" DEPOSIT ABSOLUTE /end AXIS_DESCR
 /begin AXIS_DESCR STD_AXIS Epm_nEngLRes nmot_q40 12 0 10000 FORMAT "%5.0" PHYS_UNIT "1/min" DEPOSIT ABSOLUTE /end AXIS_DESCR
/end CHARACTERISTIC
/begin CHARACTERISTIC AKRGRCO_VAR1 "Characteristic map for exhaust flap control depending on the gangsist and nmot, with the convertible top open" MAP 0x96E4FDE KfAxU8AyU8SstxU8SstyU8WU8 99.61 ___MGF_CC_Pedal_x100_d256 0 99.61 FORMAT "%5.2"
 /begin AXIS_DESCR STD_AXIS gangakr DEZ 6 0 127 FORMAT "%5.1" DEPOSIT ABSOLUTE /end AXIS_DESCR
 /begin AXIS_DESCR STD_AXIS Epm_nEngLRes nmot_q40 8 0 10000 FORMAT "%5.0" PHYS_UNIT "1/min" DEPOSIT ABSOLUTE /end AXIS_DESCR
/end CHARACTERISTIC
/begin CHARACTERISTIC AKRGRCOAT "Characteristic map for exhaust flap control depending on the gangsist and nmot (DKG or AT transmission), with the convertible top open" MAP 0x96E4D4A KfAxU8AyU8SstxU8SstyU8WU8 99.61 ___MGF_CC_Pedal_x100_d256 0 99.61 FORMAT "%5.2"
 /begin AXIS_DESCR STD_AXIS gangakr DEZ 10 0 127 FORMAT "%5.1" DEPOSIT ABSOLUTE /end AXIS_DESCR
 /begin AXIS_DESCR STD_AXIS Epm_nEngLRes nmot_q40 12 0 10000 FORMAT "%5.0" PHYS_UNIT "1/min" DEPOSIT ABSOLUTE /end AXIS_DESCR
/end CHARACTERISTIC
/begin CHARACTERISTIC AKRGRCOAT_VAR1 "Characteristic map for exhaust flap control depending on the gangsist and nmot (DKG or AT transmission), with the convertible top open" MAP 0x96E4EBC KfAxU8AyU8SstxU8SstyU8WU8 99.61 ___MGF_CC_Pedal_x100_d256 0 99.61 FORMAT "%5.2"
 /begin AXIS_DESCR STD_AXIS gangakr DEZ 8 0 127 FORMAT "%5.1" DEPOSIT ABSOLUTE /end AXIS_DESCR
 /begin AXIS_DESCR STD_AXIS Epm_nEngLRes nmot_q40 8 0 10000 FORMAT "%5.0" PHYS_UNIT "1/min" DEPOSIT ABSOLUTE /end AXIS_DESCR
/end CHARACTERISTIC
/begin CHARACTERISTIC AKRGRCOATM "Characteristic map for exhaust flap control depending on the gangsist and nmot (DKG or AT transmission), with the convertible top open and the sport button activated and the sport button activated" MAP 0x96E4DDA KfAxU8AyU8SstxU8SstyU8WU8 99.61 ___MGF_CC_Pedal_x100_d256 0 99.61 FORMAT "%5.2"
 /begin AXIS_DESCR STD_AXIS gangakr DEZ 10 0 127 FORMAT "%5.1" DEPOSIT ABSOLUTE /end AXIS_DESCR
 /begin AXIS_DESCR STD_AXIS Epm_nEngLRes nmot_q40 12 0 10000 FORMAT "%5.0" PHYS_UNIT "1/min" DEPOSIT ABSOLUTE /end AXIS_DESCR
/end CHARACTERISTIC
/begin CHARACTERISTIC AKRGRCOATM_VAR1 "Characteristic map for exhaust flap control depending on the gangsist and nmot (DKG or AT transmission), with the convertible top open and the sport button activated and the sport button activated" MAP 0x96E4E6A KfAxU8AyU8SstxU8SstyU8WU8 99.61 ___MGF_CC_Pedal_x100_d256 0 99.61 FORMAT "%5.2"
 /begin AXIS_DESCR STD_AXIS gangakr DEZ 8 0 127 FORMAT "%5.1" DEPOSIT ABSOLUTE /end AXIS_DESCR
 /begin AXIS_DESCR STD_AXIS Epm_nEngLRes nmot_q40 8 0 10000 FORMAT "%5.0" PHYS_UNIT "1/min" DEPOSIT ABSOLUTE /end AXIS_DESCR
/end CHARACTERISTIC
/begin CHARACTERISTIC AKRGRCOM "Map for exhaust flap control depending on the gangsist and nmot, with the convertible top open and the sports button activated" MAP 0x96E4F0E KfAxU8AyU8SstxU8SstyU8WU8 99.61 ___MGF_CC_Pedal_x100_d256 0 99.61 FORMAT "%5.2"
 /begin AXIS_DESCR STD_AXIS gangakr DEZ 10 0 127 FORMAT "%5.1" DEPOSIT ABSOLUTE /end AXIS_DESCR
 /begin AXIS_DESCR STD_AXIS Epm_nEngLRes nmot_q40 12 0 10000 FORMAT "%5.0" PHYS_UNIT "1/min" DEPOSIT ABSOLUTE /end AXIS_DESCR
/end CHARACTERISTIC
/begin CHARACTERISTIC AKRGRCOM_VAR1 "Map for exhaust flap control depending on the gangsist and nmot, with the convertible top open and the sports button activated" MAP 0x96E4F9E KfAxU8AyU8SstxU8SstyU8WU8 99.61 ___MGF_CC_Pedal_x100_d256 0 99.61 FORMAT "%5.2"
 /begin AXIS_DESCR STD_AXIS gangakr DEZ 6 0 127 FORMAT "%5.1" DEPOSIT ABSOLUTE /end AXIS_DESCR
 /begin AXIS_DESCR STD_AXIS Epm_nEngLRes nmot_q40 8 0 10000 FORMAT "%5.0" PHYS_UNIT "1/min" DEPOSIT ABSOLUTE /end AXIS_DESCR
/end CHARACTERISTIC
/begin CHARACTERISTIC Antilag_BMWtchctr_p_DifCrtnPp_M___MGF_CC_PF "Correction of pressure difference f. P-part of the performance-based boost pressure controller (X-Axis does not switch, )" MAP 0x97755DC _REC_A1CUR_1_MBSE_S2_S1 8191.875 ___MGF_CC_PressurehPa_d8 -4096 4095.875 FORMAT "%10.3"
 /begin AXIS_DESCR COM_AXIS BMWtchbas_p_Dif_sw ___MGF_CC_PressurehPa_d8 12 -4096 4095.875 AXIS_PTS_REF Antilag_BMWtchctr_p_DifCrtnPp_Ax___MGF_CC_PF FORMAT "%10.3" MONOTONY MON_INCREASE DEPOSIT ABSOLUTE /end AXIS_DESCR
 /begin AXIS_DESCR COM_AXIS BMWtchsp_mf_Ex_uw CByjozc_eCmpBAb_pljBAmd_k__0oa0 6 0 2047.96875 AXIS_PTS_REF Antilag_BMWtchctr_p_DifCrtnPp_Ay___MGF_CC_PF FORMAT "%10.3" MONOTONY STRICT_INCREASE DEPOSIT ABSOLUTE /end AXIS_DESCR
/end CHARACTERISTIC
/begin CHARACTERISTIC Antilag_BMWtchctr_p_DifCrtnPpDyn_M___MGF_CC_PF "Correction of pressure difference f. P-part of the performance-based boost pressure controller (X-Axis does not switch, )" MAP 0x9775678 _REC_A1CUR_1_MBSE_S2_S1 8191.875 ___MGF_CC_PressurehPa_d8 -4096 4095.875 FORMAT "%10.3"
 /begin AXIS_DESCR COM_AXIS BMWtchbas_p_Dif_sw ___MGF_CC_PressurehPa_d8 12 -4096 4095.875 AXIS_PTS_REF Antilag_BMWtchctr_p_DifCrtnPpDyn_Ax___MGF_CC_PF FORMAT "%10.3" MONOTONY MON_INCREASE DEPOSIT ABSOLUTE /end AXIS_DESCR
 /begin AXIS_DESCR COM_AXIS BMWtchsp_mf_Ex_uw CByjozc_eCmpBAb_pljBAmd_k__0oa0 6 0 2047.96875 AXIS_PTS_REF Antilag_BMWtchctr_p_DifCrtnPpDyn_Ay___MGF_CC_PF FORMAT "%10.3" MONOTONY STRICT_INCREASE DEPOSIT ABSOLUTE /end AXIS_DESCR
/end CHARACTERISTIC
/begin CHARACTERISTIC Antilag_BMWtchctr_pwr_Dp_M___MGF_CC_PF "D part of the performance-based boost pressure controller (X-Axis and Y-Axis do not switch)" MAP 0x9775714 _REC_A1CUR_1_MBSE_S2_S1 127.998046875 jucyrzb_bpFgwfd_uqrfhgc_k__aoa0 -64 63.998046875 FORMAT "%10.3"
 /begin AXIS_DESCR COM_AXIS BMWtchbas_p_Dif_sw ___MGF_CC_PressurehPa_d8 14 -4096 4095.875 AXIS_PTS_REF BMWtchctr_pwr_Dp_Ax FORMAT "%10.3" MONOTONY STRICT_INCREASE DEPOSIT ABSOLUTE /end AXIS_DESCR
 /begin AXIS_DESCR COM_AXIS BMWtchbas_p_DifGra_sw ___MGF_CC_PressurehPa_d8 14 -4096 4095.875 AXIS_PTS_REF BMWtchctr_pwr_Dp_Ay FORMAT "%10.3" MONOTONY STRICT_INCREASE DEPOSIT ABSOLUTE /end AXIS_DESCR
/end CHARACTERISTIC
/begin CHARACTERISTIC Antilag_BMWtchctr_pwr_Pctl_M___MGF_CC_PF "Compressor map with required compressor / turbine performance ()" MAP 0x9775312 _REC_A1CUR_1_MBSE_U2_S2 127.998046875 jucyrzb_bpFgwfd_uqrfhgc_k__aoa0 0 127.998046875 FORMAT "%11.4"
 /begin AXIS_DESCR COM_AXIS BMWtchsp_rat_p_CmprLim_uw acriqBc_tfkBqod_ocgjxzc_nR_8oa0 20 0 7.9998779296875 AXIS_PTS_REF Antilag_BMWtchctr_pwr_Pctl_Ax___MGF_CC_PF FORMAT "%11.4" MONOTONY MON_INCREASE DEPOSIT ABSOLUTE /end AXIS_DESCR
 /begin AXIS_DESCR COM_AXIS BMWtchsp_mf_CmprNorm_uw CByjozc_eCmpBAb_pljBAmd_k__0oa0 16 0 2047.96875 AXIS_PTS_REF Antilag_BMWtchctr_pwr_Pctl_Ay___MGF_CC_PF FORMAT "%10.3" MONOTONY STRICT_INCREASE DEPOSIT ABSOLUTE /end AXIS_DESCR
/end CHARACTERISTIC
/begin CHARACTERISTIC Antilag_IgnRoll___MGF_CC_PF "Ignition setpoint: Engine speed [Nkw] vs Boost actual [Ps]" MAP 0x9775016 CurG_Ws16 0 ___MGF_CC_IgnitionTiming_d10 -100 100 MATRIX_DIM 10 10 1
 /begin AXIS_DESCR COM_AXIS Nkw caoddzd_oAjpfzb_cAcEEha_1nR_oa0 10 0 15000 AXIS_PTS_REF Antilag_IgnRoll_X_Axis___MGF_CC_PF DEPOSIT ABSOLUTE /end AXIS_DESCR
 /begin AXIS_DESCR COM_AXIS Ps ___MGF_CC_PressurehPa_d8 10 -3000 3000 AXIS_PTS_REF Antilag_IgnRoll_Y_Axis___MGF_CC_PF DEPOSIT ABSOLUTE /end AXIS_DESCR
/end CHARACTERISTIC
/begin CHARACTERISTIC Antilag_IgnStand___MGF_CC_PF "Ignition setpoint: Engine speed [Nkw] vs Boost actual [Ps]" MAP 0x9774F26 CurG_Ws16 0 ___MGF_CC_IgnitionTiming_d10 -100 100 MATRIX_DIM 10 10 1
 /begin AXIS_DESCR COM_AXIS Nkw caoddzd_oAjpfzb_cAcEEha_1nR_oa0 10 0 15000 AXIS_PTS_REF Antilag_IgnStand_X_Axis___MGF_CC_PF DEPOSIT ABSOLUTE /end AXIS_DESCR
 /begin AXIS_DESCR COM_AXIS Ps ___MGF_CC_PressurehPa_d8 10 -3000 3000 AXIS_PTS_REF Antilag_IgnStand_Y_Axis___MGF_CC_PF DEPOSIT ABSOLUTE /end AXIS_DESCR
/end CHARACTERISTIC
/begin CHARACTERISTIC Antilag_LambdaRoll___MGF_CC_PF "Fueling setpoint: Engine speed [Nkw] vs Exhaust Gas Temperature [EGT] before turbine [Tabg_vl_xab]" MAP 0x97751F6 GkfWU16 0 ___MGF_CC_Fueling_d10 0 2 MATRIX_DIM 10 10 1
 /begin AXIS_DESCR COM_AXIS Nkw caoddzd_oAjpfzb_cAcEEha_1nR_oa0 10 0 15000 AXIS_PTS_REF Antilag_LambdaRoll_X_Axis___MGF_CC_PF DEPOSIT ABSOLUTE /end AXIS_DESCR
 /begin AXIS_DESCR COM_AXIS Tabg_vl_xab ___MGF_CC_TemperatureCelsius_d10 10 -3000 3000 AXIS_PTS_REF Antilag_LambdaRoll_Y_Axis___MGF_CC_PF DEPOSIT ABSOLUTE /end AXIS_DESCR
/end CHARACTERISTIC
/begin CHARACTERISTIC Antilag_LambdaStand___MGF_CC_PF "Fueling setpoint: Engine speed [Nkw] vs Exhaust Gas Temperature [EGT] before turbine [Tabg_vl_xab]" MAP 0x9775106 GkfWU16 0 ___MGF_CC_Fueling_d10 0 2 MATRIX_DIM 10 10 1
 /begin AXIS_DESCR COM_AXIS Nkw caoddzd_oAjpfzb_cAcEEha_1nR_oa0 10 0 15000 AXIS_PTS_REF Antilag_LambdaStand_X_Axis___MGF_CC_PF DEPOSIT ABSOLUTE /end AXIS_DESCR
 /begin AXIS_DESCR COM_AXIS Tabg_vl_xab ___MGF_CC_TemperatureCelsius_d10 10 -3000 3000 AXIS_PTS_REF Antilag_LambdaStand_Y_Axis___MGF_CC_PF DEPOSIT ABSOLUTE /end AXIS_DESCR
/end CHARACTERISTIC
/begin CHARACTERISTIC BMWchas_lam_InjMpl_M "Lambda setpoint for multiple Injection" MAP 0x96AF4F4 _REC_A1CUR_1_MBSE_U2_S2 15.999755859375 BumqDkc_mryszAa_EcglxAc_nR_4oa0 0 15.999755859375
 /begin AXIS_DESCR COM_AXIS Nkw caoddzd_oAjpfzb_cAcEEha_1nR_oa0 10 -32768 32767 AXIS_PTS_REF BMWchas_lam_InjMpl_Ax FORMAT "%5.0" MONOTONY STRICT_INCREASE DEPOSIT ABSOLUTE /end AXIS_DESCR
 /begin AXIS_DESCR COM_AXIS BMWchas_tq_CmbEng_sw Mo_trq_nm_q0p1 10 -3276.8 3276.7 AXIS_PTS_REF BMWchas_lam_InjMpl_Ay FORMAT "%6.1" MONOTONY STRICT_INCREASE DEPOSIT ABSOLUTE /end AXIS_DESCR
/end CHARACTERISTIC
/begin CHARACTERISTIC BMWchas_lam_InjMplThr_M "Lambda setpoint for multiple Injection at throttled operation mode" MAP 0x96AF5BC _REC_A1CUR_1_MBSE_U2_S2 15.999755859375 BumqDkc_mryszAa_EcglxAc_nR_4oa0 0 15.999755859375
 /begin AXIS_DESCR COM_AXIS Nkw caoddzd_oAjpfzb_cAcEEha_1nR_oa0 10 -32768 32767 AXIS_PTS_REF BMWchas_lam_InjMplThr_Ax FORMAT "%5.0" MONOTONY STRICT_INCREASE DEPOSIT ABSOLUTE /end AXIS_DESCR
 /begin AXIS_DESCR COM_AXIS BMWchas_tq_CmbEng_sw Mo_trq_nm_q0p1 10 -3276.8 3276.7 AXIS_PTS_REF BMWchas_lam_InjMplThr_Ay FORMAT "%6.1" MONOTONY STRICT_INCREASE DEPOSIT ABSOLUTE /end AXIS_DESCR
/end CHARACTERISTIC
/begin CHARACTERISTIC BMWchas_lam_InjSng_M "Lambda setpoint for single Injection" MAP 0x96AF324 _REC_A1CUR_1_MBSE_U2_S2 15.999755859375 BumqDkc_mryszAa_EcglxAc_nR_4oa0 0 15.999755859375
 /begin AXIS_DESCR COM_AXIS Nkw caoddzd_oAjpfzb_cAcEEha_1nR_oa0 10 -32768 32767 AXIS_PTS_REF BMWchas_lam_InjSng_Ax FORMAT "%5.0" MONOTONY STRICT_INCREASE DEPOSIT ABSOLUTE /end AXIS_DESCR
 /begin AXIS_DESCR COM_AXIS BMWchas_tq_CmbEng_sw Mo_trq_nm_q0p1 10 -3276.8 3276.7 AXIS_PTS_REF BMWchas_lam_InjSng_Ay FORMAT "%6.1" MONOTONY STRICT_INCREASE DEPOSIT ABSOLUTE /end AXIS_DESCR
/end CHARACTERISTIC
/begin CHARACTERISTIC BMWchas_lam_InjSngThr_M "Lambda setpoint for single injection at throttled operation mode" MAP 0x96AF3EC _REC_A1CUR_1_MBSE_U2_S2 15.999755859375 BumqDkc_mryszAa_EcglxAc_nR_4oa0 0 15.999755859375
 /begin AXIS_DESCR COM_AXIS Nkw caoddzd_oAjpfzb_cAcEEha_1nR_oa0 10 -32768 32767 AXIS_PTS_REF BMWchas_lam_InjSngThr_Ax FORMAT "%5.0" MONOTONY STRICT_INCREASE DEPOSIT ABSOLUTE /end AXIS_DESCR
 /begin AXIS_DESCR COM_AXIS BMWchas_tq_CmbEng_sw Mo_trq_nm_q0p1 10 -3276.8 3276.7 AXIS_PTS_REF BMWchas_lam_InjSngThr_Ay FORMAT "%6.1" MONOTONY STRICT_INCREASE DEPOSIT ABSOLUTE /end AXIS_DESCR
/end CHARACTERISTIC
/begin CHARACTERISTIC BMWchas_p_RailInjMpl_M "Rail pressure setpoint for multiple injection" MAP 0x96AF744 _REC_A1CUR_1_MBSE_U2_S2 39.9993896484375 cxdjuna_xpuCged_ocEpdua_MCRa2a0 0 39.9993896484375
 /begin AXIS_DESCR COM_AXIS Nkw caoddzd_oAjpfzb_cAcEEha_1nR_oa0 6 -32768 32767 AXIS_PTS_REF BMWchas_p_RailInjMpl_Ax FORMAT "%5.0" MONOTONY STRICT_INCREASE DEPOSIT ABSOLUTE /end AXIS_DESCR
 /begin AXIS_DESCR COM_AXIS BMWrailco_rat_VabHom_sw zyyxBpb_rEsnvtc_gktukCa_fR_5a0o 6 -1600 1599.951171875 AXIS_PTS_REF BMWchas_p_RailInjMpl_Ay FORMAT "%8.3" MONOTONY STRICT_INCREASE DEPOSIT ABSOLUTE /end AXIS_DESCR
/end CHARACTERISTIC
/begin CHARACTERISTIC BMWchas_p_RailInjSng_M "Rail pressure setpoint for single injection" MAP 0x96AF6C4 _REC_A1CUR_1_MBSE_U2_S2 39.9993896484375 cxdjuna_xpuCged_ocEpdua_MCRa2a0 0 39.9993896484375
 /begin AXIS_DESCR COM_AXIS Nkw caoddzd_oAjpfzb_cAcEEha_1nR_oa0 8 -32768 32767 AXIS_PTS_REF BMWchas_p_RailInjSng_Ax FORMAT "%5.0" MONOTONY STRICT_INCREASE DEPOSIT ABSOLUTE /end AXIS_DESCR
 /begin AXIS_DESCR COM_AXIS BMWrailco_rat_VabHom_sw zyyxBpb_rEsnvtc_gktukCa_fR_5a0o 8 -1600 1599.951171875 AXIS_PTS_REF BMWchas_p_RailInjSng_Ay FORMAT "%8.3" MONOTONY STRICT_INCREASE DEPOSIT ABSOLUTE /end AXIS_DESCR
/end CHARACTERISTIC
/begin CHARACTERISTIC BMWchas_st_OpmBasc_M "Basic catalyst heating mode wish" MAP 0x96BD15C _REC_A1CUR_1_MBSE_U1_S1 3 wDvwtyd_Bhgozed_DCekdfb_nsttFSS 0 3
 /begin AXIS_DESCR COM_AXIS BMWchas_ti_AftStrSca_uw noCyFga_rslwmfa_ecfnhgc_sR_2a0o 8 0 255.99609375 AXIS_PTS_REF BMWchas_st_OpmBasc_Ax MONOTONY STRICT_INCREASE DEPOSIT ABSOLUTE /end AXIS_DESCR
 /begin AXIS_DESCR COM_AXIS BMWchas_t_EngStr_sw ___MGF_CC_TemperatureCelsius_d10 8 -3276.8 3276.7 AXIS_PTS_REF BMWchas_st_OpmBasc_Ay MONOTONY MON_INCREASE DEPOSIT ABSOLUTE /end AXIS_DESCR
/end CHARACTERISTIC
/begin CHARACTERISTIC BMWext_lam_CptPronMinLeanTq_M "Lambda Lean Best Torque for limiting the component protection lambda" MAP 0x96925B2 _REC_A1CUR_1_MBSE_U2_S2 15.999755859375 BumqDkc_mryszAa_EcglxAc_nR_4oa0 0 15.999755859375
 /begin AXIS_DESCR COM_AXIS Nkw_atm caoddzd_oAjpfzb_cAcEEha_1nR_oa0 8 -32768 32767 AXIS_PTS_REF BMWext_lam_CptPronMinLeanTq_Ax MONOTONY STRICT_INCREASE DEPOSIT ABSOLUTE /end AXIS_DESCR
 /begin AXIS_DESCR COM_AXIS Rf_atm CgkBooc_wkiDfEd_Czglhgc_fR_1a0o 8 -327.68 327.67 AXIS_PTS_REF BMWext_lam_CptPronMinLeanTq_Ay MONOTONY STRICT_INCREASE DEPOSIT ABSOLUTE /end AXIS_DESCR
/end CHARACTERISTIC
/begin CHARACTERISTIC BMWgpfheat_p_RailInjMpl_M "Rail pressure setpoint for multiple injection" MAP 0x9694B34 _REC_A1CUR_1_MBSE_U2_S2 39.9993896484375 cxdjuna_xpuCged_ocEpdua_MCRa2a0 0 39.9993896484375
 /begin AXIS_DESCR COM_AXIS Nkw caoddzd_oAjpfzb_cAcEEha_1nR_oa0 6 -32768 32767 AXIS_PTS_REF BMWgpfheat_p_RailInjMpl_Ax FORMAT "%5.0" MONOTONY STRICT_INCREASE DEPOSIT ABSOLUTE /end AXIS_DESCR
 /begin AXIS_DESCR COM_AXIS BMWrailco_rat_VabHom_sw zyyxBpb_rEsnvtc_gktukCa_fR_5a0o 6 -1600 1599.951171875 AXIS_PTS_REF BMWgpfheat_p_RailInjMpl_Ay FORMAT "%8.3" MONOTONY STRICT_INCREASE DEPOSIT ABSOLUTE /end AXIS_DESCR
/end CHARACTERISTIC
/begin CHARACTERISTIC BMWgpfheat_p_RailInjSng_M "Rail pressure setpoint for multiple injection" MAP 0x9694AEC _REC_A1CUR_1_MBSE_U2_S2 39.9993896484375 cxdjuna_xpuCged_ocEpdua_MCRa2a0 0 39.9993896484375
 /begin AXIS_DESCR COM_AXIS Nkw caoddzd_oAjpfzb_cAcEEha_1nR_oa0 6 -32768 32767 AXIS_PTS_REF BMWgpfheat_p_RailInjSng_Ax FORMAT "%5.0" MONOTONY STRICT_INCREASE DEPOSIT ABSOLUTE /end AXIS_DESCR
 /begin AXIS_DESCR COM_AXIS BMWrailco_rat_VabHom_sw zyyxBpb_rEsnvtc_gktukCa_fR_5a0o 6 -1600 1599.951171875 AXIS_PTS_REF BMWgpfheat_p_RailInjSng_Ay FORMAT "%8.3" MONOTONY STRICT_INCREASE DEPOSIT ABSOLUTE /end AXIS_DESCR
/end CHARACTERISTIC
/begin CHARACTERISTIC BMWinjmon_fac_HppEff_M "Injection map factor efficiency high pressure pump" MAP 0x96B10CA _REC_A1CUR_1_MBSE_U2_S2 1.99996948242188 Bhvfwhc_bigEubd_BBEupBd_nR_3oa0 0 1.99996948242188 FORMAT "%6.2"
 /begin AXIS_DESCR COM_AXIS Nkw caoddzd_oAjpfzb_cAcEEha_1nR_oa0 8 -32768 32767 AXIS_PTS_REF BMWinjmon_fac_HppEff_Ax FORMAT "%5.0" MONOTONY STRICT_INCREASE DEPOSIT ABSOLUTE /end AXIS_DESCR
 /begin AXIS_DESCR COM_AXIS Prail_ist cxdjuna_xpuCged_ocEpdua_MCRa2a0 4 0 39.9993896484375 AXIS_PTS_REF BMWinjmon_fac_HppEff_Ay FORMAT "%9.4" MONOTONY STRICT_INCREASE DEPOSIT ABSOLUTE /end AXIS_DESCR
/end CHARACTERISTIC
/begin CHARACTERISTIC BMWlpa_n_EfpEngStrtAmb_M "EKP speed specification start environment" MAP 0x9694226 _REC_A1CUR_1_MBSE_U2_S2 65535 caoddzd_oAjpfzb_cAcEEha_1nR_oa0 0 65535 FORMAT "%5.0"
 /begin AXIS_DESCR COM_AXIS Tumg ___MGF_CC_TemperatureCelsius_d10 4 -3276.8 3276.7 AXIS_PTS_REF BMWlpa_n_EfpEngStrtAmb_Ax FORMAT "%6.1" MONOTONY STRICT_INCREASE DEPOSIT ABSOLUTE /end AXIS_DESCR
 /begin AXIS_DESCR COM_AXIS Pumg ___MGF_CC_PressurehPa_d8 4 0 8191.875 AXIS_PTS_REF BMWlpa_n_EfpEngStrtAmb_Ay FORMAT "%8.3" MONOTONY STRICT_INCREASE DEPOSIT ABSOLUTE /end AXIS_DESCR
/end CHARACTERISTIC
/begin CHARACTERISTIC BMWlpa_n_EfpModSafe_M "EKP speed specification safe mode" MAP 0x9694172 _REC_A1CUR_1_MBSE_U2_S2 65535 caoddzd_oAjpfzb_cAcEEha_1nR_oa0 0 65535 FORMAT "%5.0"
 /begin AXIS_DESCR COM_AXIS BMWlpi_t_Fu_sw DchEpAd_DBCFgoa_Ckhahgc_q__aoa0 4 -327.68 327.67 AXIS_PTS_REF BMWlpa_n_EfpModSafe_Ax FORMAT "%5.2" MONOTONY STRICT_INCREASE DEPOSIT ABSOLUTE /end AXIS_DESCR
 /begin AXIS_DESCR COM_AXIS BMWlpi_volf_Fu_sw zBcBzad_vmoivka_mFzjCgc_lCRooa0 4 -327.68 327.67 AXIS_PTS_REF BMWlpa_n_EfpModSafe_Ay FORMAT "%5.2" MONOTONY STRICT_INCREASE DEPOSIT ABSOLUTE /end AXIS_DESCR
/end CHARACTERISTIC
/begin CHARACTERISTIC BMWlpsc_volf_FuEjrPmp_M "Flow rate map" MAP 0x969466E _REC_A1CUR_1_MBSE_S2_S1 655.35 zBcBzad_vmoivka_mFzjCgc_lCRooa0 -327.68 327.67 FORMAT "%5.2"
 /begin AXIS_DESCR COM_AXIS BMWlpsc_p_EfpSpCtld_uw rgduxyd_mlihaBb_gsCghzb_bCRa0a0 8 0 65.535 AXIS_PTS_REF BMWlpsc_volf_FuEjrPmp_Ax FORMAT "%5.3" MONOTONY STRICT_INCREASE DEPOSIT ABSOLUTE /end AXIS_DESCR
 /begin AXIS_DESCR COM_AXIS BMWlpsc_st_TankCod_ub raChrxc_kBtBrmb_FmDuEFa_n__aa0o 4 0 255 AXIS_PTS_REF BMWlpsc_volf_FuEjrPmp_Ay FORMAT "%3.0" MONOTONY STRICT_INCREASE DEPOSIT ABSOLUTE /end AXIS_DESCR
/end CHARACTERISTIC
/begin CHARACTERISTIC BMWls_fac_rf_RednFuOctIntkT_M "Base value for the filling reduction factor depending on fuel quality and intake air temperature." MAP 0x96BE464 _REC_A1CUR_1_MBSE_U1_S1 1 ggDviCc_uydFbsa_CDgnhgc_nR_2a0o 0 1 FORMAT "%6.4"
 /begin AXIS_DESCR COM_AXIS F_octan BpaECzb_zweffod_enenhgc_nR_2a0o 6 0 0.99609375 AXIS_PTS_REF BMWls_fac_rf_RednFuOctIntkT_Ax FORMAT "%6.1" MONOTONY STRICT_INCREASE DEPOSIT ABSOLUTE /end AXIS_DESCR
 /begin AXIS_DESCR COM_AXIS Tans ___MGF_CC_TemperatureCelsius_d10 6 -3276.8 3276.7 AXIS_PTS_REF BMWls_fac_rf_RednFuOctIntkT_Ay FORMAT "%6.1" MONOTONY STRICT_INCREASE DEPOSIT ABSOLUTE /end AXIS_DESCR
/end CHARACTERISTIC
/begin CHARACTERISTIC BMWls_pct_FiMaxIgOfs_M "Filling limitation characteristic curve depending on ignition angle retard" MAP 0x969A16A _REC_A1CUR_1_MBSE_S2_S1 655.35 CgkBooc_wkiDfEd_Czglhgc_fR_1a0o -327.68 327.67 FORMAT "%7.2"
 /begin AXIS_DESCR COM_AXIS Nkw caoddzd_oAjpfzb_cAcEEha_1nR_oa0 10 -32768 32767 AXIS_PTS_REF BMWls_pct_FiMaxIgOfs_Gx FORMAT "%5.0" MONOTONY STRICT_INCREASE DEPOSIT ABSOLUTE /end AXIS_DESCR
 /begin AXIS_DESCR COM_AXIS Dzw_tot_kr juwcFuc_Dtmczic_mCgfamd_q__aa0o 8 -3276.8 3276.7 AXIS_PTS_REF BMWls_pct_FiMaxIgOfs_Gy FORMAT "%6.1" MONOTONY STRICT_INCREASE DEPOSIT ABSOLUTE /end AXIS_DESCR
/end CHARACTERISTIC
/begin CHARACTERISTIC BMWls_pct_FiMaxIgOfsSpt_M "Characteristic filling limitation depending on ignition angle retardation in sport mode" MAP 0x969A20A _REC_A1CUR_1_MBSE_S2_S1 655.35 CgkBooc_wkiDfEd_Czglhgc_fR_1a0o -327.68 327.67 FORMAT "%7.2"
 /begin AXIS_DESCR COM_AXIS Nkw caoddzd_oAjpfzb_cAcEEha_1nR_oa0 10 -32768 32767 AXIS_PTS_REF BMWls_pct_FiMaxIgOfs_Gx FORMAT "%5.0" MONOTONY STRICT_INCREASE DEPOSIT ABSOLUTE /end AXIS_DESCR
 /begin AXIS_DESCR COM_AXIS Dzw_tot_kr juwcFuc_Dtmczic_mCgfamd_q__aa0o 8 -3276.8 3276.7 AXIS_PTS_REF BMWls_pct_FiMaxIgOfs_Gy FORMAT "%6.1" MONOTONY STRICT_INCREASE DEPOSIT ABSOLUTE /end AXIS_DESCR
/end CHARACTERISTIC
/begin CHARACTERISTIC BMWls_rf_MaxEgT_M "Maximum filling when limited by the component protection controller" MAP 0x969A122 _REC_A1CUR_1_MBSE_S2_S1 655.35 ubqeuic_jteCkzd_CDglhgc_nR_1a0o -327.68 327.67 FORMAT "%7.2"
 /begin AXIS_DESCR COM_AXIS Nkw caoddzd_oAjpfzb_cAcEEha_1nR_oa0 6 -32768 32767 AXIS_PTS_REF BMWls_rf_MaxEgT_Ax FORMAT "%5.0" MONOTONY STRICT_INCREASE DEPOSIT ABSOLUTE /end AXIS_DESCR
 /begin AXIS_DESCR COM_AXIS Frfmxbsld Bhvfwhc_bigEubd_BBEupBd_nR_3oa0 6 0 1.99996948242188 AXIS_PTS_REF BMWls_rf_MaxEgT_Ay FORMAT "%14.5" MONOTONY STRICT_INCREASE DEPOSIT ABSOLUTE /end AXIS_DESCR
/end CHARACTERISTIC
/begin CHARACTERISTIC BMWls_rf_MaxFuOctIntkT_M "Maximum filling depending on the speed and the filling reduction factor at late center of gravity positions due to poor fuel and high collector temperatures." MAP 0x9699FE2 _REC_A1CUR_1_MBSE_S2_S1 655.35 CgkBooc_wkiDfEd_Czglhgc_fR_1a0o -327.68 327.67 FORMAT "%7.2"
 /begin AXIS_DESCR COM_AXIS Nkw caoddzd_oAjpfzb_cAcEEha_1nR_oa0 10 -32768 32767 AXIS_PTS_REF BMWls_pct_FiMaxIgOfs_Gx FORMAT "%5.0" MONOTONY STRICT_INCREASE DEPOSIT ABSOLUTE /end AXIS_DESCR
 /begin AXIS_DESCR COM_AXIS BMWls_fac_rf_RedFil_uw FzbmlAa_gCtylrb_ckCqxAc_nR_6oa0 8 0 0.999984741210938 AXIS_PTS_REF BMWls_rf_MaxFuOctIntkT_Gy FORMAT "%7.5" MONOTONY STRICT_INCREASE DEPOSIT ABSOLUTE /end AXIS_DESCR
/end CHARACTERISTIC
/begin CHARACTERISTIC BMWls_rf_MaxFuOctIntkTSpt_M "Maximum filling depending on the speed and the filling reduction factor at late center of gravity positions due to poor fuel and high collector temperatures in sport mode." MAP 0x969A082 _REC_A1CUR_1_MBSE_S2_S1 655.35 CgkBooc_wkiDfEd_Czglhgc_fR_1a0o -327.68 327.67 FORMAT "%7.2"
 /begin AXIS_DESCR COM_AXIS Nkw caoddzd_oAjpfzb_cAcEEha_1nR_oa0 10 -32768 32767 AXIS_PTS_REF BMWls_pct_FiMaxIgOfs_Gx FORMAT "%5.0" MONOTONY STRICT_INCREASE DEPOSIT ABSOLUTE /end AXIS_DESCR
 /begin AXIS_DESCR COM_AXIS BMWls_fac_rf_RedFil_uw FzbmlAa_gCtylrb_ckCqxAc_nR_6oa0 8 0 0.999984741210938 AXIS_PTS_REF BMWls_rf_MaxFuOctIntkT_Gy FORMAT "%7.5" MONOTONY STRICT_INCREASE DEPOSIT ABSOLUTE /end AXIS_DESCR
/end CHARACTERISTIC
/begin CHARACTERISTIC BMWls_rf_MaxModEng_M "Filling cap for temporary limitation at the start of the race." MAP 0x9699F42 _REC_A1CUR_1_MBSE_S2_S1 655.35 CgkBooc_wkiDfEd_Czglhgc_fR_1a0o -327.68 327.67 FORMAT "%7.2"
 /begin AXIS_DESCR COM_AXIS Nkw caoddzd_oAjpfzb_cAcEEha_1nR_oa0 10 -32768 32767 AXIS_PTS_REF BMWls_pct_FiMaxIgOfs_Gx FORMAT "%5.0" MONOTONY STRICT_INCREASE DEPOSIT ABSOLUTE /end AXIS_DESCR
 /begin AXIS_DESCR COM_AXIS Dzw_tot_kr juwcFuc_Dtmczic_mCgfamd_q__aa0o 8 -3276.8 3276.7 AXIS_PTS_REF BMWls_pct_FiMaxIgOfs_Gy FORMAT "%6.1" MONOTONY STRICT_INCREASE DEPOSIT ABSOLUTE /end AXIS_DESCR
/end CHARACTERISTIC
/begin CHARACTERISTIC BMWtchctr_t_ExGasMdl_M "Exhaust gas temperature during dynamic load changes for the physical ATL pilot control" MAP 0x96B81B6 _REC_A1CUR_1_MBSE_S2_S1 6553.5 ___MGF_CC_TemperatureCelsius_d10 -3276.8 3276.7 FORMAT "%7.1"
 /begin AXIS_DESCR COM_AXIS Nkw caoddzd_oAjpfzb_cAcEEha_1nR_oa0 6 -32768 32767 AXIS_PTS_REF BMWtchctr_t_ExGasMdl_Ax FORMAT "%5.0" MONOTONY STRICT_INCREASE DEPOSIT ABSOLUTE /end AXIS_DESCR
 /begin AXIS_DESCR COM_AXIS Rf CgkBooc_wkiDfEd_Czglhgc_fR_1a0o 6 -327.68 327.67 AXIS_PTS_REF BMWtchctr_t_ExGasMdl_Ay FORMAT "%7.2" MONOTONY STRICT_INCREASE DEPOSIT ABSOLUTE /end AXIS_DESCR
/end CHARACTERISTIC
/begin CHARACTERISTIC BMWtchctr_t_ExGasMdlScav_M "Exhaust gas temperature during dynamic load changes for the physical ATL pilot control" MAP 0x96B81FE _REC_A1CUR_1_MBSE_S2_S1 6553.5 ___MGF_CC_TemperatureCelsius_d10 -3276.8 3276.7 FORMAT "%7.1"
 /begin AXIS_DESCR COM_AXIS Nkw caoddzd_oAjpfzb_cAcEEha_1nR_oa0 6 -32768 32767 AXIS_PTS_REF BMWtchctr_t_ExGasMdlScav_Ax FORMAT "%5.0" MONOTONY STRICT_INCREASE DEPOSIT ABSOLUTE /end AXIS_DESCR
 /begin AXIS_DESCR COM_AXIS Rf CgkBooc_wkiDfEd_Czglhgc_fR_1a0o 6 -327.68 327.67 AXIS_PTS_REF BMWtchctr_t_ExGasMdlScav_Ay FORMAT "%7.2" MONOTONY STRICT_INCREASE DEPOSIT ABSOLUTE /end AXIS_DESCR
/end CHARACTERISTIC
/begin CHARACTERISTIC BMWtchsp_rat_p_CmprMax_M "KF_FPLDMAX" MAP 0x969E232 _REC_A1CUR_1_MBSE_U2_S2 3.99993896484375 ilxsavd_hkzmBfc_lAzCpAb_nR_1oa0 0 3.99993896484375
 /begin AXIS_DESCR COM_AXIS BMWtchsp_mf_CmprNorm_uw CByjozc_eCmpBAb_pljBAmd_k__0oa0 8 0 2047.96875 AXIS_PTS_REF BMWtchsp_rat_p_CmprMax_Ax FORMAT "%10.3" MONOTONY STRICT_INCREASE DEPOSIT ABSOLUTE /end AXIS_DESCR
 /begin AXIS_DESCR COM_AXIS BMWtchtbc_t_BefCmpr_sw ___MGF_CC_TemperatureCelsius_d10 6 -3276.8 3276.7 AXIS_PTS_REF BMWtchsp_rat_p_CmprMax_Ay FORMAT "%6.1" MONOTONY STRICT_INCREASE DEPOSIT ABSOLUTE /end AXIS_DESCR
/end CHARACTERISTIC
/begin CHARACTERISTIC BMWtqe_b_SptDet4NoiseAcvn_M "Detection of sport mode depending on St_usecase_antr and St_dsc_can" MAP 0x96C08E8 _REC_A1CUR_1_MBSE_U1_S1 1 fgjpsvb_fDqjECa_acgrbDd_n_dae__ 0 1
 /begin AXIS_DESCR COM_AXIS Status_usecase_antr raChrxc_kBtBrmb_FmDuEFa_n__aa0o 12 0 11 AXIS_PTS_REF BMWtqe_b_SptDet4NoiseAcvn_Ax FORMAT "%6.0" MONOTONY STRICT_INCREASE DEPOSIT ABSOLUTE /end AXIS_DESCR
 /begin AXIS_DESCR COM_AXIS St_dsc_can raChrxc_kBtBrmb_FmDuEFa_n__aa0o 4 0 11 AXIS_PTS_REF BMWtqe_b_SptDet4NoiseAcvn_Ay FORMAT "%3.0" MONOTONY STRICT_INCREASE DEPOSIT ABSOLUTE /end AXIS_DESCR
/end CHARACTERISTIC
/begin CHARACTERISTIC IKCtl_facKnkRtdtCyl0_M "Retardation per knock event for cylinder 0" MAP 0x96F0C4C RB_Map_S16U8_S8_Static 6 kw_q0p75 -6 0 FORMAT "%5.3"
 /begin AXIS_DESCR STD_AXIS Epm_nEng EngN 8 -16384 16383.5 FORMAT "%8.2" DEPOSIT ABSOLUTE /end AXIS_DESCR
 /begin AXIS_DESCR STD_AXIS IKCtl_facKnkInten_u8 fak_ub_b16 4 0 15.94 FORMAT "%5.2" DEPOSIT ABSOLUTE /end AXIS_DESCR
/end CHARACTERISTIC
/begin CHARACTERISTIC IKCtl_facKnkRtdtCyl1_M "Retardation per knock event for cylinder 1" MAP 0x96F0C84 RB_Map_S16U8_S8_Static 6 kw_q0p75 -6 0 FORMAT "%5.3"
 /begin AXIS_DESCR STD_AXIS Epm_nEng EngN 8 -16384 16383.5 FORMAT "%8.2" DEPOSIT ABSOLUTE /end AXIS_DESCR
 /begin AXIS_DESCR STD_AXIS IKCtl_facKnkInten_u8 fak_ub_b16 4 0 15.94 FORMAT "%5.2" DEPOSIT ABSOLUTE /end AXIS_DESCR
/end CHARACTERISTIC
/begin CHARACTERISTIC IKCtl_facKnkRtdtCyl2_M "Retardation per knock event for cylinder 2" MAP 0x96F0CBC RB_Map_S16U8_S8_Static 6 kw_q0p75 -6 0 FORMAT "%5.3"
 /begin AXIS_DESCR STD_AXIS Epm_nEng EngN 8 -16384 16383.5 FORMAT "%8.2" DEPOSIT ABSOLUTE /end AXIS_DESCR
 /begin AXIS_DESCR STD_AXIS IKCtl_facKnkInten_u8 fak_ub_b16 4 0 15.94 FORMAT "%5.2" DEPOSIT ABSOLUTE /end AXIS_DESCR
/end CHARACTERISTIC
/begin CHARACTERISTIC IKCtl_facKnkRtdtCyl3_M "Retarding per knock event for cylinder 3" MAP 0x96F0CF4 RB_Map_S16U8_S8_Static 6 kw_q0p75 -6 0 FORMAT "%5.3"
 /begin AXIS_DESCR STD_AXIS Epm_nEng EngN 8 -16384 16383.5 FORMAT "%8.2" DEPOSIT ABSOLUTE /end AXIS_DESCR
 /begin AXIS_DESCR STD_AXIS IKCtl_facKnkInten_u8 fak_ub_b16 4 0 15.94 FORMAT "%5.2" DEPOSIT ABSOLUTE /end AXIS_DESCR
/end CHARACTERISTIC
/begin CHARACTERISTIC IKCtl_facKnkRtdtCyl4_M "Retardation per knock event for cylinder 4" MAP 0x96F0D2C RB_Map_S16U8_S8_Static 6 kw_q0p75 -6 0 FORMAT "%5.3"
 /begin AXIS_DESCR STD_AXIS Epm_nEng EngN 8 -16384 16383.5 FORMAT "%8.2" DEPOSIT ABSOLUTE /end AXIS_DESCR
 /begin AXIS_DESCR STD_AXIS IKCtl_facKnkInten_u8 fak_ub_b16 4 0 15.94 FORMAT "%5.2" DEPOSIT ABSOLUTE /end AXIS_DESCR
/end CHARACTERISTIC
/begin CHARACTERISTIC IKCtl_facKnkRtdtCyl5_M "Retardation per knock event for cylinder 5" MAP 0x96F0D64 RB_Map_S16U8_S8_Static 6 kw_q0p75 -6 0 FORMAT "%5.3"
 /begin AXIS_DESCR STD_AXIS Epm_nEng EngN 8 -16384 16383.5 FORMAT "%8.2" DEPOSIT ABSOLUTE /end AXIS_DESCR
 /begin AXIS_DESCR STD_AXIS IKCtl_facKnkInten_u8 fak_ub_b16 4 0 15.94 FORMAT "%5.2" DEPOSIT ABSOLUTE /end AXIS_DESCR
/end CHARACTERISTIC
/begin CHARACTERISTIC IKCtl_FacKnockDetThd0_GM "Knock detection factor map cylinder counter 0" MAP 0x96F06BE FklWUb 3.438 fak_ub_b16 0.0625 3.5 FORMAT "%5.3"
 /begin AXIS_DESCR COM_AXIS Epm_nEng EngN 16 -16384 16383.5 AXIS_PTS_REF IKCtl_nEngB16_X_AX FORMAT "%8.2" DEPOSIT ABSOLUTE /end AXIS_DESCR
 /begin AXIS_DESCR COM_AXIS rl_msg rel_ub_q0p75 4 0 191.3 AXIS_PTS_REF IKCtl_LoadAdd04_X_AX FORMAT "%5.1" DEPOSIT ABSOLUTE /end AXIS_DESCR
/end CHARACTERISTIC
/begin CHARACTERISTIC IKCtl_FacKnockDetThd1_GM "Knock detection factor map cylinder counter 1" MAP 0x96F06FE FklWUb 3.438 fak_ub_b16 0.0625 3.5 FORMAT "%5.3"
 /begin AXIS_DESCR COM_AXIS Epm_nEng EngN 16 -16384 16383.5 AXIS_PTS_REF IKCtl_nEngB16_X_AX FORMAT "%8.2" DEPOSIT ABSOLUTE /end AXIS_DESCR
 /begin AXIS_DESCR COM_AXIS rl_msg rel_ub_q0p75 4 0 191.3 AXIS_PTS_REF IKCtl_LoadAdd04_X_AX FORMAT "%5.1" DEPOSIT ABSOLUTE /end AXIS_DESCR
/end CHARACTERISTIC
/begin CHARACTERISTIC IKCtl_FacKnockDetThd2_GM "Knock detection factor map cylinder counter 2" MAP 0x96F073E FklWUb 3.438 fak_ub_b16 0.0625 3.5 FORMAT "%5.3"
 /begin AXIS_DESCR COM_AXIS Epm_nEng EngN 16 -16384 16383.5 AXIS_PTS_REF IKCtl_nEngB16_X_AX FORMAT "%8.2" DEPOSIT ABSOLUTE /end AXIS_DESCR
 /begin AXIS_DESCR COM_AXIS rl_msg rel_ub_q0p75 4 0 191.3 AXIS_PTS_REF IKCtl_LoadAdd04_X_AX FORMAT "%5.1" DEPOSIT ABSOLUTE /end AXIS_DESCR
/end CHARACTERISTIC
/begin CHARACTERISTIC IKCtl_FacKnockDetThd3_GM "Knock detection factor map cylinder counter 3" MAP 0x96F077E FklWUb 3.438 fak_ub_b16 0.0625 3.5 FORMAT "%5.3"
 /begin AXIS_DESCR COM_AXIS Epm_nEng EngN 16 -16384 16383.5 AXIS_PTS_REF IKCtl_nEngB16_X_AX FORMAT "%8.2" DEPOSIT ABSOLUTE /end AXIS_DESCR
 /begin AXIS_DESCR COM_AXIS rl_msg rel_ub_q0p75 4 0 191.3 AXIS_PTS_REF IKCtl_LoadAdd04_X_AX FORMAT "%5.1" DEPOSIT ABSOLUTE /end AXIS_DESCR
/end CHARACTERISTIC
/begin CHARACTERISTIC IKCtl_FacKnockDetThd4_GM "Knock detection factor map cylinder counter 4" MAP 0x96F07BE FklWUb 3.438 fak_ub_b16 0.0625 3.5 FORMAT "%5.3"
 /begin AXIS_DESCR COM_AXIS Epm_nEng EngN 16 -16384 16383.5 AXIS_PTS_REF IKCtl_nEngB16_X_AX FORMAT "%8.2" DEPOSIT ABSOLUTE /end AXIS_DESCR
 /begin AXIS_DESCR COM_AXIS rl_msg rel_ub_q0p75 4 0 191.3 AXIS_PTS_REF IKCtl_LoadAdd04_X_AX FORMAT "%5.1" DEPOSIT ABSOLUTE /end AXIS_DESCR
/end CHARACTERISTIC
/begin CHARACTERISTIC IKCtl_FacKnockDetThd5_GM "Knock detection factor map cylinder counter 5" MAP 0x96F07FE FklWUb 3.438 fak_ub_b16 0.0625 3.5 FORMAT "%5.3"
 /begin AXIS_DESCR COM_AXIS Epm_nEng EngN 16 -16384 16383.5 AXIS_PTS_REF IKCtl_nEngB16_X_AX FORMAT "%8.2" DEPOSIT ABSOLUTE /end AXIS_DESCR
 /begin AXIS_DESCR COM_AXIS rl_msg rel_ub_q0p75 4 0 191.3 AXIS_PTS_REF IKCtl_LoadAdd04_X_AX FORMAT "%5.1" DEPOSIT ABSOLUTE /end AXIS_DESCR
/end CHARACTERISTIC
/begin CHARACTERISTIC KF_BSLGF "Lambda grease limit for component protection filling intervention" MAP 0x9692592 _REC_A1CUR_1_MBSE_U2_S2 15.999755859375 BumqDkc_mryszAa_EcglxAc_nR_4oa0 0 15.999755859375
 /begin AXIS_DESCR COM_AXIS Nkw_atm caoddzd_oAjpfzb_cAcEEha_1nR_oa0 4 -32768 32767 AXIS_PTS_REF AXX_KF_BSLGF MONOTONY STRICT_INCREASE DEPOSIT ABSOLUTE /end AXIS_DESCR
 /begin AXIS_DESCR COM_AXIS Rf_atm CgkBooc_wkiDfEd_Czglhgc_fR_1a0o 4 -327.68 327.67 AXIS_PTS_REF AXY_KF_BSLGF MONOTONY STRICT_INCREASE DEPOSIT ABSOLUTE /end AXIS_DESCR
/end CHARACTERISTIC
/begin CHARACTERISTIC KF_DLAMBSVST_TABG "Deltalambda for pre-control component protection exhaust gas temperature branch" MAP 0x9692778 _REC_A1CUR_1_MBSE_S2_S1 8 BumqDkc_mryszAa_EcglxAc_nR_4oa0 -8 0 FORMAT "%7.4"
 /begin AXIS_DESCR COM_AXIS Nkw_atm caoddzd_oAjpfzb_cAcEEha_1nR_oa0 8 -32768 32767 AXIS_PTS_REF AXX_KF_DLAMBSVST_TABG MONOTONY STRICT_INCREASE DEPOSIT ABSOLUTE /end AXIS_DESCR
 /begin AXIS_DESCR COM_AXIS Rf_atm CgkBooc_wkiDfEd_Czglhgc_fR_1a0o 8 -327.68 327.67 AXIS_PTS_REF AXY_KF_DLAMBSVST_TABG MONOTONY STRICT_INCREASE DEPOSIT ABSOLUTE /end AXIS_DESCR
/end CHARACTERISTIC
/begin CHARACTERISTIC KF_DPLDS_PRED "Offset setpoint boost pressure as f(engine speed, dynamic Rf_setpoint damping)" MAP 0x96B6F10 _REC_A1CUR_1_MBSE_U2_S2 8191.875 rAdkuaa_wDllxja_BnDuEFa_n__aa0o 0 8191.875
 /begin AXIS_DESCR COM_AXIS NO_INPUT_QUANTITY caoddzd_oAjpfzb_cAcEEha_1nR_oa0 6 0 32767 AXIS_PTS_REF AXX_KF_DPLDS_PRED FORMAT "%5.0" MONOTONY MON_INCREASE DEPOSIT ABSOLUTE /end AXIS_DESCR
 /begin AXIS_DESCR COM_AXIS NO_INPUT_QUANTITY CgkBooc_wkiDfEd_Czglhgc_fR_1a0o 6 0 655.35 AXIS_PTS_REF AXY_KF_DPLDS_PRED MONOTONY MON_INCREASE DEPOSIT ABSOLUTE /end AXIS_DESCR
/end CHARACTERISTIC
/begin CHARACTERISTIC KF_DPLDSOLL_SPORT "Map boost pressure offset to the target boost pressure (in sport mode)" MAP 0x969C722 _REC_A1CUR_1_MBSE_U2_S2 8191.875 ___MGF_CC_PressurehPa_d8 0 8191.875 FORMAT "%8.3"
 /begin AXIS_DESCR COM_AXIS NO_INPUT_QUANTITY caoddzd_oAjpfzb_cAcEEha_1nR_oa0 6 0 32767 AXIS_PTS_REF AXX_KF_DPLDSOLL_SPORT FORMAT "%5.0" MONOTONY MON_INCREASE DEPOSIT ABSOLUTE /end AXIS_DESCR
 /begin AXIS_DESCR COM_AXIS NO_INPUT_QUANTITY acriqBc_tfkBqod_ocgjxzc_nR_8oa0 6 0 7.9998779296875 AXIS_PTS_REF AXY_KF_DPLDSOLL_SPORT FORMAT "%7.5" MONOTONY MON_INCREASE DEPOSIT ABSOLUTE /end AXIS_DESCR
/end CHARACTERISTIC
/begin CHARACTERISTIC KF_DZW_DYN "Delta ignition angle dynamic correction" MAP 0x96C3CD0 _REC_A1CUR_1_MBSE_S1_S1 127.5 aAwkuzc_BFpgCmb_tmDukma_q__aa0o -64 63.5 FORMAT "%4.1"
 /begin AXIS_DESCR COM_AXIS Nkw caoddzd_oAjpfzb_cAcEEha_1nR_oa0 4 -32768 32767 AXIS_PTS_REF AXX_KF_DZW_DYN FORMAT "%5.0" MONOTONY STRICT_INCREASE DEPOSIT ABSOLUTE /end AXIS_DESCR
 /begin AXIS_DESCR COM_AXIS NO_INPUT_QUANTITY CgkBooc_wkiDfEd_Czglhgc_fR_1a0o 4 -327.68 327.67 AXIS_PTS_REF AXY_KF_DZW_DYN FORMAT "%9.2" MONOTONY STRICT_INCREASE DEPOSIT ABSOLUTE /end AXIS_DESCR
/end CHARACTERISTIC
/begin CHARACTERISTIC KF_DZWMIN_NORMAL_SOT "Ignition angle intervention for sound tuning" MAP 0x96C776C _REC_A1CUR_1_MBSE_S1_S1 127.5 aAwkuzc_BFpgCmb_tmDukma_q__aa0o -64 63.5
 /begin AXIS_DESCR COM_AXIS Nkw caoddzd_oAjpfzb_cAcEEha_1nR_oa0 6 -32768 32767 AXIS_PTS_REF AXX_KF_DZWMIN_NORMAL_SOT FORMAT "%5.0" MONOTONY STRICT_INCREASE DEPOSIT ABSOLUTE /end AXIS_DESCR
 /begin AXIS_DESCR COM_AXIS V AFeDmkb_cAbjmcc_kAkskhd_k__0oa0 4 0 65535 AXIS_PTS_REF AXY_KF_DZWMIN_NORMAL_SOT FORMAT "%5.0" MONOTONY STRICT_INCREASE DEPOSIT ABSOLUTE /end AXIS_DESCR
/end CHARACTERISTIC
/begin CHARACTERISTIC KF_DZWMIN_SPORT_SOT "Ignition angle intervention for sound tuning at B_sport" MAP 0x96C7714 _REC_A1CUR_1_MBSE_S1_S1 127.5 aAwkuzc_BFpgCmb_tmDukma_q__aa0o -64 63.5
 /begin AXIS_DESCR COM_AXIS Nkw caoddzd_oAjpfzb_cAcEEha_1nR_oa0 6 -32768 32767 AXIS_PTS_REF AXX_KF_DZWMIN_SPORT_SOT FORMAT "%5.0" MONOTONY STRICT_INCREASE DEPOSIT ABSOLUTE /end AXIS_DESCR
 /begin AXIS_DESCR COM_AXIS V AFeDmkb_cAbjmcc_kAkskhd_k__0oa0 4 0 65535 AXIS_PTS_REF AXY_KF_DZWMIN_SPORT_SOT FORMAT "%5.0" MONOTONY STRICT_INCREASE DEPOSIT ABSOLUTE /end AXIS_DESCR
/end CHARACTERISTIC
/begin CHARACTERISTIC KF_DZWT_PF1 "Temperature correction ZW knock limit path 1" MAP 0x96C7378 _REC_A1CUR_1_MBSE_S1_S1 127.5 aAwkuzc_BFpgCmb_tmDukma_q__aa0o -64 63.5 FORMAT "%4.1"
 /begin AXIS_DESCR COM_AXIS Nkw caoddzd_oAjpfzb_cAcEEha_1nR_oa0 20 -32768 32767 AXIS_PTS_REF AXX_KF_DZWT_PF1 FORMAT "%5.0" MONOTONY MON_INCREASE DEPOSIT ABSOLUTE /end AXIS_DESCR
 /begin AXIS_DESCR COM_AXIS NO_INPUT_QUANTITY CgkBooc_wkiDfEd_Czglhgc_fR_1a0o 16 -327.68 327.67 AXIS_PTS_REF AXY_KF_DZWT_PF1 FORMAT "%9.2" MONOTONY MON_INCREASE DEPOSIT ABSOLUTE /end AXIS_DESCR
/end CHARACTERISTIC
/begin CHARACTERISTIC KF_DZWT_PF2 "Temperature correction ZW knock limit path 2" MAP 0x96C7238 _REC_A1CUR_1_MBSE_S1_S1 127.5 aAwkuzc_BFpgCmb_tmDukma_q__aa0o -64 63.5 FORMAT "%4.1"
 /begin AXIS_DESCR COM_AXIS Nkw caoddzd_oAjpfzb_cAcEEha_1nR_oa0 20 -32768 32767 AXIS_PTS_REF AXX_KF_DZWT_PF2 FORMAT "%5.0" MONOTONY MON_INCREASE DEPOSIT ABSOLUTE /end AXIS_DESCR
 /begin AXIS_DESCR COM_AXIS NO_INPUT_QUANTITY CgkBooc_wkiDfEd_Czglhgc_fR_1a0o 16 -327.68 327.67 AXIS_PTS_REF AXY_KF_DZWT_PF2 FORMAT "%9.2" MONOTONY MON_INCREASE DEPOSIT ABSOLUTE /end AXIS_DESCR
/end CHARACTERISTIC
/begin CHARACTERISTIC KF_DZWT_UESP_PF1 "Temperature correction ZW knock limit path 1 flush" MAP 0x96C71C0 _REC_A1CUR_1_MBSE_S1_S1 127.5 aAwkuzc_BFpgCmb_tmDukma_q__aa0o -64 63.5 FORMAT "%4.1"
 /begin AXIS_DESCR COM_AXIS Nkw caoddzd_oAjpfzb_cAcEEha_1nR_oa0 10 -32768 32767 AXIS_PTS_REF AXX_KF_DZWT_UESP_PF1 FORMAT "%5.0" MONOTONY STRICT_INCREASE DEPOSIT ABSOLUTE /end AXIS_DESCR
 /begin AXIS_DESCR COM_AXIS NO_INPUT_QUANTITY CgkBooc_wkiDfEd_Czglhgc_fR_1a0o 12 -327.68 327.67 AXIS_PTS_REF AXY_KF_DZWT_UESP_PF1 FORMAT "%9.2" MONOTONY STRICT_INCREASE DEPOSIT ABSOLUTE /end AXIS_DESCR
/end CHARACTERISTIC
/begin CHARACTERISTIC KF_DZWT_UESP_PF2 "Temperature correction ZW knock limit path 2 flush" MAP 0x96C7148 _REC_A1CUR_1_MBSE_S1_S1 127.5 aAwkuzc_BFpgCmb_tmDukma_q__aa0o -64 63.5 FORMAT "%4.1"
 /begin AXIS_DESCR COM_AXIS Nkw caoddzd_oAjpfzb_cAcEEha_1nR_oa0 10 -32768 32767 AXIS_PTS_REF AXX_KF_DZWT_UESP_PF2 FORMAT "%5.0" MONOTONY STRICT_INCREASE DEPOSIT ABSOLUTE /end AXIS_DESCR
 /begin AXIS_DESCR COM_AXIS NO_INPUT_QUANTITY CgkBooc_wkiDfEd_Czglhgc_fR_1a0o 12 -327.68 327.67 AXIS_PTS_REF AXY_KF_DZWT_UESP_PF2 FORMAT "%9.2" MONOTONY STRICT_INCREASE DEPOSIT ABSOLUTE /end AXIS_DESCR
/end CHARACTERISTIC
/begin CHARACTERISTIC KF_EDA_ANZ_SPORT_MD_EM1_IST "Adjustment of the moment for the performance display" MAP 0x9689D8A _REC_A1CUR_1_MBSE_S2_S1 6553.5 Mo_trq_nm_q0p1 -3276.8 3276.7 FORMAT "%7.2"
 /begin AXIS_DESCR COM_AXIS NO_INPUT_QUANTITY Mo_trq_nm_q0p1 6 -3276.8 3276.7 AXIS_PTS_REF AXX_KF_EDA_ANZ_SPORT_MD_EM1_IST FORMAT "%7.2" MONOTONY STRICT_INCREASE DEPOSIT ABSOLUTE /end AXIS_DESCR
 /begin AXIS_DESCR COM_AXIS NO_INPUT_QUANTITY caoddzd_oAjpfzb_cAcEEha_1nR_oa0 6 -32768 32767 AXIS_PTS_REF AXY_KF_EDA_ANZ_SPORT_MD_EM1_IST FORMAT "%5.0" MONOTONY STRICT_INCREASE DEPOSIT ABSOLUTE /end AXIS_DESCR
/end CHARACTERISTIC
/begin CHARACTERISTIC KF_FDZW_DYN1 "Weighting factor dynamic correction via Tans and Dzw_annm for manual transmissions" MAP 0x96C6DB0 _REC_A1CUR_1_MBSE_U1_S1 0.99609375 BpaECzb_zweffod_enenhgc_nR_2a0o 0 0.99609375
 /begin AXIS_DESCR COM_AXIS Tans ___MGF_CC_TemperatureCelsius_d10 4 -3276.8 3276.7 AXIS_PTS_REF AXX_KF_FDZW_DYN1 FORMAT "%6.1" MONOTONY STRICT_INCREASE DEPOSIT ABSOLUTE /end AXIS_DESCR
 /begin AXIS_DESCR COM_AXIS Dzw_annm juwcFuc_Dtmczic_mCgfamd_q__aa0o 4 -50 60 AXIS_PTS_REF AXY_KF_FDZW_DYN1 FORMAT "%6.1" MONOTONY STRICT_INCREASE DEPOSIT ABSOLUTE /end AXIS_DESCR
/end CHARACTERISTIC
/begin CHARACTERISTIC KF_FDZW_DYN2 "Weighting factor dynamic correction via V and gears for manual transmission" MAP 0x96C6D88 _REC_A1CUR_1_MBSE_U1_S1 0.99609375 BpaECzb_zweffod_enenhgc_nR_2a0o 0 0.99609375
 /begin AXIS_DESCR COM_AXIS Gangi raChrxc_kBtBrmb_FmDuEFa_n__aa0o 10 0 255 AXIS_PTS_REF AXX_KF_FDZW_DYN2 FORMAT "%3.0" MONOTONY MON_INCREASE DEPOSIT ABSOLUTE /end AXIS_DESCR
 /begin AXIS_DESCR COM_AXIS V AFeDmkb_cAbjmcc_kAkskhd_k__0oa0 4 0 360 AXIS_PTS_REF AXY_KF_FDZW_DYN2 FORMAT "%5.0" MONOTONY STRICT_INCREASE DEPOSIT ABSOLUTE /end AXIS_DESCR
/end CHARACTERISTIC
/begin CHARACTERISTIC KF_FDZW_DYN3 "Weighting factor dynamic correction via Tans and Dzw_annm for automatic transmission" MAP 0x96C6D78 _REC_A1CUR_1_MBSE_U1_S1 0.99609375 BpaECzb_zweffod_enenhgc_nR_2a0o 0 0.99609375
 /begin AXIS_DESCR COM_AXIS Tans ___MGF_CC_TemperatureCelsius_d10 4 -3276.8 3276.7 AXIS_PTS_REF AXX_KF_FDZW_DYN3 FORMAT "%6.1" MONOTONY STRICT_INCREASE DEPOSIT ABSOLUTE /end AXIS_DESCR
 /begin AXIS_DESCR COM_AXIS Dzw_annm juwcFuc_Dtmczic_mCgfamd_q__aa0o 4 -50 60 AXIS_PTS_REF AXY_KF_FDZW_DYN3 FORMAT "%6.1" MONOTONY STRICT_INCREASE DEPOSIT ABSOLUTE /end AXIS_DESCR
/end CHARACTERISTIC
/begin CHARACTERISTIC KF_FDZW_DYN4 "Weighting factor dynamic correction via V and Gangi for automatic transmissions" MAP 0x96C6D50 _REC_A1CUR_1_MBSE_U1_S1 0.99609375 BpaECzb_zweffod_enenhgc_nR_2a0o 0 0.99609375
 /begin AXIS_DESCR COM_AXIS Gangi raChrxc_kBtBrmb_FmDuEFa_n__aa0o 10 0 255 AXIS_PTS_REF AXX_KF_FDZW_DYN4 FORMAT "%3.0" MONOTONY MON_INCREASE DEPOSIT ABSOLUTE /end AXIS_DESCR
 /begin AXIS_DESCR COM_AXIS V AFeDmkb_cAbjmcc_kAkskhd_k__0oa0 4 0 360 AXIS_PTS_REF AXY_KF_FDZW_DYN4 FORMAT "%5.0" MONOTONY STRICT_INCREASE DEPOSIT ABSOLUTE /end AXIS_DESCR
/end CHARACTERISTIC
/begin CHARACTERISTIC KF_FDZWT_BEST_PF1 "Factor temperature correction ZW-Best path 1" MAP 0x96ACD1A _REC_A1CUR_1_MBSE_S2_S1 3.99993896484375 ilxsavd_hkzmBfc_lAzCpAb_nR_1oa0 -2 1.99993896484375 FORMAT "%14.5"
 /begin AXIS_DESCR COM_AXIS Tmot DchEpAd_DBCFgoa_Ckhahgc_q__aoa0 6 -327.68 327.67 AXIS_PTS_REF AXX_KF_FDZWT_BEST_PF1 FORMAT "%7.2" MONOTONY STRICT_INCREASE DEPOSIT ABSOLUTE /end AXIS_DESCR
 /begin AXIS_DESCR COM_AXIS Tans ___MGF_CC_TemperatureCelsius_d10 6 -3276.8 3276.7 AXIS_PTS_REF AXY_KF_FDZWT_BEST_PF1 FORMAT "%6.1" MONOTONY STRICT_INCREASE DEPOSIT ABSOLUTE /end AXIS_DESCR
/end CHARACTERISTIC
/begin CHARACTERISTIC KF_FDZWT_BEST_PF2 "Factor temperature correction ZW-Best path 2" MAP 0x96ACCD2 _REC_A1CUR_1_MBSE_S2_S1 3.99993896484375 ilxsavd_hkzmBfc_lAzCpAb_nR_1oa0 -2 1.99993896484375 FORMAT "%14.5"
 /begin AXIS_DESCR COM_AXIS Tmot DchEpAd_DBCFgoa_Ckhahgc_q__aoa0 6 -327.68 327.67 AXIS_PTS_REF AXX_KF_FDZWT_BEST_PF2 FORMAT "%7.2" MONOTONY STRICT_INCREASE DEPOSIT ABSOLUTE /end AXIS_DESCR
 /begin AXIS_DESCR COM_AXIS Tans ___MGF_CC_TemperatureCelsius_d10 6 -3276.8 3276.7 AXIS_PTS_REF AXY_KF_FDZWT_BEST_PF2 FORMAT "%6.1" MONOTONY STRICT_INCREASE DEPOSIT ABSOLUTE /end AXIS_DESCR
/end CHARACTERISTIC
/begin CHARACTERISTIC KF_FDZWT_PF1 "Factor temperature correction ZW knock limit path 1" MAP 0x96ACDDA _REC_A1CUR_1_MBSE_S2_S1 3.9998779296875 ilxsavd_hkzmBfc_lAzCpAb_nR_1oa0 -2 1.9998779296875 FORMAT "%14.5"
 /begin AXIS_DESCR COM_AXIS Tmot DchEpAd_DBCFgoa_Ckhahgc_q__aoa0 6 -327.68 327.67 AXIS_PTS_REF AXX_KF_FDZWT_PF1 FORMAT "%7.2" MONOTONY STRICT_INCREASE DEPOSIT ABSOLUTE /end AXIS_DESCR
 /begin AXIS_DESCR COM_AXIS Tans ___MGF_CC_TemperatureCelsius_d10 6 -3276.8 3276.7 AXIS_PTS_REF AXY_KF_FDZWT_PF1 FORMAT "%6.1" MONOTONY STRICT_INCREASE DEPOSIT ABSOLUTE /end AXIS_DESCR
/end CHARACTERISTIC
/begin CHARACTERISTIC KF_FDZWT_PF2 "Factor temperature correction ZW knock limit path 2" MAP 0x96ACD92 _REC_A1CUR_1_MBSE_S2_S1 3.9998779296875 ilxsavd_hkzmBfc_lAzCpAb_nR_1oa0 -2 1.9998779296875 FORMAT "%14.5"
 /begin AXIS_DESCR COM_AXIS Tmot DchEpAd_DBCFgoa_Ckhahgc_q__aoa0 6 -327.68 327.67 AXIS_PTS_REF AXX_KF_FDZWT_PF2 FORMAT "%7.2" MONOTONY STRICT_INCREASE DEPOSIT ABSOLUTE /end AXIS_DESCR
 /begin AXIS_DESCR COM_AXIS Tans ___MGF_CC_TemperatureCelsius_d10 6 -3276.8 3276.7 AXIS_PTS_REF AXY_KF_FDZWT_PF2 FORMAT "%6.1" MONOTONY STRICT_INCREASE DEPOSIT ABSOLUTE /end AXIS_DESCR
/end CHARACTERISTIC
/begin CHARACTERISTIC KF_FRKKORRF_1 "Map pre-control correction bank 1" MAP 0x968EEB2 _REC_A1CUR_1_MBSE_U2_S2 1.99996948242188 Bhvfwhc_bigEubd_BBEupBd_nR_3oa0 0 1.99996948242188 FORMAT "%14.5"
 /begin AXIS_DESCR COM_AXIS Nkw caoddzd_oAjpfzb_cAcEEha_1nR_oa0 16 -32768 32767 AXIS_PTS_REF AXX_KF_FRKKORRF_1 FORMAT "%5.0" MONOTONY STRICT_INCREASE DEPOSIT ABSOLUTE /end AXIS_DESCR
 /begin AXIS_DESCR COM_AXIS Rf CgkBooc_wkiDfEd_Czglhgc_fR_1a0o 16 -327.68 327.67 AXIS_PTS_REF AXY_KF_FRKKORRF_1 FORMAT "%7.2" MONOTONY STRICT_INCREASE DEPOSIT ABSOLUTE /end AXIS_DESCR
/end CHARACTERISTIC
/begin CHARACTERISTIC KF_KOEFF_B_LA "Coefficient B for lambda correction ZW knock limit" MAP 0x96AD0F2 _REC_A1CUR_1_MBSE_U2_S2 15.999755859375 BumqDkc_mryszAa_EcglxAc_nR_4oa0 0 15.999755859375 FORMAT "%9.4"
 /begin AXIS_DESCR COM_AXIS Nkw caoddzd_oAjpfzb_cAcEEha_1nR_oa0 6 -32768 32767 AXIS_PTS_REF AXX_KF_KOEFF_B_LA FORMAT "%5.0" MONOTONY STRICT_INCREASE DEPOSIT ABSOLUTE /end AXIS_DESCR
 /begin AXIS_DESCR COM_AXIS NO_INPUT_QUANTITY CgkBooc_wkiDfEd_Czglhgc_fR_1a0o 6 -327.68 327.67 AXIS_PTS_REF AXY_KF_KOEFF_B_LA FORMAT "%9.2" MONOTONY STRICT_INCREASE DEPOSIT ABSOLUTE /end AXIS_DESCR
/end CHARACTERISTIC
/begin CHARACTERISTIC KF_LA_BEZ "Reference lambda for lambda correction ZW knock limit" MAP 0x96AD092 _REC_A1CUR_1_MBSE_U2_S2 15.999755859375 BumqDkc_mryszAa_EcglxAc_nR_4oa0 0 15.999755859375 FORMAT "%9.4"
 /begin AXIS_DESCR COM_AXIS Nkw caoddzd_oAjpfzb_cAcEEha_1nR_oa0 6 -32768 32767 AXIS_PTS_REF AXX_KF_LA_BEZ FORMAT "%5.0" MONOTONY STRICT_INCREASE DEPOSIT ABSOLUTE /end AXIS_DESCR
 /begin AXIS_DESCR COM_AXIS NO_INPUT_QUANTITY CgkBooc_wkiDfEd_Czglhgc_fR_1a0o 8 -327.68 327.67 AXIS_PTS_REF AXY_KF_LA_BEZ FORMAT "%9.2" MONOTONY MON_INCREASE DEPOSIT ABSOLUTE /end AXIS_DESCR
/end CHARACTERISTIC
/begin CHARACTERISTIC KF_LA_SK "Base lambda in homogeneous with super knocker" MAP 0x96BA5D6 _REC_A1CUR_1_MBSE_U2_S2 15.999755859375 BumqDkc_mryszAa_EcglxAc_nR_4oa0 0 15.999755859375 FORMAT "%9.4"
 /begin AXIS_DESCR COM_AXIS Nkw caoddzd_oAjpfzb_cAcEEha_1nR_oa0 18 -32768 32767 AXIS_PTS_REF GXX_KF_LABAS FORMAT "%5.0" MONOTONY STRICT_INCREASE DEPOSIT ABSOLUTE /end AXIS_DESCR
 /begin AXIS_DESCR COM_AXIS Rf CgkBooc_wkiDfEd_Czglhgc_fR_1a0o 17 -327.68 327.67 AXIS_PTS_REF GXY_KF_LABAS FORMAT "%7.2" MONOTONY STRICT_INCREASE DEPOSIT ABSOLUTE /end AXIS_DESCR
/end CHARACTERISTIC
/begin CHARACTERISTIC KF_LABAS_1 "Base lambda in the homogeneous bank 1" MAP 0x96BAA9E _REC_A1CUR_1_MBSE_U2_S2 15.999755859375 BumqDkc_mryszAa_EcglxAc_nR_4oa0 0 15.999755859375 FORMAT "%9.4"
 /begin AXIS_DESCR COM_AXIS Nkw caoddzd_oAjpfzb_cAcEEha_1nR_oa0 18 -32768 32767 AXIS_PTS_REF GXX_KF_LABAS FORMAT "%5.0" MONOTONY STRICT_INCREASE DEPOSIT ABSOLUTE /end AXIS_DESCR
 /begin AXIS_DESCR COM_AXIS Rf CgkBooc_wkiDfEd_Czglhgc_fR_1a0o 17 -327.68 327.67 AXIS_PTS_REF GXY_KF_LABAS FORMAT "%7.2" MONOTONY STRICT_INCREASE DEPOSIT ABSOLUTE /end AXIS_DESCR
/end CHARACTERISTIC
/begin CHARACTERISTIC KF_LABAS_2 "Base lambda in the homogeneous bank 2" MAP 0x96BA83A _REC_A1CUR_1_MBSE_U2_S2 15.999755859375 BumqDkc_mryszAa_EcglxAc_nR_4oa0 0 15.999755859375 FORMAT "%9.4"
 /begin AXIS_DESCR COM_AXIS Nkw caoddzd_oAjpfzb_cAcEEha_1nR_oa0 18 -32768 32767 AXIS_PTS_REF GXX_KF_LABAS FORMAT "%5.0" MONOTONY STRICT_INCREASE DEPOSIT ABSOLUTE /end AXIS_DESCR
 /begin AXIS_DESCR COM_AXIS Rf CgkBooc_wkiDfEd_Czglhgc_fR_1a0o 17 -327.68 327.67 AXIS_PTS_REF GXY_KF_LABAS FORMAT "%7.2" MONOTONY STRICT_INCREASE DEPOSIT ABSOLUTE /end AXIS_DESCR
/end CHARACTERISTIC
/begin CHARACTERISTIC KF_LAMIN_H "Lamda burning limits bold" MAP 0x9697910 _REC_A1CUR_1_MBSE_U2_S2 15.999755859375 BumqDkc_mryszAa_EcglxAc_nR_4oa0 0 15.999755859375 FORMAT "%9.4"
 /begin AXIS_DESCR COM_AXIS Nkw caoddzd_oAjpfzb_cAcEEha_1nR_oa0 6 -32768 32767 AXIS_PTS_REF AXX_KF_LAMIN_H FORMAT "%5.0" MONOTONY STRICT_INCREASE DEPOSIT ABSOLUTE /end AXIS_DESCR
 /begin AXIS_DESCR COM_AXIS Rf CgkBooc_wkiDfEd_Czglhgc_fR_1a0o 6 -327.68 327.67 AXIS_PTS_REF AXY_KF_LAMIN_H FORMAT "%7.2" MONOTONY STRICT_INCREASE DEPOSIT ABSOLUTE /end AXIS_DESCR
/end CHARACTERISTIC
/begin CHARACTERISTIC KF_MD_RES_NST_KEY "Momentum reserve in the post-start" MAP 0x96A7524 _REC_A1CUR_1_MBSE_S2_S1 6553.5 Mo_trq_nm_q0p1 -3276.8 3276.7 FORMAT "%6.1"
 /begin AXIS_DESCR COM_AXIS Tn_start_10 camcxxd_bxlpdsa_Cshlhgc_sR_1a0o 4 0 655.35 AXIS_PTS_REF AXX_KF_MD_RES_NST_KEY FORMAT "%7.2" MONOTONY STRICT_INCREASE DEPOSIT ABSOLUTE /end AXIS_DESCR
 /begin AXIS_DESCR COM_AXIS Tmot DchEpAd_DBCFgoa_Ckhahgc_q__aoa0 4 -327.68 327.67 AXIS_PTS_REF AXY_KF_MD_RES_NST_KEY FORMAT "%7.2" MONOTONY STRICT_INCREASE DEPOSIT ABSOLUTE /end AXIS_DESCR
/end CHARACTERISTIC
/begin CHARACTERISTIC KF_MDIOP_1_TQE "KF_MDIOP_1" MAP 0x96A2DB0 _REC_A1CUR_1_MBSE_S2_S1 6553.5 Mo_trq_nm_q0p1 -3276.8 3276.7
 /begin AXIS_DESCR COM_AXIS Rf_zh_ber CgkBooc_wkiDfEd_Czglhgc_fR_1a0o 18 -327.68 327.67 AXIS_PTS_REF AXX_KF_MDIOP_1_TQE FORMAT "%6.2" MONOTONY STRICT_INCREASE DEPOSIT ABSOLUTE /end AXIS_DESCR
 /begin AXIS_DESCR COM_AXIS Nkw caoddzd_oAjpfzb_cAcEEha_1nR_oa0 20 -32768 32767 AXIS_PTS_REF AXY_KF_MDIOP_1_TQE FORMAT "%5.0" MONOTONY STRICT_INCREASE DEPOSIT ABSOLUTE /end AXIS_DESCR
/end CHARACTERISTIC
/begin CHARACTERISTIC KF_MDK_MAX_GANG_NKW "KF_MDK_MAX_GANG_NKW" MAP 0x96B87D0 _REC_A1CUR_1_MBSE_S2_S1 6553.5 Mo_trq_nm_q0p1 -3276.8 3276.7 FORMAT "%6.2"
 /begin AXIS_DESCR COM_AXIS Gang_gb1_ist raChrxc_kBtBrmb_FmDuEFa_n__aa0o 10 -128 127 AXIS_PTS_REF AXX_KF_MDK_MAX_GANG_NKW FORMAT "%6.0" MONOTONY STRICT_INCREASE DEPOSIT ABSOLUTE /end AXIS_DESCR
 /begin AXIS_DESCR COM_AXIS Nkw_plaus caoddzd_oAjpfzb_cAcEEha_1nR_oa0 8 -32768 32767 AXIS_PTS_REF AXY_KF_MDK_MAX_GANG_NKW FORMAT "%6.0" MONOTONY STRICT_INCREASE DEPOSIT ABSOLUTE /end AXIS_DESCR
/end CHARACTERISTIC
/begin CHARACTERISTIC KF_PHA_H_B1_SK_PRE "Characteristic map starting angle ES1 Preventive super knocking." MAP 0x9690290 _REC_A1CUR_1_MBSE_S2_S1 1535.9765625 aEmoCzd_erpwvfb_msfkhgc_qR_1a0o -768 767.9765625
 /begin AXIS_DESCR COM_AXIS Nkw caoddzd_oAjpfzb_cAcEEha_1nR_oa0 10 -32768 32767 AXIS_PTS_REF GXX_KF_PHA_H_B1_BAS FORMAT "%5.0" MONOTONY STRICT_INCREASE DEPOSIT ABSOLUTE /end AXIS_DESCR
 /begin AXIS_DESCR COM_AXIS NO_INPUT_QUANTITY zyyxBpb_rEsnvtc_gktukCa_fR_5a0o 12 -1600 1599.951171875 AXIS_PTS_REF GXY_KF_PHA_H_B1_BAS FORMAT "%8.3" MONOTONY STRICT_INCREASE DEPOSIT ABSOLUTE /end AXIS_DESCR
/end CHARACTERISTIC
/begin CHARACTERISTIC KF_PHA_H_B1_W "Kennfeld Beginnwinkel ES1 Warm" MAP 0x9690120 _REC_A1CUR_1_MBSE_S2_S1 1535.9765625 aEmoCzd_erpwvfb_msfkhgc_qR_1a0o -768 767.9765625
 /begin AXIS_DESCR COM_AXIS Nkw caoddzd_oAjpfzb_cAcEEha_1nR_oa0 10 -32768 32767 AXIS_PTS_REF GXX_KF_PHA_H_B1_BAS FORMAT "%5.0" MONOTONY STRICT_INCREASE DEPOSIT ABSOLUTE /end AXIS_DESCR
 /begin AXIS_DESCR COM_AXIS NO_INPUT_QUANTITY zyyxBpb_rEsnvtc_gktukCa_fR_5a0o 12 -1600 1599.951171875 AXIS_PTS_REF GXY_KF_PHA_H_B1_BAS FORMAT "%8.3" MONOTONY STRICT_INCREASE DEPOSIT ABSOLUTE /end AXIS_DESCR
/end CHARACTERISTIC
/begin CHARACTERISTIC KF_PHA_H_E1 "KF_PHA_H_E1" MAP 0x96916C0 _REC_A1CUR_1_MBSE_S2_S1 1535.9765625 ridxkCa_Dxvxtdc_CChkhgc_nR_1a0o -768 767.9765625
 /begin AXIS_DESCR COM_AXIS Nkw caoddzd_oAjpfzb_cAcEEha_1nR_oa0 8 -32768 32767 AXIS_PTS_REF AXX_KF_PHA_H_E1 FORMAT "%5.0" MONOTONY STRICT_INCREASE DEPOSIT ABSOLUTE /end AXIS_DESCR
 /begin AXIS_DESCR COM_AXIS NO_INPUT_QUANTITY zyyxBpb_rEsnvtc_gktukCa_fR_5a0o 8 -1600 1599.951171875 AXIS_PTS_REF AXY_KF_PHA_H_E1 MONOTONY STRICT_INCREASE DEPOSIT ABSOLUTE /end AXIS_DESCR
/end CHARACTERISTIC
/begin CHARACTERISTIC KF_PRAIL_H "Map RAIL PRESSURE HOMOGENOUS -- with active VVT" MAP 0x969D95A _REC_A1CUR_1_MBSE_U2_S2 39.9993896484375 cxdjuna_xpuCged_ocEpdua_MCRa2a0 0 39.9993896484375 FORMAT "%9.4"
 /begin AXIS_DESCR COM_AXIS Nkw caoddzd_oAjpfzb_cAcEEha_1nR_oa0 8 -32768 32767 AXIS_PTS_REF AXX_KF_PRAIL_H FORMAT "%5.0" MONOTONY STRICT_INCREASE DEPOSIT ABSOLUTE /end AXIS_DESCR
 /begin AXIS_DESCR COM_AXIS BMWrailco_rat_VabHom_sw zyyxBpb_rEsnvtc_gktukCa_fR_5a0o 8 -1600 1599.951171875 AXIS_PTS_REF AXY_KF_PRAIL_H FORMAT "%8.3" MONOTONY STRICT_INCREASE DEPOSIT ABSOLUTE /end AXIS_DESCR
/end CHARACTERISTIC
/begin CHARACTERISTIC KF_PRAIL_H_K "Map RAIL PRESSURE HOMOGENEOUS COLD -- with active VVT" MAP 0x969D75A _REC_A1CUR_1_MBSE_U2_S2 39.9993896484375 cxdjuna_xpuCged_ocEpdua_MCRa2a0 0 39.9993896484375 FORMAT "%9.4"
 /begin AXIS_DESCR COM_AXIS Nkw caoddzd_oAjpfzb_cAcEEha_1nR_oa0 8 -32768 32767 AXIS_PTS_REF AXX_KF_PRAIL_H_K FORMAT "%5.0" MONOTONY STRICT_INCREASE DEPOSIT ABSOLUTE /end AXIS_DESCR
 /begin AXIS_DESCR COM_AXIS BMWrailco_rat_VabHom_sw zyyxBpb_rEsnvtc_gktukCa_fR_5a0o 8 -1600 1599.951171875 AXIS_PTS_REF AXY_KF_PRAIL_H_K FORMAT "%8.3" MONOTONY STRICT_INCREASE DEPOSIT ABSOLUTE /end AXIS_DESCR
/end CHARACTERISTIC
/begin CHARACTERISTIC KF_PRAIL_HGD "Map RAIL PRESSURE HOMOGENOUS -- with deactivated VVT (GD)" MAP 0x969D85A _REC_A1CUR_1_MBSE_U2_S2 39.9993896484375 cxdjuna_xpuCged_ocEpdua_MCRa2a0 0 39.9993896484375 FORMAT "%9.4"
 /begin AXIS_DESCR COM_AXIS Nkw caoddzd_oAjpfzb_cAcEEha_1nR_oa0 8 -32768 32767 AXIS_PTS_REF AXX_KF_PRAIL_HGD FORMAT "%5.0" MONOTONY STRICT_INCREASE DEPOSIT ABSOLUTE /end AXIS_DESCR
 /begin AXIS_DESCR COM_AXIS BMWrailco_rat_VabHom_sw zyyxBpb_rEsnvtc_gktukCa_fR_5a0o 8 -1600 1599.951171875 AXIS_PTS_REF AXY_KF_PRAIL_HGD FORMAT "%8.3" MONOTONY STRICT_INCREASE DEPOSIT ABSOLUTE /end AXIS_DESCR
/end CHARACTERISTIC
/begin CHARACTERISTIC KF_PRAIL_HGD_K "Map RAIL PRESSURE HOMOGENEOUS COLD -- with deactivated VVT (GD)" MAP 0x969D7DA _REC_A1CUR_1_MBSE_U2_S2 39.9993896484375 cxdjuna_xpuCged_ocEpdua_MCRa2a0 0 39.9993896484375 FORMAT "%9.4"
 /begin AXIS_DESCR COM_AXIS Nkw caoddzd_oAjpfzb_cAcEEha_1nR_oa0 8 -32768 32767 AXIS_PTS_REF AXX_KF_PRAIL_HGD_K FORMAT "%5.0" MONOTONY STRICT_INCREASE DEPOSIT ABSOLUTE /end AXIS_DESCR
 /begin AXIS_DESCR COM_AXIS BMWrailco_rat_VabHom_sw zyyxBpb_rEsnvtc_gktukCa_fR_5a0o 8 -1600 1599.951171875 AXIS_PTS_REF AXY_KF_PRAIL_HGD_K FORMAT "%8.3" MONOTONY STRICT_INCREASE DEPOSIT ABSOLUTE /end AXIS_DESCR
/end CHARACTERISTIC
/begin CHARACTERISTIC KF_ST_RKBAS_GD "Map Basic Rk Quantity throttled operation" MAP 0x96BA2FE _REC_A1CUR_1_MBSE_S2_S1 3199.951171875 zyyxBpb_rEsnvtc_gktukCa_fR_5a0o -1600 1599.951171875
 /begin AXIS_DESCR COM_AXIS Nkw caoddzd_oAjpfzb_cAcEEha_1nR_oa0 10 -32768 32767 AXIS_PTS_REF AXX_KF_ST_RKBAS_GD FORMAT "%5.0" MONOTONY STRICT_INCREASE DEPOSIT ABSOLUTE /end AXIS_DESCR
 /begin AXIS_DESCR COM_AXIS BMWinj_t_Eng_sw DchEpAd_DBCFgoa_Ckhahgc_q__aoa0 10 -327.68 327.67 AXIS_PTS_REF AXY_KF_ST_RKBAS_GD FORMAT "%7.2" MONOTONY STRICT_INCREASE DEPOSIT ABSOLUTE /end AXIS_DESCR
/end CHARACTERISTIC
/begin CHARACTERISTIC KF_ST_RKBAS_VVT "Map Base-Rk Quantity VVT Operation" MAP 0x96BA13C _REC_A1CUR_1_MBSE_S2_S1 3199.951171875 zyyxBpb_rEsnvtc_gktukCa_fR_5a0o -1600 1599.951171875
 /begin AXIS_DESCR COM_AXIS Nkw caoddzd_oAjpfzb_cAcEEha_1nR_oa0 12 -32768 32767 AXIS_PTS_REF AXX_KF_ST_RKBAS_VVT FORMAT "%5.0" MONOTONY STRICT_INCREASE DEPOSIT ABSOLUTE /end AXIS_DESCR
 /begin AXIS_DESCR COM_AXIS BMWinj_t_Eng_sw DchEpAd_DBCFgoa_Ckhahgc_q__aoa0 12 -327.68 327.67 AXIS_PTS_REF AXY_KF_ST_RKBAS_VVT FORMAT "%7.2" MONOTONY STRICT_INCREASE DEPOSIT ABSOLUTE /end AXIS_DESCR
/end CHARACTERISTIC
/begin CHARACTERISTIC KF_TA_ATLSOLL "Target temperature for exhaust gas temperature ATL" MAP 0x969287C _REC_A1CUR_1_MBSE_S2_S1 6553.5 ___MGF_CC_TemperatureCelsius_d10 -3276.8 3276.7 FORMAT "%6.1"
 /begin AXIS_DESCR COM_AXIS Nkw_atm caoddzd_oAjpfzb_cAcEEha_1nR_oa0 4 -32768 32767 AXIS_PTS_REF AXX_KF_TA_ATLSOLL MONOTONY STRICT_INCREASE DEPOSIT ABSOLUTE /end AXIS_DESCR
 /begin AXIS_DESCR COM_AXIS Rf_atm CgkBooc_wkiDfEd_Czglhgc_fR_1a0o 4 -327.68 327.67 AXIS_PTS_REF AXY_KF_TA_ATLSOLL MONOTONY STRICT_INCREASE DEPOSIT ABSOLUTE /end AXIS_DESCR
/end CHARACTERISTIC
/begin CHARACTERISTIC KF_TA_IKSOLL "Target temperature for exhaust gas temperature in cat" MAP 0x969285C _REC_A1CUR_1_MBSE_S2_S1 6553.5 ___MGF_CC_TemperatureCelsius_d10 -3276.8 3276.7 FORMAT "%6.1"
 /begin AXIS_DESCR COM_AXIS Nkw_atm caoddzd_oAjpfzb_cAcEEha_1nR_oa0 4 -32768 32767 AXIS_PTS_REF AXX_KF_TA_IKSOLL MONOTONY STRICT_INCREASE DEPOSIT ABSOLUTE /end AXIS_DESCR
 /begin AXIS_DESCR COM_AXIS Rf_atm CgkBooc_wkiDfEd_Czglhgc_fR_1a0o 4 -327.68 327.67 AXIS_PTS_REF AXY_KF_TA_IKSOLL MONOTONY STRICT_INCREASE DEPOSIT ABSOLUTE /end AXIS_DESCR
/end CHARACTERISTIC
/begin CHARACTERISTIC KF_TA_VKSOLL "Target temperature for exhaust gas temperature mixing section" MAP 0x969283C _REC_A1CUR_1_MBSE_S2_S1 6553.5 ___MGF_CC_TemperatureCelsius_d10 -3276.8 3276.7 FORMAT "%6.1"
 /begin AXIS_DESCR COM_AXIS Nkw_atm caoddzd_oAjpfzb_cAcEEha_1nR_oa0 4 -32768 32767 AXIS_PTS_REF AXX_KF_TA_VKSOLL MONOTONY STRICT_INCREASE DEPOSIT ABSOLUTE /end AXIS_DESCR
 /begin AXIS_DESCR COM_AXIS Rf_atm CgkBooc_wkiDfEd_Czglhgc_fR_1a0o 4 -327.68 327.67 AXIS_PTS_REF AXY_KF_TA_VKSOLL MONOTONY STRICT_INCREASE DEPOSIT ABSOLUTE /end AXIS_DESCR
/end CHARACTERISTIC
/begin CHARACTERISTIC KF_TD_FETTDELAY_TABG "Duration of enrichment suppression from KF_LABAS_XXX. This time depends on the pipe wall temperature Tw_r1." MAP 0x96C7910 _REC_A1CUR_1_MBSE_U1_S1 51 CAmbmzc_faghuld_pmDugua_s__aa0o 0 51
 /begin AXIS_DESCR COM_AXIS Tw_r1 ___MGF_CC_TemperatureCelsius_d10 6 -3276.8 3276.7 AXIS_PTS_REF AXX_KF_TD_FETTDELAY_TABG FORMAT "%6.1" MONOTONY STRICT_INCREASE DEPOSIT ABSOLUTE /end AXIS_DESCR
 /begin AXIS_DESCR COM_AXIS Nkw caoddzd_oAjpfzb_cAcEEha_1nR_oa0 4 -3277 3277 AXIS_PTS_REF AXY_KF_TD_FETTDELAY_TABG FORMAT "%5.0" MONOTONY STRICT_INCREASE DEPOSIT ABSOLUTE /end AXIS_DESCR
/end CHARACTERISTIC
/begin CHARACTERISTIC KF_ZW_PF1 "Basic firing angle path 1" MAP 0x96C3B80 _REC_A1CUR_1_MBSE_S1_S1 127.5 aAwkuzc_BFpgCmb_tmDukma_q__aa0o -64 63.5 FORMAT "%4.1"
 /begin AXIS_DESCR COM_AXIS Nkw caoddzd_oAjpfzb_cAcEEha_1nR_oa0 20 -32768 32767 AXIS_PTS_REF AXX_KF_ZW_PF1 FORMAT "%5.0" MONOTONY STRICT_INCREASE DEPOSIT ABSOLUTE /end AXIS_DESCR
 /begin AXIS_DESCR COM_AXIS NO_INPUT_QUANTITY CgkBooc_wkiDfEd_Czglhgc_fR_1a0o 16 -327.68 327.67 AXIS_PTS_REF AXY_KF_ZW_PF1 FORMAT "%9.2" MONOTONY STRICT_INCREASE DEPOSIT ABSOLUTE /end AXIS_DESCR
/end CHARACTERISTIC
/begin CHARACTERISTIC KF_ZW_PF2 "Basic firing angle path 2" MAP 0x96C3A40 _REC_A1CUR_1_MBSE_S1_S1 127.5 aAwkuzc_BFpgCmb_tmDukma_q__aa0o -64 63.5 FORMAT "%4.1"
 /begin AXIS_DESCR COM_AXIS Nkw caoddzd_oAjpfzb_cAcEEha_1nR_oa0 20 -32768 32767 AXIS_PTS_REF AXX_KF_ZW_PF2 FORMAT "%5.0" MONOTONY STRICT_INCREASE DEPOSIT ABSOLUTE /end AXIS_DESCR
 /begin AXIS_DESCR COM_AXIS NO_INPUT_QUANTITY CgkBooc_wkiDfEd_Czglhgc_fR_1a0o 16 -327.68 327.67 AXIS_PTS_REF AXY_KF_ZW_PF2 FORMAT "%9.2" MONOTONY STRICT_INCREASE DEPOSIT ABSOLUTE /end AXIS_DESCR
/end CHARACTERISTIC
/begin CHARACTERISTIC KF_ZW_S_PF1 "Basic ignition angle path 1 safe" MAP 0x96C3900 _REC_A1CUR_1_MBSE_S1_S1 127.5 aAwkuzc_BFpgCmb_tmDukma_q__aa0o -64 63.5 FORMAT "%4.1"
 /begin AXIS_DESCR COM_AXIS Nkw caoddzd_oAjpfzb_cAcEEha_1nR_oa0 20 -32768 32767 AXIS_PTS_REF AXX_KF_ZW_S_PF1 FORMAT "%5.0" MONOTONY STRICT_INCREASE DEPOSIT ABSOLUTE /end AXIS_DESCR
 /begin AXIS_DESCR COM_AXIS NO_INPUT_QUANTITY CgkBooc_wkiDfEd_Czglhgc_fR_1a0o 16 -327.68 327.67 AXIS_PTS_REF AXY_KF_ZW_S_PF1 FORMAT "%9.2" MONOTONY STRICT_INCREASE DEPOSIT ABSOLUTE /end AXIS_DESCR
/end CHARACTERISTIC
/begin CHARACTERISTIC KF_ZW_S_PF2 "Basic ignition angle path 2 safe" MAP 0x96C37C0 _REC_A1CUR_1_MBSE_S1_S1 127.5 aAwkuzc_BFpgCmb_tmDukma_q__aa0o -64 63.5 FORMAT "%4.1"
 /begin AXIS_DESCR COM_AXIS Nkw caoddzd_oAjpfzb_cAcEEha_1nR_oa0 20 -32768 32767 AXIS_PTS_REF AXX_KF_ZW_S_PF2 FORMAT "%5.0" MONOTONY STRICT_INCREASE DEPOSIT ABSOLUTE /end AXIS_DESCR
 /begin AXIS_DESCR COM_AXIS NO_INPUT_QUANTITY CgkBooc_wkiDfEd_Czglhgc_fR_1a0o 16 -327.68 327.67 AXIS_PTS_REF AXY_KF_ZW_S_PF2 FORMAT "%9.2" MONOTONY STRICT_INCREASE DEPOSIT ABSOLUTE /end AXIS_DESCR
/end CHARACTERISTIC
/begin CHARACTERISTIC KF_ZW_UESP_PF1 "Basic ignition angle overflush path 1" MAP 0x96C3734 _REC_A1CUR_1_MBSE_S1_S1 127.5 aAwkuzc_BFpgCmb_tmDukma_q__aa0o -64 63.5 FORMAT "%4.1"
 /begin AXIS_DESCR COM_AXIS Nkw caoddzd_oAjpfzb_cAcEEha_1nR_oa0 10 -32768 32767 AXIS_PTS_REF AXX_KF_ZW_UESP_PF1 FORMAT "%5.0" MONOTONY STRICT_INCREASE DEPOSIT ABSOLUTE /end AXIS_DESCR
 /begin AXIS_DESCR COM_AXIS NO_INPUT_QUANTITY CgkBooc_wkiDfEd_Czglhgc_fR_1a0o 14 -327.68 327.67 AXIS_PTS_REF AXY_KF_ZW_UESP_PF1 FORMAT "%9.2" MONOTONY STRICT_INCREASE DEPOSIT ABSOLUTE /end AXIS_DESCR
/end CHARACTERISTIC
/begin CHARACTERISTIC KF_ZW_UESP_PF2 "Basic ignition angle over-scavenging path 2" MAP 0x96C36A8 _REC_A1CUR_1_MBSE_S1_S1 127.5 aAwkuzc_BFpgCmb_tmDukma_q__aa0o -64 63.5 FORMAT "%4.1"
 /begin AXIS_DESCR COM_AXIS Nkw caoddzd_oAjpfzb_cAcEEha_1nR_oa0 10 -32768 32767 AXIS_PTS_REF AXX_KF_ZW_UESP_PF2 FORMAT "%5.0" MONOTONY STRICT_INCREASE DEPOSIT ABSOLUTE /end AXIS_DESCR
 /begin AXIS_DESCR COM_AXIS NO_INPUT_QUANTITY CgkBooc_wkiDfEd_Czglhgc_fR_1a0o 14 -327.68 327.67 AXIS_PTS_REF AXY_KF_ZW_UESP_PF2 FORMAT "%9.2" MONOTONY STRICT_INCREASE DEPOSIT ABSOLUTE /end AXIS_DESCR
/end CHARACTERISTIC
/begin CHARACTERISTIC KF_ZW_VP_PF1 "Map for ignition angle vanos in stop F_basis=1 path 1" MAP 0x96C7B5C _REC_A1CUR_1_MBSE_S1_S1 127.5 aAwkuzc_BFpgCmb_tmDukma_q__aa0o -64 63.5 FORMAT "%4.1"
 /begin AXIS_DESCR COM_AXIS Nkw caoddzd_oAjpfzb_cAcEEha_1nR_oa0 20 -32768 32767 AXIS_PTS_REF AXX_KF_ZW_VP_PF1 FORMAT "%5.0" MONOTONY STRICT_INCREASE DEPOSIT ABSOLUTE /end AXIS_DESCR
 /begin AXIS_DESCR COM_AXIS Rf_zwv CgkBooc_wkiDfEd_Czglhgc_fR_1a0o 16 -327.68 327.67 AXIS_PTS_REF AXY_KF_ZW_VP_PF1 FORMAT "%9.2" MONOTONY STRICT_INCREASE DEPOSIT ABSOLUTE /end AXIS_DESCR
/end CHARACTERISTIC
/begin CHARACTERISTIC KF_ZW_VP_PF2 "Map for ignition angle vanos in stop F_basis=1 path 2" MAP 0x96C7A1C _REC_A1CUR_1_MBSE_S1_S1 127.5 aAwkuzc_BFpgCmb_tmDukma_q__aa0o -64 63.5 FORMAT "%4.1"
 /begin AXIS_DESCR COM_AXIS Nkw caoddzd_oAjpfzb_cAcEEha_1nR_oa0 20 -32768 32767 AXIS_PTS_REF AXX_KF_ZW_VP_PF2 FORMAT "%5.0" MONOTONY STRICT_INCREASE DEPOSIT ABSOLUTE /end AXIS_DESCR
 /begin AXIS_DESCR COM_AXIS Rf_zwv CgkBooc_wkiDfEd_Czglhgc_fR_1a0o 16 -327.68 327.67 AXIS_PTS_REF AXY_KF_ZW_VP_PF2 FORMAT "%9.2" MONOTONY STRICT_INCREASE DEPOSIT ABSOLUTE /end AXIS_DESCR
/end CHARACTERISTIC
/begin CHARACTERISTIC KF_ZWMIN_KSOT "Zwmin for sound tuning cold" MAP 0x96C76D4 _REC_A1CUR_1_MBSE_S1_S1 127.5 aAwkuzc_BFpgCmb_tmDukma_q__aa0o -64 63.5
 /begin AXIS_DESCR COM_AXIS Nkw caoddzd_oAjpfzb_cAcEEha_1nR_oa0 8 -32768 32767 AXIS_PTS_REF AXX_KF_ZWMIN_KSOT FORMAT "%5.0" MONOTONY STRICT_INCREASE DEPOSIT ABSOLUTE /end AXIS_DESCR
 /begin AXIS_DESCR COM_AXIS NO_INPUT_QUANTITY CgkBooc_wkiDfEd_Czglhgc_fR_1a0o 8 -327.68 327.67 AXIS_PTS_REF AXY_KF_ZWMIN_KSOT FORMAT "%9.4" MONOTONY STRICT_INCREASE DEPOSIT ABSOLUTE /end AXIS_DESCR
/end CHARACTERISTIC
/begin CHARACTERISTIC KF_ZWMIN_KSOT___MGF_CC_PF_Slot0 "Zwmin for sound tuning cold (Slot 0, at 0 RPM, X-Axis and Y-Axis do not switch, OEM Address)" MAP 0x96C76D4 _REC_A1CUR_1_MBSE_S1_S1 127.5 aAwkuzc_BFpgCmb_tmDukma_q__aa0o -64 63.5
 /begin AXIS_DESCR COM_AXIS Nkw caoddzd_oAjpfzb_cAcEEha_1nR_oa0 8 -32768 32767 AXIS_PTS_REF AXX_KF_ZWMIN_KSOT FORMAT "%5.0" MONOTONY STRICT_INCREASE DEPOSIT ABSOLUTE /end AXIS_DESCR
 /begin AXIS_DESCR COM_AXIS NO_INPUT_QUANTITY CgkBooc_wkiDfEd_Czglhgc_fR_1a0o 8 -327.68 327.67 AXIS_PTS_REF AXY_KF_ZWMIN_KSOT FORMAT "%9.4" MONOTONY STRICT_INCREASE DEPOSIT ABSOLUTE /end AXIS_DESCR
/end CHARACTERISTIC
/begin CHARACTERISTIC KF_ZWMIN_KSOT___MGF_CC_PF_Slot1 "Zwmin for sound tuning cold (Slot 1, at 1000 RPM, X-Axis and Y-Axis do not switch, Pump Fuel)" MAP 0x9770000 _REC_A1CUR_1_MBSE_S1_S1 127.5 aAwkuzc_BFpgCmb_tmDukma_q__aa0o -64 63.5
 /begin AXIS_DESCR COM_AXIS Nkw caoddzd_oAjpfzb_cAcEEha_1nR_oa0 8 -32768 32767 AXIS_PTS_REF AXX_KF_ZWMIN_KSOT FORMAT "%5.0" MONOTONY STRICT_INCREASE DEPOSIT ABSOLUTE /end AXIS_DESCR
 /begin AXIS_DESCR COM_AXIS NO_INPUT_QUANTITY CgkBooc_wkiDfEd_Czglhgc_fR_1a0o 8 -327.68 327.67 AXIS_PTS_REF AXY_KF_ZWMIN_KSOT FORMAT "%9.4" MONOTONY STRICT_INCREASE DEPOSIT ABSOLUTE /end AXIS_DESCR
/end CHARACTERISTIC
/begin CHARACTERISTIC KF_ZWMIN_KSOT___MGF_CC_PF_Slot2 "Zwmin for sound tuning cold (Slot 2, at 2000 RPM, X-Axis and Y-Axis do not switch, Pump Fuel)" MAP 0x9770040 _REC_A1CUR_1_MBSE_S1_S1 127.5 aAwkuzc_BFpgCmb_tmDukma_q__aa0o -64 63.5
 /begin AXIS_DESCR COM_AXIS Nkw caoddzd_oAjpfzb_cAcEEha_1nR_oa0 8 -32768 32767 AXIS_PTS_REF AXX_KF_ZWMIN_KSOT FORMAT "%5.0" MONOTONY STRICT_INCREASE DEPOSIT ABSOLUTE /end AXIS_DESCR
 /begin AXIS_DESCR COM_AXIS NO_INPUT_QUANTITY CgkBooc_wkiDfEd_Czglhgc_fR_1a0o 8 -327.68 327.67 AXIS_PTS_REF AXY_KF_ZWMIN_KSOT FORMAT "%9.4" MONOTONY STRICT_INCREASE DEPOSIT ABSOLUTE /end AXIS_DESCR
/end CHARACTERISTIC
/begin CHARACTERISTIC KF_ZWMIN_KSOT___MGF_CC_PF_Slot3 "Zwmin for sound tuning cold (Slot 3, at 3000 RPM, X-Axis and Y-Axis do not switch, Pump Fuel)" MAP 0x9770080 _REC_A1CUR_1_MBSE_S1_S1 127.5 aAwkuzc_BFpgCmb_tmDukma_q__aa0o -64 63.5
 /begin AXIS_DESCR COM_AXIS Nkw caoddzd_oAjpfzb_cAcEEha_1nR_oa0 8 -32768 32767 AXIS_PTS_REF AXX_KF_ZWMIN_KSOT FORMAT "%5.0" MONOTONY STRICT_INCREASE DEPOSIT ABSOLUTE /end AXIS_DESCR
 /begin AXIS_DESCR COM_AXIS NO_INPUT_QUANTITY CgkBooc_wkiDfEd_Czglhgc_fR_1a0o 8 -327.68 327.67 AXIS_PTS_REF AXY_KF_ZWMIN_KSOT FORMAT "%9.4" MONOTONY STRICT_INCREASE DEPOSIT ABSOLUTE /end AXIS_DESCR
/end CHARACTERISTIC
/begin CHARACTERISTIC KF_ZWMIN_KSOT___MGF_CC_PF_Slot4 "Zwmin for sound tuning cold (Slot 4, at 4000 RPM, X-Axis and Y-Axis do not switch, Pump Fuel)" MAP 0x97700C0 _REC_A1CUR_1_MBSE_S1_S1 127.5 aAwkuzc_BFpgCmb_tmDukma_q__aa0o -64 63.5
 /begin AXIS_DESCR COM_AXIS Nkw caoddzd_oAjpfzb_cAcEEha_1nR_oa0 8 -32768 32767 AXIS_PTS_REF AXX_KF_ZWMIN_KSOT FORMAT "%5.0" MONOTONY STRICT_INCREASE DEPOSIT ABSOLUTE /end AXIS_DESCR
 /begin AXIS_DESCR COM_AXIS NO_INPUT_QUANTITY CgkBooc_wkiDfEd_Czglhgc_fR_1a0o 8 -327.68 327.67 AXIS_PTS_REF AXY_KF_ZWMIN_KSOT FORMAT "%9.4" MONOTONY STRICT_INCREASE DEPOSIT ABSOLUTE /end AXIS_DESCR
/end CHARACTERISTIC
/begin CHARACTERISTIC KF_ZWMIN_KSOT___MGF_CC_PF_Slot5 "Zwmin for sound tuning cold (Slot 5, at 5000 RPM, X-Axis and Y-Axis do not switch, Pump Fuel)" MAP 0x9770100 _REC_A1CUR_1_MBSE_S1_S1 127.5 aAwkuzc_BFpgCmb_tmDukma_q__aa0o -64 63.5
 /begin AXIS_DESCR COM_AXIS Nkw caoddzd_oAjpfzb_cAcEEha_1nR_oa0 8 -32768 32767 AXIS_PTS_REF AXX_KF_ZWMIN_KSOT FORMAT "%5.0" MONOTONY STRICT_INCREASE DEPOSIT ABSOLUTE /end AXIS_DESCR
 /begin AXIS_DESCR COM_AXIS NO_INPUT_QUANTITY CgkBooc_wkiDfEd_Czglhgc_fR_1a0o 8 -327.68 327.67 AXIS_PTS_REF AXY_KF_ZWMIN_KSOT FORMAT "%9.4" MONOTONY STRICT_INCREASE DEPOSIT ABSOLUTE /end AXIS_DESCR
/end CHARACTERISTIC
/begin CHARACTERISTIC KF_ZWMIN_WSOT "Zwmin for sound tuning warm" MAP 0x96C7694 _REC_A1CUR_1_MBSE_S1_S1 127.5 aAwkuzc_BFpgCmb_tmDukma_q__aa0o -64 63.5
 /begin AXIS_DESCR COM_AXIS Nkw caoddzd_oAjpfzb_cAcEEha_1nR_oa0 8 -32768 32767 AXIS_PTS_REF AXX_KF_ZWMIN_WSOT FORMAT "%5.0" MONOTONY STRICT_INCREASE DEPOSIT ABSOLUTE /end AXIS_DESCR
 /begin AXIS_DESCR COM_AXIS NO_INPUT_QUANTITY CgkBooc_wkiDfEd_Czglhgc_fR_1a0o 8 -327.68 327.67 AXIS_PTS_REF AXY_KF_ZWMIN_WSOT FORMAT "%9.4" MONOTONY STRICT_INCREASE DEPOSIT ABSOLUTE /end AXIS_DESCR
/end CHARACTERISTIC
/begin CHARACTERISTIC KF_ZWMIN_WSOT___MGF_CC_PF_Slot0 "Zwmin for sound tuning warm (Slot 0, at 0 RPM, X-Axis and Y-Axis do not switch, OEM Address)" MAP 0x96C7694 _REC_A1CUR_1_MBSE_S1_S1 127.5 aAwkuzc_BFpgCmb_tmDukma_q__aa0o -64 63.5
 /begin AXIS_DESCR COM_AXIS Nkw caoddzd_oAjpfzb_cAcEEha_1nR_oa0 8 -32768 32767 AXIS_PTS_REF AXX_KF_ZWMIN_WSOT FORMAT "%5.0" MONOTONY STRICT_INCREASE DEPOSIT ABSOLUTE /end AXIS_DESCR
 /begin AXIS_DESCR COM_AXIS NO_INPUT_QUANTITY CgkBooc_wkiDfEd_Czglhgc_fR_1a0o 8 -327.68 327.67 AXIS_PTS_REF AXY_KF_ZWMIN_WSOT FORMAT "%9.4" MONOTONY STRICT_INCREASE DEPOSIT ABSOLUTE /end AXIS_DESCR
/end CHARACTERISTIC
/begin CHARACTERISTIC KF_ZWMIN_WSOT___MGF_CC_PF_Slot1 "Zwmin for sound tuning warm (Slot 1, at 1000 RPM, X-Axis and Y-Axis do not switch, Pump Fuel)" MAP 0x97758EE _REC_A1CUR_1_MBSE_S1_S1 127.5 aAwkuzc_BFpgCmb_tmDukma_q__aa0o -64 63.5
 /begin AXIS_DESCR COM_AXIS Nkw caoddzd_oAjpfzb_cAcEEha_1nR_oa0 8 -32768 32767 AXIS_PTS_REF AXX_KF_ZWMIN_WSOT FORMAT "%5.0" MONOTONY STRICT_INCREASE DEPOSIT ABSOLUTE /end AXIS_DESCR
 /begin AXIS_DESCR COM_AXIS NO_INPUT_QUANTITY CgkBooc_wkiDfEd_Czglhgc_fR_1a0o 8 -327.68 327.67 AXIS_PTS_REF AXY_KF_ZWMIN_WSOT FORMAT "%9.4" MONOTONY STRICT_INCREASE DEPOSIT ABSOLUTE /end AXIS_DESCR
/end CHARACTERISTIC
/begin CHARACTERISTIC KF_ZWMIN_WSOT___MGF_CC_PF_Slot2 "Zwmin for sound tuning warm (Slot 2, at 2000 RPM, X-Axis and Y-Axis do not switch, Pump Fuel)" MAP 0x977592E _REC_A1CUR_1_MBSE_S1_S1 127.5 aAwkuzc_BFpgCmb_tmDukma_q__aa0o -64 63.5
 /begin AXIS_DESCR COM_AXIS Nkw caoddzd_oAjpfzb_cAcEEha_1nR_oa0 8 -32768 32767 AXIS_PTS_REF AXX_KF_ZWMIN_WSOT FORMAT "%5.0" MONOTONY STRICT_INCREASE DEPOSIT ABSOLUTE /end AXIS_DESCR
 /begin AXIS_DESCR COM_AXIS NO_INPUT_QUANTITY CgkBooc_wkiDfEd_Czglhgc_fR_1a0o 8 -327.68 327.67 AXIS_PTS_REF AXY_KF_ZWMIN_WSOT FORMAT "%9.4" MONOTONY STRICT_INCREASE DEPOSIT ABSOLUTE /end AXIS_DESCR
/end CHARACTERISTIC
/begin CHARACTERISTIC KF_ZWMIN_WSOT___MGF_CC_PF_Slot3 "Zwmin for sound tuning warm (Slot 3, at 3000 RPM, X-Axis and Y-Axis do not switch, Pump Fuel)" MAP 0x977596E _REC_A1CUR_1_MBSE_S1_S1 127.5 aAwkuzc_BFpgCmb_tmDukma_q__aa0o -64 63.5
 /begin AXIS_DESCR COM_AXIS Nkw caoddzd_oAjpfzb_cAcEEha_1nR_oa0 8 -32768 32767 AXIS_PTS_REF AXX_KF_ZWMIN_WSOT FORMAT "%5.0" MONOTONY STRICT_INCREASE DEPOSIT ABSOLUTE /end AXIS_DESCR
 /begin AXIS_DESCR COM_AXIS NO_INPUT_QUANTITY CgkBooc_wkiDfEd_Czglhgc_fR_1a0o 8 -327.68 327.67 AXIS_PTS_REF AXY_KF_ZWMIN_WSOT FORMAT "%9.4" MONOTONY STRICT_INCREASE DEPOSIT ABSOLUTE /end AXIS_DESCR
/end CHARACTERISTIC
/begin CHARACTERISTIC KF_ZWMIN_WSOT___MGF_CC_PF_Slot4 "Zwmin for sound tuning warm (Slot 4, at 4000 RPM, X-Axis and Y-Axis do not switch, Pump Fuel)" MAP 0x97759AE _REC_A1CUR_1_MBSE_S1_S1 127.5 aAwkuzc_BFpgCmb_tmDukma_q__aa0o -64 63.5
 /begin AXIS_DESCR COM_AXIS Nkw caoddzd_oAjpfzb_cAcEEha_1nR_oa0 8 -32768 32767 AXIS_PTS_REF AXX_KF_ZWMIN_WSOT FORMAT "%5.0" MONOTONY STRICT_INCREASE DEPOSIT ABSOLUTE /end AXIS_DESCR
 /begin AXIS_DESCR COM_AXIS NO_INPUT_QUANTITY CgkBooc_wkiDfEd_Czglhgc_fR_1a0o 8 -327.68 327.67 AXIS_PTS_REF AXY_KF_ZWMIN_WSOT FORMAT "%9.4" MONOTONY STRICT_INCREASE DEPOSIT ABSOLUTE /end AXIS_DESCR
/end CHARACTERISTIC
/begin CHARACTERISTIC KF_ZWMIN_WSOT___MGF_CC_PF_Slot5 "Zwmin for sound tuning warm (Slot 5, at 5000 RPM, X-Axis and Y-Axis do not switch, Pump Fuel)" MAP 0x97759EE _REC_A1CUR_1_MBSE_S1_S1 127.5 aAwkuzc_BFpgCmb_tmDukma_q__aa0o -64 63.5
 /begin AXIS_DESCR COM_AXIS Nkw caoddzd_oAjpfzb_cAcEEha_1nR_oa0 8 -32768 32767 AXIS_PTS_REF AXX_KF_ZWMIN_WSOT FORMAT "%5.0" MONOTONY STRICT_INCREASE DEPOSIT ABSOLUTE /end AXIS_DESCR
 /begin AXIS_DESCR COM_AXIS NO_INPUT_QUANTITY CgkBooc_wkiDfEd_Czglhgc_fR_1a0o 8 -327.68 327.67 AXIS_PTS_REF AXY_KF_ZWMIN_WSOT FORMAT "%9.4" MONOTONY STRICT_INCREASE DEPOSIT ABSOLUTE /end AXIS_DESCR
/end CHARACTERISTIC
/begin FUNCTION Antilag "Build boost before accelerating"
 /begin DEF_CHARACTERISTIC Antilag_Pedal___MGF_CC_PF Antilag_CutMethod___MGF_CC_PF Antilag_ActivationDelay___MGF_CC_PF Antilag_TargetNumberOfCylindersToSuppress___MGF_CC_PF /end DEF_CHARACTERISTIC
 /begin SUB_FUNCTION Antilag_Codewords Antilag_PIDs Antilag_Rolling Antilag_Safety Antilag_Standing /end SUB_FUNCTION
/end FUNCTION
/begin FUNCTION Antilag_Codewords "" /begin DEF_CHARACTERISTIC CW_Antilag___MGF_CC /end DEF_CHARACTERISTIC /end FUNCTION
/begin FUNCTION Antilag_PIDs ""
 /begin DEF_CHARACTERISTIC Antilag_BMWtchctr_pwr_Pctl_M___MGF_CC_PF Antilag_BMWtchctr_p_DifCrtnPp_M___MGF_CC_PF Antilag_BMWtchctr_p_DifCrtnPpDyn_M___MGF_CC_PF Antilag_BMWtchctr_pwr_Dp_M___MGF_CC_PF /end DEF_CHARACTERISTIC
/end FUNCTION
/begin FUNCTION Antilag_Rolling ""
 /begin DEF_CHARACTERISTIC Antilag_RpmDelayUntilCutRoll___MGF_CC_PF Antilag_RollingSpeedThreshold___MGF_CC_PF Antilag_RollRpmMax___MGF_CC_PF Antilag_RollRpmMin___MGF_CC_PF Antilag_IgnRoll___MGF_CC_PF Antilag_LambdaRoll___MGF_CC_PF Antilag_TargetBoostRoll___MGF_CC_PF /end DEF_CHARACTERISTIC
/end FUNCTION
/begin FUNCTION Antilag_Safety ""
 /begin DEF_CHARACTERISTIC Antilag_CoolantTempMin___MGF_CC_PF Antilag_CoolantTempMax___MGF_CC_PF Antilag_EgtTempMax___MGF_CC_PF Antilag_OverBoostThreshold___MGF_CC_PF Antilag_IatTempMax___MGF_CC_PF Antilag_SafetyTorqueCap___MGF_CC_PF Antilag_MaxDuration___MGF_CC_PF /end DEF_CHARACTERISTIC
/end FUNCTION
/begin FUNCTION Antilag_Standing ""
 /begin DEF_CHARACTERISTIC Antilag_RpmSetpoint___MGF_CC_PF Antilag_RpmDelayUntilCutStand___MGF_CC_PF Antilag_IgnStand___MGF_CC_PF Antilag_LambdaStand___MGF_CC_PF Antilag_TargetBoostStand___MGF_CC_PF /end DEF_CHARACTERISTIC
/end FUNCTION
/begin FUNCTION Boost "Intake/exhaust pressure targets/limits"
 /begin DEF_CHARACTERISTIC K_PAK_MX BMWlpa_n_EfpEngStrtAmb_M K_MAX_PSSOLBER KL_RFTNLMX KF_DPLDSOLL_SPORT BMWtchdiag_n_EngMin_C BMWtchob_p_DifEnd_C BMWtchob_fac_tq_Delt_T BMWtchob_p_DifGraTrigMin_C BMWtchsp_p_ReqMax_C BMWtchsp_p_OfsMax_C BMWtchsp_rat_p_CmprPmp_T BMWtchsp_rat_p_CmprMax_M BMWtchsp_fac_FilPRatCmpr_T BMWtchsp_fac_mf_FilCmprNorm_T KF_DPLDS_PRED BMWtchctr_fac_pwr_CompLimPctl_T BMWtchctr_rat_p_ComprLimPctl_T PVDMX /end DEF_CHARACTERISTIC
/end FUNCTION
/begin FUNCTION BoostByGear "" /begin SUB_FUNCTION BoostByGear_Codewords /end SUB_FUNCTION /end FUNCTION
/begin FUNCTION BoostByGear_Codewords "" /end FUNCTION
/begin FUNCTION Burbles "Pops and bangs"
 /begin SUB_FUNCTION Burbles_Codewords Burbles_Slot0 Burbles_Slot1 Burbles_Slot2 Burbles_Slot3 Burbles_Slot4 Burbles_Slot5 /end SUB_FUNCTION
/end FUNCTION
/begin FUNCTION Burbles_Codewords "" /begin DEF_CHARACTERISTIC CW_BurblesOnTheFly___MGF_CC /end DEF_CHARACTERISTIC /end FUNCTION
/begin FUNCTION Burbles_Slot0 ""
 /begin DEF_CHARACTERISTIC KF_ZWMIN_WSOT___MGF_CC_PF_Slot0 KF_ZWMIN_KSOT___MGF_CC_PF_Slot0 /end DEF_CHARACTERISTIC
/end FUNCTION
/begin FUNCTION Burbles_Slot1 ""
 /begin DEF_CHARACTERISTIC KF_ZWMIN_WSOT___MGF_CC_PF_Slot1 KF_ZWMIN_KSOT___MGF_CC_PF_Slot1 /end DEF_CHARACTERISTIC
/end FUNCTION
/begin FUNCTION Burbles_Slot2 ""
 /begin DEF_CHARACTERISTIC KF_ZWMIN_WSOT___MGF_CC_PF_Slot2 KF_ZWMIN_KSOT___MGF_CC_PF_Slot2 /end DEF_CHARACTERISTIC
/end FUNCTION
/begin FUNCTION Burbles_Slot3 ""
 /begin DEF_CHARACTERISTIC KF_ZWMIN_WSOT___MGF_CC_PF_Slot3 KF_ZWMIN_KSOT___MGF_CC_PF_Slot3 /end DEF_CHARACTERISTIC
/end FUNCTION
/begin FUNCTION Burbles_Slot4 ""
 /begin DEF_CHARACTERISTIC KF_ZWMIN_WSOT___MGF_CC_PF_Slot4 KF_ZWMIN_KSOT___MGF_CC_PF_Slot4 /end DEF_CHARACTERISTIC
/end FUNCTION
/begin FUNCTION Burbles_Slot5 ""
 /begin DEF_CHARACTERISTIC KF_ZWMIN_WSOT___MGF_CC_PF_Slot5 KF_ZWMIN_KSOT___MGF_CC_PF_Slot5 /end DEF_CHARACTERISTIC
/end FUNCTION
/begin FUNCTION Cooling "Engine cooling"
 /begin DEF_CHARACTERISTIC KL_NEL_TMOT KL_TKW_NO KL_TKW_HI KL_FLD_KKS K_TKW_WA K_TKW_MX /end DEF_CHARACTERISTIC
/end FUNCTION
/begin FUNCTION CustomCode ""
 /begin SUB_FUNCTION Antilag BoostByGear Burbles CustomCodeMenu ExhaustFlap FlexFuel MaxCooling RadiatorFlap SwitchableMaps TcuTorqueLimiter Valet /end SUB_FUNCTION
/end FUNCTION
/begin FUNCTION CustomCodeMenu "On-The-Fly access to custom features"
 /begin DEF_CHARACTERISTIC CcmEnterMenuDelay___MGF_CC_PF CcmTimeout___MGF_CC_PF UniRockerEnterDetectionDelay___MGF_CC_PF /end DEF_CHARACTERISTIC
 /begin SUB_FUNCTION CustomCodeMenu_Codewords CustomCodeMenu_CanBusIds /end SUB_FUNCTION
/end FUNCTION
/begin FUNCTION CustomCodeMenu_CanBusIds ""
 /begin DEF_CHARACTERISTIC CustomCanBusCruiseControlIdMap___MGF_CC_PF CustomCanBusEcaIdMap___MGF_CC_PF CustomCanBusMotivReflexOutputIdMap___MGF_CC_PF CustomCanBusTurnSignalIdMap___MGF_CC_PF /end DEF_CHARACTERISTIC
/end FUNCTION
/begin FUNCTION CustomCodeMenu_Codewords ""
 /begin DEF_CHARACTERISTIC CW_CustomCodeMenu___MGF_CC CW_CruiseControlConfig___MGF_CC CW_UseAllCruiseControlCanBusData___MGF_CC CW_LowPressureFuelPressureSensorInstalled___MGF_CC CW_MgfLimpModeProtectionEnabled___MGF_CC CW_MotivReflexInstalled___MGF_CC /end DEF_CHARACTERISTIC
/end FUNCTION
/begin FUNCTION DisplayCalibration "Sport gauge scales for power and torque"
 /begin DEF_CHARACTERISTIC K_EDA_P_ANZ_SPORT_BS_SCAL_CODE3 K_EDA_P_ANZ_SPORT_BS_SCAL_CODE2 K_EDA_P_ANZ_SPORT_BS_SCAL_CODE1 K_EDA_P_ANZ_SPORT_BS_SCAL_CODE0 K_EDA_MD_ANZ_BS_SCAL_CODE4 K_EDA_MD_ANZ_BS_SCAL_CODE3 K_EDA_MD_ANZ_BS_SCAL_CODE2 K_EDA_MD_ANZ_BS_SCAL_CODE1 K_EDA_MD_ANZ_BS_SCAL_CODE0 /end DEF_CHARACTERISTIC
/end FUNCTION
/begin FUNCTION Exhaust "Exhaust flap, burbles and noise"
 /begin DEF_CHARACTERISTIC K_V_SOT_MN BMWgpfheat_p_RailTstrPcg_C BMWgpfheat_tq_ResExhFlpClsdHys_C BMWgpfheat_p_RailInjSng_M BMWgpfheat_p_RailInjMpl_M BMWgpfheat_tq_ResExhFlpClsd_T K_V_SOUND_MX K_V_SOUND_MN K_T_VL_SOUND_MX K_T_NK_SOUND_MX K_T_SOUND_MN KL_T_IKAT_SOUND_MX KL_NKW_SOUND_MX KL_NKW_SOUND_MN KL_TD_SOUND_MX_SPORT KL_TD_SOUND_MX_FREI KL_TD_SOUND_MX KF_MD_RES_NST_KEY BMWchas_v_MaxExhFlpClsd_C BMWchas_v_IdlGearAcvMin_C BMWchas_tq_ResExhFlpClsdHys_C BMWchas_tq_ResExhFlpClsd_T K_F_SOT_RUECKBLICK_STAND K_F_SOT_RUECKBLICK_RS BMWchas_st_OpmBasc_M BMWgpfp_swi_PclFil_C BMWtchbas_cw_Noise_C CW_SOUND BMWtqe_b_SptDet4NoiseAcvn_M BMWtqe_b_Clu4NoiseDeac_T KF_ZWMIN_WSOT KF_ZWMIN_KSOT KF_DZWMIN_SPORT_SOT KF_DZWMIN_NORMAL_SOT AKRGRCC AKRGRCCAT AKRGRCCATM AKRGRCCATM_VAR1 AKRGRCCATM_VAR2 AKRGRCCATM_VAR3 AKRGRCCAT_VAR1 AKRGRCCAT_VAR2 AKRGRCCAT_VAR3 AKRGRCCM AKRGRCCM_VAR1 AKRGRCCM_VAR2 AKRGRCCM_VAR3 AKRGRCC_VAR1 AKRGRCC_VAR2 AKRGRCC_VAR3 AKRGRCO AKRGRCOAT AKRGRCOATM AKRGRCOATM_VAR1 AKRGRCOAT_VAR1 AKRGRCOM AKRGRCOM_VAR1 AKRGRCO_VAR1 AKR_dmHFMThdMin_C AKR_stSpt_C CWAKR CWSTEGSPROGAKR TMOTAKR TVSTAKR VMINAKR PFlt_stActv_C PFlt_stPfilTyp_C CWVMAXCOD VMAXOVC Exh_swtSensCfgPPFlt_C /end DEF_CHARACTERISTIC
/end FUNCTION
/begin FUNCTION ExhaustFlap "Force exhaust flap controls" /begin DEF_CHARACTERISTIC ExhaustFlapClosedMaxLoad___MGF_CC_PF /end DEF_CHARACTERISTIC /begin SUB_FUNCTION ExhaustFlap_Codewords /end SUB_FUNCTION /end FUNCTION
/begin FUNCTION ExhaustFlap_Codewords "" /begin DEF_CHARACTERISTIC CW_ExhaustFlapOnTheFly___MGF_CC /end DEF_CHARACTERISTIC /end FUNCTION
/begin FUNCTION ExhaustGasTemperature "Target EGT"
 /begin DEF_CHARACTERISTIC KF_TA_VKSOLL KF_TA_IKSOLL KF_TA_ATLSOLL BMWtchctr_t_ExGasMdl_M BMWtchctr_t_ExGasMdlScav_M /end DEF_CHARACTERISTIC
/end FUNCTION
/begin FUNCTION FlexFuel "Blend fuel maps with an ECA or hard-coded E%" /begin DEF_CHARACTERISTIC FlexFuelEthanolDisplayActivationDelay___MGF_CC_PF /end DEF_CHARACTERISTIC
 /begin SUB_FUNCTION FlexFuel_Codewords FlexFuel_Slot0 FlexFuel_Slot1 FlexFuel_Slot2 FlexFuel_Slot3 FlexFuel_Slot4 /end SUB_FUNCTION
/end FUNCTION
/begin FUNCTION FlexFuel_Codewords ""
 /begin DEF_CHARACTERISTIC CW_FlexFuelBlending___MGF_CC CW_FlexFuel___MGF_CC CW_SensorEthanol___MGF_CC /end DEF_CHARACTERISTIC
/end FUNCTION
/begin FUNCTION FlexFuel_Slot0 "Used for all slots if CW_UseMultipleFlexFuelSlots is disabled"
 /begin SUB_FUNCTION FlexFuel_Slot0_Codewords FlexFuel_Slot0_Blenders FlexFuel_Slot0_SensorlessValues /end SUB_FUNCTION
/end FUNCTION
/begin FUNCTION FlexFuel_Slot0_Blenders "" /end FUNCTION
/begin FUNCTION FlexFuel_Slot0_Codewords "" /end FUNCTION
/begin FUNCTION FlexFuel_Slot0_SensorlessValues "E% without sensor (ECA)" /end FUNCTION
/begin FUNCTION FlexFuel_Slot1 "Only used if CW_UseMultipleFlexFuelSlots is enabled"
 /begin SUB_FUNCTION FlexFuel_Slot1_Codewords FlexFuel_Slot1_Blenders FlexFuel_Slot1_SensorlessValues /end SUB_FUNCTION
/end FUNCTION
/begin FUNCTION FlexFuel_Slot1_Blenders "" /end FUNCTION
/begin FUNCTION FlexFuel_Slot1_Codewords "" /end FUNCTION
/begin FUNCTION FlexFuel_Slot1_SensorlessValues "E% without sensor (ECA)" /end FUNCTION
/begin FUNCTION FlexFuel_Slot2 "Only used if CW_UseMultipleFlexFuelSlots is enabled"
 /begin SUB_FUNCTION FlexFuel_Slot2_Codewords FlexFuel_Slot2_Blenders FlexFuel_Slot2_SensorlessValues /end SUB_FUNCTION
/end FUNCTION
/begin FUNCTION FlexFuel_Slot2_Blenders "" /end FUNCTION
/begin FUNCTION FlexFuel_Slot2_Codewords "" /end FUNCTION
/begin FUNCTION FlexFuel_Slot2_SensorlessValues "E% without sensor (ECA)" /end FUNCTION
/begin FUNCTION FlexFuel_Slot3 "Only used if CW_UseMultipleFlexFuelSlots is enabled"
 /begin SUB_FUNCTION FlexFuel_Slot3_Codewords FlexFuel_Slot3_Blenders FlexFuel_Slot3_SensorlessValues /end SUB_FUNCTION
/end FUNCTION
/begin FUNCTION FlexFuel_Slot3_Blenders "" /end FUNCTION
/begin FUNCTION FlexFuel_Slot3_Codewords "" /end FUNCTION
/begin FUNCTION FlexFuel_Slot3_SensorlessValues "E% without sensor (ECA)" /end FUNCTION
/begin FUNCTION FlexFuel_Slot4 "Only used if CW_UseMultipleFlexFuelSlots is enabled"
 /begin SUB_FUNCTION FlexFuel_Slot4_Codewords FlexFuel_Slot4_Blenders FlexFuel_Slot4_SensorlessValues /end SUB_FUNCTION
/end FUNCTION
/begin FUNCTION FlexFuel_Slot4_Blenders "" /end FUNCTION
/begin FUNCTION FlexFuel_Slot4_Codewords "" /end FUNCTION
/begin FUNCTION FlexFuel_Slot4_SensorlessValues "E% without sensor (ECA)" /end FUNCTION
/begin FUNCTION FuelCorrection "Lambda modifiers" /begin DEF_CHARACTERISTIC KF_FRKKORRF_1 KF_PHA_H_B1_W KF_PHA_H_E1 /end DEF_CHARACTERISTIC /end FUNCTION
/begin FUNCTION FuelLimits "Lambda limits" /begin DEF_CHARACTERISTIC K_FRFMXBS_MN KF_BSLGF K_BS_MN KL_LA_SBL /end DEF_CHARACTERISTIC /end FUNCTION
/begin FUNCTION FuelTargets "Lambda targets"
 /begin DEF_CHARACTERISTIC KF_LABAS_1 KF_PHA_H_B1_SK_PRE KF_DLAMBSVST_TABG BMWlpa_n_EfpModMax_C BMWlpa_n_EfpModSafe_M BMWlpa_n_EfpEngStrtPRail_T BMWlpsc_volf_FuEjrPmp_M BMWlpsd_p_RailDifMax_T KF_LAMIN_H KF_PRAIL_H_K KF_PRAIL_HGD_K KF_PRAIL_HGD KF_PRAIL_H KF_LA_BEZ KF_KOEFF_B_LA BMWchas_lam_InjSng_M BMWchas_lam_InjSngThr_M BMWchas_lam_InjMpl_M BMWchas_lam_InjMplThr_M BMWchas_p_RailInjSng_M BMWchas_p_RailInjMpl_M K_MSVANST_DIFFPRAIL BMWinjmon_fac_HppEff_M BMWlpa_volf_FuFpcOvrT_C BMWlpsc_p_HppMax_T K_PRAIL_ST_MAX KF_ST_RKBAS_VVT KF_ST_RKBAS_GD K_LA_FETTDELAY KF_LA_SK KF_LABAS_2 CW_ATMOD S_PRAIL_GL_LA1 S_AUSWAHL_FETTDELAY K_T_FETTDELAY_SPERR KF_TD_FETTDELAY_TABG VSEKPMXN FWIHDR FWPHDR KLIHDR KLPHDR KLPHDRTF NMXHDR KLFVSTOTF KLVSTMSVG MK2TE /end DEF_CHARACTERISTIC
/end FUNCTION
/begin FUNCTION GenericCharacteristics "OEM Maps"
 /begin SUB_FUNCTION FuelTargets Cooling LowPressureFuelPump TorqueLimiters Exhaust LoadControl Boost MAFSensor FuelCorrection FuelLimits ExhaustGasTemperature ThrottleControl Vanos WastegateControl Ignition Knock Limits DisplayCalibration TorqueMonitoring /end SUB_FUNCTION
/end FUNCTION
/begin FUNCTION Ignition "Timing targets"
 /begin DEF_CHARACTERISTIC KF_FDZWT_BEST_PF2 KF_FDZWT_BEST_PF1 KF_ZW_UESP_PF2 KF_ZW_UESP_PF1 KF_ZW_S_PF2 KF_ZW_S_PF1 KF_ZW_PF2 KF_ZW_PF1 KF_DZW_DYN KF_FDZW_DYN4 KF_FDZW_DYN3 KF_FDZW_DYN2 KF_FDZW_DYN1 KF_DZWT_UESP_PF2 KF_DZWT_UESP_PF1 KF_DZWT_PF2 KF_DZWT_PF1 KF_ZW_VP_PF2 KF_ZW_VP_PF1 /end DEF_CHARACTERISTIC
/end FUNCTION
/begin FUNCTION Knock "Knock factors and corrections"
 /begin DEF_CHARACTERISTIC KF_FDZWT_PF2 KF_FDZWT_PF1 IKCtl_FacKnockDetThd0_GM IKCtl_FacKnockDetThd1_GM IKCtl_FacKnockDetThd2_GM IKCtl_FacKnockDetThd3_GM IKCtl_FacKnockDetThd4_GM IKCtl_FacKnockDetThd5_GM IKCtl_facKnkRtdtCyl0_M IKCtl_facKnkRtdtCyl1_M IKCtl_facKnkRtdtCyl2_M IKCtl_facKnkRtdtCyl3_M IKCtl_facKnkRtdtCyl4_M IKCtl_facKnkRtdtCyl5_M /end DEF_CHARACTERISTIC
/end FUNCTION
/begin FUNCTION Limits "General limiters" /begin DEF_CHARACTERISTIC BMWinjmon_vol_HppCmpn_C KF_MDK_MAX_GANG_NKW VROHMAX /end DEF_CHARACTERISTIC /end FUNCTION
/begin FUNCTION LoadControl "Load targets and limiters"
 /begin DEF_CHARACTERISTIC KF_EDA_ANZ_SPORT_MD_EM1_IST K_RFVIST_MX BMWinjafs_fac_RatAirMax_T KL_FRFMXBS BMWext_lam_CptPronMinLeanTq_M KL_RFVHUBDYNKOR KL_RF_MAX_UESP KL_RF_MAX BMWls_rf_MaxModEng_M BMWls_rf_MaxFuOctIntkT_M BMWls_rf_MaxFuOctIntkTSpt_M BMWls_rf_MaxEgT_M BMWls_pct_FiMaxIgOfs_M BMWls_pct_FiMaxIgOfsSpt_M KL_LAMX BMWtchdiag_rf_SpMin_C BMWtchsp_rf_Liho_T KF_MDIOP_1_TQE KL_RFMIN_KRSTSYS S_BSRFMX BMWls_fac_rf_RednFuOctIntkT_M CoEng_ratChrgAirCylMaxDesLim_C /end DEF_CHARACTERISTIC
/end FUNCTION
/begin COMPU_METHOD ___MGF_CC_EngineSpeedCutMethodCompuMethod "default compuMethod" TAB_VERB "%6.3" "-" COMPU_TAB_REF ___MGF_CC_EngineSpeedCutMethodCompuVTab /end COMPU_METHOD
/begin COMPU_METHOD ___MGF_CC_Fueling_d10 "default compuMethod" RAT_FUNC "%8.3" "�" COEFFS 0 4096 0 0 0 1 /end COMPU_METHOD
/begin COMPU_METHOD ___MGF_CC_IgnitionTiming_d10 "default compuMethod" RAT_FUNC "%8.3" "�" COEFFS 0 10 0 0 0 1 /end COMPU_METHOD
/begin COMPU_METHOD ___MGF_CC_Pedal_x100_d256 "default compuMethod" RAT_FUNC "%6.3" "%" COEFFS 0 256 0 0 0 100 /end COMPU_METHOD
/begin COMPU_METHOD ___MGF_CC_PressurehPa_d8 "default compuMethod" RAT_FUNC "%6.3" "hPa" COEFFS 0 8 0 0 0 1 /end COMPU_METHOD
/begin COMPU_METHOD ___MGF_CC_Speedkmh_d64 "default compuMethod" RAT_FUNC "%6.4" "km/h" COEFFS 0 64 0 0 0 1 /end COMPU_METHOD
/begin COMPU_METHOD ___MGF_CC_TemperatureCelsius_d10 "default compuMethod" RAT_FUNC "%6.3" "�C" COEFFS 0 10 0 0 0 1 /end COMPU_METHOD
/begin COMPU_METHOD ___MGF_CC_TemperatureCelsius_x3_d4_s48 "default compuMethod" RAT_FUNC "%6.2" "�C" COEFFS 0 1 48 0 0 0.75 /end COMPU_METHOD
/begin COMPU_METHOD aAwkuzc_BFpgCmb_tmDukma_q__aa0o "aAwkuzc_BFpgCmb_tmDukma_q__aa0o" RAT_FUNC "%6.3" "�" COEFFS 0 2 0 0 0 1 /end COMPU_METHOD
/begin COMPU_METHOD acriqBc_tfkBqod_ocgjxzc_nR_8oa0 "acriqBc_tfkBqod_ocgjxzc_nR_8oa0" RAT_FUNC "%6.3" "-" COEFFS 0 8192 0 0 0 1 /end COMPU_METHOD
/begin COMPU_METHOD aEmoCzd_erpwvfb_msfkhgc_qR_1a0o "aEmoCzd_erpwvfb_msfkhgc_qR_1a0o" RAT_FUNC "%6.3" "�" COEFFS 0 128 0 0 0 3 /end COMPU_METHOD
/begin COMPU_METHOD AFeDmkb_cAbjmcc_kAkskhd_k__0oa0 "Def_q1" RAT_FUNC "%6.3" "km/h" COEFFS 0 1 0 0 0 1 /end COMPU_METHOD
/begin COMPU_METHOD asfzqDd_xfCuqha_hliBAmd_k__0oa0 "asfzqDd_xfCuqha_hliBAmd_k__0oa0" RAT_FUNC "%6.3" "kg/h" COEFFS 0 10 0 0 0 1 /end COMPU_METHOD
/begin COMPU_METHOD Asyaixa_wdvtenb_FCefaCb_n__aa0o "Asyaixa_wdvtenb_FCefaCb_n__aa0o" RAT_FUNC "%6.3" "-" COEFFS 0 50 0 0 0 1 /end COMPU_METHOD
/begin COMPU_METHOD B_TRUE "" TAB_VERB "%6.3" "" COMPU_TAB_REF ACCMPR_CODAVL_SY_Compu /end COMPU_METHOD
/begin COMPU_METHOD Bhvfwhc_bigEubd_BBEupBd_nR_3oa0 "Bhvfwhc_bigEubd_BBEupBd_nR_3oa0" RAT_FUNC "%6.3" "-" COEFFS 0 32768 0 0 0 1 /end COMPU_METHOD
/begin COMPU_METHOD BMW_q1 "" RAT_FUNC "%6.2" "-" COEFFS 0 1 0 0 0 1 /end COMPU_METHOD
/begin COMPU_METHOD BpaECzb_zweffod_enenhgc_nR_2a0o "BpaECzb_zweffod_enenhgc_nR_2a0o" RAT_FUNC "%6.3" "-" COEFFS 0 256 0 0 0 1 /end COMPU_METHOD
/begin COMPU_METHOD BumqDkc_mryszAa_EcglxAc_nR_4oa0 "BumqDkc_mryszAa_EcglxAc_nR_4oa0" RAT_FUNC "%6.3" "-" COEFFS 0 4096 0 0 0 1 /end COMPU_METHOD
/begin COMPU_METHOD CAmbmzc_faghuld_pmDugua_s__aa0o "CAmbmzc_faghuld_pmDugua_s__aa0o" RAT_FUNC "%6.3" "s" COEFFS 0 5 0 0 0 1 /end COMPU_METHOD
/begin COMPU_METHOD camcxxd_bxlpdsa_Cshlhgc_sR_1a0o "Def_q0p01" RAT_FUNC "%6.3" "s" COEFFS 0 100 0 0 0 1 /end COMPU_METHOD
/begin COMPU_METHOD caoddzd_oAjpfzb_cAcEEha_1nR_oa0 "Def_q1" RAT_FUNC "%6.3" "1/min" COEFFS 0 1 0 0 0 1 /end COMPU_METHOD
/begin COMPU_METHOD CByjozc_eCmpBAb_pljBAmd_k__0oa0 "CByjozc_eCmpBAb_pljBAmd_k__0oa0" RAT_FUNC "%6.3" "kg/h" COEFFS 0 32 0 0 0 1 /end COMPU_METHOD
/begin COMPU_METHOD CgkBooc_wkiDfEd_Czglhgc_fR_1a0o "Def_q0p01" RAT_FUNC "%6.3" "%" COEFFS 0 100 0 0 0 1 /end COMPU_METHOD
/begin COMPU_METHOD cxdjuna_xpuCged_ocEpdua_MCRa2a0 "cxdjuna_xpuCged_ocEpdua_MCRa2a0" RAT_FUNC "%6.3" "MPa" COEFFS 0 8192 0 0 0 5 /end COMPU_METHOD
/begin COMPU_METHOD DchEpAd_DBCFgoa_Ckhahgc_q__aoa0 "DchEpAd_DBCFgoa_Ckhahgc_q__aoa0" RAT_FUNC "%6.3" "�C" COEFFS 0 100 0 0 0 1 /end COMPU_METHOD
/begin COMPU_METHOD DEZ "" RAT_FUNC "%6.2" "" COEFFS 0 1 0 0 0 1 /end COMPU_METHOD
/begin COMPU_METHOD EngN "" RAT_FUNC "%6.3" "rpm" COEFFS 0 2 0 0 0 1 /end COMPU_METHOD
/begin COMPU_METHOD fak_q6p1035Em5 "" RAT_FUNC "%7.6" "-" COEFFS 0 65536 0 0 0 4 /end COMPU_METHOD
/begin COMPU_METHOD fak_sw_b4 "" RAT_FUNC "%6.5" "-" COEFFS 0 65536 0 0 0 8 /end COMPU_METHOD
/begin COMPU_METHOD fak_ub_b16 "" RAT_FUNC "%6.4" "-" COEFFS 0 256 0 0 0 16 /end COMPU_METHOD
/begin COMPU_METHOD fak_ub_b2 "" RAT_FUNC "%8.5" "-" COEFFS 0 256 0 0 0 2 /end COMPU_METHOD
/begin COMPU_METHOD fgjpsvb_fDqjECa_acgrbDd_n_dae__ "Def_bool" TAB_VERB "%6.3" "-" COMPU_TAB_REF fgjpsvb_fDqjECa_acgrbDd_n_dae__ /end COMPU_METHOD
/begin COMPU_METHOD FzbmlAa_gCtylrb_ckCqxAc_nR_6oa0 "FzbmlAa_gCtylrb_ckCqxAc_nR_6oa0" RAT_FUNC "%6.3" "-" COEFFS 0 65536 0 0 0 1 /end COMPU_METHOD
/begin COMPU_METHOD ggDviCc_uydFbsa_CDgnhgc_nR_2a0o "ggDviCc_uydFbsa_CDgnhgc_nR_2a0o" RAT_FUNC "%6.3" "-" COEFFS 0 200 0 0 0 1 /end COMPU_METHOD
/begin COMPU_METHOD hcpywvc_dcqzDlc_FmDugua_s__aa0o "Def_q1" RAT_FUNC "%6.3" "s" COEFFS 0 1 0 0 0 1 /end COMPU_METHOD
/begin COMPU_METHOD ilxsavd_hkzmBfc_lAzCpAb_nR_1oa0 "ilxsavd_hkzmBfc_lAzCpAb_nR_1oa0" RAT_FUNC "%6.3" "-" COEFFS 0 16384 0 0 0 1 /end COMPU_METHOD
/begin COMPU_METHOD InjDDGdi_mkte_q0p10416Em4 "" RAT_FUNC "%7.6" "ms * Hub/mg" COEFFS 0 96000 0 0 0 1 /end COMPU_METHOD
/begin COMPU_METHOD jgbhAma_smpAegb_hlEBAmd_k__0oa0 "jgbhAma_smpAegb_hlEBAmd_k__0oa0" RAT_FUNC "%6.3" "km/h" COEFFS 0 50 0 0 0 1 /end COMPU_METHOD
/begin COMPU_METHOD jucyrzb_bpFgwfd_uqrfhgc_k__aoa0 "jucyrzb_bpFgwfd_uqrfhgc_k__aoa0" RAT_FUNC "%6.3" "kW" COEFFS 0 512 0 0 0 1 /end COMPU_METHOD
/begin COMPU_METHOD juwcFuc_Dtmczic_mCgfamd_q__aa0o "juwcFuc_Dtmczic_mCgfamd_q__aa0o" RAT_FUNC "%6.3" "�" COEFFS 0 10 0 0 0 1 /end COMPU_METHOD
/begin COMPU_METHOD kEEdlBb_gsrEhkd_rmDuAhc_uCRoa0o "kEEdlBb_gsrEhkd_rmDuAhc_uCRoa0o" RAT_FUNC "%6.3" "ul" COEFFS 0 1 0 0 0 1 /end COMPU_METHOD
/begin COMPU_METHOD kw_q0p75 "" RAT_FUNC "%6.3" "Grad KW" COEFFS 0 4 0 0 0 3 /end COMPU_METHOD
/begin COMPU_METHOD Mo_trq_nm_q0p1 "" RAT_FUNC "%6.3" "Nm" COEFFS 0 10 0 0 0 1 /end COMPU_METHOD
/begin COMPU_METHOD n_sw_q0p5 "" RAT_FUNC "%6.3" "1/min" COEFFS 0 2 0 0 0 1 /end COMPU_METHOD
/begin COMPU_METHOD nmot_sw_q0p25 "" RAT_FUNC "%6.3" "1/min" COEFFS 0 1 0 0 0 0.25 /end COMPU_METHOD
/begin COMPU_METHOD noCyFga_rslwmfa_ecfnhgc_sR_2a0o "noCyFga_rslwmfa_ecfnhgc_sR_2a0o" RAT_FUNC "%6.3" "s" COEFFS 0 256 0 0 0 1 /end COMPU_METHOD
/begin COMPU_METHOD p_uw_q0p078 "" RAT_FUNC "%6.4" "hPa" COEFFS 0 256 0 0 0 20 /end COMPU_METHOD
/begin COMPU_METHOD qtfFcac_cfbwAaa_Cbeysaa_fR_60oa "Def_ub_b100" RAT_FUNC "%6.3" "%" COEFFS 0 64 0 0 0 25 /end COMPU_METHOD
/begin COMPU_METHOD raChrxc_kBtBrmb_FmDuEFa_n__aa0o "Def_q1" RAT_FUNC "%6.3" "-" COEFFS 0 1 0 0 0 1 /end COMPU_METHOD
/begin COMPU_METHOD rAdkuaa_wDllxja_BnDuEFa_n__aa0o "rAdkuaa_wDllxja_BnDuEFa_n__aa0o" RAT_FUNC "%6.3" "-" COEFFS 0 8 0 0 0 1 /end COMPU_METHOD
/begin COMPU_METHOD RBPtCel_p_0p002_1 "" RAT_FUNC "%6.4" "MPa" COEFFS 0 1000 0 0 0 2 /end COMPU_METHOD
/begin COMPU_METHOD RBPtCel_vol_1p0_1 "" RAT_FUNC "%6.2" "l" COEFFS 0 1 0 0 0 1 /end COMPU_METHOD
/begin COMPU_METHOD rel_q0p0234 "" RAT_FUNC "%6.4" "%" COEFFS 0 128 0 0 0 3 /end COMPU_METHOD
/begin COMPU_METHOD rel_ub_q0p75 "" RAT_FUNC "%6.3" "%" COEFFS 0 1 0 0 0 0.75 /end COMPU_METHOD
/begin COMPU_METHOD rgduxyd_mlihaBb_gsCghzb_bCRa0a0 "rgduxyd_mlihaBb_gsCghzb_bCRa0a0" RAT_FUNC "%6.3" "bar" COEFFS 0 1000 0 0 0 1 /end COMPU_METHOD
/begin COMPU_METHOD ridxkCa_Dxvxtdc_CChkhgc_nR_1a0o "ridxkCa_Dxvxtdc_CChkhgc_nR_1a0o" RAT_FUNC "%6.3" "-" COEFFS 0 128 0 0 0 3 /end COMPU_METHOD
/begin COMPU_METHOD t10msxs_ub_b2p55 "" RAT_FUNC "%6.4" "s" COEFFS 0 1 0 0 0 0.01 /end COMPU_METHOD
/begin COMPU_METHOD temp_ub_q0p75_o48 "" RAT_FUNC "%6.2" "Grad C" COEFFS 0 1 48 0 0 0.75 /end COMPU_METHOD
/begin COMPU_METHOD ubqeuic_jteCkzd_CDglhgc_nR_1a0o "ubqeuic_jteCkzd_CDglhgc_nR_1a0o" RAT_FUNC "%6.3" "-" COEFFS 0 100 0 0 0 1 /end COMPU_METHOD
/begin COMPU_METHOD vfzg_sw_q0p00781 "" RAT_FUNC "%6.4" "km/h" COEFFS 0 1 0 0 0 0.0078125 /end COMPU_METHOD
/begin COMPU_METHOD vfzg_ub_q1p25 "" RAT_FUNC "%6.2" "km/h" COEFFS 0 1 0 0 0 1.25 /end COMPU_METHOD
/begin COMPU_METHOD vfzg_uw_b512 "" RAT_FUNC "%6.4" "km/h" COEFFS 0 65536 0 0 0 512 /end COMPU_METHOD
/begin COMPU_METHOD wDvwtyd_Bhgozed_DCekdfb_nsttFSS "wDvwtyd_Bhgozed_DCekdfb_nsttFSS" TAB_VERB "%6.3" "-" COMPU_TAB_REF wDvwtyd_Bhgozed_DCekdfb_nsttFSS /end COMPU_METHOD
/begin COMPU_METHOD zBcBzad_vmoivka_mFzjCgc_lCRooa0 "zBcBzad_vmoivka_mFzjCgc_lCRooa0" RAT_FUNC "%6.3" "l/h" COEFFS 0 100 0 0 0 1 /end COMPU_METHOD
/begin COMPU_METHOD zyyxBpb_rEsnvtc_gktukCa_fR_5a0o "zyyxBpb_rEsnvtc_gktukCa_fR_5a0o" RAT_FUNC "%6.3" "%" COEFFS 0 512 0 0 0 25 /end COMPU_METHOD
/begin COMPU_VTAB ___MGF_CC_EngineSpeedCutMethodCompuVTab "" TAB_VERB 3 0 "Fuel" 1 "Ignition" 3 "Factory" DEFAULT_VALUE "Not Defined, unexpected results" /end COMPU_VTAB
/begin COMPU_VTAB ACCMPR_CODAVL_SY_Compu "" TAB_VERB 2 0 "FALSE" 1 "TRUE" /end COMPU_VTAB
/begin COMPU_VTAB fgjpsvb_fDqjECa_acgrbDd_n_dae__ "Def_bool" TAB_VERB 2 0 "false" 1 "true" DEFAULT_VALUE "Zustand nicht definiert" /end COMPU_VTAB
/begin COMPU_VTAB wDvwtyd_Bhgozed_DCekdfb_nsttFSS "wDvwtyd_Bhgozed_DCekdfb_nsttFSS" TAB_VERB 4 0 "CH_OFF" 1 "CH_1ES" 2 "CH_2ES" 3 "CH_3ES" DEFAULT_VALUE "Zustand nicht definiert" /end COMPU_VTAB
/begin RECORD_LAYOUT ___MGF_CC_Antilag_Ign_Roll_xAxis AXIS_PTS_X 0 SWORD INDEX_INCR PLONG /end RECORD_LAYOUT
/begin RECORD_LAYOUT _REC_A1AXS_1_MBSE_S1 ALIGNMENT_BYTE 1 ALIGNMENT_WORD 2 ALIGNMENT_LONG 4 ALIGNMENT_FLOAT32_IEEE 4 ALIGNMENT_FLOAT64_IEEE 4 AXIS_PTS_X 1 SBYTE INDEX_INCR DIRECT /end RECORD_LAYOUT
/begin RECORD_LAYOUT _REC_A1AXS_1_MBSE_S2 ALIGNMENT_BYTE 1 ALIGNMENT_WORD 2 ALIGNMENT_LONG 4 ALIGNMENT_FLOAT32_IEEE 4 ALIGNMENT_FLOAT64_IEEE 4 AXIS_PTS_X 1 SWORD INDEX_INCR DIRECT /end RECORD_LAYOUT
/begin RECORD_LAYOUT _REC_A1AXS_1_MBSE_U1 ALIGNMENT_BYTE 1 ALIGNMENT_WORD 2 ALIGNMENT_LONG 4 ALIGNMENT_FLOAT32_IEEE 4 ALIGNMENT_FLOAT64_IEEE 4 AXIS_PTS_X 1 UBYTE INDEX_INCR DIRECT /end RECORD_LAYOUT
/begin RECORD_LAYOUT _REC_A1AXS_1_MBSE_U2 ALIGNMENT_BYTE 1 ALIGNMENT_WORD 2 ALIGNMENT_LONG 4 ALIGNMENT_FLOAT32_IEEE 4 ALIGNMENT_FLOAT64_IEEE 4 AXIS_PTS_X 1 UWORD INDEX_INCR DIRECT /end RECORD_LAYOUT
/begin RECORD_LAYOUT _REC_A1CUR_1_MBSE_S1_S1 ALIGNMENT_BYTE 1 ALIGNMENT_WORD 2 ALIGNMENT_LONG 4 ALIGNMENT_FLOAT32_IEEE 4 ALIGNMENT_FLOAT64_IEEE 4 FNC_VALUES 1 SBYTE ROW_DIR DIRECT /end RECORD_LAYOUT
/begin RECORD_LAYOUT _REC_A1CUR_1_MBSE_S2_S1 ALIGNMENT_BYTE 1 ALIGNMENT_WORD 2 ALIGNMENT_LONG 4 ALIGNMENT_FLOAT32_IEEE 4 ALIGNMENT_FLOAT64_IEEE 4 FNC_VALUES 1 SWORD ROW_DIR DIRECT /end RECORD_LAYOUT
/begin RECORD_LAYOUT _REC_A1CUR_1_MBSE_U1_S1 ALIGNMENT_BYTE 1 ALIGNMENT_WORD 2 ALIGNMENT_LONG 4 ALIGNMENT_FLOAT32_IEEE 4 ALIGNMENT_FLOAT64_IEEE 4 FNC_VALUES 1 UBYTE ROW_DIR DIRECT /end RECORD_LAYOUT
/begin RECORD_LAYOUT _REC_A1CUR_1_MBSE_U2_S2 ALIGNMENT_BYTE 1 ALIGNMENT_WORD 2 ALIGNMENT_LONG 4 ALIGNMENT_FLOAT32_IEEE 4 ALIGNMENT_FLOAT64_IEEE 4 FNC_VALUES 1 UWORD ROW_DIR DIRECT /end RECORD_LAYOUT
/begin RECORD_LAYOUT _REC_S4CUR_52_KL_S2_1_S2 ALIGNMENT_BYTE 1 ALIGNMENT_WORD 2 ALIGNMENT_LONG 4 ALIGNMENT_FLOAT32_IEEE 4 ALIGNMENT_FLOAT64_IEEE 4 NO_AXIS_PTS_X 1 UBYTE RESERVED 2 BYTE AXIS_PTS_X 3 SWORD INDEX_INCR DIRECT FNC_VALUES 4 SWORD COLUMN_DIR DIRECT /end RECORD_LAYOUT
/begin RECORD_LAYOUT _REC_S4CUR_52_KL_U1_1_S2 ALIGNMENT_BYTE 1 ALIGNMENT_WORD 2 ALIGNMENT_LONG 4 ALIGNMENT_FLOAT32_IEEE 4 ALIGNMENT_FLOAT64_IEEE 4 NO_AXIS_PTS_X 1 UBYTE RESERVED 2 BYTE AXIS_PTS_X 3 SWORD INDEX_INCR DIRECT FNC_VALUES 4 UBYTE COLUMN_DIR DIRECT /end RECORD_LAYOUT
/begin RECORD_LAYOUT _REC_S4CUR_52_KL_U1_1_U2 ALIGNMENT_BYTE 1 ALIGNMENT_WORD 2 ALIGNMENT_LONG 4 ALIGNMENT_FLOAT32_IEEE 4 ALIGNMENT_FLOAT64_IEEE 4 NO_AXIS_PTS_X 1 UBYTE RESERVED 2 BYTE AXIS_PTS_X 3 UWORD INDEX_INCR DIRECT FNC_VALUES 4 UBYTE COLUMN_DIR DIRECT /end RECORD_LAYOUT
/begin RECORD_LAYOUT Axis_Xs16 ALIGNMENT_BYTE 1 ALIGNMENT_WORD 2 ALIGNMENT_LONG 4 ALIGNMENT_FLOAT32_IEEE 4 ALIGNMENT_FLOAT64_IEEE 4 NO_AXIS_PTS_X 1 SWORD AXIS_PTS_X 2 SWORD INDEX_INCR DIRECT /end RECORD_LAYOUT
/begin RECORD_LAYOUT Axis_Xu16 ALIGNMENT_BYTE 1 ALIGNMENT_WORD 2 ALIGNMENT_LONG 4 ALIGNMENT_FLOAT32_IEEE 4 ALIGNMENT_FLOAT64_IEEE 4 NO_AXIS_PTS_X 1 UWORD AXIS_PTS_X 2 UWORD INDEX_INCR DIRECT /end RECORD_LAYOUT
/begin RECORD_LAYOUT Axis_Xu8 ALIGNMENT_BYTE 1 ALIGNMENT_WORD 2 ALIGNMENT_LONG 4 ALIGNMENT_FLOAT32_IEEE 4 ALIGNMENT_FLOAT64_IEEE 4 NO_AXIS_PTS_X 1 UBYTE AXIS_PTS_X 2 UBYTE INDEX_INCR DIRECT /end RECORD_LAYOUT
/begin RECORD_LAYOUT Cur_Xu8Wu8 ALIGNMENT_BYTE 1 ALIGNMENT_WORD 2 ALIGNMENT_LONG 4 ALIGNMENT_FLOAT32_IEEE 4 ALIGNMENT_FLOAT64_IEEE 4 NO_AXIS_PTS_X 1 UBYTE AXIS_PTS_X 2 UBYTE INDEX_INCR DIRECT FNC_VALUES 3 UBYTE COLUMN_DIR DIRECT /end RECORD_LAYOUT
/begin RECORD_LAYOUT CurG_Ws16 ALIGNMENT_BYTE 1 ALIGNMENT_WORD 2 ALIGNMENT_LONG 4 ALIGNMENT_FLOAT32_IEEE 4 ALIGNMENT_FLOAT64_IEEE 4 FNC_VALUES 1 SWORD COLUMN_DIR DIRECT /end RECORD_LAYOUT
/begin RECORD_LAYOUT FklWUb ALIGNMENT_BYTE 1 ALIGNMENT_WORD 2 ALIGNMENT_LONG 4 ALIGNMENT_FLOAT32_IEEE 4 ALIGNMENT_FLOAT64_IEEE 4 FNC_VALUES 1 UBYTE COLUMN_DIR DIRECT /end RECORD_LAYOUT
/begin RECORD_LAYOUT GkfWU16 ALIGNMENT_BYTE 1 ALIGNMENT_WORD 2 ALIGNMENT_LONG 4 ALIGNMENT_FLOAT32_IEEE 4 ALIGNMENT_FLOAT64_IEEE 4 FNC_VALUES 1 UWORD COLUMN_DIR DIRECT /end RECORD_LAYOUT
/begin RECORD_LAYOUT KfAxU8AyU8SstxU8SstyU8WU8 ALIGNMENT_BYTE 1 ALIGNMENT_WORD 2 ALIGNMENT_LONG 4 ALIGNMENT_FLOAT32_IEEE 4 ALIGNMENT_FLOAT64_IEEE 4 NO_AXIS_PTS_X 1 UBYTE NO_AXIS_PTS_Y 2 UBYTE AXIS_PTS_X 3 UBYTE INDEX_INCR DIRECT AXIS_PTS_Y 4 UBYTE INDEX_INCR DIRECT FNC_VALUES 5 UBYTE COLUMN_DIR DIRECT /end RECORD_LAYOUT
/begin RECORD_LAYOUT RB_Map_S16U8_S8_Static ALIGNMENT_BYTE 1 ALIGNMENT_WORD 2 ALIGNMENT_LONG 4 ALIGNMENT_FLOAT32_IEEE 4 ALIGNMENT_FLOAT64_IEEE 4 NO_AXIS_PTS_X 1 SWORD NO_AXIS_PTS_Y 2 SWORD AXIS_PTS_X 3 SWORD INDEX_INCR DIRECT AXIS_PTS_Y 4 UBYTE INDEX_INCR DIRECT FNC_VALUES 5 SBYTE COLUMN_DIR DIRECT STATIC_RECORD_LAYOUT /end RECORD_LAYOUT
/end MODULE
/end PROJECT
