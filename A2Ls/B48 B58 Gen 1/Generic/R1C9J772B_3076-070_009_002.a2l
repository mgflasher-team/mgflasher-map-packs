/*
The MG Flasher Team
4/2/2026
Created with optimization mode
*/
ASAP2_VERSION 1 60
/begin PROJECT MG1CS003_BX8_R1C2J772B "MG1CS003"
/begin HEADER "" VERSION "R1C2J772B" PROJECT_NO MG1CS003_BX8_R1C2J772B /end HEADER
/begin MODULE DIM ""
/begin MOD_PAR "MG1CS003" VERSION "R1C2J772B" CUSTOMER_NO "11" USER "APPLICATOR" ECU "MG1CS003" CPU_TYPE "JDP" EPK "53/1/MG1CS003/11/MG1CS003_BX8_R1C2J772B//R1C2J772B///" ADDR_EPK 0x96C5278
 /begin MEMORY_SEGMENT Pst8FC0000 "" RESERVED FLASH INTERN 0x8FC0000 0x20 -1 -1 -1 -1 -1 /end MEMORY_SEGMENT
 /begin MEMORY_SEGMENT Pst8FC0020 "" RESERVED FLASH INTERN 0x8FC0020 0xBFE0 -1 -1 -1 -1 -1 /end MEMORY_SEGMENT
 /begin MEMORY_SEGMENT Pst8FD0000 "" RESERVED FLASH INTERN 0x8FD0000 0x8000 -1 -1 -1 -1 -1 /end MEMORY_SEGMENT
 /begin MEMORY_SEGMENT Pst9040000 "" CODE FLASH INTERN 0x9040000 0x4CD700 -1 -1 -1 -1 -1
  /begin IF_DATA ETK_XETK
   /begin ETK_XETK_ACCESS SERIAL_INTERFACE /end ETK_XETK_ACCESS
  /end IF_DATA
  /begin IF_DATA XCPplus 0x0102
   /begin SEGMENT 0x0 0x1 0x0 0x0 0x0 /begin CHECKSUM XCP_CRC_32 /end CHECKSUM
    /begin PAGE 0x0 ECU_ACCESS_WITH_XCP_ONLY XCP_READ_ACCESS_WITH_ECU_ONLY XCP_WRITE_ACCESS_NOT_ALLOWED /end PAGE
   /end SEGMENT
  /end IF_DATA
 /end MEMORY_SEGMENT
 /begin MEMORY_SEGMENT Pst950D700 "" RESERVED FLASH INTERN 0x950D700 0x540 -1 -1 -1 -1 -1 /end MEMORY_SEGMENT
 /begin MEMORY_SEGMENT Pst9000000 "" CODE FLASH INTERN 0x9000000 0x3FD00 -1 -1 -1 -1 -1
  /begin IF_DATA ETK_XETK
   /begin ETK_XETK_ACCESS SERIAL_INTERFACE /end ETK_XETK_ACCESS
  /end IF_DATA
  /begin IF_DATA XCPplus 0x0102
   /begin SEGMENT 0x1 0x1 0x0 0x0 0x0 /begin CHECKSUM XCP_CRC_32 /end CHECKSUM
    /begin PAGE 0x0 ECU_ACCESS_WITH_XCP_ONLY XCP_READ_ACCESS_WITH_ECU_ONLY XCP_WRITE_ACCESS_NOT_ALLOWED /end PAGE
   /end SEGMENT
  /end IF_DATA
 /end MEMORY_SEGMENT
 /begin MEMORY_SEGMENT Pst96F6FA0 "" RESERVED FLASH INTERN 0x96F6FA0 0x9060 -1 -1 -1 -1 -1 /begin IF_DATA ETK_XETK WRITE_AT_DATA_UPDATE USE_FILE ETK_XETK_REF 1 /end IF_DATA /end MEMORY_SEGMENT
 /begin MEMORY_SEGMENT Pst60C100 "" RESERVED FLASH INTERN 0x60C100 0x3F00 -1 -1 -1 -1 -1 /end MEMORY_SEGMENT
 /begin MEMORY_SEGMENT Pst610100 "" RESERVED FLASH INTERN 0x610100 0x1FF00 -1 -1 -1 -1 -1 /end MEMORY_SEGMENT
 /begin MEMORY_SEGMENT Pst60C000 "" RESERVED FLASH INTERN 0x60C000 0x100 -1 -1 -1 -1 -1 /end MEMORY_SEGMENT
 /begin MEMORY_SEGMENT Pst610000 "" RESERVED FLASH INTERN 0x610000 0x100 -1 -1 -1 -1 -1 /end MEMORY_SEGMENT
 /begin MEMORY_SEGMENT Pst8FD8000 "" RESERVED FLASH INTERN 0x8FD8000 0x8000 -1 -1 -1 -1 -1 /end MEMORY_SEGMENT
 /begin MEMORY_SEGMENT Pst903FD00 "" RESERVED FLASH INTERN 0x903FD00 0x300 -1 -1 -1 -1 -1 /end MEMORY_SEGMENT
 /begin MEMORY_SEGMENT Pst967FD00 "" RESERVED FLASH INTERN 0x967FD00 0x300 -1 -1 -1 -1 -1 /end MEMORY_SEGMENT
 /begin MEMORY_SEGMENT Dst9680000 "" DATA FLASH INTERN 0x9680000 0x76FA0 -1 -1 -1 -1 -1
  /begin IF_DATA ETK_XETK
   /begin ETK_XETK_ACCESS SERIAL_INTERFACE /end ETK_XETK_ACCESS
  /end IF_DATA
  /begin IF_DATA XCPplus 0x0102
   /begin SEGMENT 0x2 0x2 0x0 0x0 0x0 /begin CHECKSUM XCP_CRC_32 /end CHECKSUM
    /begin PAGE 0x0 ECU_ACCESS_DONT_CARE XCP_READ_ACCESS_DONT_CARE XCP_WRITE_ACCESS_NOT_ALLOWED /end PAGE
    /begin PAGE 0x1 ECU_ACCESS_DONT_CARE XCP_READ_ACCESS_DONT_CARE XCP_WRITE_ACCESS_WITH_ECU_ONLY /end PAGE
   /end SEGMENT
  /end IF_DATA
 /end MEMORY_SEGMENT
 /begin MEMORY_SEGMENT Dst977FD00 "" DATA FLASH INTERN 0x977FD00 0x300 -1 -1 -1 -1 -1
  /begin IF_DATA ETK_XETK
   /begin ETK_XETK_ACCESS SERIAL_INTERFACE /end ETK_XETK_ACCESS
  /end IF_DATA
  /begin IF_DATA XCPplus 0x0102
   /begin SEGMENT 0x3 0x2 0x0 0x0 0x0 /begin CHECKSUM XCP_CRC_32 /end CHECKSUM
    /begin PAGE 0x0 ECU_ACCESS_DONT_CARE XCP_READ_ACCESS_DONT_CARE XCP_WRITE_ACCESS_NOT_ALLOWED /end PAGE
    /begin PAGE 0x1 ECU_ACCESS_DONT_CARE XCP_READ_ACCESS_DONT_CARE XCP_WRITE_ACCESS_WITH_ECU_ONLY /end PAGE
   /end SEGMENT
  /end IF_DATA
 /end MEMORY_SEGMENT
 /begin MEMORY_SEGMENT Ram40000000 "" VARIABLES RAM INTERN 0x40000000 0x60000 -1 -1 -1 -1 -1
  /begin IF_DATA ETK_XETK
   /begin ETK_XETK_ACCESS SERIAL_INTERFACE /end ETK_XETK_ACCESS
  /end IF_DATA
  /begin IF_DATA XCPplus 0x0102
   /begin SEGMENT 0x4 0x0 0x0 0x0 0x0 /end SEGMENT
  /end IF_DATA
 /end MEMORY_SEGMENT
 /begin MEMORY_SEGMENT Ram50000000 "" VARIABLES RAM INTERN 0x50000000 0x4000 -1 -1 -1 -1 -1
  /begin IF_DATA ETK_XETK
   /begin ETK_XETK_ACCESS SERIAL_INTERFACE /end ETK_XETK_ACCESS
  /end IF_DATA
  /begin IF_DATA XCPplus 0x0102
   /begin SEGMENT 0x5 0x0 0x0 0x0 0x0 /end SEGMENT
  /end IF_DATA
 /end MEMORY_SEGMENT
 /begin MEMORY_SEGMENT Ram51000000 "" VARIABLES RAM INTERN 0x51000000 0x4000 -1 -1 -1 -1 -1
  /begin IF_DATA ETK_XETK
   /begin ETK_XETK_ACCESS SERIAL_INTERFACE /end ETK_XETK_ACCESS
  /end IF_DATA
  /begin IF_DATA XCPplus 0x0102
   /begin SEGMENT 0x6 0x0 0x0 0x0 0x0 /end SEGMENT
  /end IF_DATA
 /end MEMORY_SEGMENT
 /begin MEMORY_SEGMENT Ram52000000 "" VARIABLES RAM INTERN 0x52000000 0x4000 -1 -1 -1 -1 -1
  /begin IF_DATA ETK_XETK
   /begin ETK_XETK_ACCESS SERIAL_INTERFACE /end ETK_XETK_ACCESS
  /end IF_DATA
  /begin IF_DATA XCPplus 0x0102
   /begin SEGMENT 0x7 0x0 0x0 0x0 0x0 /end SEGMENT
  /end IF_DATA
 /end MEMORY_SEGMENT
 /begin MEMORY_SEGMENT Ram50800000 "" VARIABLES RAM INTERN 0x50800000 0x10000 -1 -1 -1 -1 -1
  /begin IF_DATA ETK_XETK
   /begin ETK_XETK_ACCESS SERIAL_INTERFACE /end ETK_XETK_ACCESS
  /end IF_DATA
  /begin IF_DATA XCPplus 0x0102
   /begin SEGMENT 0x8 0x0 0x0 0x0 0x0 /end SEGMENT
  /end IF_DATA
 /end MEMORY_SEGMENT
 /begin MEMORY_SEGMENT Ram51800000 "" VARIABLES RAM INTERN 0x51800000 0x10000 -1 -1 -1 -1 -1
  /begin IF_DATA ETK_XETK
   /begin ETK_XETK_ACCESS SERIAL_INTERFACE /end ETK_XETK_ACCESS
  /end IF_DATA
  /begin IF_DATA XCPplus 0x0102
   /begin SEGMENT 0x9 0x0 0x0 0x0 0x0 /end SEGMENT
  /end IF_DATA
 /end MEMORY_SEGMENT
 /begin MEMORY_SEGMENT Ram52800000 "" VARIABLES RAM INTERN 0x52800000 0xC000 -1 -1 -1 -1 -1
  /begin IF_DATA ETK_XETK
   /begin ETK_XETK_ACCESS SERIAL_INTERFACE /end ETK_XETK_ACCESS
  /end IF_DATA
  /begin IF_DATA XCPplus 0x0102
   /begin SEGMENT 0xA 0x0 0x0 0x0 0x0 /end SEGMENT
  /end IF_DATA
 /end MEMORY_SEGMENT
 /begin MEMORY_SEGMENT RamC1FB648 "" VARIABLES RAM INTERN 0xC1FB648 0x49B8 -1 -1 -1 -1 -1
  /begin IF_DATA ETK_XETK
   /begin ETK_XETK_ACCESS SERIAL_INTERFACE /end ETK_XETK_ACCESS
  /end IF_DATA
  /begin IF_DATA XCPplus 0x0102
   /begin SEGMENT 0xB 0x0 0x0 0x0 0x0 /end SEGMENT
  /end IF_DATA
 /end MEMORY_SEGMENT
 /begin MEMORY_SEGMENT RamC1E0000 "" CALIBRATION_VARIABLES RAM INTERN 0xC1E0000 0x1B648 -1 -1 -1 -1 -1
  /begin IF_DATA ETK_XETK
   /begin ETK_XETK_ACCESS SERIAL_INTERFACE /end ETK_XETK_ACCESS
  /end IF_DATA
  /begin IF_DATA XCPplus 0x0102
   /begin SEGMENT 0xC 0x0 0x0 0x0 0x0 /end SEGMENT
  /end IF_DATA
 /end MEMORY_SEGMENT
/end MOD_PAR
/begin MOD_COMMON "" BYTE_ORDER MSB_FIRST DEPOSIT ABSOLUTE ALIGNMENT_BYTE 1 ALIGNMENT_WORD 2 ALIGNMENT_LONG 4 ALIGNMENT_FLOAT32_IEEE 4 ALIGNMENT_FLOAT64_IEEE 4 /end MOD_COMMON
/begin AXIS_PTS AXX_KF_BSLGF "AXX_KF_BSLGF" 0x969134A Nkw_atm _REC_A1AXS_1_MBSE_S2 65535 caoddzd_oAjpfzb_cAcEEha_1nR_oa0 4 -32768 32767 DEPOSIT ABSOLUTE /end AXIS_PTS
/begin AXIS_PTS AXX_KF_DLAMBSVST_TABG "AXX_KF_DLAMBSVST_TABG" 0x96915DC Nkw_atm _REC_A1AXS_1_MBSE_S2 65535 caoddzd_oAjpfzb_cAcEEha_1nR_oa0 8 -32768 32767 DEPOSIT ABSOLUTE /end AXIS_PTS
/begin AXIS_PTS AXX_KF_DPLDS_PRED "Nkw" 0x96B4F5E NO_INPUT_QUANTITY _REC_A1AXS_1_MBSE_S2 32767 caoddzd_oAjpfzb_cAcEEha_1nR_oa0 6 0 32767 FORMAT "%5.0" DEPOSIT ABSOLUTE /end AXIS_PTS
/begin AXIS_PTS AXX_KF_DPLDSOLL_SPORT "Nkw" 0x969B59E NO_INPUT_QUANTITY _REC_A1AXS_1_MBSE_S2 32767 caoddzd_oAjpfzb_cAcEEha_1nR_oa0 6 0 32767 FORMAT "%5.0" DEPOSIT ABSOLUTE /end AXIS_PTS
/begin AXIS_PTS AXX_KF_DZWMIN_NORMAL_SOT "AXX_KF_DZWMIN_NORMAL_SOT" 0x96B82D0 Nkw _REC_A1AXS_1_MBSE_S2 65535 caoddzd_oAjpfzb_cAcEEha_1nR_oa0 6 -32768 32767 FORMAT "%5.0" DEPOSIT ABSOLUTE /end AXIS_PTS
/begin AXIS_PTS AXX_KF_DZWMIN_SPORT_SOT "AXX_KF_DZWMIN_SPORT_SOT" 0x96B82B4 Nkw _REC_A1AXS_1_MBSE_S2 65535 caoddzd_oAjpfzb_cAcEEha_1nR_oa0 6 -32768 32767 FORMAT "%5.0" DEPOSIT ABSOLUTE /end AXIS_PTS
/begin AXIS_PTS AXX_KF_FRKKORRF_1 "AXX_KF_FRKKORRF_1" 0x968DEB2 Nkw _REC_A1AXS_1_MBSE_S2 65535 caoddzd_oAjpfzb_cAcEEha_1nR_oa0 16 -32768 32767 FORMAT "%5.0" DEPOSIT ABSOLUTE /end AXIS_PTS
/begin AXIS_PTS AXX_KF_KOEFF_B_LA "AXX_KF_KOEFF_B_LA" 0x96AB86A Nkw _REC_A1AXS_1_MBSE_S2 65535 caoddzd_oAjpfzb_cAcEEha_1nR_oa0 6 -32768 32767 FORMAT "%5.0" DEPOSIT ABSOLUTE /end AXIS_PTS
/begin AXIS_PTS AXX_KF_LA_BEZ "AXX_KF_LA_BEZ" 0x96AB85E Nkw _REC_A1AXS_1_MBSE_S2 65535 caoddzd_oAjpfzb_cAcEEha_1nR_oa0 6 -32768 32767 FORMAT "%5.0" DEPOSIT ABSOLUTE /end AXIS_PTS
/begin AXIS_PTS AXX_KF_LA_EZA "AXX_KF_LA_EZA" 0x96966BC Nkw _REC_A1AXS_1_MBSE_S2 65535 caoddzd_oAjpfzb_cAcEEha_1nR_oa0 6 -32768 32767 FORMAT "%5.0" DEPOSIT ABSOLUTE /end AXIS_PTS
/begin AXIS_PTS AXX_KF_LAMIN_H "AXX_KF_LAMIN_H" 0x9696756 Nkw _REC_A1AXS_1_MBSE_S2 65535 caoddzd_oAjpfzb_cAcEEha_1nR_oa0 6 -32768 32767 FORMAT "%5.0" DEPOSIT ABSOLUTE /end AXIS_PTS
/begin AXIS_PTS AXX_KF_MD_RES_NST_KEY "AXX_KF_MD_RES_NST_KEY" 0x96A5C4C Tn_start_10 _REC_A1AXS_1_MBSE_U2 655.35 camcxxd_bxlpdsa_Cshlhgc_sR_1a0o 4 0 655.35 FORMAT "%7.2" DEPOSIT ABSOLUTE /end AXIS_PTS
/begin AXIS_PTS AXX_KF_N_GASSTOSS_UND_ANFAHR "KF_N_GASSTOSS_UND_ANFAHR" 0x969DBDC NO_INPUT_QUANTITY _REC_A1AXS_1_MBSE_S2 1310.7 jgbhAma_smpAegb_hlEBAmd_k__0oa0 6 -655.36 655.34 FORMAT "%7.2" DEPOSIT ABSOLUTE /end AXIS_PTS
/begin AXIS_PTS AXX_KF_NMAX_ANFAHR_MODE_0 "KF_NMAX_ANFAHR_MODE_0" 0x969E162 NO_INPUT_QUANTITY _REC_A1AXS_1_MBSE_S2 1310.7 jgbhAma_smpAegb_hlEBAmd_k__0oa0 6 -655.36 655.34 FORMAT "%7.2" DEPOSIT ABSOLUTE /end AXIS_PTS
/begin AXIS_PTS AXX_KF_NMAX_ANFAHR_MODE_1 "KF_NMAX_ANFAHR_MODE_1" 0x969E156 NO_INPUT_QUANTITY _REC_A1AXS_1_MBSE_S2 1310.7 jgbhAma_smpAegb_hlEBAmd_k__0oa0 6 -655.36 655.34 FORMAT "%7.2" DEPOSIT ABSOLUTE /end AXIS_PTS
/begin AXIS_PTS AXX_KF_NMAX_ANFAHR_MODE_2 "KF_NMAX_ANFAHR_MODE_2" 0x969E14A NO_INPUT_QUANTITY _REC_A1AXS_1_MBSE_S2 1310.7 jgbhAma_smpAegb_hlEBAmd_k__0oa0 6 -655.36 655.34 FORMAT "%7.2" DEPOSIT ABSOLUTE /end AXIS_PTS
/begin AXIS_PTS AXX_KF_PHA_H_E1 "AXX_KF_PHA_H_E1" 0x9690A60 Nkw _REC_A1AXS_1_MBSE_S2 65535 caoddzd_oAjpfzb_cAcEEha_1nR_oa0 8 -32768 32767 FORMAT "%5.0" DEPOSIT ABSOLUTE /end AXIS_PTS
/begin AXIS_PTS AXX_KF_PRAIL_H "AXX_KF_PRAIL_H" 0x969C76C Nkw _REC_A1AXS_1_MBSE_S2 65535 caoddzd_oAjpfzb_cAcEEha_1nR_oa0 8 -32768 32767 FORMAT "%5.0" DEPOSIT ABSOLUTE /end AXIS_PTS
/begin AXIS_PTS AXX_KF_PRAIL_H_K "AXX_KF_PRAIL_H_K" 0x969C72C Nkw _REC_A1AXS_1_MBSE_S2 65535 caoddzd_oAjpfzb_cAcEEha_1nR_oa0 8 -32768 32767 FORMAT "%5.0" DEPOSIT ABSOLUTE /end AXIS_PTS
/begin AXIS_PTS AXX_KF_PRAIL_HDPWARM "Achse" 0x969C75C Nkw _REC_A1AXS_1_MBSE_S2 65535 caoddzd_oAjpfzb_cAcEEha_1nR_oa0 8 -32768 32767 FORMAT "%5.0" DEPOSIT ABSOLUTE /end AXIS_PTS
/begin AXIS_PTS AXX_KF_PRAIL_HGD "Achse" 0x969C74C Nkw _REC_A1AXS_1_MBSE_S2 65535 caoddzd_oAjpfzb_cAcEEha_1nR_oa0 8 -32768 32767 FORMAT "%5.0" DEPOSIT ABSOLUTE /end AXIS_PTS
/begin AXIS_PTS AXX_KF_PRAIL_HGD_K "Achse" 0x969C73C Nkw _REC_A1AXS_1_MBSE_S2 65535 caoddzd_oAjpfzb_cAcEEha_1nR_oa0 8 -32768 32767 FORMAT "%5.0" DEPOSIT ABSOLUTE /end AXIS_PTS
/begin AXIS_PTS AXX_KF_ST_RKBAS_GD "AXX_KF_ST_RKBAS_GD" 0x96B8700 Nkw _REC_A1AXS_1_MBSE_S2 65535 caoddzd_oAjpfzb_cAcEEha_1nR_oa0 10 -32768 32767 FORMAT "%5.0" DEPOSIT ABSOLUTE /end AXIS_PTS
/begin AXIS_PTS AXX_KF_ST_RKBAS_VVT "AXX_KF_ST_RKBAS_VVT" 0x96B854E Nkw _REC_A1AXS_1_MBSE_S2 65535 caoddzd_oAjpfzb_cAcEEha_1nR_oa0 12 -32768 32767 FORMAT "%5.0" DEPOSIT ABSOLUTE /end AXIS_PTS
/begin AXIS_PTS AXX_KF_TA_ATLSOLL "AXX_KF_TA_ATLSOLL" 0x96915C4 Nkw_atm _REC_A1AXS_1_MBSE_S2 65535 caoddzd_oAjpfzb_cAcEEha_1nR_oa0 4 -32768 32767 DEPOSIT ABSOLUTE /end AXIS_PTS
/begin AXIS_PTS AXX_KF_TA_IKSOLL "AXX_KF_TA_IKSOLL" 0x96915BC Nkw_atm _REC_A1AXS_1_MBSE_S2 65535 caoddzd_oAjpfzb_cAcEEha_1nR_oa0 4 -32768 32767 DEPOSIT ABSOLUTE /end AXIS_PTS
/begin AXIS_PTS AXX_KF_TA_VKSOLL "AXX_KF_TA_VKSOLL" 0x96915B4 Nkw_atm _REC_A1AXS_1_MBSE_S2 65535 caoddzd_oAjpfzb_cAcEEha_1nR_oa0 4 -32768 32767 DEPOSIT ABSOLUTE /end AXIS_PTS
/begin AXIS_PTS AXX_KF_TD_FETTDELAY_TABG "AXX_KF_TD_FETTDELAY_TABG" 0x96B8F9E Tw_r1 _REC_A1AXS_1_MBSE_S2 6553.5 bdktxuc_qvvFmxd_seefaCc_q__aa0o 6 -3276.8 3276.7 FORMAT "%6.1" DEPOSIT ABSOLUTE /end AXIS_PTS
/begin AXIS_PTS AXX_KF_ZWMIN_KSOT "AXX_KF_ZWMIN_KSOT" 0x96B82A4 Nkw _REC_A1AXS_1_MBSE_S2 65535 caoddzd_oAjpfzb_cAcEEha_1nR_oa0 8 -32768 32767 FORMAT "%5.0" DEPOSIT ABSOLUTE /end AXIS_PTS
/begin AXIS_PTS AXX_KF_ZWMIN_WSOT "AXX_KF_ZWMIN_WSOT" 0x96B8294 Nkw _REC_A1AXS_1_MBSE_S2 65535 caoddzd_oAjpfzb_cAcEEha_1nR_oa0 8 -32768 32767 FORMAT "%5.0" DEPOSIT ABSOLUTE /end AXIS_PTS
/begin AXIS_PTS AXX_KL_LA_SBL "AXX_KL_LA_SBL" 0x96B8FF8 Nkw _REC_A1AXS_1_MBSE_S2 65535 caoddzd_oAjpfzb_cAcEEha_1nR_oa0 6 -32768 32767 FORMAT "%5.0" DEPOSIT ABSOLUTE /end AXIS_PTS
/begin AXIS_PTS AXX_KL_NKW_SOUND_MNMX "AXX_KL_NKW_SOUND_MNMX" 0x96BE16C Gangi _REC_A1AXS_1_MBSE_U1 255 raChrxc_kBtBrmb_FmDuEFa_n__aa0o 8 0 255 FORMAT "%3.0" DEPOSIT ABSOLUTE /end AXIS_PTS
/begin AXIS_PTS AXX_KL_PSPVDK_SOLMAXGD "Nkw" 0x96969A0 NO_INPUT_QUANTITY _REC_A1AXS_1_MBSE_S2 32767 caoddzd_oAjpfzb_cAcEEha_1nR_oa0 6 0 32767 FORMAT "%5.0" DEPOSIT ABSOLUTE /end AXIS_PTS
/begin AXIS_PTS AXX_KL_RFTNLMX "Nkw" 0x9696EDE NO_INPUT_QUANTITY _REC_A1AXS_1_MBSE_S2 32767 caoddzd_oAjpfzb_cAcEEha_1nR_oa0 10 0 32767 FORMAT "%5.0" DEPOSIT ABSOLUTE /end AXIS_PTS
/begin AXIS_PTS AXX_KL_T_IKAT_SOUND_MX "AXX_KL_T_IKAT_SOUND_MX" 0x96BE168 Anz_b_sound _REC_A1AXS_1_MBSE_U1 255 raChrxc_kBtBrmb_FmDuEFa_n__aa0o 4 0 255 FORMAT "%5.0" DEPOSIT ABSOLUTE /end AXIS_PTS
/begin AXIS_PTS AXX_KL_TD_SOUND_MX "AXX_KL_TD_SOUND_MX" 0x96A2542 V_fzg_plaus _REC_A1AXS_1_MBSE_S2 1310.7 jgbhAma_smpAegb_hlEBAmd_k__0oa0 4 -655.36 655.34 FORMAT "%6.2" DEPOSIT ABSOLUTE /end AXIS_PTS
/begin AXIS_PTS AXX_KL_TD_SOUND_MX_FREI "AXX_KL_TD_SOUND_MX_FREI" 0x96A253A V_fzg_plaus _REC_A1AXS_1_MBSE_S2 1310.7 jgbhAma_smpAegb_hlEBAmd_k__0oa0 4 -655.36 655.34 FORMAT "%6.2" DEPOSIT ABSOLUTE /end AXIS_PTS
/begin AXIS_PTS AXX_KL_TD_SOUND_MX_SPORT "AXX_KL_TD_SOUND_MX_SPORT" 0x96A2532 V_fzg_plaus _REC_A1AXS_1_MBSE_S2 1310.7 jgbhAma_smpAegb_hlEBAmd_k__0oa0 4 -655.36 655.34 FORMAT "%6.2" DEPOSIT ABSOLUTE /end AXIS_PTS
/begin AXIS_PTS AXY_KF_BSLGF "AXY_KF_BSLGF" 0x96912F4 Rf_atm _REC_A1AXS_1_MBSE_S2 655.35 CgkBooc_wkiDfEd_Czglhgc_fR_1a0o 4 -327.68 327.67 DEPOSIT ABSOLUTE /end AXIS_PTS
/begin AXIS_PTS AXY_KF_DLAMBSVST_TABG "AXY_KF_DLAMBSVST_TABG" 0x969156C Rf_atm _REC_A1AXS_1_MBSE_S2 655.35 CgkBooc_wkiDfEd_Czglhgc_fR_1a0o 8 -327.68 327.67 DEPOSIT ABSOLUTE /end AXIS_PTS
/begin AXIS_PTS AXY_KF_DPLDS_PRED "Drf_s2spred" 0x96B4F52 NO_INPUT_QUANTITY _REC_A1AXS_1_MBSE_U2 655.35 CgkBooc_wkiDfEd_Czglhgc_fR_1a0o 6 0 655.35 DEPOSIT ABSOLUTE /end AXIS_PTS
/begin AXIS_PTS AXY_KF_DPLDSOLL_SPORT "F_psspu" 0x969B572 NO_INPUT_QUANTITY _REC_A1AXS_1_MBSE_U2 7.9998779296875 acriqBc_tfkBqod_ocgjxzc_nR_8oa0 6 0 7.9998779296875 FORMAT "%7.5" DEPOSIT ABSOLUTE /end AXIS_PTS
/begin AXIS_PTS AXY_KF_DZWMIN_NORMAL_SOT "AXY_KF_DZWMIN_NORMAL_SOT" 0x96B828C V _REC_A1AXS_1_MBSE_U2 65535 AFeDmkb_cAbjmcc_kAkskhd_k__0oa0 4 0 65535 FORMAT "%5.0" DEPOSIT ABSOLUTE /end AXIS_PTS
/begin AXIS_PTS AXY_KF_DZWMIN_SPORT_SOT "AXY_KF_DZWMIN_SPORT_SOT" 0x96B8284 V _REC_A1AXS_1_MBSE_U2 65535 AFeDmkb_cAbjmcc_kAkskhd_k__0oa0 4 0 65535 FORMAT "%5.0" DEPOSIT ABSOLUTE /end AXIS_PTS
/begin AXIS_PTS AXY_KF_FRKKORRF_1 "AXY_KF_FRKKORRF_1" 0x968DE86 Rf _REC_A1AXS_1_MBSE_S2 655.35 CgkBooc_wkiDfEd_Czglhgc_fR_1a0o 16 -327.68 327.67 FORMAT "%7.2" DEPOSIT ABSOLUTE /end AXIS_PTS
/begin AXIS_PTS AXY_KF_KOEFF_B_LA "AXY_KF_KOEFF_B_LA" 0x96AB7FE NO_INPUT_QUANTITY _REC_A1AXS_1_MBSE_S2 655.35 CgkBooc_wkiDfEd_Czglhgc_fR_1a0o 6 -327.68 327.67 FORMAT "%9.2" DEPOSIT ABSOLUTE /end AXIS_PTS
/begin AXIS_PTS AXY_KF_LA_BEZ "AXY_KF_LA_BEZ" 0x96AB7EE NO_INPUT_QUANTITY _REC_A1AXS_1_MBSE_S2 655.35 CgkBooc_wkiDfEd_Czglhgc_fR_1a0o 8 -327.68 327.67 FORMAT "%9.2" DEPOSIT ABSOLUTE /end AXIS_PTS
/begin AXIS_PTS AXY_KF_LA_EZA "AXY_KF_LA_EZA" 0x9696640 Rf _REC_A1AXS_1_MBSE_S2 655.35 CgkBooc_wkiDfEd_Czglhgc_fR_1a0o 6 -327.68 327.67 FORMAT "%7.2" DEPOSIT ABSOLUTE /end AXIS_PTS
/begin AXIS_PTS AXY_KF_LAMIN_H "AXY_KF_LAMIN_H" 0x969674A Rf _REC_A1AXS_1_MBSE_S2 655.35 CgkBooc_wkiDfEd_Czglhgc_fR_1a0o 6 -327.68 327.67 FORMAT "%7.2" DEPOSIT ABSOLUTE /end AXIS_PTS
/begin AXIS_PTS AXY_KF_MD_RES_NST_KEY "AXY_KF_MD_RES_NST_KEY" 0x96A5C5C Tmot _REC_A1AXS_1_MBSE_S2 655.35 DchEpAd_DBCFgoa_Ckhahgc_q__aoa0 4 -327.68 327.67 FORMAT "%7.2" DEPOSIT ABSOLUTE /end AXIS_PTS
/begin AXIS_PTS AXY_KF_N_GASSTOSS_UND_ANFAHR "KF_NMAX_ANFAHR_MODE_0" 0x969DBD4 NO_INPUT_QUANTITY _REC_A1AXS_1_MBSE_S2 1599.9755859375 vfyBdwd_ftexgja_BcFdiDd_fR_1a0o 4 -800 799.9755859375 FORMAT "%7.2" DEPOSIT ABSOLUTE /end AXIS_PTS
/begin AXIS_PTS AXY_KF_NMAX_ANFAHR_MODE_0 "KF_NMAX_ANFAHR_MODE_0" 0x969E0AE NO_INPUT_QUANTITY _REC_A1AXS_1_MBSE_S2 1599.9755859375 vfyBdwd_ftexgja_BcFdiDd_fR_1a0o 4 -800 799.9755859375 FORMAT "%7.2" DEPOSIT ABSOLUTE /end AXIS_PTS
/begin AXIS_PTS AXY_KF_NMAX_ANFAHR_MODE_1 "KF_NMAX_ANFAHR_MODE_1" 0x969E0A6 NO_INPUT_QUANTITY _REC_A1AXS_1_MBSE_S2 1599.9755859375 vfyBdwd_ftexgja_BcFdiDd_fR_1a0o 4 -800 799.9755859375 FORMAT "%7.2" DEPOSIT ABSOLUTE /end AXIS_PTS
/begin AXIS_PTS AXY_KF_NMAX_ANFAHR_MODE_2 "KF_NMAX_ANFAHR_MODE_2" 0x969E09E NO_INPUT_QUANTITY _REC_A1AXS_1_MBSE_S2 1599.9755859375 vfyBdwd_ftexgja_BcFdiDd_fR_1a0o 4 -800 799.9755859375 FORMAT "%7.2" DEPOSIT ABSOLUTE /end AXIS_PTS
/begin AXIS_PTS AXY_KF_PHA_H_E1 "AXY_KF_PHA_H_E1" 0x969098C NO_INPUT_QUANTITY _REC_A1AXS_1_MBSE_S2 3199.951171875 zyyxBpb_rEsnvtc_gktukCa_fR_5a0o 8 -1600 1599.951171875 DEPOSIT ABSOLUTE /end AXIS_PTS
/begin AXIS_PTS AXY_KF_PRAIL_H "AXY_KF_PRAIL_H" 0x969C714 BMWrailco_rat_VabHom_sw _REC_A1AXS_1_MBSE_S2 3199.951171875 zyyxBpb_rEsnvtc_gktukCa_fR_5a0o 8 -1600 1599.951171875 FORMAT "%8.3" DEPOSIT ABSOLUTE /end AXIS_PTS
/begin AXIS_PTS AXY_KF_PRAIL_H_K "AXY_KF_PRAIL_H_K" 0x969C6D4 BMWrailco_rat_VabHom_sw _REC_A1AXS_1_MBSE_S2 3199.951171875 zyyxBpb_rEsnvtc_gktukCa_fR_5a0o 8 -1600 1599.951171875 FORMAT "%8.3" DEPOSIT ABSOLUTE /end AXIS_PTS
/begin AXIS_PTS AXY_KF_PRAIL_HDPWARM "Achse" 0x969C704 BMWrailco_rat_VabHom_sw _REC_A1AXS_1_MBSE_S2 3199.951171875 zyyxBpb_rEsnvtc_gktukCa_fR_5a0o 8 -1600 1599.951171875 FORMAT "%8.3" DEPOSIT ABSOLUTE /end AXIS_PTS
/begin AXIS_PTS AXY_KF_PRAIL_HGD "Achse" 0x969C6F4 BMWrailco_rat_VabHom_sw _REC_A1AXS_1_MBSE_S2 3199.951171875 zyyxBpb_rEsnvtc_gktukCa_fR_5a0o 8 -1600 1599.951171875 FORMAT "%8.3" DEPOSIT ABSOLUTE /end AXIS_PTS
/begin AXIS_PTS AXY_KF_PRAIL_HGD_K "Achse" 0x969C6E4 BMWrailco_rat_VabHom_sw _REC_A1AXS_1_MBSE_S2 3199.951171875 zyyxBpb_rEsnvtc_gktukCa_fR_5a0o 8 -1600 1599.951171875 FORMAT "%8.3" DEPOSIT ABSOLUTE /end AXIS_PTS
/begin AXIS_PTS AXY_KF_ST_RKBAS_GD "AXY_KF_ST_RKBAS_GD" 0x96B8674 BMWinj_t_Eng_sw _REC_A1AXS_1_MBSE_S2 655.35 DchEpAd_DBCFgoa_Ckhahgc_q__aoa0 10 -327.68 327.67 FORMAT "%7.2" DEPOSIT ABSOLUTE /end AXIS_PTS
/begin AXIS_PTS AXY_KF_ST_RKBAS_VVT "AXY_KF_ST_RKBAS_VVT" 0x96B850A BMWinj_t_Eng_sw _REC_A1AXS_1_MBSE_S2 655.35 DchEpAd_DBCFgoa_Ckhahgc_q__aoa0 12 -327.68 327.67 FORMAT "%7.2" DEPOSIT ABSOLUTE /end AXIS_PTS
/begin AXIS_PTS AXY_KF_TA_ATLSOLL "AXY_KF_TA_ATLSOLL" 0x9691554 Rf_atm _REC_A1AXS_1_MBSE_S2 655.35 CgkBooc_wkiDfEd_Czglhgc_fR_1a0o 4 -327.68 327.67 DEPOSIT ABSOLUTE /end AXIS_PTS
/begin AXIS_PTS AXY_KF_TA_IKSOLL "AXY_KF_TA_IKSOLL" 0x969154C Rf_atm _REC_A1AXS_1_MBSE_S2 655.35 CgkBooc_wkiDfEd_Czglhgc_fR_1a0o 4 -327.68 327.67 DEPOSIT ABSOLUTE /end AXIS_PTS
/begin AXIS_PTS AXY_KF_TA_VKSOLL "AXY_KF_TA_VKSOLL" 0x9691544 Rf_atm _REC_A1AXS_1_MBSE_S2 655.35 CgkBooc_wkiDfEd_Czglhgc_fR_1a0o 4 -327.68 327.67 DEPOSIT ABSOLUTE /end AXIS_PTS
/begin AXIS_PTS AXY_KF_TD_FETTDELAY_TABG "AXY_KF_TD_FETTDELAY_TABG" 0x96B8FF0 Nkw _REC_A1AXS_1_MBSE_S2 6554 caoddzd_oAjpfzb_cAcEEha_1nR_oa0 4 -3277 3277 FORMAT "%5.0" DEPOSIT ABSOLUTE /end AXIS_PTS
/begin AXIS_PTS AXY_KF_ZWMIN_KSOT "AXY_KF_ZWMIN_KSOT" 0x96B8264 NO_INPUT_QUANTITY _REC_A1AXS_1_MBSE_S2 655.35 CgkBooc_wkiDfEd_Czglhgc_fR_1a0o 8 -327.68 327.67 FORMAT "%9.4" DEPOSIT ABSOLUTE /end AXIS_PTS
/begin AXIS_PTS AXY_KF_ZWMIN_WSOT "AXY_KF_ZWMIN_WSOT" 0x96B8254 NO_INPUT_QUANTITY _REC_A1AXS_1_MBSE_S2 655.35 CgkBooc_wkiDfEd_Czglhgc_fR_1a0o 8 -327.68 327.67 FORMAT "%9.4" DEPOSIT ABSOLUTE /end AXIS_PTS
/begin AXIS_PTS BMWausy_p_DifCat_Ax "Mass flow through catalyst for pressure loss across catalyst" 0x968A714 NO_INPUT_QUANTITY _REC_A1AXS_1_MBSE_U2 2047.96875 CByjozc_eCmpBAb_pljBAmd_k__0oa0 8 0 2047.96875 FORMAT "%8.3" DEPOSIT ABSOLUTE /end AXIS_PTS
/begin AXIS_PTS BMWchas_lam_InjMpl_Ax "Catalyst heating after start, lambda injection multiple X-axis" 0x96AE7A2 Nkw _REC_A1AXS_1_MBSE_S2 65535 caoddzd_oAjpfzb_cAcEEha_1nR_oa0 10 -32768 32767 FORMAT "%5.0" DEPOSIT ABSOLUTE /end AXIS_PTS
/begin AXIS_PTS BMWchas_lam_InjMpl_Ay "Catalyst heating after start, lambda injection multiple Y-axis" 0x96AE50E BMWchas_tq_CmbEng_sw _REC_A1AXS_1_MBSE_S2 6553.5 Mo_trq_nm_q0p1 10 -3276.8 3276.7 FORMAT "%6.1" DEPOSIT ABSOLUTE /end AXIS_PTS
/begin AXIS_PTS BMWchas_lam_InjMplThr_Ax "Catalyst heating after start, lambda injection multiple throttle X-axis" 0x96AE7B6 Nkw _REC_A1AXS_1_MBSE_S2 65535 caoddzd_oAjpfzb_cAcEEha_1nR_oa0 10 -32768 32767 FORMAT "%5.0" DEPOSIT ABSOLUTE /end AXIS_PTS
/begin AXIS_PTS BMWchas_lam_InjMplThr_Ay "Catalyst heating after start, lambda injection multiple throttle Y-axis" 0x96AE522 BMWchas_tq_CmbEng_sw _REC_A1AXS_1_MBSE_S2 6553.5 Mo_trq_nm_q0p1 10 -3276.8 3276.7 FORMAT "%6.1" DEPOSIT ABSOLUTE /end AXIS_PTS
/begin AXIS_PTS BMWchas_lam_InjSng_Ax "Catalyst heating after start, lambda injection single X-axis" 0x96AE76A Nkw _REC_A1AXS_1_MBSE_S2 65535 caoddzd_oAjpfzb_cAcEEha_1nR_oa0 10 -32768 32767 FORMAT "%5.0" DEPOSIT ABSOLUTE /end AXIS_PTS
/begin AXIS_PTS BMWchas_lam_InjSng_Ay "Catalyst heating after start, lambda injection single Y-axis" 0x96AE4D6 BMWchas_tq_CmbEng_sw _REC_A1AXS_1_MBSE_S2 6553.5 Mo_trq_nm_q0p1 10 -3276.8 3276.7 FORMAT "%6.1" DEPOSIT ABSOLUTE /end AXIS_PTS
/begin AXIS_PTS BMWchas_lam_InjSngThr_Ax "Catalyst heating after start, lambda injection single throttle X-axis" 0x96AE77E Nkw _REC_A1AXS_1_MBSE_S2 65535 caoddzd_oAjpfzb_cAcEEha_1nR_oa0 10 -32768 32767 FORMAT "%5.0" DEPOSIT ABSOLUTE /end AXIS_PTS
/begin AXIS_PTS BMWchas_lam_InjSngThr_Ay "Catalyst heating after start, lambda injection single throttle Y-axis" 0x96AE4EA BMWchas_tq_CmbEng_sw _REC_A1AXS_1_MBSE_S2 6553.5 Mo_trq_nm_q0p1 10 -3276.8 3276.7 FORMAT "%6.1" DEPOSIT ABSOLUTE /end AXIS_PTS
/begin AXIS_PTS BMWchas_p_RailInjMpl_Ax "Catalyst heating after start, rail pressure injection multiple X-axis" 0x96AE75E Nkw _REC_A1AXS_1_MBSE_S2 65535 caoddzd_oAjpfzb_cAcEEha_1nR_oa0 6 -32768 32767 FORMAT "%5.0" DEPOSIT ABSOLUTE /end AXIS_PTS
/begin AXIS_PTS BMWchas_p_RailInjMpl_Ay "Catalyst heating after start, rail pressure injection multiple Y-axis" 0x96AE37A BMWrailco_rat_VabHom_sw _REC_A1AXS_1_MBSE_S2 3199.951171875 zyyxBpb_rEsnvtc_gktukCa_fR_5a0o 6 -1600 1599.951171875 FORMAT "%8.3" DEPOSIT ABSOLUTE /end AXIS_PTS
/begin AXIS_PTS BMWchas_p_RailInjSng_Ax "Catalyst heating after start, rail pressure injection single X-axis" 0x96AE74E Nkw _REC_A1AXS_1_MBSE_S2 65535 caoddzd_oAjpfzb_cAcEEha_1nR_oa0 8 -32768 32767 FORMAT "%5.0" DEPOSIT ABSOLUTE /end AXIS_PTS
/begin AXIS_PTS BMWchas_p_RailInjSng_Ay "Catalyst heating after start, rail pressure injection single Y-axis" 0x96AE36A BMWrailco_rat_VabHom_sw _REC_A1AXS_1_MBSE_S2 3199.951171875 zyyxBpb_rEsnvtc_gktukCa_fR_5a0o 8 -1600 1599.951171875 FORMAT "%8.3" DEPOSIT ABSOLUTE /end AXIS_PTS
/begin AXIS_PTS BMWchas_st_OpmBasc_Ax "Catalyst heating after start, operating mode basic X-axis" 0x968AAD0 BMWchas_ti_AftStrSca_uw _REC_A1AXS_1_MBSE_U2 255.99609375 noCyFga_rslwmfa_ecfnhgc_sR_2a0o 8 0 255.99609375 DEPOSIT ABSOLUTE /end AXIS_PTS
/begin AXIS_PTS BMWchas_st_OpmBasc_Ay "Catalyst heating after start, operating mode basic Y-axis" 0x968AB4C BMWchas_t_EngStr_sw _REC_A1AXS_1_MBSE_S2 6553.5 bdktxuc_qvvFmxd_seefaCc_q__aa0o 8 -3276.8 3276.7 DEPOSIT ABSOLUTE /end AXIS_PTS
/begin AXIS_PTS BMWchas_tq_ResExhFlpClsd_Ax "Catalyst heating after start, torque result exhaust flap closed X-axis" 0x96AE66E Nkw _REC_A1AXS_1_MBSE_S2 65535 caoddzd_oAjpfzb_cAcEEha_1nR_oa0 8 -32768 32767 FORMAT "%5.0" DEPOSIT ABSOLUTE /end AXIS_PTS
/begin AXIS_PTS BMWext_lam_CptPronDfco_Ax "Exhaust temperature model, lambda component protection deceleration fuel cutoff X-axis" 0x96B0460 NO_INPUT_QUANTITY _REC_A1AXS_1_MBSE_S2 65535 caoddzd_oAjpfzb_cAcEEha_1nR_oa0 6 -32768 32767 FORMAT "%5.0" DEPOSIT ABSOLUTE /end AXIS_PTS
/begin AXIS_PTS BMWgpfheat_p_RailInjMpl_Ax "GPF heating, rail pressure injection multiple X-axis" 0x9693D7C Nkw _REC_A1AXS_1_MBSE_S2 65535 caoddzd_oAjpfzb_cAcEEha_1nR_oa0 6 -32768 32767 FORMAT "%5.0" DEPOSIT ABSOLUTE /end AXIS_PTS
/begin AXIS_PTS BMWgpfheat_p_RailInjMpl_Ay "GPF heating, rail pressure injection multiple Y-axis" 0x9693C8C BMWrailco_rat_VabHom_sw _REC_A1AXS_1_MBSE_S2 3199.951171875 zyyxBpb_rEsnvtc_gktukCa_fR_5a0o 6 -1600 1599.951171875 FORMAT "%8.3" DEPOSIT ABSOLUTE /end AXIS_PTS
/begin AXIS_PTS BMWgpfheat_p_RailInjSng_Ax "GPF heating, rail pressure injection single X-axis" 0x9693D70 Nkw _REC_A1AXS_1_MBSE_S2 65535 caoddzd_oAjpfzb_cAcEEha_1nR_oa0 6 -32768 32767 FORMAT "%5.0" DEPOSIT ABSOLUTE /end AXIS_PTS
/begin AXIS_PTS BMWgpfheat_p_RailInjSng_Ay "GPF heating, rail pressure injection single Y-axis" 0x9693C80 BMWrailco_rat_VabHom_sw _REC_A1AXS_1_MBSE_S2 3199.951171875 zyyxBpb_rEsnvtc_gktukCa_fR_5a0o 6 -1600 1599.951171875 FORMAT "%8.3" DEPOSIT ABSOLUTE /end AXIS_PTS
/begin AXIS_PTS BMWgpfheat_tq_ResExhFlpClsd_Ax "GPF heating, torque result exhaust flap closed X-axis" 0x9693D60 Nkw _REC_A1AXS_1_MBSE_S2 65535 caoddzd_oAjpfzb_cAcEEha_1nR_oa0 8 -32768 32767 FORMAT "%5.0" DEPOSIT ABSOLUTE /end AXIS_PTS
/begin AXIS_PTS BMWinjmon_fac_HppEff_Ax "Injection map factor for high-pressure pump efficiency (X-axis)" 0x96AF6A2 Nkw _REC_A1AXS_1_MBSE_S2 65535 caoddzd_oAjpfzb_cAcEEha_1nR_oa0 8 -32768 32767 FORMAT "%5.0" DEPOSIT ABSOLUTE /end AXIS_PTS
/begin AXIS_PTS BMWinjmon_fac_HppEff_Ay "Injection map factor for high-pressure pump efficiency (Y-axis)" 0x96AF682 Prail_ist _REC_A1AXS_1_MBSE_U2 39.9993896484375 cxdjuna_xpuCged_ocEpdua_MCRa2a0 4 0 39.9993896484375 FORMAT "%9.4" DEPOSIT ABSOLUTE /end AXIS_PTS
/begin AXIS_PTS BMWlpa_n_EfpEngStrtAmb_Ax "Electric fuel pump speed setpoint for start ambient X-axis" 0x9692EAE Tumg _REC_A1AXS_1_MBSE_S2 6553.5 bdktxuc_qvvFmxd_seefaCc_q__aa0o 4 -3276.8 3276.7 FORMAT "%6.1" DEPOSIT ABSOLUTE /end AXIS_PTS
/begin AXIS_PTS BMWlpa_n_EfpEngStrtAmb_Ay "Electric fuel pump speed setpoint for start ambient Y-axis" 0x9692EA6 Pumg _REC_A1AXS_1_MBSE_U2 8191.875 dufmqFa_ggtdFtc_rzCuowa_hCRoa0o 4 0 8191.875 FORMAT "%8.3" DEPOSIT ABSOLUTE /end AXIS_PTS
/begin AXIS_PTS BMWlpa_n_EfpEngStrtPRail_Ax "Electric fuel pump speed setpoint for start rail pressure X-axis" 0x9692EA2 Prail_ist _REC_A1AXS_1_MBSE_U2 39.9993896484375 cxdjuna_xpuCged_ocEpdua_MCRa2a0 2 0 39.9993896484375 FORMAT "%9.4" DEPOSIT ABSOLUTE /end AXIS_PTS
/begin AXIS_PTS BMWlpa_n_EfpModSafe_Ax "Electric fuel pump speed setpoint safe mode X-axis" 0x9692EBE BMWlpi_t_Fu_sw _REC_A1AXS_1_MBSE_S2 655.35 DchEpAd_DBCFgoa_Ckhahgc_q__aoa0 4 -327.68 327.67 FORMAT "%5.2" DEPOSIT ABSOLUTE /end AXIS_PTS
/begin AXIS_PTS BMWlpa_n_EfpModSafe_Ay "Electric fuel pump speed setpoint safe mode Y-axis" 0x9692EB6 BMWlpi_volf_Fu_sw _REC_A1AXS_1_MBSE_S2 655.35 zBcBzad_vmoivka_mFzjCgc_lCRooa0 4 -327.68 327.67 FORMAT "%5.2" DEPOSIT ABSOLUTE /end AXIS_PTS
/begin AXIS_PTS BMWlpsc_p_HppMax_Ax "Achse" 0x96B07D2 BMWlpi_volf_Fu_sw _REC_A1AXS_1_MBSE_S2 655.35 zBcBzad_vmoivka_mFzjCgc_lCRooa0 4 -327.68 327.67 FORMAT "%5.2" DEPOSIT ABSOLUTE /end AXIS_PTS
/begin AXIS_PTS BMWlpsc_volf_FuEjrPmp_Ax "Achse" 0x96933CA BMWlpsc_p_EfpSpCtld_uw _REC_A1AXS_1_MBSE_U2 65.535 rgduxyd_mlihaBb_gsCghzb_bCRa0a0 8 0 65.535 FORMAT "%5.3" DEPOSIT ABSOLUTE /end AXIS_PTS
/begin AXIS_PTS BMWlpsc_volf_FuEjrPmp_Ay "Achse" 0x96BB650 BMWlpsc_st_TankCod_ub _REC_A1AXS_1_MBSE_U1 255 raChrxc_kBtBrmb_FmDuEFa_n__aa0o 4 0 255 FORMAT "%3.0" DEPOSIT ABSOLUTE /end AXIS_PTS
/begin AXIS_PTS BMWlpsd_p_RailDifMax_Ax "Achse" 0x9693456 Prail_ist _REC_A1AXS_1_MBSE_U2 39.9993896484375 cxdjuna_xpuCged_ocEpdua_MCRa2a0 4 0 39.9993896484375 FORMAT "%9.4" DEPOSIT ABSOLUTE /end AXIS_PTS
/begin AXIS_PTS BMWshl_n_SpdMaxAt_Ax "X-axis BMWshl_n_SpdMaxAt" 0x96C1FEC Gangi _REC_A1AXS_1_MBSE_U1 255 raChrxc_kBtBrmb_FmDuEFa_n__aa0o 8 0 255 FORMAT "%3.0" DEPOSIT ABSOLUTE /end AXIS_PTS
/begin AXIS_PTS BMWshl_n_SpdMaxMt_Ax "X-axis BMWshl_n_SpdMaxMt" 0x96C1FE4 Gangi _REC_A1AXS_1_MBSE_U1 255 raChrxc_kBtBrmb_FmDuEFa_n__aa0o 6 0 255 FORMAT "%3.0" DEPOSIT ABSOLUTE /end AXIS_PTS
/begin AXIS_PTS BMWtchctr_fac_pwr_CompLimPctl_Ax "AXX_KL_F_PTURBVST" 0x96B6456 BMWtchsp_mf_CmprNorm_uw _REC_A1AXS_1_MBSE_U2 2047.96875 CByjozc_eCmpBAb_pljBAmd_k__0oa0 6 0 2047.96875 FORMAT "%10.3" DEPOSIT ABSOLUTE /end AXIS_PTS
/begin AXIS_PTS BMWtchctr_rat_p_ComprLimPctl_Ax "AXX_KL_FPLDSVLD_MN_DIS" 0x96B643E BMWtchsp_mf_CmprNorm_uw _REC_A1AXS_1_MBSE_U2 2047.96875 CByjozc_eCmpBAb_pljBAmd_k__0oa0 12 0 2047.96875 FORMAT "%10.3" DEPOSIT ABSOLUTE /end AXIS_PTS
/begin AXIS_PTS BMWtchctr_t_ExGasMdl_Ax "AXX_KF_TABGATL" 0x96B63E2 Nkw _REC_A1AXS_1_MBSE_S2 65535 caoddzd_oAjpfzb_cAcEEha_1nR_oa0 6 -32768 32767 FORMAT "%5.0" DEPOSIT ABSOLUTE /end AXIS_PTS
/begin AXIS_PTS BMWtchctr_t_ExGasMdl_Ay "AXY_KF_TABGATL" 0x96B637A Rf _REC_A1AXS_1_MBSE_S2 655.35 CgkBooc_wkiDfEd_Czglhgc_fR_1a0o 6 -327.68 327.67 FORMAT "%7.2" DEPOSIT ABSOLUTE /end AXIS_PTS
/begin AXIS_PTS BMWtchctr_t_ExGasMdlScav_Ax "AXX_KF_TABGATL" 0x96B63EE Nkw _REC_A1AXS_1_MBSE_S2 65535 caoddzd_oAjpfzb_cAcEEha_1nR_oa0 6 -32768 32767 FORMAT "%5.0" DEPOSIT ABSOLUTE /end AXIS_PTS
/begin AXIS_PTS BMWtchctr_t_ExGasMdlScav_Ay "AXY_KF_TABGATL" 0x96B6386 Rf _REC_A1AXS_1_MBSE_S2 655.35 CgkBooc_wkiDfEd_Czglhgc_fR_1a0o 6 -327.68 327.67 FORMAT "%7.2" DEPOSIT ABSOLUTE /end AXIS_PTS
/begin AXIS_PTS BMWtchob_fac_tq_Delt_Ax "AXX_KL_FDMDMX_OB" 0x969CC38 Tans _REC_A1AXS_1_MBSE_S2 6553.5 bdktxuc_qvvFmxd_seefaCc_q__aa0o 4 -3276.8 3276.7 FORMAT "%6.1" DEPOSIT ABSOLUTE /end AXIS_PTS
/begin AXIS_PTS BMWtchsp_fac_FilPRatCmpr_Ax "AXX_KL_FK_PLDSVLD" 0x969CF6E BMWtchsp_mf_CmprNorm_uw _REC_A1AXS_1_MBSE_U2 2047.96875 CByjozc_eCmpBAb_pljBAmd_k__0oa0 4 0 2047.96875 FORMAT "%10.3" DEPOSIT ABSOLUTE /end AXIS_PTS
/begin AXIS_PTS BMWtchsp_fac_mf_FilCmprNorm_Ax "AXX_KL_FK_MSSOLATL" 0x969CFAC NO_INPUT_QUANTITY _REC_A1AXS_1_MBSE_U2 2047.96875 CByjozc_eCmpBAb_pljBAmd_k__0oa0 4 0 2047.96875 FORMAT "%10.3" DEPOSIT ABSOLUTE /end AXIS_PTS
/begin AXIS_PTS BMWtchsp_rat_p_CmprMax_Ax "AXX_KF_FPLDMAX" 0x969CF4E BMWtchsp_mf_CmprNorm_uw _REC_A1AXS_1_MBSE_U2 2047.96875 CByjozc_eCmpBAb_pljBAmd_k__0oa0 8 0 2047.96875 FORMAT "%10.3" DEPOSIT ABSOLUTE /end AXIS_PTS
/begin AXIS_PTS BMWtchsp_rat_p_CmprMax_Ay "AXY_KF_FPLDMAX" 0x969CF32 BMWtchtbc_t_BefCmpr_sw _REC_A1AXS_1_MBSE_S2 6553.5 bdktxuc_qvvFmxd_seefaCc_q__aa0o 6 -3276.8 3276.7 FORMAT "%6.1" DEPOSIT ABSOLUTE /end AXIS_PTS
/begin AXIS_PTS BMWtchsp_rat_p_CmprPmp_Ax "AXX_KL_FPLDPUMP" 0x969CF3E BMWtchsp_mf_CmprNorm_uw _REC_A1AXS_1_MBSE_U2 2047.96875 CByjozc_eCmpBAb_pljBAmd_k__0oa0 8 0 2047.96875 FORMAT "%10.3" DEPOSIT ABSOLUTE /end AXIS_PTS
/begin AXIS_PTS BMWtqe_b_SptDet4NoiseAcvn_Ax "Torque engine, sport detection noise activation X-axis" 0x96BE1B4 Status_usecase_antr _REC_A1AXS_1_MBSE_U1 11 raChrxc_kBtBrmb_FmDuEFa_n__aa0o 12 0 11 FORMAT "%6.0" DEPOSIT ABSOLUTE /end AXIS_PTS
/begin AXIS_PTS BMWtqe_b_SptDet4NoiseAcvn_Ay "Torque engine, sport detection noise activation Y-axis" 0x96BE1B0 St_dsc_can _REC_A1AXS_1_MBSE_U1 11 raChrxc_kBtBrmb_FmDuEFa_n__aa0o 4 0 11 FORMAT "%3.0" DEPOSIT ABSOLUTE /end AXIS_PTS
/begin AXIS_PTS GXX_KF_LABAS "Group X-axis for KF_LABASxxx and KF_LA_SK" 0x96B8FCC Nkw _REC_A1AXS_1_MBSE_S2 65535 caoddzd_oAjpfzb_cAcEEha_1nR_oa0 18 -32768 32767 FORMAT "%5.0" DEPOSIT ABSOLUTE /end AXIS_PTS
/begin AXIS_PTS GXX_KF_PHA_H_B1_BAS "GXX_KF_PHA_H_B1_BAS" 0x968F5C4 Nkw _REC_A1AXS_1_MBSE_S2 65535 caoddzd_oAjpfzb_cAcEEha_1nR_oa0 10 -32768 32767 FORMAT "%5.0" DEPOSIT ABSOLUTE /end AXIS_PTS
/begin AXIS_PTS GXY_KF_LABAS "Group Y-axis for KF_LABASxxx and KF_LA_SK" 0x96B8FAA Rf _REC_A1AXS_1_MBSE_S2 655.35 CgkBooc_wkiDfEd_Czglhgc_fR_1a0o 17 -327.68 327.67 FORMAT "%7.2" DEPOSIT ABSOLUTE /end AXIS_PTS
/begin AXIS_PTS GXY_KF_PHA_H_B1_BAS "GXY_KF_PHA_H_B1_BAS input Rk_soll_h_xlb" 0x968F58C NO_INPUT_QUANTITY _REC_A1AXS_1_MBSE_S2 3199.951171875 zyyxBpb_rEsnvtc_gktukCa_fR_5a0o 12 -1600 1599.951171875 FORMAT "%8.3" DEPOSIT ABSOLUTE /end AXIS_PTS
/begin AXIS_PTS SNM08HDUW "Breakpoint distribution for engine speed" 0x96F15C6 NO_INPUT_QUANTITY Axis_Xu16 16383.75 nmot_sw_q0p25 8 0 16383.75 FORMAT "%8.2" DEPOSIT ABSOLUTE /end AXIS_PTS
/begin AXIS_PTS SPD06HDSW "Breakpoint distribution for rail pressure control deviation" 0x96E9E06 FuPHi_pHpRglnDeLoc Axis_Xs16 131.07 RBPtCel_p_0p002_1 6 -65.536 65.534 FORMAT "%8.5" DEPOSIT ABSOLUTE /end AXIS_PTS
/begin CHARACTERISTIC AKR_dmHFMThdMin_C "Minimum threshold for HFM value to close exhaust flap" VALUE 0x96DFBAA GkfWU16 6553.5 asfzqDd_xfCuqha_hliBAmd_k__0oa0 0 6553.5 FORMAT "%8.3" /end CHARACTERISTIC
/begin CHARACTERISTIC AKR_stSpt_C "Sport mode status" VALUE 0x96DFDD8 FklWUb 255 DEZ 0 255 FORMAT "%5.1" /end CHARACTERISTIC
/begin CHARACTERISTIC BMWchas_tq_ResExhFlpClsdHys_C "Hysterese für das schließen der Abgasklappe " VALUE 0x96AD6B6 CurG_Ws16 6553.5 Mo_trq_nm_q0p1 -3276.8 3276.7 FORMAT "%6.1" /end CHARACTERISTIC
/begin CHARACTERISTIC BMWchas_v_IdlGearAcvMin_C "Threshold vehicle velocity for setting gear engaged for manual transmission vehicles" VALUE 0x96AD6B2 CurG_Ws16 1310.7 jgbhAma_smpAegb_hlEBAmd_k__0oa0 -655.36 655.34 FORMAT "%6.2" /end CHARACTERISTIC
/begin CHARACTERISTIC BMWgpfdiag_m_ThdAshSnsr_C "Threshold for setting PWarnAsche regarding learned ash mass" VALUE 0x9693676 CurG_Ws16 65.535 tFsjAyd_phhEqra_gswpFBc_gR_1oa0 -32.768 32.767 /end CHARACTERISTIC
/begin CHARACTERISTIC BMWgpfheat_tq_ResExhFlpClsdHys_C "Hysterese für das schließen der Abgasklappe " VALUE 0x969370C CurG_Ws16 6553.5 Mo_trq_nm_q0p1 -3276.8 3276.7 FORMAT "%6.1" /end CHARACTERISTIC
/begin CHARACTERISTIC BMWgpfp_swi_PclFil_C "Manual switch to activate GPF functionality in Gpf_Cluster. NOTE: The switch is only evaluated in the INI function. Changes to the switch must be flashed and the ECU must enter sleep mode." VALUE 0x96BB76D FklWUb 1 fgjpsvb_fDqjECa_acgrbDd_n_dae__ 0 1 /end CHARACTERISTIC
/begin CHARACTERISTIC BMWlpa_n_EfpModMax_C "Electric fuel pump speed setpoint max mode" VALUE 0x9692DB4 GkfWU16 65535 caoddzd_oAjpfzb_cAcEEha_1nR_oa0 0 65535 FORMAT "%5.0" /end CHARACTERISTIC
/begin CHARACTERISTIC BMWlpa_volf_FuFpcOvrT_C "LoPAsst filling limitation due to electric fuel pump over-temperature maximum volume flow" VALUE 0x96B0598 CurG_Ws16 655.35 zBcBzad_vmoivka_mFzjCgc_lCRooa0 -327.68 327.67 /end CHARACTERISTIC
/begin CHARACTERISTIC BMWshl_n_ThdSpdDispSegAlOn_C "RPM threshold at which shift lights always flash" VALUE 0x9687A32 CurG_Ws16 10000 caoddzd_oAjpfzb_cAcEEha_1nR_oa0 0 10000 /end CHARACTERISTIC
/begin CHARACTERISTIC BMWtchbas_cw_Noise_C "Configuration for wastegate opening for acoustic reasons" VALUE 0x96BC502 FklWUb 255 raChrxc_kBtBrmb_FmDuEFa_n__aa0o 0 255 FORMAT "%5.0" /end CHARACTERISTIC
/begin CHARACTERISTIC BMWtchdiag_n_EngMin_C "Lower RPM threshold for leakage detection" VALUE 0x969C9FC CurG_Ws16 65535 caoddzd_oAjpfzb_cAcEEha_1nR_oa0 -32768 32767 FORMAT "%5.0" /end CHARACTERISTIC
/begin CHARACTERISTIC BMWtchob_p_DifEnd_C "Control deviation for overboost end" VALUE 0x969CB66 CurG_Ws16 8191.875 dufmqFa_ggtdFtc_rzCuowa_hCRoa0o -4096 4095.875 FORMAT "%10.3" /end CHARACTERISTIC
/begin CHARACTERISTIC BMWtchob_p_DifGraTrigMin_C "Control deviation gradient for triggering overboost" VALUE 0x969CC56 CurG_Ws16 8191.875 dufmqFa_ggtdFtc_rzCuowa_hCRoa0o -4096 4095.875 FORMAT "%10.3" /end CHARACTERISTIC
/begin CHARACTERISTIC BMWtchsp_p_OfsMax_C "Offset on Pld_soll_max. This is subtracted from Pld_soll_max. If actual pressure Pvdkds rises above this threshold, Rf_max_pldmax calculation is activated (load is high enough for Fups and Pirg to be used for Rfmax calculation)" VALUE 0x969CE54 GkfWU16 8191.875 dufmqFa_ggtdFtc_rzCuowa_hCRoa0o 0 8191.875 FORMAT "%10.3" /end CHARACTERISTIC
/begin CHARACTERISTIC BMWtchsp_p_ReqMax_C "Maximum target boost pressure due to boost pressure sensor diagnostics" VALUE 0x969CE50 GkfWU16 8191.875 dufmqFa_ggtdFtc_rzCuowa_hCRoa0o 0 8191.875 FORMAT "%10.3" /end CHARACTERISTIC
/begin CHARACTERISTIC BMWtqe_n_LamStrdMax_C "Max permitted lambda in stratified operation" VALUE 0x96A5050 CurG_Ws16 65535 raChrxc_kBtBrmb_FmDuEFa_n__aa0o -32768 32767 FORMAT "%6.0" /end CHARACTERISTIC
/begin CHARACTERISTIC CW_ATMOD "" VALUE 0x96BB460 FklWUb 1 B_TRUE 0 1 FORMAT "%13.11" /end CHARACTERISTIC
/begin CHARACTERISTIC CW_SOUND "CW_SOUND" VALUE 0x96BE167 FklWUb 255 raChrxc_kBtBrmb_FmDuEFa_n__aa0o 0 255 FORMAT "%7.0" /end CHARACTERISTIC
/begin CHARACTERISTIC CWAKR "Codeword for exhaust flap control" VALUE 0x96DFE19 FklWUb 255 DEZ 0 255 FORMAT "%5.1" /end CHARACTERISTIC
/begin CHARACTERISTIC CWSTEGSPROGAKR "Codeword for exhaust flap control via stegsprog" VALUE 0x96DFE1D FklWUb 255 DEZ 0 255 FORMAT "%5.1" /end CHARACTERISTIC
/begin CHARACTERISTIC CWVMAXCOD "Codeword VMAX coding active" VALUE 0x96F1449 FklWUb 255 DEZ 0 255 FORMAT "%5.1" /end CHARACTERISTIC
/begin CHARACTERISTIC Exh_swtSensCfgPPFlt_C "Switch for configuration/adjustment of the pressure sensor" VALUE 0x96F69EE FklWUb 255 DFC_OneToOne 0 255 FORMAT "%5.1" /end CHARACTERISTIC
/begin CHARACTERISTIC K_BS_MN "Lambda minimum value for component protection" VALUE 0x96915FA GkfWU16 15.999755859375 BumqDkc_mryszAa_EcglxAc_nR_4oa0 0 15.999755859375 /end CHARACTERISTIC
/begin CHARACTERISTIC K_EDA_MD_ANZ_BS_SCAL_CODE0 "Base scaling per range in the display" VALUE 0x96BAD11 FklWUb 255 raChrxc_kBtBrmb_FmDuEFa_n__aa0o 0 255 /end CHARACTERISTIC
/begin CHARACTERISTIC K_EDA_MD_ANZ_BS_SCAL_CODE1 "Base scaling per range in the display" VALUE 0x96BAD10 FklWUb 255 raChrxc_kBtBrmb_FmDuEFa_n__aa0o 0 255 /end CHARACTERISTIC
/begin CHARACTERISTIC K_EDA_MD_ANZ_BS_SCAL_CODE2 "Base scaling per range in the display" VALUE 0x96BAD0F FklWUb 255 raChrxc_kBtBrmb_FmDuEFa_n__aa0o 0 255 /end CHARACTERISTIC
/begin CHARACTERISTIC K_EDA_MD_ANZ_BS_SCAL_CODE3 "Base scaling per range in the display" VALUE 0x96BAD0E FklWUb 255 raChrxc_kBtBrmb_FmDuEFa_n__aa0o 0 255 /end CHARACTERISTIC
/begin CHARACTERISTIC K_EDA_MD_ANZ_BS_SCAL_CODE4 "Base scaling per range in the display" VALUE 0x96BAD0D FklWUb 255 raChrxc_kBtBrmb_FmDuEFa_n__aa0o 0 255 /end CHARACTERISTIC
/begin CHARACTERISTIC K_EDA_P_ANZ_SPORT_BS_SCAL_CODE0 "Base scaling per range in the display" VALUE 0x96BAD0C FklWUb 255 raChrxc_kBtBrmb_FmDuEFa_n__aa0o 0 255 /end CHARACTERISTIC
/begin CHARACTERISTIC K_EDA_P_ANZ_SPORT_BS_SCAL_CODE1 "Base scaling per range in the display" VALUE 0x96BAD0B FklWUb 255 raChrxc_kBtBrmb_FmDuEFa_n__aa0o 0 255 /end CHARACTERISTIC
/begin CHARACTERISTIC K_EDA_P_ANZ_SPORT_BS_SCAL_CODE2 "Base scaling per range in the display" VALUE 0x96BAD0A FklWUb 255 raChrxc_kBtBrmb_FmDuEFa_n__aa0o 0 255 /end CHARACTERISTIC
/begin CHARACTERISTIC K_EDA_P_ANZ_SPORT_BS_SCAL_CODE3 "Base scaling per range in the display" VALUE 0x96BAD09 FklWUb 255 raChrxc_kBtBrmb_FmDuEFa_n__aa0o 0 255 /end CHARACTERISTIC
/begin CHARACTERISTIC K_F_SOT_RUECKBLICK_RS "Offset for overrun burble factor during downshift" VALUE 0x96BA968 FklWUb 0.99609375 BpaECzb_zweffod_enenhgc_nR_2a0o 0 0.99609375 FORMAT "%6.4" /end CHARACTERISTIC
/begin CHARACTERISTIC K_F_SOT_RUECKBLICK_STAND "Factor for overrun burble at standstill" VALUE 0x96BA967 FklWUb 0.99609375 BpaECzb_zweffod_enenhgc_nR_2a0o 0 0.99609375 FORMAT "%6.4" /end CHARACTERISTIC
/begin CHARACTERISTIC K_FRFMXBS_MN "Limitation factor for filling intervention at component protection rich running limit" VALUE 0x9691190 GkfWU16 1.99996948242188 Bhvfwhc_bigEubd_BBEupBd_nR_3oa0 0 1.99996948242188 FORMAT "%14.5" /end CHARACTERISTIC
/begin CHARACTERISTIC K_LA_FETTDELAY "Lambda threshold above which an enrichment request from KF_LABAS_XXX is suppressed" VALUE 0x96B8864 GkfWU16 15.999755859375 BumqDkc_mryszAa_EcglxAc_nR_4oa0 0 15.999755859375 FORMAT "%9.4" /end CHARACTERISTIC
/begin CHARACTERISTIC K_MAX_PSSOLBER "Maximum Ps_soll_offs (for calculation of Ps_soll_sm_nl)" VALUE 0x9696CF4 CurG_Ws16 8191.875 dufmqFa_ggtdFtc_rzCuowa_hCRoa0o -4096 4095.875 FORMAT "%8.3" /end CHARACTERISTIC
/begin CHARACTERISTIC K_MSVANST_DIFFPRAIL "Constant monitoring of high-pressure pump actuation minimum rail pressure undershoot" VALUE 0x96AF5CC GkfWU16 39.9993896484375 cxdjuna_xpuCged_ocEpdua_MCRa2a0 0 39.9993896484375 FORMAT "%6.2" /end CHARACTERISTIC
/begin CHARACTERISTIC K_N_GB1_IN_MAX_OSC "Max speed for GB1 (gearbox stage 1) protection" VALUE 0x9689B30 CurG_Ws16 65535 caoddzd_oAjpfzb_cAcEEha_1nR_oa0 -32768 32767 FORMAT "%5.0" /end CHARACTERISTIC
/begin CHARACTERISTIC K_NADONNMX "Upper engine speed limit for releasing N.N. adaptation, throttle or lift (B_mradon)" VALUE 0x968BDE8 CurG_Ws16 32767 caoddzd_oAjpfzb_cAcEEha_1nR_oa0 0 32767 FORMAT "%5.0" /end CHARACTERISTIC
/begin CHARACTERISTIC K_NKW_MAX "Max crankshaft speed" VALUE 0x969EBAC CurG_Ws16 32767 caoddzd_oAjpfzb_cAcEEha_1nR_oa0 0 32767 FORMAT "%5.0" /end CHARACTERISTIC
/begin CHARACTERISTIC K_NMX_VM_BA_GD "Maximum speed in throttled operating mode (GD)" VALUE 0x96A5D5C CurG_Ws16 65535 caoddzd_oAjpfzb_cAcEEha_1nR_oa0 -32768 32767 FORMAT "%5.0" /end CHARACTERISTIC
/begin CHARACTERISTIC K_NMX_VM_BA_VVT "Maximum speed in VVT operating mode" VALUE 0x96A5D5A CurG_Ws16 65535 caoddzd_oAjpfzb_cAcEEha_1nR_oa0 -32768 32767 FORMAT "%5.0" /end CHARACTERISTIC
/begin CHARACTERISTIC K_NMX_VM_FETRAWE "Maximum speed in FETRAWE mode" VALUE 0x96A5D58 CurG_Ws16 65535 caoddzd_oAjpfzb_cAcEEha_1nR_oa0 -32768 32767 FORMAT "%5.0" /end CHARACTERISTIC
/begin CHARACTERISTIC K_NMX_VM_OG_COMFORT "Upper RPM limit in COMFORT mode (Status_usecase_antr)" VALUE 0x96A5D54 CurG_Ws16 65535 caoddzd_oAjpfzb_cAcEEha_1nR_oa0 -32768 32767 FORMAT "%5.0" /end CHARACTERISTIC
/begin CHARACTERISTIC K_NMX_VM_OG_ECO "Upper RPM limit in ECO mode (Status_usecase_antr)" VALUE 0x96A5D52 CurG_Ws16 65535 caoddzd_oAjpfzb_cAcEEha_1nR_oa0 -32768 32767 FORMAT "%5.0" /end CHARACTERISTIC
/begin CHARACTERISTIC K_NMX_VM_OG_RENNSTART "Upper RPM limit in LAUNCH CONTROL mode (Status_usecase_antr)" VALUE 0x96A5D50 CurG_Ws16 65535 caoddzd_oAjpfzb_cAcEEha_1nR_oa0 -32768 32767 FORMAT "%5.0" /end CHARACTERISTIC
/begin CHARACTERISTIC K_NMX_VM_OG_SPORT "Upper RPM limit in SPORT mode (Status_usecase_antr)" VALUE 0x96A5D4E CurG_Ws16 65535 caoddzd_oAjpfzb_cAcEEha_1nR_oa0 -32768 32767 FORMAT "%5.0" /end CHARACTERISTIC
/begin CHARACTERISTIC K_NMX_VM_OG_SPORTPLUS "Upper RPM limit in SPORT PLUS mode (Status_usecase_antr)" VALUE 0x96A5D4C CurG_Ws16 65535 caoddzd_oAjpfzb_cAcEEha_1nR_oa0 -32768 32767 FORMAT "%5.0" /end CHARACTERISTIC
/begin CHARACTERISTIC K_PAK_MX "Maximum exhaust manifold pressure" VALUE 0x968A596 GkfWU16 8191.875 dufmqFa_ggtdFtc_rzCuowa_hCRoa0o 0 8191.875 FORMAT "%7.1" /end CHARACTERISTIC
/begin CHARACTERISTIC K_PAM_MODE_FUELLUNGSEG_NKW_HYS "Hysteresis for RPM thresholds for downshift of Pam_fuellungsseg_mode (2->1 or 1->0)" VALUE 0x968C9DE CurG_Ws16 65535 caoddzd_oAjpfzb_cAcEEha_1nR_oa0 -32768 32767 FORMAT "%5.0" /end CHARACTERISTIC
/begin CHARACTERISTIC K_PAM_MODE_FUELLUNGSEG_NKW1 "RPM threshold for switching Pam_fuellungseg_mode from 0 to 1" VALUE 0x968C9E2 CurG_Ws16 32767 caoddzd_oAjpfzb_cAcEEha_1nR_oa0 0 32767 FORMAT "%5.0" /end CHARACTERISTIC
/begin CHARACTERISTIC K_PAM_MODE_FUELLUNGSEG_NKW2 "RPM threshold for switching Pam_fuellungseg_mode from 1 to 2" VALUE 0x968C9E0 CurG_Ws16 32767 caoddzd_oAjpfzb_cAcEEha_1nR_oa0 0 32767 FORMAT "%5.0" /end CHARACTERISTIC
/begin CHARACTERISTIC K_PRAIL_ST_MAX "Maximum rail pressure setpoint for engine start" VALUE 0x96B519E GkfWU16 39.9993896484375 cxdjuna_xpuCged_ocEpdua_MCRa2a0 0 39.9993896484375 FORMAT "%9.4" /end CHARACTERISTIC
/begin CHARACTERISTIC K_QS_ANF_KLIMA_MX "Maximum considered heat flow request from IHKA" VALUE 0x96C3728 FklWUb 99.609375 qtfFcac_cfbwAaa_Cbeysaa_fR_60oa 0 99.609375 /end CHARACTERISTIC
/begin CHARACTERISTIC K_T_FETTDELAY_SPERR "Time during which a renewed enrichment suppression is blocked" VALUE 0x96C4E12 FklWUb 255 hcpywvc_dcqzDlc_FmDugua_s__aa0o 0 255 FORMAT "%5.2" /end CHARACTERISTIC
/begin CHARACTERISTIC K_T_NK_SOUND_MX "K_T_NK_SOUND_MX" VALUE 0x96A24E0 CurG_Ws16 6553.5 bdktxuc_qvvFmxd_seefaCc_q__aa0o -3276.8 3276.7 /end CHARACTERISTIC
/begin CHARACTERISTIC K_T_SOUND_MN "K_T_SOUND_MN" VALUE 0x96A24E6 CurG_Ws16 655.35 DchEpAd_DBCFgoa_Ckhahgc_q__aoa0 -327.68 327.67 /end CHARACTERISTIC
/begin CHARACTERISTIC K_T_VL_SOUND_MX "K_T_VL_SOUND_MX" VALUE 0x96A24DE CurG_Ws16 6553.5 bdktxuc_qvvFmxd_seefaCc_q__aa0o -3276.8 3276.7 /end CHARACTERISTIC
/begin CHARACTERISTIC K_TKW_MX "Coolant target temperature in MAX operating mode" VALUE 0x96AB1AC CurG_Ws16 655.35 DchEpAd_DBCFgoa_Ckhahgc_q__aoa0 -327.68 327.67 /end CHARACTERISTIC
/begin CHARACTERISTIC K_TKW_WA "Coolant target temperature in warm-up operating mode" VALUE 0x96AB1A0 CurG_Ws16 655.35 DchEpAd_DBCFgoa_Ckhahgc_q__aoa0 -327.68 327.67 /end CHARACTERISTIC
/begin CHARACTERISTIC K_V_SOT_MN "Min. vehicle speed for overrun burble" VALUE 0x9689B60 CurG_Ws16 1310.7 Asyaixa_wdvtenb_FCefaCb_n__aa0o -655.36 655.34 FORMAT "%7.1" /end CHARACTERISTIC
/begin CHARACTERISTIC K_V_SOUND_MN "K_V_SOUND_MN" VALUE 0x96A24DC GkfWU16 1310.7 jgbhAma_smpAegb_hlEBAmd_k__0oa0 0 1310.7 /end CHARACTERISTIC
/begin CHARACTERISTIC K_V_SOUND_MX "K_V_SOUND_MX" VALUE 0x96A24DA GkfWU16 1310.7 jgbhAma_smpAegb_hlEBAmd_k__0oa0 0 1310.7 /end CHARACTERISTIC
/begin CHARACTERISTIC MK2TE "Conversion factor mass to injection time" VALUE 0x96F4FE8 GkfWU16 0.68266 InjDDGdi_mkte_q0p10416Em4 0 0.68266 FORMAT "%7.5" /end CHARACTERISTIC
/begin CHARACTERISTIC NMAX "RPM limiter" VALUE 0x96ECC34 GkfWU16 16383.75 nmot_sw_q0p25 0 16383.75 FORMAT "%8.2" /end CHARACTERISTIC
/begin CHARACTERISTIC NMAXKR "RPM limit at safety retard of knock control" VALUE 0x96ECC3E GkfWU16 16383.75 nmot_sw_q0p25 0 16383.75 FORMAT "%8.2" /end CHARACTERISTIC
/begin CHARACTERISTIC NMAXSWT "RPM limit via SWT" VALUE 0x96ECC42 GkfWU16 16383.75 nmot_sw_q0p25 0 16383.75 FORMAT "%8.2" /end CHARACTERISTIC
/begin CHARACTERISTIC NMXHDR "RPM limit at high-pressure rail controller fault" VALUE 0x96EC5B6 CurG_Ws16 16383.5 n_sw_q0p5 0 16383.5 FORMAT "%8.2" /end CHARACTERISTIC
/begin CHARACTERISTIC NWARNORINI "Tachometer orange zone start RPM" VALUE 0x96E0172 GkfWU16 16383.75 nmot_sw_q0p25 0 16383.75 FORMAT "%8.2" /end CHARACTERISTIC
/begin CHARACTERISTIC PFlt_stActv_C "Activation of particle filter functionality" VALUE 0x96EDF14 FklWUb 255 DFC_OneToOne 0 255 FORMAT "%5.1" /end CHARACTERISTIC
/begin CHARACTERISTIC PFlt_stPfilTyp_C "Bit-coded type of the particle filter" VALUE 0x96EDF15 FklWUb 255 DFC_OneToOne 0 255 FORMAT "%5.1" /end CHARACTERISTIC
/begin CHARACTERISTIC PVDMX "Upper pressure threshold for range check" VALUE 0x96E336E GkfWU16 5119.922 p_uw_q0p078 0 5119.922 FORMAT "%8.3" /end CHARACTERISTIC
/begin CHARACTERISTIC S_AUSWAHL_FETTDELAY "Switch for changing the lambda setpoint during enrichment suppression. Either lambda=1 or max selection between La_main and K_LA_FETTDELAY is output." VALUE 0x96C4E11 FklWUb 1 raChrxc_kBtBrmb_FmDuEFa_n__aa0o 0 1 FORMAT "%3.0" /end CHARACTERISTIC
/begin CHARACTERISTIC S_PRAIL_GL_LA1 "Schalter zur Aktivierung des Sollraildrucks aus Grundkennfeld im Betriebsmodus CILCN " VALUE 0x96BC31D FklWUb 255 raChrxc_kBtBrmb_FmDuEFa_n__aa0o 0 255 FORMAT "%3.0" /end CHARACTERISTIC
/begin CHARACTERISTIC TMOTAKR "Temperature threshold for engine temperature dependent exhaust flap control" VALUE 0x96DFE24 FklWUb 191.3 temp_ub_q0p75_o48 -48 143.3 FORMAT "%5.1" /end CHARACTERISTIC
/begin CHARACTERISTIC TVSTAKR "Delay time for exhaust flap actuation after start" VALUE 0x96DFE26 GkfWU16 655.35 t10msxs_ub_b2p55 0 655.35 FORMAT "%8.4" /end CHARACTERISTIC
/begin CHARACTERISTIC VMAXOVC "Vmax limitation value, variant-coded" VALUE 0x96F14C4 GkfWU16 511.9922 vfzg_sw_q0p00781 0 511.9922 FORMAT "%8.4" /end CHARACTERISTIC
/begin CHARACTERISTIC VMINAKR "Minimum vehicle speed for pulse output" VALUE 0x96DFE28 FklWUb 318.8 vfzg_ub_q1p25 0 318.8 FORMAT "%5.1" /end CHARACTERISTIC
/begin CHARACTERISTIC BMWausy_p_DifCat_T "Exhaust system pressure loss across the catalyst depending on mass flow" CURVE 0x968A6DC _REC_A1CUR_2_MBSE_U2_S1 8191.875 dufmqFa_ggtdFtc_rzCuowa_hCRoa0o 0 8191.875 FORMAT "%8.3"
 /begin AXIS_DESCR COM_AXIS NO_INPUT_QUANTITY CByjozc_eCmpBAb_pljBAmd_k__0oa0 8 0 2047.96875 AXIS_PTS_REF BMWausy_p_DifCat_Ax FORMAT "%8.3" MONOTONY STRICT_INCREASE DEPOSIT ABSOLUTE /end AXIS_DESCR
/end CHARACTERISTIC
/begin CHARACTERISTIC BMWchas_tq_ResExhFlpClsd_T "Torque reserve above which the exhaust flap should be closed for acoustic reasons" CURVE 0x96ADCBE _REC_A1CUR_2_MBSE_S2_S1 6553.5 Mo_trq_nm_q0p1 -3276.8 3276.7 FORMAT "%6.1"
 /begin AXIS_DESCR COM_AXIS Nkw caoddzd_oAjpfzb_cAcEEha_1nR_oa0 8 -32768 32767 AXIS_PTS_REF BMWchas_tq_ResExhFlpClsd_Ax FORMAT "%5.0" MONOTONY STRICT_INCREASE DEPOSIT ABSOLUTE /end AXIS_DESCR
/end CHARACTERISTIC
/begin CHARACTERISTIC BMWext_lam_CptPronDfco_T "Lambda feedforward value after cylinder deactivation in component protection" CURVE 0x96B0448 _REC_A1CUR_2_MBSE_U2_S1 15.999755859375 BumqDkc_mryszAa_EcglxAc_nR_4oa0 0 15.999755859375 FORMAT "%9.4"
 /begin AXIS_DESCR COM_AXIS NO_INPUT_QUANTITY caoddzd_oAjpfzb_cAcEEha_1nR_oa0 6 -32768 32767 AXIS_PTS_REF BMWext_lam_CptPronDfco_Ax FORMAT "%5.0" MONOTONY STRICT_INCREASE DEPOSIT ABSOLUTE /end AXIS_DESCR
/end CHARACTERISTIC
/begin CHARACTERISTIC BMWgpfheat_tq_ResExhFlpClsd_T "Torque reserve above which the exhaust flap should be closed for acoustic reasons" CURVE 0x9693C70 _REC_A1CUR_2_MBSE_S2_S1 6553.5 Mo_trq_nm_q0p1 -3276.8 3276.7 FORMAT "%6.1"
 /begin AXIS_DESCR COM_AXIS Nkw caoddzd_oAjpfzb_cAcEEha_1nR_oa0 8 -32768 32767 AXIS_PTS_REF BMWgpfheat_tq_ResExhFlpClsd_Ax FORMAT "%5.0" MONOTONY STRICT_INCREASE DEPOSIT ABSOLUTE /end AXIS_DESCR
/end CHARACTERISTIC
/begin CHARACTERISTIC BMWlpa_n_EfpEngStrtPRail_T "Electric fuel pump speed setpoint for start rail pressure" CURVE 0x9692E7E _REC_A1CUR_2_MBSE_U2_S1 65535 caoddzd_oAjpfzb_cAcEEha_1nR_oa0 0 65535 FORMAT "%5.0"
 /begin AXIS_DESCR COM_AXIS Prail_ist cxdjuna_xpuCged_ocEpdua_MCRa2a0 2 0 39.9993896484375 AXIS_PTS_REF BMWlpa_n_EfpEngStrtPRail_Ax FORMAT "%9.4" MONOTONY STRICT_INCREASE DEPOSIT ABSOLUTE /end AXIS_DESCR
/end CHARACTERISTIC
/begin CHARACTERISTIC BMWlpsc_p_HppMax_T "Curve maximum pressure before high-pressure pump depending on flow rate" CURVE 0x96B0716 _REC_A1CUR_2_MBSE_U2_S1 65.535 rgduxyd_mlihaBb_gsCghzb_bCRa0a0 0 65.535 FORMAT "%5.3"
 /begin AXIS_DESCR COM_AXIS BMWlpi_volf_Fu_sw zBcBzad_vmoivka_mFzjCgc_lCRooa0 4 -327.68 327.67 AXIS_PTS_REF BMWlpsc_p_HppMax_Ax FORMAT "%5.2" MONOTONY STRICT_INCREASE DEPOSIT ABSOLUTE /end AXIS_DESCR
/end CHARACTERISTIC
/begin CHARACTERISTIC BMWlpsd_p_RailDifMax_T "Rail pressure deviation threshold" CURVE 0x969344E _REC_A1CUR_2_MBSE_U2_S1 39.9993896484375 cxdjuna_xpuCged_ocEpdua_MCRa2a0 0 39.9993896484375 FORMAT "%9.4"
 /begin AXIS_DESCR COM_AXIS Prail_ist cxdjuna_xpuCged_ocEpdua_MCRa2a0 4 0 39.9993896484375 AXIS_PTS_REF BMWlpsd_p_RailDifMax_Ax FORMAT "%9.4" MONOTONY STRICT_INCREASE DEPOSIT ABSOLUTE /end AXIS_DESCR
/end CHARACTERISTIC
/begin CHARACTERISTIC BMWshl_n_SpdMaxAt_T "Gear-dependent maximum RPM for automatic transmission shift light" CURVE 0x96ACC7A _REC_A1CUR_2_MBSE_S2_S1 65535 caoddzd_oAjpfzb_cAcEEha_1nR_oa0 -32768 32767
 /begin AXIS_DESCR COM_AXIS Gangi raChrxc_kBtBrmb_FmDuEFa_n__aa0o 8 0 255 AXIS_PTS_REF BMWshl_n_SpdMaxAt_Ax FORMAT "%3.0" MONOTONY STRICT_INCREASE DEPOSIT ABSOLUTE /end AXIS_DESCR
/end CHARACTERISTIC
/begin CHARACTERISTIC BMWshl_n_SpdMaxMt_T "Gear-dependent maximum RPM for manual transmission shift light" CURVE 0x96ACC6E _REC_A1CUR_2_MBSE_S2_S1 65535 caoddzd_oAjpfzb_cAcEEha_1nR_oa0 -32768 32767
 /begin AXIS_DESCR COM_AXIS Gangi raChrxc_kBtBrmb_FmDuEFa_n__aa0o 6 0 255 AXIS_PTS_REF BMWshl_n_SpdMaxMt_Ax FORMAT "%3.0" MONOTONY STRICT_INCREASE DEPOSIT ABSOLUTE /end AXIS_DESCR
/end CHARACTERISTIC
/begin CHARACTERISTIC BMWtchctr_fac_pwr_CompLimPctl_T "Feedforward factor up to which the controller can raise compressor power above feedforward using P and D components" CURVE 0x96B641A _REC_A1CUR_2_MBSE_U2_S1 1.99996948242188 Bhvfwhc_bigEubd_BBEupBd_nR_3oa0 0 1.99996948242188 FORMAT "%11.4"
 /begin AXIS_DESCR COM_AXIS BMWtchsp_mf_CmprNorm_uw CByjozc_eCmpBAb_pljBAmd_k__0oa0 6 0 2047.96875 AXIS_PTS_REF BMWtchctr_fac_pwr_CompLimPctl_Ax FORMAT "%10.3" MONOTONY STRICT_INCREASE DEPOSIT ABSOLUTE /end AXIS_DESCR
/end CHARACTERISTIC
/begin CHARACTERISTIC BMWtchctr_rat_p_ComprLimPctl_T "Minimum limit of target charge factor for aborting boost pressure control with decreasing target pressure" CURVE 0x96B6426 _REC_A1CUR_2_MBSE_U2_S1 7.9998779296875 acriqBc_tfkBqod_ocgjxzc_nR_8oa0 0 7.9998779296875 FORMAT "%10.3"
 /begin AXIS_DESCR COM_AXIS BMWtchsp_mf_CmprNorm_uw CByjozc_eCmpBAb_pljBAmd_k__0oa0 12 0 2047.96875 AXIS_PTS_REF BMWtchctr_rat_p_ComprLimPctl_Ax FORMAT "%10.3" MONOTONY STRICT_INCREASE DEPOSIT ABSOLUTE /end AXIS_DESCR
/end CHARACTERISTIC
/begin CHARACTERISTIC BMWtchob_fac_tq_Delt_T "Reduction factor for overboost torque via intake air temperature" CURVE 0x969CB90 _REC_A1CUR_2_MBSE_U2_S1 0.999984741210938 FzbmlAa_gCtylrb_ckCqxAc_nR_6oa0 0 0.999984741210938 FORMAT "%6.4"
 /begin AXIS_DESCR COM_AXIS Tans bdktxuc_qvvFmxd_seefaCc_q__aa0o 4 -3276.8 3276.7 AXIS_PTS_REF BMWtchob_fac_tq_Delt_Ax FORMAT "%6.1" MONOTONY STRICT_INCREASE DEPOSIT ABSOLUTE /end AXIS_DESCR
/end CHARACTERISTIC
/begin CHARACTERISTIC BMWtchsp_fac_FilPRatCmpr_T "Filter constant for target pressure ratio" CURVE 0x969CECA _REC_A1CUR_2_MBSE_U2_S1 0.999984741210938 FzbmlAa_gCtylrb_ckCqxAc_nR_6oa0 0 0.999984741210938 FORMAT "%14.5"
 /begin AXIS_DESCR COM_AXIS BMWtchsp_mf_CmprNorm_uw CByjozc_eCmpBAb_pljBAmd_k__0oa0 4 0 2047.96875 AXIS_PTS_REF BMWtchsp_fac_FilPRatCmpr_Ax FORMAT "%10.3" MONOTONY STRICT_INCREASE DEPOSIT ABSOLUTE /end AXIS_DESCR
/end CHARACTERISTIC
/begin CHARACTERISTIC BMWtchsp_fac_mf_FilCmprNorm_T "Filter constant for corrected target mass flow" CURVE 0x969CF84 _REC_A1CUR_2_MBSE_U2_S1 0.999984741210938 FzbmlAa_gCtylrb_ckCqxAc_nR_6oa0 0 0.999984741210938 FORMAT "%14.5"
 /begin AXIS_DESCR COM_AXIS NO_INPUT_QUANTITY CByjozc_eCmpBAb_pljBAmd_k__0oa0 4 0 2047.96875 AXIS_PTS_REF BMWtchsp_fac_mf_FilCmprNorm_Ax FORMAT "%10.3" MONOTONY STRICT_INCREASE DEPOSIT ABSOLUTE /end AXIS_DESCR
/end CHARACTERISTIC
/begin CHARACTERISTIC BMWtchsp_rat_p_CmprPmp_T "KL_FPLDPUMP" CURVE 0x969CE5A _REC_A1CUR_2_MBSE_U2_S1 3.99993896484375 ilxsavd_hkzmBfc_lAzCpAb_nR_1oa0 0 3.99993896484375
 /begin AXIS_DESCR COM_AXIS BMWtchsp_mf_CmprNorm_uw CByjozc_eCmpBAb_pljBAmd_k__0oa0 8 0 2047.96875 AXIS_PTS_REF BMWtchsp_rat_p_CmprPmp_Ax FORMAT "%10.3" MONOTONY STRICT_INCREASE DEPOSIT ABSOLUTE /end AXIS_DESCR
/end CHARACTERISTIC
/begin CHARACTERISTIC BMWtqe_b_Clu4NoiseDeac_T "Torque engine clutch noise deactivation curve" CURVE 0x96BE1A4 _REC_A1CUR_2_MBSE_U1_S1 1 fgjpsvb_fDqjECa_acgrbDd_n_dae__ 0 1
 /begin AXIS_DESCR COM_AXIS Status_usecase_antr raChrxc_kBtBrmb_FmDuEFa_n__aa0o 12 0 11 AXIS_PTS_REF BMWtqe_b_SptDet4NoiseAcvn_Ax FORMAT "%6.0" MONOTONY STRICT_INCREASE DEPOSIT ABSOLUTE /end AXIS_DESCR
/end CHARACTERISTIC
/begin CHARACTERISTIC EngPrt_nMax_CUR "Maximum permissible engine speed (steady-state)" CURVE 0x96ECC00 RB_Curve_S8_U16_Static 16383.75 nmot_sw_q0p25 0 16383.75 FORMAT "%8.2"
 /begin AXIS_DESCR STD_AXIS EngPrt_NMAXSgangsis_mp DEZ 11 -128 127 FORMAT "%5.1" DEPOSIT ABSOLUTE /end AXIS_DESCR
/end CHARACTERISTIC
/begin CHARACTERISTIC EngPrt_nMaxAt_CUR "Maximum permissible engine speed (steady-state) in AT vehicles" CURVE 0x96ECAAA RB_Curve_S8_U16_Static 16383.75 nmot_sw_q0p25 0 16383.75 FORMAT "%8.2"
 /begin AXIS_DESCR STD_AXIS EngPrt_NMAXSgangsis_mp DEZ 11 -128 127 FORMAT "%5.1" DEPOSIT ABSOLUTE /end AXIS_DESCR
/end CHARACTERISTIC
/begin CHARACTERISTIC EngPrt_nMaxAtNES_CUR "Maximum permissible engine speed (steady-state) in AT vehicles without forced upshift" CURVE 0x96ECA88 RB_Curve_S8_U16_Static 16383.75 nmot_sw_q0p25 0 16383.75 FORMAT "%8.2"
 /begin AXIS_DESCR STD_AXIS EngPrt_NMAXSgangsis_mp DEZ 11 -128 127 FORMAT "%5.1" DEPOSIT ABSOLUTE /end AXIS_DESCR
/end CHARACTERISTIC
/begin CHARACTERISTIC EngPrt_nMaxBoost_CUR "Maximum permissible engine speed (short-term overshoot)" CURVE 0x96ECB76 RB_Curve_S8_U16_Static 16383.75 nmot_sw_q0p25 0 16383.75 FORMAT "%8.2"
 /begin AXIS_DESCR STD_AXIS EngPrt_NMAXSgangsis_mp DEZ 11 -128 127 FORMAT "%5.1" DEPOSIT ABSOLUTE /end AXIS_DESCR
/end CHARACTERISTIC
/begin CHARACTERISTIC EngPrt_nMaxBoostAt_CUR "Maximum permissible engine speed (short-term overshoot) in AT vehicles" CURVE 0x96ECAEE RB_Curve_S8_U16_Static 16383.75 nmot_sw_q0p25 0 16383.75 FORMAT "%8.2"
 /begin AXIS_DESCR STD_AXIS EngPrt_NMAXSgangsis_mp DEZ 11 -128 127 FORMAT "%5.1" DEPOSIT ABSOLUTE /end AXIS_DESCR
/end CHARACTERISTIC
/begin CHARACTERISTIC EngPrt_nMaxBoostAtNES_CUR "Maximum permissible engine speed (short-term overshoot) in AT vehicles without forced upshift" CURVE 0x96ECACC RB_Curve_S8_U16_Static 16383.75 nmot_sw_q0p25 0 16383.75 FORMAT "%8.2"
 /begin AXIS_DESCR STD_AXIS EngPrt_NMAXSgangsis_mp DEZ 11 -128 127 FORMAT "%5.1" DEPOSIT ABSOLUTE /end AXIS_DESCR
/end CHARACTERISTIC
/begin CHARACTERISTIC EngPrt_nMaxBoostRed_CUR "Reduced max. permissible engine speed (short-term overshoot)" CURVE 0x96ECB54 RB_Curve_S8_U16_Static 16383.75 nmot_sw_q0p25 0 16383.75 FORMAT "%8.2"
 /begin AXIS_DESCR STD_AXIS EngPrt_NMAXSgangsis_mp DEZ 11 -128 127 FORMAT "%5.1" DEPOSIT ABSOLUTE /end AXIS_DESCR
/end CHARACTERISTIC
/begin CHARACTERISTIC EngPrt_nMaxBoostRedAt_CUR "Reduced max. permissible engine speed (short-term overshoot) in AT vehicles" CURVE 0x96ECB32 RB_Curve_S8_U16_Static 16383.75 nmot_sw_q0p25 0 16383.75 FORMAT "%8.2"
 /begin AXIS_DESCR STD_AXIS EngPrt_NMAXSgangsis_mp DEZ 11 -128 127 FORMAT "%5.1" DEPOSIT ABSOLUTE /end AXIS_DESCR
/end CHARACTERISTIC
/begin CHARACTERISTIC EngPrt_nMaxBoostRedAtNES_CUR "Reduced max. permissible engine speed (short-term overshoot) in AT vehicles without forced upshift" CURVE 0x96ECB10 RB_Curve_S8_U16_Static 16383.75 nmot_sw_q0p25 0 16383.75 FORMAT "%8.2"
 /begin AXIS_DESCR STD_AXIS EngPrt_NMAXSgangsis_mp DEZ 11 -128 127 FORMAT "%5.1" DEPOSIT ABSOLUTE /end AXIS_DESCR
/end CHARACTERISTIC
/begin CHARACTERISTIC EngPrt_nMaxRed_CUR "Reduced max. permissible engine speed (steady-state) AT" CURVE 0x96ECBDE RB_Curve_S8_U16_Static 16383.75 nmot_sw_q0p25 0 16383.75 FORMAT "%8.2"
 /begin AXIS_DESCR STD_AXIS EngPrt_NMAXSgangsis_mp DEZ 11 -128 127 FORMAT "%5.1" DEPOSIT ABSOLUTE /end AXIS_DESCR
/end CHARACTERISTIC
/begin CHARACTERISTIC EngPrt_nMaxRedAt_CUR "Reduced max. permissible engine speed (steady-state) in AT vehicles" CURVE 0x96ECBBC RB_Curve_S8_U16_Static 16383.75 nmot_sw_q0p25 0 16383.75 FORMAT "%8.2"
 /begin AXIS_DESCR STD_AXIS EngPrt_NMAXSgangsis_mp DEZ 11 -128 127 FORMAT "%5.1" DEPOSIT ABSOLUTE /end AXIS_DESCR
/end CHARACTERISTIC
/begin CHARACTERISTIC EngPrt_nMaxRedAtNES_CUR "Reduced max. permissible engine speed (steady-state) in AT vehicles without forced upshift" CURVE 0x96ECB9A RB_Curve_S8_U16_Static 16383.75 nmot_sw_q0p25 0 16383.75 FORMAT "%8.2"
 /begin AXIS_DESCR STD_AXIS EngPrt_NMAXSgangsis_mp DEZ 11 -128 127 FORMAT "%5.1" DEPOSIT ABSOLUTE /end AXIS_DESCR
/end CHARACTERISTIC
/begin CHARACTERISTIC FWIHDR "Weighting factor PI controller parameter high-pressure rail; I-component" CURVE 0x96E9DC2 Cur_Xu8Wu8 1.992188 fak_ub_b2 0 1.992188 FORMAT "%8.6"
 /begin AXIS_DESCR STD_AXIS Epm_nEngLRes nmot_q40 8 0 10200 FORMAT "%5.0" PHYS_UNIT "1/min" DEPOSIT ABSOLUTE /end AXIS_DESCR
/end CHARACTERISTIC
/begin CHARACTERISTIC FWPHDR "Weighting factor PI controller parameter high-pressure rail; P-component" CURVE 0x96E9DD3 Cur_Xu8Wu8 1.992188 fak_ub_b2 0 1.992188 FORMAT "%8.6"
 /begin AXIS_DESCR STD_AXIS Epm_nEngLRes nmot_q40 8 0 10200 FORMAT "%5.0" PHYS_UNIT "1/min" DEPOSIT ABSOLUTE /end AXIS_DESCR
/end CHARACTERISTIC
/begin CHARACTERISTIC KL_FLD_KKS "Request for switching the intake manifold flap depending on the filtered average throttle pressure" CURVE 0x96878BC _REC_S4CUR_52_KL_U1_1_U2 10 raChrxc_kBtBrmb_FmDuEFa_n__aa0o 0 10
 /begin AXIS_DESCR STD_AXIS F_pld_wm_f acriqBc_tfkBqod_ocgjxzc_nR_8oa0 6 0 7.9998779296875 MONOTONY STRICT_INCREASE DEPOSIT ABSOLUTE /end AXIS_DESCR
/end CHARACTERISTIC
/begin CHARACTERISTIC KL_LA_SBL "Curve lambda setpoint for overrun burble" CURVE 0x96B8866 _REC_A1CUR_2_MBSE_U2_S1 15.999755859375 BumqDkc_mryszAa_EcglxAc_nR_4oa0 0 15.999755859375 FORMAT "%9.4"
 /begin AXIS_DESCR COM_AXIS Nkw caoddzd_oAjpfzb_cAcEEha_1nR_oa0 6 -32768 32767 AXIS_PTS_REF AXX_KL_LA_SBL FORMAT "%5.0" MONOTONY STRICT_INCREASE DEPOSIT ABSOLUTE /end AXIS_DESCR
/end CHARACTERISTIC
/begin CHARACTERISTIC KL_NEL_I "Weighting factor for accumulated coolant difference" CURVE 0x968524A _REC_S4CUR_52_KL_U2_1_S2 199.996948242188 hrjAuFd_bEwmcob_wxyfvwa_f_Ra2ao 0 199.996948242188
 /begin AXIS_DESCR STD_AXIS Dtmot_tkwsoll DchEpAd_DBCFgoa_Ckhahgc_q__aoa0 4 -327.68 327.67 MONOTONY STRICT_INCREASE DEPOSIT ABSOLUTE /end AXIS_DESCR
/end CHARACTERISTIC
/begin CHARACTERISTIC KL_NEL_KLIMA_MX "Maximum electric fan speed request from air conditioning depending on ambient temperature" CURVE 0x9687772 _REC_S4CUR_52_KL_U1_1_S2 99.609375 qtfFcac_cfbwAaa_Cbeysaa_fR_60oa 0 99.609375
 /begin AXIS_DESCR STD_AXIS Tumg_wm bdktxuc_qvvFmxd_seefaCc_q__aa0o 4 -3276.8 3276.7 MONOTONY STRICT_INCREASE DEPOSIT ABSOLUTE /end AXIS_DESCR
/end CHARACTERISTIC
/begin CHARACTERISTIC KL_NEL_SPL "Electric fan speed request to support engine compartment purging" CURVE 0x968522E _REC_S4CUR_52_KL_U1_1_U2 99.609375 qtfFcac_cfbwAaa_Cbeysaa_fR_60oa 0 99.609375
 /begin AXIS_DESCR STD_AXIS V_wm knyFDjc_sDytACd_hlCBAmd_k__0oa0 4 0 6553.5 MONOTONY STRICT_INCREASE DEPOSIT ABSOLUTE /end AXIS_DESCR
/end CHARACTERISTIC
/begin CHARACTERISTIC KL_NEL_TABG_TUMG "Factor for adjusting electric fan speed based on exhaust gas temperature" CURVE 0x9685220 _REC_S4CUR_52_KL_U1_1_S2 0.99609375 BpaECzb_zweffod_enenhgc_nR_2a0o 0 0.99609375
 /begin AXIS_DESCR STD_AXIS Tumg_wm bdktxuc_qvvFmxd_seefaCc_q__aa0o 4 -3276.8 3276.7 MONOTONY STRICT_INCREASE DEPOSIT ABSOLUTE /end AXIS_DESCR
/end CHARACTERISTIC
/begin CHARACTERISTIC KL_NEL_TANS_KLOPF "Electric fan speed request due to intake air temperature from knock detection" CURVE 0x9685212 _REC_S4CUR_52_KL_U1_1_S2 99.609375 qtfFcac_cfbwAaa_Cbeysaa_fR_60oa 0 99.609375
 /begin AXIS_DESCR STD_AXIS Dtans_tumg_wm bdktxuc_qvvFmxd_seefaCc_q__aa0o 4 -3276.8 3276.7 MONOTONY STRICT_INCREASE DEPOSIT ABSOLUTE /end AXIS_DESCR
/end CHARACTERISTIC
/begin CHARACTERISTIC KL_NEL_TDME "Electric fan speed request due to DME temperature" CURVE 0x9685204 _REC_S4CUR_52_KL_U1_1_S2 99.609375 qtfFcac_cfbwAaa_Cbeysaa_fR_60oa 0 99.609375
 /begin AXIS_DESCR STD_AXIS Tdme_wm DchEpAd_DBCFgoa_Ckhahgc_q__aoa0 4 -327.68 327.67 MONOTONY STRICT_INCREASE DEPOSIT ABSOLUTE /end AXIS_DESCR
/end CHARACTERISTIC
/begin CHARACTERISTIC KL_NEL_TEGS "Electric fan speed request due to EGS temperature" CURVE 0x96851F6 _REC_S4CUR_52_KL_U1_1_S2 99.609375 qtfFcac_cfbwAaa_Cbeysaa_fR_60oa 0 99.609375
 /begin AXIS_DESCR STD_AXIS Tegs_wm BufnDdb_jpjgsgc_jmDugsa_qCRoa0o 4 -32768 32767 MONOTONY STRICT_INCREASE DEPOSIT ABSOLUTE /end AXIS_DESCR
/end CHARACTERISTIC
/begin CHARACTERISTIC KL_NEL_TKA "Electric fan speed request depending on coolant radiator outlet temperature" CURVE 0x96851CE _REC_S4CUR_52_KL_U1_1_S2 99.609375 qtfFcac_cfbwAaa_Cbeysaa_fR_60oa 0 99.609375
 /begin AXIS_DESCR STD_AXIS Tka_wm DchEpAd_DBCFgoa_Ckhahgc_q__aoa0 6 -327.68 327.67 MONOTONY STRICT_INCREASE DEPOSIT ABSOLUTE /end AXIS_DESCR
/end CHARACTERISTIC
/begin CHARACTERISTIC KL_NEL_TMOT "Electric fan speed request due to engine temperature" CURVE 0x96851A8 _REC_S4CUR_52_KL_U1_1_S2 99.609375 qtfFcac_cfbwAaa_Cbeysaa_fR_60oa 0 99.609375
 /begin AXIS_DESCR STD_AXIS Dtmot_tkwsoll_f DchEpAd_DBCFgoa_Ckhahgc_q__aoa0 12 -327.68 327.67 MONOTONY STRICT_INCREASE DEPOSIT ABSOLUTE /end AXIS_DESCR
/end CHARACTERISTIC
/begin CHARACTERISTIC KL_NEL_V_MX "Maximum electric fan speed request from integrated coolant difference depending on vehicle speed" CURVE 0x968519A _REC_S4CUR_52_KL_U1_1_U2 99.609375 qtfFcac_cfbwAaa_Cbeysaa_fR_60oa 0 99.609375
 /begin AXIS_DESCR STD_AXIS V_wm knyFDjc_sDytACd_hlCBAmd_k__0oa0 4 0 6553.5 MONOTONY STRICT_INCREASE DEPOSIT ABSOLUTE /end AXIS_DESCR
/end CHARACTERISTIC
/begin CHARACTERISTIC KL_NEWP_KLIMA_MX "Maximum permissible EWP speed request from air conditioning depending on ambient temperature" CURVE 0x9687764 _REC_S4CUR_52_KL_U1_1_S2 100 nnxvdDd_vDnjvqd_FmDuEEa_f__aa0o 0 100
 /begin AXIS_DESCR STD_AXIS Tumg_wm bdktxuc_qvvFmxd_seefaCc_q__aa0o 4 -3276.8 3276.7 MONOTONY STRICT_INCREASE DEPOSIT ABSOLUTE /end AXIS_DESCR
/end CHARACTERISTIC
/begin CHARACTERISTIC KL_NKW_SOUND_MN "Min. RPM threshold for activation of BMWtqe_b_NoisePre_bo depending on gear" CURVE 0x96A2502 _REC_A1CUR_2_MBSE_S2_S1 65535 caoddzd_oAjpfzb_cAcEEha_1nR_oa0 -32768 32767
 /begin AXIS_DESCR COM_AXIS Gangi raChrxc_kBtBrmb_FmDuEFa_n__aa0o 8 0 255 AXIS_PTS_REF AXX_KL_NKW_SOUND_MNMX FORMAT "%3.0" MONOTONY STRICT_INCREASE DEPOSIT ABSOLUTE /end AXIS_DESCR
/end CHARACTERISTIC
/begin CHARACTERISTIC KL_NKW_SOUND_MX "Max. RPM threshold for activation of BMWtqe_b_NoisePre_bo depending on gear" CURVE 0x96A24F2 _REC_A1CUR_2_MBSE_S2_S1 65535 caoddzd_oAjpfzb_cAcEEha_1nR_oa0 -32768 32767
 /begin AXIS_DESCR COM_AXIS Gangi raChrxc_kBtBrmb_FmDuEFa_n__aa0o 8 0 255 AXIS_PTS_REF AXX_KL_NKW_SOUND_MNMX FORMAT "%3.0" MONOTONY STRICT_INCREASE DEPOSIT ABSOLUTE /end AXIS_DESCR
/end CHARACTERISTIC
/begin CHARACTERISTIC KL_PSPVDK_SOLMAXGD "Maximum target pressure ratio across throttle; speed-dependent with intercooler behind throttle" CURVE 0x9696994 _REC_A1CUR_2_MBSE_U2_S1 3.99993896484375 ilxsavd_hkzmBfc_lAzCpAb_nR_1oa0 0 3.99993896484375 FORMAT "%7.4"
 /begin AXIS_DESCR COM_AXIS NO_INPUT_QUANTITY caoddzd_oAjpfzb_cAcEEha_1nR_oa0 6 0 32767 AXIS_PTS_REF AXX_KL_PSPVDK_SOLMAXGD FORMAT "%5.0" MONOTONY STRICT_INCREASE DEPOSIT ABSOLUTE /end AXIS_DESCR
/end CHARACTERISTIC
/begin CHARACTERISTIC KL_RFTNLMX "Maximum nonlinear Drf for calculation of Ps_soll_sm_nl" CURVE 0x9696E44 _REC_A1CUR_2_MBSE_S2_S1 327.67 CgkBooc_wkiDfEd_Czglhgc_fR_1a0o 0 327.67 FORMAT "%7.2"
 /begin AXIS_DESCR COM_AXIS NO_INPUT_QUANTITY caoddzd_oAjpfzb_cAcEEha_1nR_oa0 10 0 32767 AXIS_PTS_REF AXX_KL_RFTNLMX FORMAT "%5.0" MONOTONY MON_INCREASE DEPOSIT ABSOLUTE /end AXIS_DESCR
/end CHARACTERISTIC
/begin CHARACTERISTIC KL_T_IKAT_SOUND_MX "Temperaturschwelle Kat fürSchubblubberfreigabe " CURVE 0x96A24EA _REC_A1CUR_2_MBSE_S2_S1 6553.5 bdktxuc_qvvFmxd_seefaCc_q__aa0o -3276.8 3276.7
 /begin AXIS_DESCR COM_AXIS Anz_b_sound raChrxc_kBtBrmb_FmDuEFa_n__aa0o 4 0 255 AXIS_PTS_REF AXX_KL_T_IKAT_SOUND_MX FORMAT "%5.0" MONOTONY STRICT_INCREASE DEPOSIT ABSOLUTE /end AXIS_DESCR
/end CHARACTERISTIC
/begin CHARACTERISTIC KL_TD_SOUND_MX "KL_TD_SOUND_MX" CURVE 0x96A252A _REC_A1CUR_2_MBSE_U2_S1 655.35 camcxxd_bxlpdsa_Cshlhgc_sR_1a0o 0 655.35
 /begin AXIS_DESCR COM_AXIS V_fzg_plaus jgbhAma_smpAegb_hlEBAmd_k__0oa0 4 -655.36 655.34 AXIS_PTS_REF AXX_KL_TD_SOUND_MX FORMAT "%6.2" MONOTONY STRICT_INCREASE DEPOSIT ABSOLUTE /end AXIS_DESCR
/end CHARACTERISTIC
/begin CHARACTERISTIC KL_TD_SOUND_MX_FREI "Sound duration freely configurable" CURVE 0x96A2522 _REC_A1CUR_2_MBSE_U2_S1 655.35 camcxxd_bxlpdsa_Cshlhgc_sR_1a0o 0 655.35
 /begin AXIS_DESCR COM_AXIS V_fzg_plaus jgbhAma_smpAegb_hlEBAmd_k__0oa0 4 -655.36 655.34 AXIS_PTS_REF AXX_KL_TD_SOUND_MX_FREI FORMAT "%6.2" MONOTONY STRICT_INCREASE DEPOSIT ABSOLUTE /end AXIS_DESCR
/end CHARACTERISTIC
/begin CHARACTERISTIC KL_TD_SOUND_MX_SPORT "KL_TD_SOUND_MX_SPORT" CURVE 0x96A251A _REC_A1CUR_2_MBSE_U2_S1 655.35 camcxxd_bxlpdsa_Cshlhgc_sR_1a0o 0 655.35
 /begin AXIS_DESCR COM_AXIS V_fzg_plaus jgbhAma_smpAegb_hlEBAmd_k__0oa0 4 -655.36 655.34 AXIS_PTS_REF AXX_KL_TD_SOUND_MX_SPORT FORMAT "%6.2" MONOTONY STRICT_INCREASE DEPOSIT ABSOLUTE /end AXIS_DESCR
/end CHARACTERISTIC
/begin CHARACTERISTIC KL_TKW_HI "Coolant target temperature in high operating mode depending on ambient temperature" CURVE 0x9685A2E _REC_S4CUR_52_KL_S2_1_S2 655.35 DchEpAd_DBCFgoa_Ckhahgc_q__aoa0 -327.68 327.67
 /begin AXIS_DESCR STD_AXIS Tumg_wm bdktxuc_qvvFmxd_seefaCc_q__aa0o 4 -3276.8 3276.7 MONOTONY STRICT_INCREASE DEPOSIT ABSOLUTE /end AXIS_DESCR
/end CHARACTERISTIC
/begin CHARACTERISTIC KL_TKW_NO "Coolant target temperature in normal operating mode depending on ambient temperature" CURVE 0x9685A1C _REC_S4CUR_52_KL_S2_1_S2 655.35 DchEpAd_DBCFgoa_Ckhahgc_q__aoa0 -327.68 327.67
 /begin AXIS_DESCR STD_AXIS Tumg_wm bdktxuc_qvvFmxd_seefaCc_q__aa0o 4 -3276.8 3276.7 MONOTONY STRICT_INCREASE DEPOSIT ABSOLUTE /end AXIS_DESCR
/end CHARACTERISTIC
/begin CHARACTERISTIC KLFVSTOTF "Offset correction of MSV feedforward depending on fuel temperature" CURVE 0x96F15AF Cur_Xu8Wu8 1.992188 fak_ub_b2 0 1.992188 FORMAT "%8.6"
 /begin AXIS_DESCR STD_AXIS tfuelsq_msg temp_ub_q0p75_o48 3 -48 143.3 FORMAT "%5.1" DEPOSIT ABSOLUTE /end AXIS_DESCR
/end CHARACTERISTIC
/begin CHARACTERISTIC KLIHDR "I-component of the rail pressure controller" CURVE 0x96E9DE4 GkfWU16 7.999878 fak_sw_b4 0 7.999878 FORMAT "%8.6"
 /begin AXIS_DESCR COM_AXIS FuPHi_pHpRglnDeLoc RBPtCel_p_0p002_1 6 -65.536 65.534 AXIS_PTS_REF SPD06HDSW FORMAT "%8.5" DEPOSIT ABSOLUTE /end AXIS_DESCR
/end CHARACTERISTIC
/begin CHARACTERISTIC KLPHDR "P-component of the rail pressure controller" CURVE 0x96E9DF0 GkfWU16 7.999878 fak_sw_b4 0 7.999878 FORMAT "%8.6"
 /begin AXIS_DESCR COM_AXIS FuPHi_pHpRglnDeLoc RBPtCel_p_0p002_1 6 -65.536 65.534 AXIS_PTS_REF SPD06HDSW FORMAT "%8.5" DEPOSIT ABSOLUTE /end AXIS_DESCR
/end CHARACTERISTIC
/begin CHARACTERISTIC KLPHDRTF "Factor for P-component of high-pressure rail controller as function of temperature" CURVE 0x96E9DFC Cur_Xu8Wu8 1.992188 fak_ub_b2 0 1.992188 FORMAT "%8.6"
 /begin AXIS_DESCR STD_AXIS tfuelsq_msg temp_ub_q0p75_o48 4 -48 143.3 FORMAT "%5.1" DEPOSIT ABSOLUTE /end AXIS_DESCR
/end CHARACTERISTIC
/begin CHARACTERISTIC KLVSTMSVG "Gain factor for MSV feedforward" CURVE 0x96F15B6 GkfWU16 3.999939 fak_q6p1035Em5 0 3.999939 FORMAT "%8.6"
 /begin AXIS_DESCR COM_AXIS NO_INPUT_QUANTITY nmot_sw_q0p25 8 0 16383.75 AXIS_PTS_REF SNM08HDUW FORMAT "%8.2" DEPOSIT ABSOLUTE /end AXIS_DESCR
/end CHARACTERISTIC
/begin CHARACTERISTIC NMAXTMM "RPM limiter at high engine temperature" CURVE 0x96ECC44 KlAUbSstUbWUw_Static 16383.75 nmot_sw_q0p25 0 16383.75 FORMAT "%8.2"
 /begin AXIS_DESCR STD_AXIS EngPrt_t1_mp temp_ub_q0p75_o48 4 -48 143.3 FORMAT "%5.1" DEPOSIT ABSOLUTE /end AXIS_DESCR
/end CHARACTERISTIC
/begin CHARACTERISTIC NMAXTO "RPM limiter at high oil temperature" CURVE 0x96ECC52 Cur_Xu16Wu16 16383.75 nmot_sw_q0p25 0 16383.75 FORMAT "%8.2"
 /begin AXIS_DESCR STD_AXIS EngPrt_t2_mp temp_q0p0234_o273 4 -273.15 1262.827 FORMAT "%8.3" DEPOSIT ABSOLUTE /end AXIS_DESCR
/end CHARACTERISTIC
/begin CHARACTERISTIC VSEKPMXN "Curve target fuel volume flow at full load depending on engine speed" CURVE 0x96E1A65 Cur_Xu8Wu8 255 fuel_ub_q1 0 255 FORMAT "%5.1"
 /begin AXIS_DESCR STD_AXIS NO_INPUT_QUANTITY nmot_q40 5 0 10200 FORMAT "%5.0" PHYS_UNIT "1/min" DEPOSIT ABSOLUTE /end AXIS_DESCR
/end CHARACTERISTIC
/begin CHARACTERISTIC AKRGRCC "Map for exhaust flap control depending on current gear and engine speed, with closed convertible top" MAP 0x96DF29A KfAxU8AyU8SstxU8SstyU8WU8 99.61 rel_q0p39 0 99.61 FORMAT "%5.2"
 /begin AXIS_DESCR STD_AXIS gangakr DEZ 10 0 127 FORMAT "%5.1" DEPOSIT ABSOLUTE /end AXIS_DESCR
 /begin AXIS_DESCR STD_AXIS Epm_nEngLRes nmot_q40 12 0 10000 FORMAT "%5.0" PHYS_UNIT "1/min" DEPOSIT ABSOLUTE /end AXIS_DESCR
/end CHARACTERISTIC
/begin CHARACTERISTIC AKRGRCC_VAR1 "Map for exhaust flap control depending on current gear and engine speed, with closed convertible top and sport button active" MAP 0x96DF786 KfAxU8AyU8SstxU8SstyU8WU8 99.61 rel_q0p39 0 99.61 FORMAT "%5.2"
 /begin AXIS_DESCR STD_AXIS gangakr DEZ 6 0 127 FORMAT "%5.1" DEPOSIT ABSOLUTE /end AXIS_DESCR
 /begin AXIS_DESCR STD_AXIS Epm_nEngLRes nmot_q40 8 0 10000 FORMAT "%5.0" PHYS_UNIT "1/min" DEPOSIT ABSOLUTE /end AXIS_DESCR
/end CHARACTERISTIC
/begin CHARACTERISTIC AKRGRCC_VAR2 "Map for exhaust flap control depending on current gear and engine speed, with closed convertible top and sport button active" MAP 0x96DF7C6 KfAxU8AyU8SstxU8SstyU8WU8 99.61 rel_q0p39 0 99.61 FORMAT "%5.2"
 /begin AXIS_DESCR STD_AXIS gangakr DEZ 6 0 127 FORMAT "%5.1" DEPOSIT ABSOLUTE /end AXIS_DESCR
 /begin AXIS_DESCR STD_AXIS Epm_nEngLRes nmot_q40 8 0 10000 FORMAT "%5.0" PHYS_UNIT "1/min" DEPOSIT ABSOLUTE /end AXIS_DESCR
/end CHARACTERISTIC
/begin CHARACTERISTIC AKRGRCC_VAR3 "Map for exhaust flap control depending on current gear and engine speed, with closed convertible top and sport button active" MAP 0x96DF806 KfAxU8AyU8SstxU8SstyU8WU8 99.61 rel_q0p39 0 99.61 FORMAT "%5.2"
 /begin AXIS_DESCR STD_AXIS gangakr DEZ 6 0 127 FORMAT "%5.1" DEPOSIT ABSOLUTE /end AXIS_DESCR
 /begin AXIS_DESCR STD_AXIS Epm_nEngLRes nmot_q40 8 0 10000 FORMAT "%5.0" PHYS_UNIT "1/min" DEPOSIT ABSOLUTE /end AXIS_DESCR
/end CHARACTERISTIC
/begin CHARACTERISTIC AKRGRCCAT "Map for exhaust flap control depending on current gear and engine speed (DCT or AT gearbox), with closed convertible top" MAP 0x96DF32A KfAxU8AyU8SstxU8SstyU8WU8 99.61 rel_q0p39 0 99.61 FORMAT "%5.2"
 /begin AXIS_DESCR STD_AXIS gangakr DEZ 10 0 127 FORMAT "%5.1" DEPOSIT ABSOLUTE /end AXIS_DESCR
 /begin AXIS_DESCR STD_AXIS Epm_nEngLRes nmot_q40 12 0 10000 FORMAT "%5.0" PHYS_UNIT "1/min" DEPOSIT ABSOLUTE /end AXIS_DESCR
/end CHARACTERISTIC
/begin CHARACTERISTIC AKRGRCCAT_VAR1 "Map for exhaust flap control depending on current gear and engine speed (DCT or AT gearbox), with closed convertible top" MAP 0x96DF540 KfAxU8AyU8SstxU8SstyU8WU8 99.61 rel_q0p39 0 99.61 FORMAT "%5.2"
 /begin AXIS_DESCR STD_AXIS gangakr DEZ 8 0 127 FORMAT "%5.1" DEPOSIT ABSOLUTE /end AXIS_DESCR
 /begin AXIS_DESCR STD_AXIS Epm_nEngLRes nmot_q40 8 0 10000 FORMAT "%5.0" PHYS_UNIT "1/min" DEPOSIT ABSOLUTE /end AXIS_DESCR
/end CHARACTERISTIC
/begin CHARACTERISTIC AKRGRCCAT_VAR2 "Map for exhaust flap control depending on current gear and engine speed (DCT or AT gearbox), with closed convertible top" MAP 0x96DF592 KfAxU8AyU8SstxU8SstyU8WU8 99.61 rel_q0p39 0 99.61 FORMAT "%5.2"
 /begin AXIS_DESCR STD_AXIS gangakr DEZ 8 0 127 FORMAT "%5.1" DEPOSIT ABSOLUTE /end AXIS_DESCR
 /begin AXIS_DESCR STD_AXIS Epm_nEngLRes nmot_q40 8 0 10000 FORMAT "%5.0" PHYS_UNIT "1/min" DEPOSIT ABSOLUTE /end AXIS_DESCR
/end CHARACTERISTIC
/begin CHARACTERISTIC AKRGRCCAT_VAR3 "Map for exhaust flap control depending on current gear and engine speed (DCT or AT gearbox), with closed convertible top" MAP 0x96DF5E4 KfAxU8AyU8SstxU8SstyU8WU8 99.61 rel_q0p39 0 99.61 FORMAT "%5.2"
 /begin AXIS_DESCR STD_AXIS gangakr DEZ 8 0 127 FORMAT "%5.1" DEPOSIT ABSOLUTE /end AXIS_DESCR
 /begin AXIS_DESCR STD_AXIS Epm_nEngLRes nmot_q40 8 0 10000 FORMAT "%5.0" PHYS_UNIT "1/min" DEPOSIT ABSOLUTE /end AXIS_DESCR
/end CHARACTERISTIC
/begin CHARACTERISTIC AKRGRCCATM "Map for exhaust flap control depending on current gear and engine speed (DCT or AT gearbox), with closed convertible top and sport button active" MAP 0x96DF3BA KfAxU8AyU8SstxU8SstyU8WU8 99.61 rel_q0p39 0 99.61 FORMAT "%5.2"
 /begin AXIS_DESCR STD_AXIS gangakr DEZ 10 0 127 FORMAT "%5.1" DEPOSIT ABSOLUTE /end AXIS_DESCR
 /begin AXIS_DESCR STD_AXIS Epm_nEngLRes nmot_q40 12 0 10000 FORMAT "%5.0" PHYS_UNIT "1/min" DEPOSIT ABSOLUTE /end AXIS_DESCR
/end CHARACTERISTIC
/begin CHARACTERISTIC AKRGRCCATM_VAR1 "Map for exhaust flap control depending on current gear and engine speed (DCT or AT gearbox), with closed convertible top and sport button active" MAP 0x96DF44A KfAxU8AyU8SstxU8SstyU8WU8 99.61 rel_q0p39 0 99.61 FORMAT "%5.2"
 /begin AXIS_DESCR STD_AXIS gangakr DEZ 8 0 127 FORMAT "%5.1" DEPOSIT ABSOLUTE /end AXIS_DESCR
 /begin AXIS_DESCR STD_AXIS Epm_nEngLRes nmot_q40 8 0 10000 FORMAT "%5.0" PHYS_UNIT "1/min" DEPOSIT ABSOLUTE /end AXIS_DESCR
/end CHARACTERISTIC
/begin CHARACTERISTIC AKRGRCCATM_VAR2 "Map for exhaust flap control depending on current gear and engine speed (DCT or AT gearbox), with closed convertible top and sport button active" MAP 0x96DF49C KfAxU8AyU8SstxU8SstyU8WU8 99.61 rel_q0p39 0 99.61 FORMAT "%5.2"
 /begin AXIS_DESCR STD_AXIS gangakr DEZ 8 0 127 FORMAT "%5.1" DEPOSIT ABSOLUTE /end AXIS_DESCR
 /begin AXIS_DESCR STD_AXIS Epm_nEngLRes nmot_q40 8 0 10000 FORMAT "%5.0" PHYS_UNIT "1/min" DEPOSIT ABSOLUTE /end AXIS_DESCR
/end CHARACTERISTIC
/begin CHARACTERISTIC AKRGRCCATM_VAR3 "Map for exhaust flap control depending on current gear and engine speed (DCT or AT gearbox), with closed convertible top and sport button active" MAP 0x96DF4EE KfAxU8AyU8SstxU8SstyU8WU8 99.61 rel_q0p39 0 99.61 FORMAT "%5.2"
 /begin AXIS_DESCR STD_AXIS gangakr DEZ 8 0 127 FORMAT "%5.1" DEPOSIT ABSOLUTE /end AXIS_DESCR
 /begin AXIS_DESCR STD_AXIS Epm_nEngLRes nmot_q40 8 0 10000 FORMAT "%5.0" PHYS_UNIT "1/min" DEPOSIT ABSOLUTE /end AXIS_DESCR
/end CHARACTERISTIC
/begin CHARACTERISTIC AKRGRCCM "Map for exhaust flap control depending on current gear and engine speed, with closed convertible top and sport button active" MAP 0x96DF636 KfAxU8AyU8SstxU8SstyU8WU8 99.61 rel_q0p39 0 99.61 FORMAT "%5.2"
 /begin AXIS_DESCR STD_AXIS gangakr DEZ 10 0 127 FORMAT "%5.1" DEPOSIT ABSOLUTE /end AXIS_DESCR
 /begin AXIS_DESCR STD_AXIS Epm_nEngLRes nmot_q40 12 0 10000 FORMAT "%5.0" PHYS_UNIT "1/min" DEPOSIT ABSOLUTE /end AXIS_DESCR
/end CHARACTERISTIC
/begin CHARACTERISTIC AKRGRCCM_VAR1 "Map for exhaust flap control depending on current gear and engine speed, with closed convertible top and sport button active" MAP 0x96DF6C6 KfAxU8AyU8SstxU8SstyU8WU8 99.61 rel_q0p39 0 99.61 FORMAT "%5.2"
 /begin AXIS_DESCR STD_AXIS gangakr DEZ 6 0 127 FORMAT "%5.1" DEPOSIT ABSOLUTE /end AXIS_DESCR
 /begin AXIS_DESCR STD_AXIS Epm_nEngLRes nmot_q40 8 0 10000 FORMAT "%5.0" PHYS_UNIT "1/min" DEPOSIT ABSOLUTE /end AXIS_DESCR
/end CHARACTERISTIC
/begin CHARACTERISTIC AKRGRCCM_VAR2 "Map for exhaust flap control depending on current gear and engine speed, with closed convertible top and sport button active" MAP 0x96DF706 KfAxU8AyU8SstxU8SstyU8WU8 99.61 rel_q0p39 0 99.61 FORMAT "%5.2"
 /begin AXIS_DESCR STD_AXIS gangakr DEZ 6 0 127 FORMAT "%5.1" DEPOSIT ABSOLUTE /end AXIS_DESCR
 /begin AXIS_DESCR STD_AXIS Epm_nEngLRes nmot_q40 8 0 10000 FORMAT "%5.0" PHYS_UNIT "1/min" DEPOSIT ABSOLUTE /end AXIS_DESCR
/end CHARACTERISTIC
/begin CHARACTERISTIC AKRGRCCM_VAR3 "Map for exhaust flap control depending on current gear and engine speed, with closed convertible top and sport button active" MAP 0x96DF746 KfAxU8AyU8SstxU8SstyU8WU8 99.61 rel_q0p39 0 99.61 FORMAT "%5.2"
 /begin AXIS_DESCR STD_AXIS gangakr DEZ 6 0 127 FORMAT "%5.1" DEPOSIT ABSOLUTE /end AXIS_DESCR
 /begin AXIS_DESCR STD_AXIS Epm_nEngLRes nmot_q40 8 0 10000 FORMAT "%5.0" PHYS_UNIT "1/min" DEPOSIT ABSOLUTE /end AXIS_DESCR
/end CHARACTERISTIC
/begin CHARACTERISTIC AKRGRCO "Map for exhaust flap control depending on current gear and engine speed, with open convertible top" MAP 0x96DF846 KfAxU8AyU8SstxU8SstyU8WU8 99.61 rel_q0p39 0 99.61 FORMAT "%5.2"
 /begin AXIS_DESCR STD_AXIS gangakr DEZ 10 0 127 FORMAT "%5.1" DEPOSIT ABSOLUTE /end AXIS_DESCR
 /begin AXIS_DESCR STD_AXIS Epm_nEngLRes nmot_q40 12 0 10000 FORMAT "%5.0" PHYS_UNIT "1/min" DEPOSIT ABSOLUTE /end AXIS_DESCR
/end CHARACTERISTIC
/begin CHARACTERISTIC AKRGRCO_VAR1 "Map for exhaust flap control depending on current gear and engine speed, with open convertible top" MAP 0x96DFB6A KfAxU8AyU8SstxU8SstyU8WU8 99.61 rel_q0p39 0 99.61 FORMAT "%5.2"
 /begin AXIS_DESCR STD_AXIS gangakr DEZ 6 0 127 FORMAT "%5.1" DEPOSIT ABSOLUTE /end AXIS_DESCR
 /begin AXIS_DESCR STD_AXIS Epm_nEngLRes nmot_q40 8 0 10000 FORMAT "%5.0" PHYS_UNIT "1/min" DEPOSIT ABSOLUTE /end AXIS_DESCR
/end CHARACTERISTIC
/begin CHARACTERISTIC AKRGRCOAT "Map for exhaust flap control depending on current gear and engine speed (DCT or AT gearbox), with open convertible top" MAP 0x96DF8D6 KfAxU8AyU8SstxU8SstyU8WU8 99.61 rel_q0p39 0 99.61 FORMAT "%5.2"
 /begin AXIS_DESCR STD_AXIS gangakr DEZ 10 0 127 FORMAT "%5.1" DEPOSIT ABSOLUTE /end AXIS_DESCR
 /begin AXIS_DESCR STD_AXIS Epm_nEngLRes nmot_q40 12 0 10000 FORMAT "%5.0" PHYS_UNIT "1/min" DEPOSIT ABSOLUTE /end AXIS_DESCR
/end CHARACTERISTIC
/begin CHARACTERISTIC AKRGRCOAT_VAR1 "Map for exhaust flap control depending on current gear and engine speed (DCT or AT gearbox), with open convertible top" MAP 0x96DFA48 KfAxU8AyU8SstxU8SstyU8WU8 99.61 rel_q0p39 0 99.61 FORMAT "%5.2"
 /begin AXIS_DESCR STD_AXIS gangakr DEZ 8 0 127 FORMAT "%5.1" DEPOSIT ABSOLUTE /end AXIS_DESCR
 /begin AXIS_DESCR STD_AXIS Epm_nEngLRes nmot_q40 8 0 10000 FORMAT "%5.0" PHYS_UNIT "1/min" DEPOSIT ABSOLUTE /end AXIS_DESCR
/end CHARACTERISTIC
/begin CHARACTERISTIC AKRGRCOATM "Map for exhaust flap control depending on current gear and engine speed (DCT or AT gearbox), with open convertible top and sport button active" MAP 0x96DF966 KfAxU8AyU8SstxU8SstyU8WU8 99.61 rel_q0p39 0 99.61 FORMAT "%5.2"
 /begin AXIS_DESCR STD_AXIS gangakr DEZ 10 0 127 FORMAT "%5.1" DEPOSIT ABSOLUTE /end AXIS_DESCR
 /begin AXIS_DESCR STD_AXIS Epm_nEngLRes nmot_q40 12 0 10000 FORMAT "%5.0" PHYS_UNIT "1/min" DEPOSIT ABSOLUTE /end AXIS_DESCR
/end CHARACTERISTIC
/begin CHARACTERISTIC AKRGRCOATM_VAR1 "Map for exhaust flap control depending on current gear and engine speed (DCT or AT gearbox), with open convertible top and sport button active" MAP 0x96DF9F6 KfAxU8AyU8SstxU8SstyU8WU8 99.61 rel_q0p39 0 99.61 FORMAT "%5.2"
 /begin AXIS_DESCR STD_AXIS gangakr DEZ 8 0 127 FORMAT "%5.1" DEPOSIT ABSOLUTE /end AXIS_DESCR
 /begin AXIS_DESCR STD_AXIS Epm_nEngLRes nmot_q40 8 0 10000 FORMAT "%5.0" PHYS_UNIT "1/min" DEPOSIT ABSOLUTE /end AXIS_DESCR
/end CHARACTERISTIC
/begin CHARACTERISTIC AKRGRCOM "Map for exhaust flap control depending on current gear and engine speed, with open convertible top and sport button active" MAP 0x96DFA9A KfAxU8AyU8SstxU8SstyU8WU8 99.61 rel_q0p39 0 99.61 FORMAT "%5.2"
 /begin AXIS_DESCR STD_AXIS gangakr DEZ 10 0 127 FORMAT "%5.1" DEPOSIT ABSOLUTE /end AXIS_DESCR
 /begin AXIS_DESCR STD_AXIS Epm_nEngLRes nmot_q40 12 0 10000 FORMAT "%5.0" PHYS_UNIT "1/min" DEPOSIT ABSOLUTE /end AXIS_DESCR
/end CHARACTERISTIC
/begin CHARACTERISTIC AKRGRCOM_VAR1 "Map for exhaust flap control depending on current gear and engine speed, with open convertible top and sport button active" MAP 0x96DFB2A KfAxU8AyU8SstxU8SstyU8WU8 99.61 rel_q0p39 0 99.61 FORMAT "%5.2"
 /begin AXIS_DESCR STD_AXIS gangakr DEZ 6 0 127 FORMAT "%5.1" DEPOSIT ABSOLUTE /end AXIS_DESCR
 /begin AXIS_DESCR STD_AXIS Epm_nEngLRes nmot_q40 8 0 10000 FORMAT "%5.0" PHYS_UNIT "1/min" DEPOSIT ABSOLUTE /end AXIS_DESCR
/end CHARACTERISTIC
/begin CHARACTERISTIC BMWchas_lam_InjMpl_M "Lambda setpoint for multiple injection" MAP 0x96ADA26 _REC_A1CUR_2_MBSE_U2_S1 15.999755859375 BumqDkc_mryszAa_EcglxAc_nR_4oa0 0 15.999755859375
 /begin AXIS_DESCR COM_AXIS Nkw caoddzd_oAjpfzb_cAcEEha_1nR_oa0 10 -32768 32767 AXIS_PTS_REF BMWchas_lam_InjMpl_Ax FORMAT "%5.0" MONOTONY STRICT_INCREASE DEPOSIT ABSOLUTE /end AXIS_DESCR
 /begin AXIS_DESCR COM_AXIS BMWchas_tq_CmbEng_sw Mo_trq_nm_q0p1 10 -3276.8 3276.7 AXIS_PTS_REF BMWchas_lam_InjMpl_Ay FORMAT "%6.1" MONOTONY STRICT_INCREASE DEPOSIT ABSOLUTE /end AXIS_DESCR
/end CHARACTERISTIC
/begin CHARACTERISTIC BMWchas_lam_InjMplThr_M "Lambda setpoint for multiple injection at throttled operation mode" MAP 0x96ADAEE _REC_A1CUR_2_MBSE_U2_S1 15.999755859375 BumqDkc_mryszAa_EcglxAc_nR_4oa0 0 15.999755859375
 /begin AXIS_DESCR COM_AXIS Nkw caoddzd_oAjpfzb_cAcEEha_1nR_oa0 10 -32768 32767 AXIS_PTS_REF BMWchas_lam_InjMplThr_Ax FORMAT "%5.0" MONOTONY STRICT_INCREASE DEPOSIT ABSOLUTE /end AXIS_DESCR
 /begin AXIS_DESCR COM_AXIS BMWchas_tq_CmbEng_sw Mo_trq_nm_q0p1 10 -3276.8 3276.7 AXIS_PTS_REF BMWchas_lam_InjMplThr_Ay FORMAT "%6.1" MONOTONY STRICT_INCREASE DEPOSIT ABSOLUTE /end AXIS_DESCR
/end CHARACTERISTIC
/begin CHARACTERISTIC BMWchas_lam_InjSng_M "Lambda setpoint for single injection" MAP 0x96AD856 _REC_A1CUR_2_MBSE_U2_S1 15.999755859375 BumqDkc_mryszAa_EcglxAc_nR_4oa0 0 15.999755859375
 /begin AXIS_DESCR COM_AXIS Nkw caoddzd_oAjpfzb_cAcEEha_1nR_oa0 10 -32768 32767 AXIS_PTS_REF BMWchas_lam_InjSng_Ax FORMAT "%5.0" MONOTONY STRICT_INCREASE DEPOSIT ABSOLUTE /end AXIS_DESCR
 /begin AXIS_DESCR COM_AXIS BMWchas_tq_CmbEng_sw Mo_trq_nm_q0p1 10 -3276.8 3276.7 AXIS_PTS_REF BMWchas_lam_InjSng_Ay FORMAT "%6.1" MONOTONY STRICT_INCREASE DEPOSIT ABSOLUTE /end AXIS_DESCR
/end CHARACTERISTIC
/begin CHARACTERISTIC BMWchas_lam_InjSngThr_M "Lambda setpoint for single injection at throttled operation mode" MAP 0x96AD91E _REC_A1CUR_2_MBSE_U2_S1 15.999755859375 BumqDkc_mryszAa_EcglxAc_nR_4oa0 0 15.999755859375
 /begin AXIS_DESCR COM_AXIS Nkw caoddzd_oAjpfzb_cAcEEha_1nR_oa0 10 -32768 32767 AXIS_PTS_REF BMWchas_lam_InjSngThr_Ax FORMAT "%5.0" MONOTONY STRICT_INCREASE DEPOSIT ABSOLUTE /end AXIS_DESCR
 /begin AXIS_DESCR COM_AXIS BMWchas_tq_CmbEng_sw Mo_trq_nm_q0p1 10 -3276.8 3276.7 AXIS_PTS_REF BMWchas_lam_InjSngThr_Ay FORMAT "%6.1" MONOTONY STRICT_INCREASE DEPOSIT ABSOLUTE /end AXIS_DESCR
/end CHARACTERISTIC
/begin CHARACTERISTIC BMWchas_p_RailInjMpl_M "Rail pressure setpoint for multiple injection" MAP 0x96ADC76 _REC_A1CUR_2_MBSE_U2_S1 39.9993896484375 cxdjuna_xpuCged_ocEpdua_MCRa2a0 0 39.9993896484375
 /begin AXIS_DESCR COM_AXIS Nkw caoddzd_oAjpfzb_cAcEEha_1nR_oa0 6 -32768 32767 AXIS_PTS_REF BMWchas_p_RailInjMpl_Ax FORMAT "%5.0" MONOTONY STRICT_INCREASE DEPOSIT ABSOLUTE /end AXIS_DESCR
 /begin AXIS_DESCR COM_AXIS BMWrailco_rat_VabHom_sw zyyxBpb_rEsnvtc_gktukCa_fR_5a0o 6 -1600 1599.951171875 AXIS_PTS_REF BMWchas_p_RailInjMpl_Ay FORMAT "%8.3" MONOTONY STRICT_INCREASE DEPOSIT ABSOLUTE /end AXIS_DESCR
/end CHARACTERISTIC
/begin CHARACTERISTIC BMWchas_p_RailInjSng_M "Rail pressure setpoint for single injection" MAP 0x96ADBF6 _REC_A1CUR_2_MBSE_U2_S1 39.9993896484375 cxdjuna_xpuCged_ocEpdua_MCRa2a0 0 39.9993896484375
 /begin AXIS_DESCR COM_AXIS Nkw caoddzd_oAjpfzb_cAcEEha_1nR_oa0 8 -32768 32767 AXIS_PTS_REF BMWchas_p_RailInjSng_Ax FORMAT "%5.0" MONOTONY STRICT_INCREASE DEPOSIT ABSOLUTE /end AXIS_DESCR
 /begin AXIS_DESCR COM_AXIS BMWrailco_rat_VabHom_sw zyyxBpb_rEsnvtc_gktukCa_fR_5a0o 8 -1600 1599.951171875 AXIS_PTS_REF BMWchas_p_RailInjSng_Ay FORMAT "%8.3" MONOTONY STRICT_INCREASE DEPOSIT ABSOLUTE /end AXIS_DESCR
/end CHARACTERISTIC
/begin CHARACTERISTIC BMWchas_st_OpmBasc_M "Basic catalyst heating mode wish" MAP 0x96BADF0 _REC_A1CUR_2_MBSE_U1_S1 3 wDvwtyd_Bhgozed_DCekdfb_nsttFSS 0 3
 /begin AXIS_DESCR COM_AXIS BMWchas_ti_AftStrSca_uw noCyFga_rslwmfa_ecfnhgc_sR_2a0o 8 0 255.99609375 AXIS_PTS_REF BMWchas_st_OpmBasc_Ax MONOTONY STRICT_INCREASE DEPOSIT ABSOLUTE /end AXIS_DESCR
 /begin AXIS_DESCR COM_AXIS BMWchas_t_EngStr_sw bdktxuc_qvvFmxd_seefaCc_q__aa0o 8 -3276.8 3276.7 AXIS_PTS_REF BMWchas_st_OpmBasc_Ay MONOTONY MON_INCREASE DEPOSIT ABSOLUTE /end AXIS_DESCR
/end CHARACTERISTIC
/begin CHARACTERISTIC BMWgpfheat_p_RailInjMpl_M "GPF heating, rail pressure setpoint for multiple injection" MAP 0x9693770 _REC_A1CUR_2_MBSE_U2_S1 39.9993896484375 cxdjuna_xpuCged_ocEpdua_MCRa2a0 0 39.9993896484375
 /begin AXIS_DESCR COM_AXIS Nkw caoddzd_oAjpfzb_cAcEEha_1nR_oa0 6 -32768 32767 AXIS_PTS_REF BMWgpfheat_p_RailInjMpl_Ax FORMAT "%5.0" MONOTONY STRICT_INCREASE DEPOSIT ABSOLUTE /end AXIS_DESCR
 /begin AXIS_DESCR COM_AXIS BMWrailco_rat_VabHom_sw zyyxBpb_rEsnvtc_gktukCa_fR_5a0o 6 -1600 1599.951171875 AXIS_PTS_REF BMWgpfheat_p_RailInjMpl_Ay FORMAT "%8.3" MONOTONY STRICT_INCREASE DEPOSIT ABSOLUTE /end AXIS_DESCR
/end CHARACTERISTIC
/begin CHARACTERISTIC BMWgpfheat_p_RailInjSng_M "GPF heating, rail pressure setpoint for single injection" MAP 0x9693728 _REC_A1CUR_2_MBSE_U2_S1 39.9993896484375 cxdjuna_xpuCged_ocEpdua_MCRa2a0 0 39.9993896484375
 /begin AXIS_DESCR COM_AXIS Nkw caoddzd_oAjpfzb_cAcEEha_1nR_oa0 6 -32768 32767 AXIS_PTS_REF BMWgpfheat_p_RailInjSng_Ax FORMAT "%5.0" MONOTONY STRICT_INCREASE DEPOSIT ABSOLUTE /end AXIS_DESCR
 /begin AXIS_DESCR COM_AXIS BMWrailco_rat_VabHom_sw zyyxBpb_rEsnvtc_gktukCa_fR_5a0o 6 -1600 1599.951171875 AXIS_PTS_REF BMWgpfheat_p_RailInjSng_Ay FORMAT "%8.3" MONOTONY STRICT_INCREASE DEPOSIT ABSOLUTE /end AXIS_DESCR
/end CHARACTERISTIC
/begin CHARACTERISTIC BMWinjmon_fac_HppEff_M "Injection map factor for high-pressure pump efficiency" MAP 0x96AF5DE _REC_A1CUR_2_MBSE_U2_S1 1.99996948242188 Bhvfwhc_bigEubd_BBEupBd_nR_3oa0 0 1.99996948242188 FORMAT "%6.2"
 /begin AXIS_DESCR COM_AXIS Nkw caoddzd_oAjpfzb_cAcEEha_1nR_oa0 8 -32768 32767 AXIS_PTS_REF BMWinjmon_fac_HppEff_Ax FORMAT "%5.0" MONOTONY STRICT_INCREASE DEPOSIT ABSOLUTE /end AXIS_DESCR
 /begin AXIS_DESCR COM_AXIS Prail_ist cxdjuna_xpuCged_ocEpdua_MCRa2a0 4 0 39.9993896484375 AXIS_PTS_REF BMWinjmon_fac_HppEff_Ay FORMAT "%9.4" MONOTONY STRICT_INCREASE DEPOSIT ABSOLUTE /end AXIS_DESCR
/end CHARACTERISTIC
/begin CHARACTERISTIC BMWlpa_n_EfpEngStrtAmb_M "Electric fuel pump speed setpoint for start ambient" MAP 0x9692E82 _REC_A1CUR_2_MBSE_U2_S1 65535 caoddzd_oAjpfzb_cAcEEha_1nR_oa0 0 65535 FORMAT "%5.0"
 /begin AXIS_DESCR COM_AXIS Tumg bdktxuc_qvvFmxd_seefaCc_q__aa0o 4 -3276.8 3276.7 AXIS_PTS_REF BMWlpa_n_EfpEngStrtAmb_Ax FORMAT "%6.1" MONOTONY STRICT_INCREASE DEPOSIT ABSOLUTE /end AXIS_DESCR
 /begin AXIS_DESCR COM_AXIS Pumg dufmqFa_ggtdFtc_rzCuowa_hCRoa0o 4 0 8191.875 AXIS_PTS_REF BMWlpa_n_EfpEngStrtAmb_Ay FORMAT "%8.3" MONOTONY STRICT_INCREASE DEPOSIT ABSOLUTE /end AXIS_DESCR
/end CHARACTERISTIC
/begin CHARACTERISTIC BMWlpa_n_EfpModSafe_M "Electric fuel pump speed setpoint safe mode" MAP 0x9692DCE _REC_A1CUR_2_MBSE_U2_S1 65535 caoddzd_oAjpfzb_cAcEEha_1nR_oa0 0 65535 FORMAT "%5.0"
 /begin AXIS_DESCR COM_AXIS BMWlpi_t_Fu_sw DchEpAd_DBCFgoa_Ckhahgc_q__aoa0 4 -327.68 327.67 AXIS_PTS_REF BMWlpa_n_EfpModSafe_Ax FORMAT "%5.2" MONOTONY STRICT_INCREASE DEPOSIT ABSOLUTE /end AXIS_DESCR
 /begin AXIS_DESCR COM_AXIS BMWlpi_volf_Fu_sw zBcBzad_vmoivka_mFzjCgc_lCRooa0 4 -327.68 327.67 AXIS_PTS_REF BMWlpa_n_EfpModSafe_Ay FORMAT "%5.2" MONOTONY STRICT_INCREASE DEPOSIT ABSOLUTE /end AXIS_DESCR
/end CHARACTERISTIC
/begin CHARACTERISTIC BMWlpsc_volf_FuEjrPmp_M "Map volume flow" MAP 0x96932CA _REC_A1CUR_2_MBSE_S2_S1 655.35 zBcBzad_vmoivka_mFzjCgc_lCRooa0 -327.68 327.67 FORMAT "%5.2"
 /begin AXIS_DESCR COM_AXIS BMWlpsc_p_EfpSpCtld_uw rgduxyd_mlihaBb_gsCghzb_bCRa0a0 8 0 65.535 AXIS_PTS_REF BMWlpsc_volf_FuEjrPmp_Ax FORMAT "%5.3" MONOTONY STRICT_INCREASE DEPOSIT ABSOLUTE /end AXIS_DESCR
 /begin AXIS_DESCR COM_AXIS BMWlpsc_st_TankCod_ub raChrxc_kBtBrmb_FmDuEFa_n__aa0o 4 0 255 AXIS_PTS_REF BMWlpsc_volf_FuEjrPmp_Ay FORMAT "%3.0" MONOTONY STRICT_INCREASE DEPOSIT ABSOLUTE /end AXIS_DESCR
/end CHARACTERISTIC
/begin CHARACTERISTIC BMWtchctr_t_ExGasMdl_M "Exhaust gas temperature during dynamic load changes for physical turbocharger feedforward control" MAP 0x96B613E _REC_A1CUR_2_MBSE_S2_S1 6553.5 bdktxuc_qvvFmxd_seefaCc_q__aa0o -3276.8 3276.7 FORMAT "%7.1"
 /begin AXIS_DESCR COM_AXIS Nkw caoddzd_oAjpfzb_cAcEEha_1nR_oa0 6 -32768 32767 AXIS_PTS_REF BMWtchctr_t_ExGasMdl_Ax FORMAT "%5.0" MONOTONY STRICT_INCREASE DEPOSIT ABSOLUTE /end AXIS_DESCR
 /begin AXIS_DESCR COM_AXIS Rf CgkBooc_wkiDfEd_Czglhgc_fR_1a0o 6 -327.68 327.67 AXIS_PTS_REF BMWtchctr_t_ExGasMdl_Ay FORMAT "%7.2" MONOTONY STRICT_INCREASE DEPOSIT ABSOLUTE /end AXIS_DESCR
/end CHARACTERISTIC
/begin CHARACTERISTIC BMWtchctr_t_ExGasMdlScav_M "Exhaust gas temperature during dynamic load changes for physical turbocharger feedforward control" MAP 0x96B6186 _REC_A1CUR_2_MBSE_S2_S1 6553.5 bdktxuc_qvvFmxd_seefaCc_q__aa0o -3276.8 3276.7 FORMAT "%7.1"
 /begin AXIS_DESCR COM_AXIS Nkw caoddzd_oAjpfzb_cAcEEha_1nR_oa0 6 -32768 32767 AXIS_PTS_REF BMWtchctr_t_ExGasMdlScav_Ax FORMAT "%5.0" MONOTONY STRICT_INCREASE DEPOSIT ABSOLUTE /end AXIS_DESCR
 /begin AXIS_DESCR COM_AXIS Rf CgkBooc_wkiDfEd_Czglhgc_fR_1a0o 6 -327.68 327.67 AXIS_PTS_REF BMWtchctr_t_ExGasMdlScav_Ay FORMAT "%7.2" MONOTONY STRICT_INCREASE DEPOSIT ABSOLUTE /end AXIS_DESCR
/end CHARACTERISTIC
/begin CHARACTERISTIC BMWtchsp_rat_p_CmprMax_M "Max allowed compressor pressure ratio (model-based)" MAP 0x969CE6A _REC_A1CUR_2_MBSE_U2_S1 3.99993896484375 ilxsavd_hkzmBfc_lAzCpAb_nR_1oa0 0 3.99993896484375
 /begin AXIS_DESCR COM_AXIS BMWtchsp_mf_CmprNorm_uw CByjozc_eCmpBAb_pljBAmd_k__0oa0 8 0 2047.96875 AXIS_PTS_REF BMWtchsp_rat_p_CmprMax_Ax FORMAT "%10.3" MONOTONY STRICT_INCREASE DEPOSIT ABSOLUTE /end AXIS_DESCR
 /begin AXIS_DESCR COM_AXIS BMWtchtbc_t_BefCmpr_sw bdktxuc_qvvFmxd_seefaCc_q__aa0o 6 -3276.8 3276.7 AXIS_PTS_REF BMWtchsp_rat_p_CmprMax_Ay FORMAT "%6.1" MONOTONY STRICT_INCREASE DEPOSIT ABSOLUTE /end AXIS_DESCR
/end CHARACTERISTIC
/begin CHARACTERISTIC BMWtqe_b_SptDet4NoiseAcvn_M "Sport mode detection depending on St_usecase_antr and St_dsc_can" MAP 0x96BE174 _REC_A1CUR_2_MBSE_U1_S1 1 fgjpsvb_fDqjECa_acgrbDd_n_dae__ 0 1
 /begin AXIS_DESCR COM_AXIS Status_usecase_antr raChrxc_kBtBrmb_FmDuEFa_n__aa0o 12 0 11 AXIS_PTS_REF BMWtqe_b_SptDet4NoiseAcvn_Ax FORMAT "%6.0" MONOTONY STRICT_INCREASE DEPOSIT ABSOLUTE /end AXIS_DESCR
 /begin AXIS_DESCR COM_AXIS St_dsc_can raChrxc_kBtBrmb_FmDuEFa_n__aa0o 4 0 11 AXIS_PTS_REF BMWtqe_b_SptDet4NoiseAcvn_Ay FORMAT "%3.0" MONOTONY STRICT_INCREASE DEPOSIT ABSOLUTE /end AXIS_DESCR
/end CHARACTERISTIC
/begin CHARACTERISTIC KF_BSLGF "Lambda rich running limit for component protection filling intervention" MAP 0x969120A _REC_A1CUR_2_MBSE_U2_S1 15.999755859375 BumqDkc_mryszAa_EcglxAc_nR_4oa0 0 15.999755859375
 /begin AXIS_DESCR COM_AXIS Nkw_atm caoddzd_oAjpfzb_cAcEEha_1nR_oa0 4 -32768 32767 AXIS_PTS_REF AXX_KF_BSLGF MONOTONY STRICT_INCREASE DEPOSIT ABSOLUTE /end AXIS_DESCR
 /begin AXIS_DESCR COM_AXIS Rf_atm CgkBooc_wkiDfEd_Czglhgc_fR_1a0o 4 -327.68 327.67 AXIS_PTS_REF AXY_KF_BSLGF MONOTONY STRICT_INCREASE DEPOSIT ABSOLUTE /end AXIS_DESCR
/end CHARACTERISTIC
/begin CHARACTERISTIC KF_DLAMBSVST_TABG "Delta lambda for feedforward control of component protection exhaust temperature branch" MAP 0x96913F0 _REC_A1CUR_2_MBSE_S2_S1 8 BumqDkc_mryszAa_EcglxAc_nR_4oa0 -8 0 FORMAT "%7.4"
 /begin AXIS_DESCR COM_AXIS Nkw_atm caoddzd_oAjpfzb_cAcEEha_1nR_oa0 8 -32768 32767 AXIS_PTS_REF AXX_KF_DLAMBSVST_TABG MONOTONY STRICT_INCREASE DEPOSIT ABSOLUTE /end AXIS_DESCR
 /begin AXIS_DESCR COM_AXIS Rf_atm CgkBooc_wkiDfEd_Czglhgc_fR_1a0o 8 -327.68 327.67 AXIS_PTS_REF AXY_KF_DLAMBSVST_TABG MONOTONY STRICT_INCREASE DEPOSIT ABSOLUTE /end AXIS_DESCR
/end CHARACTERISTIC
/begin CHARACTERISTIC KF_DPLDS_PRED "Offset target boost pressure as f(engine speed, dynamic Rf_soll damping)" MAP 0x96B4F02 _REC_A1CUR_2_MBSE_U2_S1 8191.875 rAdkuaa_wDllxja_BnDuEFa_n__aa0o 0 8191.875
 /begin AXIS_DESCR COM_AXIS NO_INPUT_QUANTITY caoddzd_oAjpfzb_cAcEEha_1nR_oa0 6 0 32767 AXIS_PTS_REF AXX_KF_DPLDS_PRED FORMAT "%5.0" MONOTONY MON_INCREASE DEPOSIT ABSOLUTE /end AXIS_DESCR
 /begin AXIS_DESCR COM_AXIS NO_INPUT_QUANTITY CgkBooc_wkiDfEd_Czglhgc_fR_1a0o 6 0 655.35 AXIS_PTS_REF AXY_KF_DPLDS_PRED MONOTONY MON_INCREASE DEPOSIT ABSOLUTE /end AXIS_DESCR
/end CHARACTERISTIC
/begin CHARACTERISTIC KF_DPLDSOLL_SPORT "Map boost pressure offset on target boost pressure (in sport mode)" MAP 0x969B512 _REC_A1CUR_2_MBSE_U2_S1 8191.875 dufmqFa_ggtdFtc_rzCuowa_hCRoa0o 0 8191.875 FORMAT "%8.3"
 /begin AXIS_DESCR COM_AXIS NO_INPUT_QUANTITY caoddzd_oAjpfzb_cAcEEha_1nR_oa0 6 0 32767 AXIS_PTS_REF AXX_KF_DPLDSOLL_SPORT FORMAT "%5.0" MONOTONY MON_INCREASE DEPOSIT ABSOLUTE /end AXIS_DESCR
 /begin AXIS_DESCR COM_AXIS NO_INPUT_QUANTITY acriqBc_tfkBqod_ocgjxzc_nR_8oa0 6 0 7.9998779296875 AXIS_PTS_REF AXY_KF_DPLDSOLL_SPORT FORMAT "%7.5" MONOTONY MON_INCREASE DEPOSIT ABSOLUTE /end AXIS_DESCR
/end CHARACTERISTIC
/begin CHARACTERISTIC KF_DZWMIN_NORMAL_SOT "Ignition angle intervention for sound tuning" MAP 0x96C4C88 _REC_A1CUR_2_MBSE_S1_S1 127.5 aAwkuzc_BFpgCmb_tmDukma_q__aa0o -64 63.5
 /begin AXIS_DESCR COM_AXIS Nkw caoddzd_oAjpfzb_cAcEEha_1nR_oa0 6 -32768 32767 AXIS_PTS_REF AXX_KF_DZWMIN_NORMAL_SOT FORMAT "%5.0" MONOTONY STRICT_INCREASE DEPOSIT ABSOLUTE /end AXIS_DESCR
 /begin AXIS_DESCR COM_AXIS V AFeDmkb_cAbjmcc_kAkskhd_k__0oa0 4 0 65535 AXIS_PTS_REF AXY_KF_DZWMIN_NORMAL_SOT FORMAT "%5.0" MONOTONY STRICT_INCREASE DEPOSIT ABSOLUTE /end AXIS_DESCR
/end CHARACTERISTIC
/begin CHARACTERISTIC KF_DZWMIN_SPORT_SOT "Ignition angle intervention for sound tuning at B_sport" MAP 0x96C4C30 _REC_A1CUR_2_MBSE_S1_S1 127.5 aAwkuzc_BFpgCmb_tmDukma_q__aa0o -64 63.5
 /begin AXIS_DESCR COM_AXIS Nkw caoddzd_oAjpfzb_cAcEEha_1nR_oa0 6 -32768 32767 AXIS_PTS_REF AXX_KF_DZWMIN_SPORT_SOT FORMAT "%5.0" MONOTONY STRICT_INCREASE DEPOSIT ABSOLUTE /end AXIS_DESCR
 /begin AXIS_DESCR COM_AXIS V AFeDmkb_cAbjmcc_kAkskhd_k__0oa0 4 0 65535 AXIS_PTS_REF AXY_KF_DZWMIN_SPORT_SOT FORMAT "%5.0" MONOTONY STRICT_INCREASE DEPOSIT ABSOLUTE /end AXIS_DESCR
/end CHARACTERISTIC
/begin CHARACTERISTIC KF_FRKKORRF_1 "Map feedforward correction bank 1" MAP 0x968DC6E _REC_A1CUR_2_MBSE_U2_S1 1.99996948242188 Bhvfwhc_bigEubd_BBEupBd_nR_3oa0 0 1.99996948242188 FORMAT "%14.5"
 /begin AXIS_DESCR COM_AXIS Nkw caoddzd_oAjpfzb_cAcEEha_1nR_oa0 16 -32768 32767 AXIS_PTS_REF AXX_KF_FRKKORRF_1 FORMAT "%5.0" MONOTONY STRICT_INCREASE DEPOSIT ABSOLUTE /end AXIS_DESCR
 /begin AXIS_DESCR COM_AXIS Rf CgkBooc_wkiDfEd_Czglhgc_fR_1a0o 16 -327.68 327.67 AXIS_PTS_REF AXY_KF_FRKKORRF_1 FORMAT "%7.2" MONOTONY STRICT_INCREASE DEPOSIT ABSOLUTE /end AXIS_DESCR
/end CHARACTERISTIC
/begin CHARACTERISTIC KF_KLIMA_KKS "Map for converting air flap position depending on climate fan request and vehicle speed" MAP 0x968772C KfAxUbAyUbSstxUbSstyUwWUb 10 raChrxc_kBtBrmb_FmDuEFa_n__aa0o 0 10
 /begin AXIS_DESCR STD_AXIS Nelueft_klima_wm qtfFcac_cfbwAaa_Cbeysaa_fR_60oa 6 0 99.609375 MONOTONY STRICT_INCREASE DEPOSIT ABSOLUTE /end AXIS_DESCR
 /begin AXIS_DESCR STD_AXIS V_wm knyFDjc_sDytACd_hlCBAmd_k__0oa0 6 0 6553.5 MONOTONY STRICT_INCREASE DEPOSIT ABSOLUTE /end AXIS_DESCR
/end CHARACTERISTIC
/begin CHARACTERISTIC KF_KOEFF_B_LA "Coefficient B for lambda correction of ignition angle knock limit" MAP 0x96AB7A6 _REC_A1CUR_2_MBSE_U2_S1 15.999755859375 BumqDkc_mryszAa_EcglxAc_nR_4oa0 0 15.999755859375 FORMAT "%9.4"
 /begin AXIS_DESCR COM_AXIS Nkw caoddzd_oAjpfzb_cAcEEha_1nR_oa0 6 -32768 32767 AXIS_PTS_REF AXX_KF_KOEFF_B_LA FORMAT "%5.0" MONOTONY STRICT_INCREASE DEPOSIT ABSOLUTE /end AXIS_DESCR
 /begin AXIS_DESCR COM_AXIS NO_INPUT_QUANTITY CgkBooc_wkiDfEd_Czglhgc_fR_1a0o 6 -327.68 327.67 AXIS_PTS_REF AXY_KF_KOEFF_B_LA FORMAT "%9.2" MONOTONY STRICT_INCREASE DEPOSIT ABSOLUTE /end AXIS_DESCR
/end CHARACTERISTIC
/begin CHARACTERISTIC KF_LA_BEZ "Reference lambda for lambda correction of ignition angle knock limit" MAP 0x96AB746 _REC_A1CUR_2_MBSE_U2_S1 15.999755859375 BumqDkc_mryszAa_EcglxAc_nR_4oa0 0 15.999755859375 FORMAT "%9.4"
 /begin AXIS_DESCR COM_AXIS Nkw caoddzd_oAjpfzb_cAcEEha_1nR_oa0 6 -32768 32767 AXIS_PTS_REF AXX_KF_LA_BEZ FORMAT "%5.0" MONOTONY STRICT_INCREASE DEPOSIT ABSOLUTE /end AXIS_DESCR
 /begin AXIS_DESCR COM_AXIS NO_INPUT_QUANTITY CgkBooc_wkiDfEd_Czglhgc_fR_1a0o 8 -327.68 327.67 AXIS_PTS_REF AXY_KF_LA_BEZ FORMAT "%9.2" MONOTONY MON_INCREASE DEPOSIT ABSOLUTE /end AXIS_DESCR
/end CHARACTERISTIC
/begin CHARACTERISTIC KF_LA_EZA "Lambda setpoint for single cylinder deactivation" MAP 0x96964AC _REC_A1CUR_2_MBSE_U2_S1 15.999755859375 BumqDkc_mryszAa_EcglxAc_nR_4oa0 0 15.999755859375 FORMAT "%9.4"
 /begin AXIS_DESCR COM_AXIS Nkw caoddzd_oAjpfzb_cAcEEha_1nR_oa0 6 -32768 32767 AXIS_PTS_REF AXX_KF_LA_EZA FORMAT "%5.0" MONOTONY STRICT_INCREASE DEPOSIT ABSOLUTE /end AXIS_DESCR
 /begin AXIS_DESCR COM_AXIS Rf CgkBooc_wkiDfEd_Czglhgc_fR_1a0o 6 -327.68 327.67 AXIS_PTS_REF AXY_KF_LA_EZA FORMAT "%7.2" MONOTONY STRICT_INCREASE DEPOSIT ABSOLUTE /end AXIS_DESCR
/end CHARACTERISTIC
/begin CHARACTERISTIC KF_LA_SK "Base lambda in homogeneous mode during super-knock" MAP 0x96B8872 _REC_A1CUR_2_MBSE_U2_S1 15.999755859375 BumqDkc_mryszAa_EcglxAc_nR_4oa0 0 15.999755859375 FORMAT "%9.4"
 /begin AXIS_DESCR COM_AXIS Nkw caoddzd_oAjpfzb_cAcEEha_1nR_oa0 18 -32768 32767 AXIS_PTS_REF GXX_KF_LABAS FORMAT "%5.0" MONOTONY STRICT_INCREASE DEPOSIT ABSOLUTE /end AXIS_DESCR
 /begin AXIS_DESCR COM_AXIS Rf CgkBooc_wkiDfEd_Czglhgc_fR_1a0o 17 -327.68 327.67 AXIS_PTS_REF GXY_KF_LABAS FORMAT "%7.2" MONOTONY STRICT_INCREASE DEPOSIT ABSOLUTE /end AXIS_DESCR
/end CHARACTERISTIC
/begin CHARACTERISTIC KF_LABAS_1 "Base lambda in homogeneous mode bank 1" MAP 0x96B8D3A _REC_A1CUR_2_MBSE_U2_S1 15.999755859375 BumqDkc_mryszAa_EcglxAc_nR_4oa0 0 15.999755859375 FORMAT "%9.4"
 /begin AXIS_DESCR COM_AXIS Nkw caoddzd_oAjpfzb_cAcEEha_1nR_oa0 18 -32768 32767 AXIS_PTS_REF GXX_KF_LABAS FORMAT "%5.0" MONOTONY STRICT_INCREASE DEPOSIT ABSOLUTE /end AXIS_DESCR
 /begin AXIS_DESCR COM_AXIS Rf CgkBooc_wkiDfEd_Czglhgc_fR_1a0o 17 -327.68 327.67 AXIS_PTS_REF GXY_KF_LABAS FORMAT "%7.2" MONOTONY STRICT_INCREASE DEPOSIT ABSOLUTE /end AXIS_DESCR
/end CHARACTERISTIC
/begin CHARACTERISTIC KF_LABAS_2 "Base lambda in homogeneous mode bank 2" MAP 0x96B8AD6 _REC_A1CUR_2_MBSE_U2_S1 15.999755859375 BumqDkc_mryszAa_EcglxAc_nR_4oa0 0 15.999755859375 FORMAT "%9.4"
 /begin AXIS_DESCR COM_AXIS Nkw caoddzd_oAjpfzb_cAcEEha_1nR_oa0 18 -32768 32767 AXIS_PTS_REF GXX_KF_LABAS FORMAT "%5.0" MONOTONY STRICT_INCREASE DEPOSIT ABSOLUTE /end AXIS_DESCR
 /begin AXIS_DESCR COM_AXIS Rf CgkBooc_wkiDfEd_Czglhgc_fR_1a0o 17 -327.68 327.67 AXIS_PTS_REF GXY_KF_LABAS FORMAT "%7.2" MONOTONY STRICT_INCREASE DEPOSIT ABSOLUTE /end AXIS_DESCR
/end CHARACTERISTIC
/begin CHARACTERISTIC KF_LAMIN_H "Lambda combustion limit rich" MAP 0x9696702 _REC_A1CUR_2_MBSE_U2_S1 15.999755859375 BumqDkc_mryszAa_EcglxAc_nR_4oa0 0 15.999755859375 FORMAT "%9.4"
 /begin AXIS_DESCR COM_AXIS Nkw caoddzd_oAjpfzb_cAcEEha_1nR_oa0 6 -32768 32767 AXIS_PTS_REF AXX_KF_LAMIN_H FORMAT "%5.0" MONOTONY STRICT_INCREASE DEPOSIT ABSOLUTE /end AXIS_DESCR
 /begin AXIS_DESCR COM_AXIS Rf CgkBooc_wkiDfEd_Czglhgc_fR_1a0o 6 -327.68 327.67 AXIS_PTS_REF AXY_KF_LAMIN_H FORMAT "%7.2" MONOTONY STRICT_INCREASE DEPOSIT ABSOLUTE /end AXIS_DESCR
/end CHARACTERISTIC
/begin CHARACTERISTIC KF_MD_RES_NST_KEY "Torque reserve during post-start" MAP 0x96A5C0C _REC_A1CUR_2_MBSE_S2_S1 6553.5 Mo_trq_nm_q0p1 -3276.8 3276.7 FORMAT "%6.1"
 /begin AXIS_DESCR COM_AXIS Tn_start_10 camcxxd_bxlpdsa_Cshlhgc_sR_1a0o 4 0 655.35 AXIS_PTS_REF AXX_KF_MD_RES_NST_KEY FORMAT "%7.2" MONOTONY STRICT_INCREASE DEPOSIT ABSOLUTE /end AXIS_DESCR
 /begin AXIS_DESCR COM_AXIS Tmot DchEpAd_DBCFgoa_Ckhahgc_q__aoa0 4 -327.68 327.67 AXIS_PTS_REF AXY_KF_MD_RES_NST_KEY FORMAT "%7.2" MONOTONY STRICT_INCREASE DEPOSIT ABSOLUTE /end AXIS_DESCR
/end CHARACTERISTIC
/begin CHARACTERISTIC KF_N_GASSTOSS_UND_ANFAHR "Max. permissible launch RPM (normal mode)" MAP 0x969DBA4 _REC_A1CUR_2_MBSE_S2_S1 65535 caoddzd_oAjpfzb_cAcEEha_1nR_oa0 -32768 32767 FORMAT "%5.0"
 /begin AXIS_DESCR COM_AXIS NO_INPUT_QUANTITY jgbhAma_smpAegb_hlEBAmd_k__0oa0 6 -655.36 655.34 AXIS_PTS_REF AXX_KF_N_GASSTOSS_UND_ANFAHR FORMAT "%7.2" MONOTONY STRICT_INCREASE DEPOSIT ABSOLUTE /end AXIS_DESCR
 /begin AXIS_DESCR COM_AXIS NO_INPUT_QUANTITY vfyBdwd_ftexgja_BcFdiDd_fR_1a0o 4 -800 799.9755859375 AXIS_PTS_REF AXY_KF_N_GASSTOSS_UND_ANFAHR FORMAT "%7.2" MONOTONY STRICT_INCREASE DEPOSIT ABSOLUTE /end AXIS_DESCR
/end CHARACTERISTIC
/begin CHARACTERISTIC KF_NEL_TABG "Electric fan speed request due to exhaust gas temperature" MAP 0x9685106 _REC_S5MAP_52_KF_U1_S2_U2 99.609375 qtfFcac_cfbwAaa_Cbeysaa_fR_60oa 0 99.609375
 /begin AXIS_DESCR STD_AXIS Tabg_wm bdktxuc_qvvFmxd_seefaCc_q__aa0o 4 -3276.8 3276.7 MONOTONY STRICT_INCREASE DEPOSIT ABSOLUTE /end AXIS_DESCR
 /begin AXIS_DESCR STD_AXIS V_wm knyFDjc_sDytACd_hlCBAmd_k__0oa0 4 0 6553.5 MONOTONY STRICT_INCREASE DEPOSIT ABSOLUTE /end AXIS_DESCR
/end CHARACTERISTIC
/begin CHARACTERISTIC KF_NEL_TANS "Electric fan speed request due to intake air temperature" MAP 0x96850E4 _REC_S5MAP_52_KF_U1_S2_S2 99.609375 qtfFcac_cfbwAaa_Cbeysaa_fR_60oa 0 99.609375
 /begin AXIS_DESCR STD_AXIS Dtans_tumg_wm bdktxuc_qvvFmxd_seefaCc_q__aa0o 4 -3276.8 3276.7 MONOTONY STRICT_INCREASE DEPOSIT ABSOLUTE /end AXIS_DESCR
 /begin AXIS_DESCR STD_AXIS Tumg_wm bdktxuc_qvvFmxd_seefaCc_q__aa0o 4 -3276.8 3276.7 MONOTONY STRICT_INCREASE DEPOSIT ABSOLUTE /end AXIS_DESCR
/end CHARACTERISTIC
/begin CHARACTERISTIC KF_NMAX_ANFAHR_MODE_0 "Max. permissible launch RPM (normal mode)" MAP 0x969DF96 _REC_A1CUR_2_MBSE_S2_S1 65535 caoddzd_oAjpfzb_cAcEEha_1nR_oa0 -32768 32767 FORMAT "%5.0"
 /begin AXIS_DESCR COM_AXIS NO_INPUT_QUANTITY jgbhAma_smpAegb_hlEBAmd_k__0oa0 6 -655.36 655.34 AXIS_PTS_REF AXX_KF_NMAX_ANFAHR_MODE_0 FORMAT "%7.2" MONOTONY STRICT_INCREASE DEPOSIT ABSOLUTE /end AXIS_DESCR
 /begin AXIS_DESCR COM_AXIS NO_INPUT_QUANTITY vfyBdwd_ftexgja_BcFdiDd_fR_1a0o 4 -800 799.9755859375 AXIS_PTS_REF AXY_KF_NMAX_ANFAHR_MODE_0 FORMAT "%7.2" MONOTONY STRICT_INCREASE DEPOSIT ABSOLUTE /end AXIS_DESCR
/end CHARACTERISTIC
/begin CHARACTERISTIC KF_NMAX_ANFAHR_MODE_1 "Max. permissible launch RPM (A_max mode / DTC)" MAP 0x969DF66 _REC_A1CUR_2_MBSE_S2_S1 65535 caoddzd_oAjpfzb_cAcEEha_1nR_oa0 -32768 32767 FORMAT "%5.0"
 /begin AXIS_DESCR COM_AXIS NO_INPUT_QUANTITY jgbhAma_smpAegb_hlEBAmd_k__0oa0 6 -655.36 655.34 AXIS_PTS_REF AXX_KF_NMAX_ANFAHR_MODE_1 FORMAT "%7.2" MONOTONY STRICT_INCREASE DEPOSIT ABSOLUTE /end AXIS_DESCR
 /begin AXIS_DESCR COM_AXIS NO_INPUT_QUANTITY vfyBdwd_ftexgja_BcFdiDd_fR_1a0o 4 -800 799.9755859375 AXIS_PTS_REF AXY_KF_NMAX_ANFAHR_MODE_1 FORMAT "%7.2" MONOTONY STRICT_INCREASE DEPOSIT ABSOLUTE /end AXIS_DESCR
/end CHARACTERISTIC
/begin CHARACTERISTIC KF_NMAX_ANFAHR_MODE_2 "Max. permissible launch RPM (smoky burnout mode / DSC off)" MAP 0x969DF36 _REC_A1CUR_2_MBSE_S2_S1 65535 caoddzd_oAjpfzb_cAcEEha_1nR_oa0 -32768 32767 FORMAT "%5.0"
 /begin AXIS_DESCR COM_AXIS NO_INPUT_QUANTITY jgbhAma_smpAegb_hlEBAmd_k__0oa0 6 -655.36 655.34 AXIS_PTS_REF AXX_KF_NMAX_ANFAHR_MODE_2 FORMAT "%7.2" MONOTONY STRICT_INCREASE DEPOSIT ABSOLUTE /end AXIS_DESCR
 /begin AXIS_DESCR COM_AXIS NO_INPUT_QUANTITY vfyBdwd_ftexgja_BcFdiDd_fR_1a0o 4 -800 799.9755859375 AXIS_PTS_REF AXY_KF_NMAX_ANFAHR_MODE_2 FORMAT "%7.2" MONOTONY STRICT_INCREASE DEPOSIT ABSOLUTE /end AXIS_DESCR
/end CHARACTERISTIC
/begin CHARACTERISTIC KF_PHA_H_B1_SK_PRE "Map start angle injection event 1 preventive super-knock" MAP 0x968F04C _REC_A1CUR_2_MBSE_S2_S1 1535.9765625 aEmoCzd_erpwvfb_msfkhgc_qR_1a0o -768 767.9765625
 /begin AXIS_DESCR COM_AXIS Nkw caoddzd_oAjpfzb_cAcEEha_1nR_oa0 10 -32768 32767 AXIS_PTS_REF GXX_KF_PHA_H_B1_BAS FORMAT "%5.0" MONOTONY STRICT_INCREASE DEPOSIT ABSOLUTE /end AXIS_DESCR
 /begin AXIS_DESCR COM_AXIS NO_INPUT_QUANTITY zyyxBpb_rEsnvtc_gktukCa_fR_5a0o 12 -1600 1599.951171875 AXIS_PTS_REF GXY_KF_PHA_H_B1_BAS FORMAT "%8.3" MONOTONY STRICT_INCREASE DEPOSIT ABSOLUTE /end AXIS_DESCR
/end CHARACTERISTIC
/begin CHARACTERISTIC KF_PHA_H_B1_W "Map start angle injection event 1 warm" MAP 0x968EEDC _REC_A1CUR_2_MBSE_S2_S1 1535.9765625 aEmoCzd_erpwvfb_msfkhgc_qR_1a0o -768 767.9765625
 /begin AXIS_DESCR COM_AXIS Nkw caoddzd_oAjpfzb_cAcEEha_1nR_oa0 10 -32768 32767 AXIS_PTS_REF GXX_KF_PHA_H_B1_BAS FORMAT "%5.0" MONOTONY STRICT_INCREASE DEPOSIT ABSOLUTE /end AXIS_DESCR
 /begin AXIS_DESCR COM_AXIS NO_INPUT_QUANTITY zyyxBpb_rEsnvtc_gktukCa_fR_5a0o 12 -1600 1599.951171875 AXIS_PTS_REF GXY_KF_PHA_H_B1_BAS FORMAT "%8.3" MONOTONY STRICT_INCREASE DEPOSIT ABSOLUTE /end AXIS_DESCR
/end CHARACTERISTIC
/begin CHARACTERISTIC KF_PHA_H_E1 "KF_PHA_H_E1" MAP 0x969047C _REC_A1CUR_2_MBSE_S2_S1 1535.9765625 ridxkCa_Dxvxtdc_CChkhgc_nR_1a0o -768 767.9765625
 /begin AXIS_DESCR COM_AXIS Nkw caoddzd_oAjpfzb_cAcEEha_1nR_oa0 8 -32768 32767 AXIS_PTS_REF AXX_KF_PHA_H_E1 FORMAT "%5.0" MONOTONY STRICT_INCREASE DEPOSIT ABSOLUTE /end AXIS_DESCR
 /begin AXIS_DESCR COM_AXIS NO_INPUT_QUANTITY zyyxBpb_rEsnvtc_gktukCa_fR_5a0o 8 -1600 1599.951171875 AXIS_PTS_REF AXY_KF_PHA_H_E1 MONOTONY STRICT_INCREASE DEPOSIT ABSOLUTE /end AXIS_DESCR
/end CHARACTERISTIC
/begin CHARACTERISTIC KF_PRAIL_H "Map rail pressure homogeneous -- with active VVT" MAP 0x969C62C _REC_A1CUR_2_MBSE_U2_S1 39.9993896484375 cxdjuna_xpuCged_ocEpdua_MCRa2a0 0 39.9993896484375 FORMAT "%9.4"
 /begin AXIS_DESCR COM_AXIS Nkw caoddzd_oAjpfzb_cAcEEha_1nR_oa0 8 -32768 32767 AXIS_PTS_REF AXX_KF_PRAIL_H FORMAT "%5.0" MONOTONY STRICT_INCREASE DEPOSIT ABSOLUTE /end AXIS_DESCR
 /begin AXIS_DESCR COM_AXIS BMWrailco_rat_VabHom_sw zyyxBpb_rEsnvtc_gktukCa_fR_5a0o 8 -1600 1599.951171875 AXIS_PTS_REF AXY_KF_PRAIL_H FORMAT "%8.3" MONOTONY STRICT_INCREASE DEPOSIT ABSOLUTE /end AXIS_DESCR
/end CHARACTERISTIC
/begin CHARACTERISTIC KF_PRAIL_H_K "Map rail pressure homogeneous cold -- with active VVT" MAP 0x969C42C _REC_A1CUR_2_MBSE_U2_S1 39.9993896484375 cxdjuna_xpuCged_ocEpdua_MCRa2a0 0 39.9993896484375 FORMAT "%9.4"
 /begin AXIS_DESCR COM_AXIS Nkw caoddzd_oAjpfzb_cAcEEha_1nR_oa0 8 -32768 32767 AXIS_PTS_REF AXX_KF_PRAIL_H_K FORMAT "%5.0" MONOTONY STRICT_INCREASE DEPOSIT ABSOLUTE /end AXIS_DESCR
 /begin AXIS_DESCR COM_AXIS BMWrailco_rat_VabHom_sw zyyxBpb_rEsnvtc_gktukCa_fR_5a0o 8 -1600 1599.951171875 AXIS_PTS_REF AXY_KF_PRAIL_H_K FORMAT "%8.3" MONOTONY STRICT_INCREASE DEPOSIT ABSOLUTE /end AXIS_DESCR
/end CHARACTERISTIC
/begin CHARACTERISTIC KF_PRAIL_HDPWARM "Map rail pressure for protection against warm high-pressure pump" MAP 0x969C5AC _REC_A1CUR_2_MBSE_U2_S1 39.9993896484375 cxdjuna_xpuCged_ocEpdua_MCRa2a0 0 39.9993896484375 FORMAT "%9.4"
 /begin AXIS_DESCR COM_AXIS Nkw caoddzd_oAjpfzb_cAcEEha_1nR_oa0 8 -32768 32767 AXIS_PTS_REF AXX_KF_PRAIL_HDPWARM FORMAT "%5.0" MONOTONY STRICT_INCREASE DEPOSIT ABSOLUTE /end AXIS_DESCR
 /begin AXIS_DESCR COM_AXIS BMWrailco_rat_VabHom_sw zyyxBpb_rEsnvtc_gktukCa_fR_5a0o 8 -1600 1599.951171875 AXIS_PTS_REF AXY_KF_PRAIL_HDPWARM FORMAT "%8.3" MONOTONY STRICT_INCREASE DEPOSIT ABSOLUTE /end AXIS_DESCR
/end CHARACTERISTIC
/begin CHARACTERISTIC KF_PRAIL_HGD "Map rail pressure homogeneous -- with inactive VVT (throttled)" MAP 0x969C52C _REC_A1CUR_2_MBSE_U2_S1 39.9993896484375 cxdjuna_xpuCged_ocEpdua_MCRa2a0 0 39.9993896484375 FORMAT "%9.4"
 /begin AXIS_DESCR COM_AXIS Nkw caoddzd_oAjpfzb_cAcEEha_1nR_oa0 8 -32768 32767 AXIS_PTS_REF AXX_KF_PRAIL_HGD FORMAT "%5.0" MONOTONY STRICT_INCREASE DEPOSIT ABSOLUTE /end AXIS_DESCR
 /begin AXIS_DESCR COM_AXIS BMWrailco_rat_VabHom_sw zyyxBpb_rEsnvtc_gktukCa_fR_5a0o 8 -1600 1599.951171875 AXIS_PTS_REF AXY_KF_PRAIL_HGD FORMAT "%8.3" MONOTONY STRICT_INCREASE DEPOSIT ABSOLUTE /end AXIS_DESCR
/end CHARACTERISTIC
/begin CHARACTERISTIC KF_PRAIL_HGD_K "Map rail pressure homogeneous cold -- with inactive VVT (throttled)" MAP 0x969C4AC _REC_A1CUR_2_MBSE_U2_S1 39.9993896484375 cxdjuna_xpuCged_ocEpdua_MCRa2a0 0 39.9993896484375 FORMAT "%9.4"
 /begin AXIS_DESCR COM_AXIS Nkw caoddzd_oAjpfzb_cAcEEha_1nR_oa0 8 -32768 32767 AXIS_PTS_REF AXX_KF_PRAIL_HGD_K FORMAT "%5.0" MONOTONY STRICT_INCREASE DEPOSIT ABSOLUTE /end AXIS_DESCR
 /begin AXIS_DESCR COM_AXIS BMWrailco_rat_VabHom_sw zyyxBpb_rEsnvtc_gktukCa_fR_5a0o 8 -1600 1599.951171875 AXIS_PTS_REF AXY_KF_PRAIL_HGD_K FORMAT "%8.3" MONOTONY STRICT_INCREASE DEPOSIT ABSOLUTE /end AXIS_DESCR
/end CHARACTERISTIC
/begin CHARACTERISTIC KF_ST_RKBAS_GD "Map base Rk quantity throttled operation" MAP 0x96B85AC _REC_A1CUR_2_MBSE_S2_S1 3199.951171875 zyyxBpb_rEsnvtc_gktukCa_fR_5a0o -1600 1599.951171875
 /begin AXIS_DESCR COM_AXIS Nkw caoddzd_oAjpfzb_cAcEEha_1nR_oa0 10 -32768 32767 AXIS_PTS_REF AXX_KF_ST_RKBAS_GD FORMAT "%5.0" MONOTONY STRICT_INCREASE DEPOSIT ABSOLUTE /end AXIS_DESCR
 /begin AXIS_DESCR COM_AXIS BMWinj_t_Eng_sw DchEpAd_DBCFgoa_Ckhahgc_q__aoa0 10 -327.68 327.67 AXIS_PTS_REF AXY_KF_ST_RKBAS_GD FORMAT "%7.2" MONOTONY STRICT_INCREASE DEPOSIT ABSOLUTE /end AXIS_DESCR
/end CHARACTERISTIC
/begin CHARACTERISTIC KF_ST_RKBAS_VVT "Map base Rk quantity VVT operation" MAP 0x96B83EA _REC_A1CUR_2_MBSE_S2_S1 3199.951171875 zyyxBpb_rEsnvtc_gktukCa_fR_5a0o -1600 1599.951171875
 /begin AXIS_DESCR COM_AXIS Nkw caoddzd_oAjpfzb_cAcEEha_1nR_oa0 12 -32768 32767 AXIS_PTS_REF AXX_KF_ST_RKBAS_VVT FORMAT "%5.0" MONOTONY STRICT_INCREASE DEPOSIT ABSOLUTE /end AXIS_DESCR
 /begin AXIS_DESCR COM_AXIS BMWinj_t_Eng_sw DchEpAd_DBCFgoa_Ckhahgc_q__aoa0 12 -327.68 327.67 AXIS_PTS_REF AXY_KF_ST_RKBAS_VVT FORMAT "%7.2" MONOTONY STRICT_INCREASE DEPOSIT ABSOLUTE /end AXIS_DESCR
/end CHARACTERISTIC
/begin CHARACTERISTIC KF_TA_ATLSOLL "Target temperature for exhaust gas temperature turbocharger" MAP 0x96914F4 _REC_A1CUR_2_MBSE_S2_S1 6553.5 bdktxuc_qvvFmxd_seefaCc_q__aa0o -3276.8 3276.7 FORMAT "%6.1"
 /begin AXIS_DESCR COM_AXIS Nkw_atm caoddzd_oAjpfzb_cAcEEha_1nR_oa0 4 -32768 32767 AXIS_PTS_REF AXX_KF_TA_ATLSOLL MONOTONY STRICT_INCREASE DEPOSIT ABSOLUTE /end AXIS_DESCR
 /begin AXIS_DESCR COM_AXIS Rf_atm CgkBooc_wkiDfEd_Czglhgc_fR_1a0o 4 -327.68 327.67 AXIS_PTS_REF AXY_KF_TA_ATLSOLL MONOTONY STRICT_INCREASE DEPOSIT ABSOLUTE /end AXIS_DESCR
/end CHARACTERISTIC
/begin CHARACTERISTIC KF_TA_IKSOLL "Target temperature for exhaust gas temperature in catalyst" MAP 0x96914D4 _REC_A1CUR_2_MBSE_S2_S1 6553.5 bdktxuc_qvvFmxd_seefaCc_q__aa0o -3276.8 3276.7 FORMAT "%6.1"
 /begin AXIS_DESCR COM_AXIS Nkw_atm caoddzd_oAjpfzb_cAcEEha_1nR_oa0 4 -32768 32767 AXIS_PTS_REF AXX_KF_TA_IKSOLL MONOTONY STRICT_INCREASE DEPOSIT ABSOLUTE /end AXIS_DESCR
 /begin AXIS_DESCR COM_AXIS Rf_atm CgkBooc_wkiDfEd_Czglhgc_fR_1a0o 4 -327.68 327.67 AXIS_PTS_REF AXY_KF_TA_IKSOLL MONOTONY STRICT_INCREASE DEPOSIT ABSOLUTE /end AXIS_DESCR
/end CHARACTERISTIC
/begin CHARACTERISTIC KF_TA_VKSOLL "Target temperature for exhaust gas temperature mixing section" MAP 0x96914B4 _REC_A1CUR_2_MBSE_S2_S1 6553.5 bdktxuc_qvvFmxd_seefaCc_q__aa0o -3276.8 3276.7 FORMAT "%6.1"
 /begin AXIS_DESCR COM_AXIS Nkw_atm caoddzd_oAjpfzb_cAcEEha_1nR_oa0 4 -32768 32767 AXIS_PTS_REF AXX_KF_TA_VKSOLL MONOTONY STRICT_INCREASE DEPOSIT ABSOLUTE /end AXIS_DESCR
 /begin AXIS_DESCR COM_AXIS Rf_atm CgkBooc_wkiDfEd_Czglhgc_fR_1a0o 4 -327.68 327.67 AXIS_PTS_REF AXY_KF_TA_VKSOLL MONOTONY STRICT_INCREASE DEPOSIT ABSOLUTE /end AXIS_DESCR
/end CHARACTERISTIC
/begin CHARACTERISTIC KF_TD_FETTDELAY_TABG "Duration of enrichment suppression from KF_LABAS_XXX. This time depends on pipe wall temperature Tw_r1." MAP 0x96C4E14 _REC_A1CUR_2_MBSE_U1_S1 51 CAmbmzc_faghuld_pmDugua_s__aa0o 0 51
 /begin AXIS_DESCR COM_AXIS Tw_r1 bdktxuc_qvvFmxd_seefaCc_q__aa0o 6 -3276.8 3276.7 AXIS_PTS_REF AXX_KF_TD_FETTDELAY_TABG FORMAT "%6.1" MONOTONY STRICT_INCREASE DEPOSIT ABSOLUTE /end AXIS_DESCR
 /begin AXIS_DESCR COM_AXIS Nkw caoddzd_oAjpfzb_cAcEEha_1nR_oa0 4 -3277 3277 AXIS_PTS_REF AXY_KF_TD_FETTDELAY_TABG FORMAT "%5.0" MONOTONY STRICT_INCREASE DEPOSIT ABSOLUTE /end AXIS_DESCR
/end CHARACTERISTIC
/begin CHARACTERISTIC KF_ZWMIN_KSOT "Minimum ignition angle for sound tuning cold" MAP 0x96C4BF0 _REC_A1CUR_2_MBSE_S1_S1 127.5 aAwkuzc_BFpgCmb_tmDukma_q__aa0o -64 63.5
 /begin AXIS_DESCR COM_AXIS Nkw caoddzd_oAjpfzb_cAcEEha_1nR_oa0 8 -32768 32767 AXIS_PTS_REF AXX_KF_ZWMIN_KSOT FORMAT "%5.0" MONOTONY STRICT_INCREASE DEPOSIT ABSOLUTE /end AXIS_DESCR
 /begin AXIS_DESCR COM_AXIS NO_INPUT_QUANTITY CgkBooc_wkiDfEd_Czglhgc_fR_1a0o 8 -327.68 327.67 AXIS_PTS_REF AXY_KF_ZWMIN_KSOT FORMAT "%9.4" MONOTONY STRICT_INCREASE DEPOSIT ABSOLUTE /end AXIS_DESCR
/end CHARACTERISTIC
/begin CHARACTERISTIC KF_ZWMIN_WSOT "Minimum ignition angle for sound tuning warm" MAP 0x96C4BB0 _REC_A1CUR_2_MBSE_S1_S1 127.5 aAwkuzc_BFpgCmb_tmDukma_q__aa0o -64 63.5
 /begin AXIS_DESCR COM_AXIS Nkw caoddzd_oAjpfzb_cAcEEha_1nR_oa0 8 -32768 32767 AXIS_PTS_REF AXX_KF_ZWMIN_WSOT FORMAT "%5.0" MONOTONY STRICT_INCREASE DEPOSIT ABSOLUTE /end AXIS_DESCR
 /begin AXIS_DESCR COM_AXIS NO_INPUT_QUANTITY CgkBooc_wkiDfEd_Czglhgc_fR_1a0o 8 -327.68 327.67 AXIS_PTS_REF AXY_KF_ZWMIN_WSOT FORMAT "%9.4" MONOTONY STRICT_INCREASE DEPOSIT ABSOLUTE /end AXIS_DESCR
/end CHARACTERISTIC
/begin FUNCTION Antilag ""
 /begin SUB_FUNCTION Antilag_Codewords Antilag_PIDs Antilag_Rolling Antilag_Safety Antilag_Standing /end SUB_FUNCTION
/end FUNCTION
/begin FUNCTION Antilag_Codewords "" /end FUNCTION
/begin FUNCTION Antilag_PIDs "" /end FUNCTION
/begin FUNCTION Antilag_Rolling "" /end FUNCTION
/begin FUNCTION Antilag_Safety "" /end FUNCTION
/begin FUNCTION Antilag_Standing "" /end FUNCTION
/begin FUNCTION Boost "Intake/exhaust pressure targets/limits"
 /begin DEF_CHARACTERISTIC K_PAK_MX BMWlpa_n_EfpEngStrtAmb_M KL_PSPVDK_SOLMAXGD K_MAX_PSSOLBER KL_RFTNLMX KF_DPLDSOLL_SPORT BMWtchdiag_n_EngMin_C BMWtchob_p_DifEnd_C BMWtchob_fac_tq_Delt_T BMWtchob_p_DifGraTrigMin_C BMWtchsp_p_ReqMax_C BMWtchsp_p_OfsMax_C BMWtchsp_rat_p_CmprPmp_T BMWtchsp_rat_p_CmprMax_M BMWtchsp_fac_FilPRatCmpr_T BMWtchsp_fac_mf_FilCmprNorm_T KF_DPLDS_PRED BMWtchctr_fac_pwr_CompLimPctl_T BMWtchctr_rat_p_ComprLimPctl_T PVDMX /end DEF_CHARACTERISTIC
/end FUNCTION
/begin FUNCTION BoostByGear "" /begin SUB_FUNCTION BoostByGear_Codewords /end SUB_FUNCTION /end FUNCTION
/begin FUNCTION BoostByGear_Codewords "" /end FUNCTION
/begin FUNCTION Burbles ""
 /begin SUB_FUNCTION Burbles_Codewords Burbles_Slot0 Burbles_Slot1 Burbles_Slot2 Burbles_Slot3 Burbles_Slot4 Burbles_Slot5 /end SUB_FUNCTION
/end FUNCTION
/begin FUNCTION Burbles_Codewords "" /end FUNCTION
/begin FUNCTION Burbles_Slot0 "" /end FUNCTION
/begin FUNCTION Burbles_Slot1 "" /end FUNCTION
/begin FUNCTION Burbles_Slot2 "" /end FUNCTION
/begin FUNCTION Burbles_Slot3 "" /end FUNCTION
/begin FUNCTION Burbles_Slot4 "" /end FUNCTION
/begin FUNCTION Burbles_Slot5 "" /end FUNCTION
/begin FUNCTION Cooling "Engine cooling"
 /begin DEF_CHARACTERISTIC KF_NEL_TANS KF_NEL_TABG KL_NEL_V_MX KL_NEL_TMOT KL_NEL_TKA KL_NEL_TEGS KL_NEL_TDME KL_NEL_TANS_KLOPF KL_NEL_TABG_TUMG KL_NEL_SPL KL_NEL_I KL_TKW_NO KL_TKW_HI KF_KLIMA_KKS KL_NEWP_KLIMA_MX KL_NEL_KLIMA_MX KL_FLD_KKS K_TKW_WA K_TKW_MX K_QS_ANF_KLIMA_MX /end DEF_CHARACTERISTIC
/end FUNCTION
/begin FUNCTION CustomCode ""
 /begin SUB_FUNCTION Antilag BoostByGear Burbles CustomCodeMenu ExhaustFlap FlexFuel MaxCooling RadiatorFlap SwitchableMaps TcuTorqueLimiter Valet /end SUB_FUNCTION
/end FUNCTION
/begin FUNCTION CustomCodeMenu "" /begin SUB_FUNCTION CustomCodeMenu_Codewords CustomCodeMenu_CanBusIds /end SUB_FUNCTION /end FUNCTION
/begin FUNCTION CustomCodeMenu_CanBusIds "" /end FUNCTION
/begin FUNCTION CustomCodeMenu_Codewords "" /end FUNCTION
/begin FUNCTION DisplayCalibration "Sport gauge scales for power and torque"
 /begin DEF_CHARACTERISTIC BMWshl_n_ThdSpdDispSegAlOn_C BMWshl_n_SpdMaxMt_T BMWshl_n_SpdMaxAt_T K_EDA_P_ANZ_SPORT_BS_SCAL_CODE3 K_EDA_P_ANZ_SPORT_BS_SCAL_CODE2 K_EDA_P_ANZ_SPORT_BS_SCAL_CODE1 K_EDA_P_ANZ_SPORT_BS_SCAL_CODE0 K_EDA_MD_ANZ_BS_SCAL_CODE4 K_EDA_MD_ANZ_BS_SCAL_CODE3 K_EDA_MD_ANZ_BS_SCAL_CODE2 K_EDA_MD_ANZ_BS_SCAL_CODE1 K_EDA_MD_ANZ_BS_SCAL_CODE0 NWARNORINI /end DEF_CHARACTERISTIC
/end FUNCTION
/begin FUNCTION EngineSpeed "Engine Speed"
 /begin DEF_CHARACTERISTIC K_N_GB1_IN_MAX_OSC K_NADONNMX K_PAM_MODE_FUELLUNGSEG_NKW_HYS K_PAM_MODE_FUELLUNGSEG_NKW2 K_PAM_MODE_FUELLUNGSEG_NKW1 KF_N_GASSTOSS_UND_ANFAHR KF_NMAX_ANFAHR_MODE_2 KF_NMAX_ANFAHR_MODE_1 KF_NMAX_ANFAHR_MODE_0 K_NKW_MAX K_NMX_VM_OG_SPORTPLUS K_NMX_VM_OG_SPORT K_NMX_VM_OG_RENNSTART K_NMX_VM_OG_ECO K_NMX_VM_OG_COMFORT K_NMX_VM_FETRAWE K_NMX_VM_BA_VVT K_NMX_VM_BA_GD EngPrt_nMaxAtNES_CUR EngPrt_nMaxAt_CUR EngPrt_nMaxBoostAtNES_CUR EngPrt_nMaxBoostAt_CUR EngPrt_nMaxBoostRedAtNES_CUR EngPrt_nMaxBoostRedAt_CUR EngPrt_nMaxBoostRed_CUR EngPrt_nMaxBoost_CUR EngPrt_nMaxRedAtNES_CUR EngPrt_nMaxRedAt_CUR EngPrt_nMaxRed_CUR EngPrt_nMax_CUR NMAX NMAXKR NMAXSWT NMAXTMM NMAXTO /end DEF_CHARACTERISTIC
/end FUNCTION
/begin FUNCTION Exhaust "Exhaust flap, burbles and noise"
 /begin DEF_CHARACTERISTIC K_V_SOT_MN BMWausy_p_DifCat_T BMWgpfdiag_m_ThdAshSnsr_C BMWgpfheat_tq_ResExhFlpClsdHys_C BMWgpfheat_p_RailInjSng_M BMWgpfheat_p_RailInjMpl_M BMWgpfheat_tq_ResExhFlpClsd_T KF_LA_EZA K_V_SOUND_MX K_V_SOUND_MN K_T_VL_SOUND_MX K_T_NK_SOUND_MX K_T_SOUND_MN KL_T_IKAT_SOUND_MX KL_NKW_SOUND_MX KL_NKW_SOUND_MN KL_TD_SOUND_MX_SPORT KL_TD_SOUND_MX_FREI KL_TD_SOUND_MX KF_MD_RES_NST_KEY BMWchas_v_IdlGearAcvMin_C BMWchas_tq_ResExhFlpClsdHys_C BMWchas_tq_ResExhFlpClsd_T K_F_SOT_RUECKBLICK_STAND K_F_SOT_RUECKBLICK_RS BMWchas_st_OpmBasc_M BMWgpfp_swi_PclFil_C BMWtchbas_cw_Noise_C CW_SOUND BMWtqe_b_SptDet4NoiseAcvn_M BMWtqe_b_Clu4NoiseDeac_T KF_ZWMIN_WSOT KF_ZWMIN_KSOT KF_DZWMIN_SPORT_SOT KF_DZWMIN_NORMAL_SOT AKRGRCC AKRGRCCAT AKRGRCCATM AKRGRCCATM_VAR1 AKRGRCCATM_VAR2 AKRGRCCATM_VAR3 AKRGRCCAT_VAR1 AKRGRCCAT_VAR2 AKRGRCCAT_VAR3 AKRGRCCM AKRGRCCM_VAR1 AKRGRCCM_VAR2 AKRGRCCM_VAR3 AKRGRCC_VAR1 AKRGRCC_VAR2 AKRGRCC_VAR3 AKRGRCO AKRGRCOAT AKRGRCOATM AKRGRCOATM_VAR1 AKRGRCOAT_VAR1 AKRGRCOM AKRGRCOM_VAR1 AKRGRCO_VAR1 AKR_dmHFMThdMin_C AKR_stSpt_C CWAKR CWSTEGSPROGAKR TMOTAKR TVSTAKR VMINAKR PFlt_stActv_C PFlt_stPfilTyp_C CWVMAXCOD VMAXOVC Exh_swtSensCfgPPFlt_C /end DEF_CHARACTERISTIC
/end FUNCTION
/begin FUNCTION ExhaustFlap "" /begin SUB_FUNCTION ExhaustFlap_Codewords /end SUB_FUNCTION /end FUNCTION
/begin FUNCTION ExhaustFlap_Codewords "" /end FUNCTION
/begin FUNCTION ExhaustGasTemperature "Target EGT"
 /begin DEF_CHARACTERISTIC KF_TA_VKSOLL KF_TA_IKSOLL KF_TA_ATLSOLL BMWtchctr_t_ExGasMdl_M BMWtchctr_t_ExGasMdlScav_M /end DEF_CHARACTERISTIC
/end FUNCTION
/begin FUNCTION FlexFuel ""
 /begin SUB_FUNCTION FlexFuel_General_Codewords FlexFuel_Map_Codewords FlexFuel_Slot0 FlexFuel_Slot1 FlexFuel_Slot2 FlexFuel_Slot3 FlexFuel_Slot4 /end SUB_FUNCTION
/end FUNCTION
/begin FUNCTION FlexFuel_General_Codewords "" /end FUNCTION
/begin FUNCTION FlexFuel_Map_Codewords "" /end FUNCTION
/begin FUNCTION FlexFuel_Slot0 "Used for all slots if CW_UseMultipleFlexFuelSlots is disabled"
 /begin SUB_FUNCTION FlexFuel_Slot0_Codewords FlexFuel_Slot0_Blenders FlexFuel_Slot0_SensorlessValues /end SUB_FUNCTION
/end FUNCTION
/begin FUNCTION FlexFuel_Slot0_Blenders "" /end FUNCTION
/begin FUNCTION FlexFuel_Slot0_Codewords "" /end FUNCTION
/begin FUNCTION FlexFuel_Slot0_SensorlessValues "E% without sensor (ECA)" /end FUNCTION
/begin FUNCTION FlexFuel_Slot1 "Only used if CW_UseMultipleFlexFuelSlots is enabled"
 /begin SUB_FUNCTION FlexFuel_Slot1_Codewords FlexFuel_Slot1_Blenders FlexFuel_Slot1_SensorlessValues /end SUB_FUNCTION
/end FUNCTION
/begin FUNCTION FlexFuel_Slot1_Blenders "" /end FUNCTION
/begin FUNCTION FlexFuel_Slot1_Codewords "" /end FUNCTION
/begin FUNCTION FlexFuel_Slot1_SensorlessValues "E% without sensor (ECA)" /end FUNCTION
/begin FUNCTION FlexFuel_Slot2 "Only used if CW_UseMultipleFlexFuelSlots is enabled"
 /begin SUB_FUNCTION FlexFuel_Slot2_Codewords FlexFuel_Slot2_Blenders FlexFuel_Slot2_SensorlessValues /end SUB_FUNCTION
/end FUNCTION
/begin FUNCTION FlexFuel_Slot2_Blenders "" /end FUNCTION
/begin FUNCTION FlexFuel_Slot2_Codewords "" /end FUNCTION
/begin FUNCTION FlexFuel_Slot2_SensorlessValues "E% without sensor (ECA)" /end FUNCTION
/begin FUNCTION FlexFuel_Slot3 "Only used if CW_UseMultipleFlexFuelSlots is enabled"
 /begin SUB_FUNCTION FlexFuel_Slot3_Codewords FlexFuel_Slot3_Blenders FlexFuel_Slot3_SensorlessValues /end SUB_FUNCTION
/end FUNCTION
/begin FUNCTION FlexFuel_Slot3_Blenders "" /end FUNCTION
/begin FUNCTION FlexFuel_Slot3_Codewords "" /end FUNCTION
/begin FUNCTION FlexFuel_Slot3_SensorlessValues "E% without sensor (ECA)" /end FUNCTION
/begin FUNCTION FlexFuel_Slot4 "Only used if CW_UseMultipleFlexFuelSlots is enabled"
 /begin SUB_FUNCTION FlexFuel_Slot4_Codewords FlexFuel_Slot4_Blenders FlexFuel_Slot4_SensorlessValues /end SUB_FUNCTION
/end FUNCTION
/begin FUNCTION FlexFuel_Slot4_Blenders "" /end FUNCTION
/begin FUNCTION FlexFuel_Slot4_Codewords "" /end FUNCTION
/begin FUNCTION FlexFuel_Slot4_SensorlessValues "E% without sensor (ECA)" /end FUNCTION
/begin FUNCTION FuelCorrection "Lambda modifiers" /begin DEF_CHARACTERISTIC KF_FRKKORRF_1 KF_PHA_H_B1_W KF_PHA_H_E1 /end DEF_CHARACTERISTIC /end FUNCTION
/begin FUNCTION FuelLimits "Lambda limits" /begin DEF_CHARACTERISTIC K_FRFMXBS_MN KF_BSLGF K_BS_MN KL_LA_SBL /end DEF_CHARACTERISTIC /end FUNCTION
/begin FUNCTION FuelTargets "Lambda targets"
 /begin DEF_CHARACTERISTIC KF_LABAS_1 KF_PHA_H_B1_SK_PRE KF_DLAMBSVST_TABG BMWlpa_n_EfpModMax_C BMWlpa_n_EfpModSafe_M BMWlpa_n_EfpEngStrtPRail_T BMWlpsc_volf_FuEjrPmp_M BMWlpsd_p_RailDifMax_T KF_LAMIN_H KF_PRAIL_H_K KF_PRAIL_HGD_K KF_PRAIL_HGD KF_PRAIL_HDPWARM KF_PRAIL_H BMWtqe_n_LamStrdMax_C KF_LA_BEZ KF_KOEFF_B_LA BMWchas_lam_InjSng_M BMWchas_lam_InjSngThr_M BMWchas_lam_InjMpl_M BMWchas_lam_InjMplThr_M BMWchas_p_RailInjSng_M BMWchas_p_RailInjMpl_M K_MSVANST_DIFFPRAIL BMWinjmon_fac_HppEff_M BMWext_lam_CptPronDfco_T BMWlpa_volf_FuFpcOvrT_C BMWlpsc_p_HppMax_T K_PRAIL_ST_MAX KF_ST_RKBAS_VVT KF_ST_RKBAS_GD K_LA_FETTDELAY KF_LA_SK KF_LABAS_2 CW_ATMOD S_PRAIL_GL_LA1 S_AUSWAHL_FETTDELAY K_T_FETTDELAY_SPERR KF_TD_FETTDELAY_TABG VSEKPMXN FWIHDR FWPHDR KLIHDR KLPHDR KLPHDRTF NMXHDR KLFVSTOTF KLVSTMSVG MK2TE /end DEF_CHARACTERISTIC
/end FUNCTION
/begin FUNCTION GenericCharacteristics "OEM Maps"
 /begin SUB_FUNCTION FuelTargets OilPressure Cooling LowPressureFuelPump TorqueLimiters DisplayCalibration EngineSpeed Exhaust LoadControl Boost MAFSensor FuelCorrection FuelLimits ExhaustGasTemperature ThrottleControl Vanos WastegateControl Ignition Knock Limits TorqueMonitoring /end SUB_FUNCTION
/end FUNCTION
/begin COMPU_METHOD aAwkuzc_BFpgCmb_tmDukma_q__aa0o "aAwkuzc_BFpgCmb_tmDukma_q__aa0o" RAT_FUNC "%6.3" "°" COEFFS 0 2 0 0 0 1 /end COMPU_METHOD
/begin COMPU_METHOD acriqBc_tfkBqod_ocgjxzc_nR_8oa0 "acriqBc_tfkBqod_ocgjxzc_nR_8oa0" RAT_FUNC "%6.3" "-" COEFFS 0 8192 0 0 0 1 /end COMPU_METHOD
/begin COMPU_METHOD aEmoCzd_erpwvfb_msfkhgc_qR_1a0o "aEmoCzd_erpwvfb_msfkhgc_qR_1a0o" RAT_FUNC "%6.3" "°" COEFFS 0 128 0 0 0 3 /end COMPU_METHOD
/begin COMPU_METHOD AFeDmkb_cAbjmcc_kAkskhd_k__0oa0 "AFeDmkb_cAbjmcc_kAkskhd_k__0oa0" RAT_FUNC "%6.3" "km/h" COEFFS 0 1 0 0 0 1 /end COMPU_METHOD
/begin COMPU_METHOD asfzqDd_xfCuqha_hliBAmd_k__0oa0 "asfzqDd_xfCuqha_hliBAmd_k__0oa0" RAT_FUNC "%6.3" "kg/h" COEFFS 0 10 0 0 0 1 /end COMPU_METHOD
/begin COMPU_METHOD Asyaixa_wdvtenb_FCefaCb_n__aa0o "Asyaixa_wdvtenb_FCefaCb_n__aa0o" RAT_FUNC "%6.3" "-" COEFFS 0 50 0 0 0 1 /end COMPU_METHOD
/begin COMPU_METHOD B_TRUE "" TAB_VERB "%6.3" "" COMPU_TAB_REF ACCMPR_CODAVL_SY_Compu /end COMPU_METHOD
/begin COMPU_METHOD bdktxuc_qvvFmxd_seefaCc_q__aa0o "bdktxuc_qvvFmxd_seefaCc_q__aa0o" RAT_FUNC "%6.3" "°C" COEFFS 0 10 0 0 0 1 /end COMPU_METHOD
/begin COMPU_METHOD Bhvfwhc_bigEubd_BBEupBd_nR_3oa0 "Bhvfwhc_bigEubd_BBEupBd_nR_3oa0" RAT_FUNC "%6.3" "-" COEFFS 0 32768 0 0 0 1 /end COMPU_METHOD
/begin COMPU_METHOD BpaECzb_zweffod_enenhgc_nR_2a0o "BpaECzb_zweffod_enenhgc_nR_2a0o" RAT_FUNC "%6.3" "-" COEFFS 0 256 0 0 0 1 /end COMPU_METHOD
/begin COMPU_METHOD BufnDdb_jpjgsgc_jmDugsa_qCRoa0o "BufnDdb_jpjgsgc_jmDugsa_qCRoa0o" RAT_FUNC "%6.3" "°C" COEFFS 0 1 0 0 0 1 /end COMPU_METHOD
/begin COMPU_METHOD BumqDkc_mryszAa_EcglxAc_nR_4oa0 "BumqDkc_mryszAa_EcglxAc_nR_4oa0" RAT_FUNC "%6.3" "-" COEFFS 0 4096 0 0 0 1 /end COMPU_METHOD
/begin COMPU_METHOD CAmbmzc_faghuld_pmDugua_s__aa0o "CAmbmzc_faghuld_pmDugua_s__aa0o" RAT_FUNC "%6.3" "s" COEFFS 0 5 0 0 0 1 /end COMPU_METHOD
/begin COMPU_METHOD camcxxd_bxlpdsa_Cshlhgc_sR_1a0o "camcxxd_bxlpdsa_Cshlhgc_sR_1a0o" RAT_FUNC "%6.3" "s" COEFFS 0 100 0 0 0 1 /end COMPU_METHOD
/begin COMPU_METHOD caoddzd_oAjpfzb_cAcEEha_1nR_oa0 "caoddzd_oAjpfzb_cAcEEha_1nR_oa0" RAT_FUNC "%6.3" "1/min" COEFFS 0 1 0 0 0 1 /end COMPU_METHOD
/begin COMPU_METHOD CByjozc_eCmpBAb_pljBAmd_k__0oa0 "CByjozc_eCmpBAb_pljBAmd_k__0oa0" RAT_FUNC "%6.3" "kg/h" COEFFS 0 32 0 0 0 1 /end COMPU_METHOD
/begin COMPU_METHOD CgkBooc_wkiDfEd_Czglhgc_fR_1a0o "CgkBooc_wkiDfEd_Czglhgc_fR_1a0o" RAT_FUNC "%6.3" "%" COEFFS 0 100 0 0 0 1 /end COMPU_METHOD
/begin COMPU_METHOD cxdjuna_xpuCged_ocEpdua_MCRa2a0 "cxdjuna_xpuCged_ocEpdua_MCRa2a0" RAT_FUNC "%6.3" "MPa" COEFFS 0 8192 0 0 0 5 /end COMPU_METHOD
/begin COMPU_METHOD DchEpAd_DBCFgoa_Ckhahgc_q__aoa0 "DchEpAd_DBCFgoa_Ckhahgc_q__aoa0" RAT_FUNC "%6.3" "°C" COEFFS 0 100 0 0 0 1 /end COMPU_METHOD
/begin COMPU_METHOD DEZ "" RAT_FUNC "%6.2" "" COEFFS 0 1 0 0 0 1 /end COMPU_METHOD
/begin COMPU_METHOD DFC_OneToOne "" RAT_FUNC "%6.2" "-" COEFFS 0 1 0 0 0 1 /end COMPU_METHOD
/begin COMPU_METHOD dufmqFa_ggtdFtc_rzCuowa_hCRoa0o "dufmqFa_ggtdFtc_rzCuowa_hCRoa0o" RAT_FUNC "%6.3" "hPa" COEFFS 0 8 0 0 0 1 /end COMPU_METHOD
/begin COMPU_METHOD fak_q6p1035Em5 "" RAT_FUNC "%7.6" "-" COEFFS 0 65536 0 0 0 4 /end COMPU_METHOD
/begin COMPU_METHOD fak_sw_b4 "" RAT_FUNC "%6.5" "-" COEFFS 0 65536 0 0 0 8 /end COMPU_METHOD
/begin COMPU_METHOD fak_ub_b2 "" RAT_FUNC "%8.5" "-" COEFFS 0 256 0 0 0 2 /end COMPU_METHOD
/begin COMPU_METHOD fgjpsvb_fDqjECa_acgrbDd_n_dae__ "fgjpsvb_fDqjECa_acgrbDd_n_dae__" TAB_VERB "%6.3" "-" COMPU_TAB_REF fgjpsvb_fDqjECa_acgrbDd_n_dae__ /end COMPU_METHOD
/begin COMPU_METHOD fuel_ub_q1 "" RAT_FUNC "%6.2" "l" COEFFS 0 1 0 0 0 1 /end COMPU_METHOD
/begin COMPU_METHOD FzbmlAa_gCtylrb_ckCqxAc_nR_6oa0 "FzbmlAa_gCtylrb_ckCqxAc_nR_6oa0" RAT_FUNC "%6.3" "-" COEFFS 0 65536 0 0 0 1 /end COMPU_METHOD
/begin COMPU_METHOD hcpywvc_dcqzDlc_FmDugua_s__aa0o "hcpywvc_dcqzDlc_FmDugua_s__aa0o" RAT_FUNC "%6.3" "s" COEFFS 0 1 0 0 0 1 /end COMPU_METHOD
/begin COMPU_METHOD hrjAuFd_bEwmcob_wxyfvwa_f_Ra2ao "hrjAuFd_bEwmcob_wxyfvwa_f_Ra2ao" RAT_FUNC "%6.3" "%/Ks" COEFFS 0 8192 0 0 0 25 /end COMPU_METHOD
/begin COMPU_METHOD ilxsavd_hkzmBfc_lAzCpAb_nR_1oa0 "ilxsavd_hkzmBfc_lAzCpAb_nR_1oa0" RAT_FUNC "%6.3" "-" COEFFS 0 16384 0 0 0 1 /end COMPU_METHOD
/begin COMPU_METHOD InjDDGdi_mkte_q0p10416Em4 "" RAT_FUNC "%7.6" "ms * Hub/mg" COEFFS 0 96000 0 0 0 1 /end COMPU_METHOD
/begin COMPU_METHOD jgbhAma_smpAegb_hlEBAmd_k__0oa0 "jgbhAma_smpAegb_hlEBAmd_k__0oa0" RAT_FUNC "%6.3" "km/h" COEFFS 0 50 0 0 0 1 /end COMPU_METHOD
/begin COMPU_METHOD knyFDjc_sDytACd_hlCBAmd_k__0oa0 "knyFDjc_sDytACd_hlCBAmd_k__0oa0" RAT_FUNC "%6.3" "km/h" COEFFS 0 10 0 0 0 1 /end COMPU_METHOD
/begin COMPU_METHOD Mo_trq_nm_q0p1 "" RAT_FUNC "%6.3" "Nm" COEFFS 0 10 0 0 0 1 /end COMPU_METHOD
/begin COMPU_METHOD n_sw_q0p5 "" RAT_FUNC "%6.3" "1/min" COEFFS 0 2 0 0 0 1 /end COMPU_METHOD
/begin COMPU_METHOD nmot_sw_q0p25 "" RAT_FUNC "%6.3" "1/min" COEFFS 0 1 0 0 0 0.25 /end COMPU_METHOD
/begin COMPU_METHOD nnxvdDd_vDnjvqd_FmDuEEa_f__aa0o "nnxvdDd_vDnjvqd_FmDuEEa_f__aa0o" RAT_FUNC "%6.3" "%" COEFFS 0 1 0 0 0 1 /end COMPU_METHOD
/begin COMPU_METHOD noCyFga_rslwmfa_ecfnhgc_sR_2a0o "noCyFga_rslwmfa_ecfnhgc_sR_2a0o" RAT_FUNC "%6.3" "s" COEFFS 0 256 0 0 0 1 /end COMPU_METHOD
/begin COMPU_METHOD p_uw_q0p078 "" RAT_FUNC "%6.4" "hPa" COEFFS 0 256 0 0 0 20 /end COMPU_METHOD
/begin COMPU_METHOD qtfFcac_cfbwAaa_Cbeysaa_fR_60oa "qtfFcac_cfbwAaa_Cbeysaa_fR_60oa" RAT_FUNC "%6.3" "%" COEFFS 0 64 0 0 0 25 /end COMPU_METHOD
/begin COMPU_METHOD raChrxc_kBtBrmb_FmDuEFa_n__aa0o "raChrxc_kBtBrmb_FmDuEFa_n__aa0o" RAT_FUNC "%6.3" "-" COEFFS 0 1 0 0 0 1 /end COMPU_METHOD
/begin COMPU_METHOD rAdkuaa_wDllxja_BnDuEFa_n__aa0o "rAdkuaa_wDllxja_BnDuEFa_n__aa0o" RAT_FUNC "%6.3" "-" COEFFS 0 8 0 0 0 1 /end COMPU_METHOD
/begin COMPU_METHOD RBPtCel_p_0p002_1 "" RAT_FUNC "%6.4" "MPa" COEFFS 0 1000 0 0 0 2 /end COMPU_METHOD
/begin COMPU_METHOD rel_q0p39 "" RAT_FUNC "%6.3" "%" COEFFS 0 256 0 0 0 100 /end COMPU_METHOD
/begin COMPU_METHOD rgduxyd_mlihaBb_gsCghzb_bCRa0a0 "rgduxyd_mlihaBb_gsCghzb_bCRa0a0" RAT_FUNC "%6.3" "bar" COEFFS 0 1000 0 0 0 1 /end COMPU_METHOD
/begin COMPU_METHOD ridxkCa_Dxvxtdc_CChkhgc_nR_1a0o "ridxkCa_Dxvxtdc_CChkhgc_nR_1a0o" RAT_FUNC "%6.3" "-" COEFFS 0 128 0 0 0 3 /end COMPU_METHOD
/begin COMPU_METHOD t10msxs_ub_b2p55 "" RAT_FUNC "%6.4" "s" COEFFS 0 1 0 0 0 0.01 /end COMPU_METHOD
/begin COMPU_METHOD temp_q0p0234_o273 "" RAT_FUNC "%6.1" "Grad C" COEFFS 0 1 273.15 0 0 0.0234375 /end COMPU_METHOD
/begin COMPU_METHOD temp_ub_q0p75_o48 "" RAT_FUNC "%6.2" "Grad C" COEFFS 0 1 48 0 0 0.75 /end COMPU_METHOD
/begin COMPU_METHOD tFsjAyd_phhEqra_gswpFBc_gR_1oa0 "tFsjAyd_phhEqra_gswpFBc_gR_1oa0" RAT_FUNC "%6.3" "g" COEFFS 0 1000 0 0 0 1 /end COMPU_METHOD
/begin COMPU_METHOD vfyBdwd_ftexgja_BcFdiDd_fR_1a0o "vfyBdwd_ftexgja_BcFdiDd_fR_1a0o" RAT_FUNC "%6.3" "%" COEFFS 0 1024 0 0 0 25 /end COMPU_METHOD
/begin COMPU_METHOD vfzg_sw_q0p00781 "" RAT_FUNC "%6.4" "km/h" COEFFS 0 1 0 0 0 0.0078125 /end COMPU_METHOD
/begin COMPU_METHOD vfzg_ub_q1p25 "" RAT_FUNC "%6.2" "km/h" COEFFS 0 1 0 0 0 1.25 /end COMPU_METHOD
/begin COMPU_METHOD wDvwtyd_Bhgozed_DCekdfb_nsttFSS "wDvwtyd_Bhgozed_DCekdfb_nsttFSS" TAB_VERB "%6.3" "-" COMPU_TAB_REF wDvwtyd_Bhgozed_DCekdfb_nsttFSS /end COMPU_METHOD
/begin COMPU_METHOD zBcBzad_vmoivka_mFzjCgc_lCRooa0 "zBcBzad_vmoivka_mFzjCgc_lCRooa0" RAT_FUNC "%6.3" "l/h" COEFFS 0 100 0 0 0 1 /end COMPU_METHOD
/begin COMPU_METHOD zyyxBpb_rEsnvtc_gktukCa_fR_5a0o "zyyxBpb_rEsnvtc_gktukCa_fR_5a0o" RAT_FUNC "%6.3" "%" COEFFS 0 512 0 0 0 25 /end COMPU_METHOD
/begin COMPU_VTAB ACCMPR_CODAVL_SY_Compu "" TAB_VERB 2 0 "FALSE" 1 "TRUE" /end COMPU_VTAB
/begin COMPU_VTAB fgjpsvb_fDqjECa_acgrbDd_n_dae__ "fgjpsvb_fDqjECa_acgrbDd_n_dae__" TAB_VERB 2 0 "false" 1 "true" DEFAULT_VALUE "Zustand nicht definiert" /end COMPU_VTAB
/begin COMPU_VTAB wDvwtyd_Bhgozed_DCekdfb_nsttFSS "wDvwtyd_Bhgozed_DCekdfb_nsttFSS" TAB_VERB 4 0 "CH_OFF" 1 "CH_1ES" 2 "CH_2ES" 3 "CH_3ES" DEFAULT_VALUE "Zustand nicht definiert" /end COMPU_VTAB
/begin RECORD_LAYOUT _REC_A1AXS_1_MBSE_S2 ALIGNMENT_BYTE 1 ALIGNMENT_WORD 2 ALIGNMENT_LONG 4 ALIGNMENT_FLOAT32_IEEE 4 ALIGNMENT_FLOAT64_IEEE 4 AXIS_PTS_X 1 SWORD INDEX_INCR DIRECT /end RECORD_LAYOUT
/begin RECORD_LAYOUT _REC_A1AXS_1_MBSE_U1 ALIGNMENT_BYTE 1 ALIGNMENT_WORD 2 ALIGNMENT_LONG 4 ALIGNMENT_FLOAT32_IEEE 4 ALIGNMENT_FLOAT64_IEEE 4 AXIS_PTS_X 1 UBYTE INDEX_INCR DIRECT /end RECORD_LAYOUT
/begin RECORD_LAYOUT _REC_A1AXS_1_MBSE_U2 ALIGNMENT_BYTE 1 ALIGNMENT_WORD 2 ALIGNMENT_LONG 4 ALIGNMENT_FLOAT32_IEEE 4 ALIGNMENT_FLOAT64_IEEE 4 AXIS_PTS_X 1 UWORD INDEX_INCR DIRECT /end RECORD_LAYOUT
/begin RECORD_LAYOUT _REC_A1CUR_2_MBSE_S1_S1 ALIGNMENT_BYTE 1 ALIGNMENT_WORD 2 ALIGNMENT_LONG 4 ALIGNMENT_FLOAT32_IEEE 4 ALIGNMENT_FLOAT64_IEEE 4 FNC_VALUES 1 SBYTE ROW_DIR DIRECT /end RECORD_LAYOUT
/begin RECORD_LAYOUT _REC_A1CUR_2_MBSE_S2_S1 ALIGNMENT_BYTE 1 ALIGNMENT_WORD 2 ALIGNMENT_LONG 4 ALIGNMENT_FLOAT32_IEEE 4 ALIGNMENT_FLOAT64_IEEE 4 FNC_VALUES 1 SWORD ROW_DIR DIRECT /end RECORD_LAYOUT
/begin RECORD_LAYOUT _REC_A1CUR_2_MBSE_U1_S1 ALIGNMENT_BYTE 1 ALIGNMENT_WORD 2 ALIGNMENT_LONG 4 ALIGNMENT_FLOAT32_IEEE 4 ALIGNMENT_FLOAT64_IEEE 4 FNC_VALUES 1 UBYTE ROW_DIR DIRECT /end RECORD_LAYOUT
/begin RECORD_LAYOUT _REC_A1CUR_2_MBSE_U2_S1 ALIGNMENT_BYTE 1 ALIGNMENT_WORD 2 ALIGNMENT_LONG 4 ALIGNMENT_FLOAT32_IEEE 4 ALIGNMENT_FLOAT64_IEEE 4 FNC_VALUES 1 UWORD ROW_DIR DIRECT /end RECORD_LAYOUT
/begin RECORD_LAYOUT _REC_S4CUR_52_KL_S2_1_S2 ALIGNMENT_BYTE 1 ALIGNMENT_WORD 2 ALIGNMENT_LONG 4 ALIGNMENT_FLOAT32_IEEE 4 ALIGNMENT_FLOAT64_IEEE 4 NO_AXIS_PTS_X 1 UBYTE RESERVED 2 BYTE AXIS_PTS_X 3 SWORD INDEX_INCR DIRECT FNC_VALUES 4 SWORD COLUMN_DIR DIRECT /end RECORD_LAYOUT
/begin RECORD_LAYOUT _REC_S4CUR_52_KL_U1_1_S2 ALIGNMENT_BYTE 1 ALIGNMENT_WORD 2 ALIGNMENT_LONG 4 ALIGNMENT_FLOAT32_IEEE 4 ALIGNMENT_FLOAT64_IEEE 4 NO_AXIS_PTS_X 1 UBYTE RESERVED 2 BYTE AXIS_PTS_X 3 SWORD INDEX_INCR DIRECT FNC_VALUES 4 UBYTE COLUMN_DIR DIRECT /end RECORD_LAYOUT
/begin RECORD_LAYOUT _REC_S4CUR_52_KL_U1_1_U2 ALIGNMENT_BYTE 1 ALIGNMENT_WORD 2 ALIGNMENT_LONG 4 ALIGNMENT_FLOAT32_IEEE 4 ALIGNMENT_FLOAT64_IEEE 4 NO_AXIS_PTS_X 1 UBYTE RESERVED 2 BYTE AXIS_PTS_X 3 UWORD INDEX_INCR DIRECT FNC_VALUES 4 UBYTE COLUMN_DIR DIRECT /end RECORD_LAYOUT
/begin RECORD_LAYOUT _REC_S4CUR_52_KL_U2_1_S2 ALIGNMENT_BYTE 1 ALIGNMENT_WORD 2 ALIGNMENT_LONG 4 ALIGNMENT_FLOAT32_IEEE 4 ALIGNMENT_FLOAT64_IEEE 4 NO_AXIS_PTS_X 1 UBYTE RESERVED 2 BYTE AXIS_PTS_X 3 SWORD INDEX_INCR DIRECT FNC_VALUES 4 UWORD COLUMN_DIR DIRECT /end RECORD_LAYOUT
/begin RECORD_LAYOUT _REC_S5MAP_52_KF_U1_S2_S2 ALIGNMENT_BYTE 1 ALIGNMENT_WORD 2 ALIGNMENT_LONG 4 ALIGNMENT_FLOAT32_IEEE 4 ALIGNMENT_FLOAT64_IEEE 4 NO_AXIS_PTS_X 1 UBYTE NO_AXIS_PTS_Y 2 UBYTE AXIS_PTS_X 3 SWORD INDEX_INCR DIRECT AXIS_PTS_Y 4 SWORD INDEX_INCR DIRECT FNC_VALUES 5 UBYTE COLUMN_DIR DIRECT /end RECORD_LAYOUT
/begin RECORD_LAYOUT _REC_S5MAP_52_KF_U1_S2_U2 ALIGNMENT_BYTE 1 ALIGNMENT_WORD 2 ALIGNMENT_LONG 4 ALIGNMENT_FLOAT32_IEEE 4 ALIGNMENT_FLOAT64_IEEE 4 NO_AXIS_PTS_X 1 UBYTE NO_AXIS_PTS_Y 2 UBYTE AXIS_PTS_X 3 SWORD INDEX_INCR DIRECT AXIS_PTS_Y 4 UWORD INDEX_INCR DIRECT FNC_VALUES 5 UBYTE COLUMN_DIR DIRECT /end RECORD_LAYOUT
/begin RECORD_LAYOUT Axis_Xs16 ALIGNMENT_BYTE 1 ALIGNMENT_WORD 2 ALIGNMENT_LONG 4 ALIGNMENT_FLOAT32_IEEE 4 ALIGNMENT_FLOAT64_IEEE 4 NO_AXIS_PTS_X 1 SWORD AXIS_PTS_X 2 SWORD INDEX_INCR DIRECT /end RECORD_LAYOUT
/begin RECORD_LAYOUT Axis_Xu16 ALIGNMENT_BYTE 1 ALIGNMENT_WORD 2 ALIGNMENT_LONG 4 ALIGNMENT_FLOAT32_IEEE 4 ALIGNMENT_FLOAT64_IEEE 4 NO_AXIS_PTS_X 1 UWORD AXIS_PTS_X 2 UWORD INDEX_INCR DIRECT /end RECORD_LAYOUT
/begin RECORD_LAYOUT Cur_Xu16Wu16 ALIGNMENT_BYTE 1 ALIGNMENT_WORD 2 ALIGNMENT_LONG 4 ALIGNMENT_FLOAT32_IEEE 4 ALIGNMENT_FLOAT64_IEEE 4 NO_AXIS_PTS_X 1 UWORD AXIS_PTS_X 2 UWORD INDEX_INCR DIRECT FNC_VALUES 3 UWORD COLUMN_DIR DIRECT /end RECORD_LAYOUT
/begin RECORD_LAYOUT Cur_Xu8Wu8 ALIGNMENT_BYTE 1 ALIGNMENT_WORD 2 ALIGNMENT_LONG 4 ALIGNMENT_FLOAT32_IEEE 4 ALIGNMENT_FLOAT64_IEEE 4 NO_AXIS_PTS_X 1 UBYTE AXIS_PTS_X 2 UBYTE INDEX_INCR DIRECT FNC_VALUES 3 UBYTE COLUMN_DIR DIRECT /end RECORD_LAYOUT
/begin RECORD_LAYOUT CurG_Ws16 ALIGNMENT_BYTE 1 ALIGNMENT_WORD 2 ALIGNMENT_LONG 4 ALIGNMENT_FLOAT32_IEEE 4 ALIGNMENT_FLOAT64_IEEE 4 FNC_VALUES 1 SWORD COLUMN_DIR DIRECT /end RECORD_LAYOUT
/begin RECORD_LAYOUT FklWUb ALIGNMENT_BYTE 1 ALIGNMENT_WORD 2 ALIGNMENT_LONG 4 ALIGNMENT_FLOAT32_IEEE 4 ALIGNMENT_FLOAT64_IEEE 4 FNC_VALUES 1 UBYTE COLUMN_DIR DIRECT /end RECORD_LAYOUT
/begin RECORD_LAYOUT GkfWU16 ALIGNMENT_BYTE 1 ALIGNMENT_WORD 2 ALIGNMENT_LONG 4 ALIGNMENT_FLOAT32_IEEE 4 ALIGNMENT_FLOAT64_IEEE 4 FNC_VALUES 1 UWORD COLUMN_DIR DIRECT /end RECORD_LAYOUT
/begin RECORD_LAYOUT KfAxU8AyU8SstxU8SstyU8WU8 ALIGNMENT_BYTE 1 ALIGNMENT_WORD 2 ALIGNMENT_LONG 4 ALIGNMENT_FLOAT32_IEEE 4 ALIGNMENT_FLOAT64_IEEE 4 NO_AXIS_PTS_X 1 UBYTE NO_AXIS_PTS_Y 2 UBYTE AXIS_PTS_X 3 UBYTE INDEX_INCR DIRECT AXIS_PTS_Y 4 UBYTE INDEX_INCR DIRECT FNC_VALUES 5 UBYTE COLUMN_DIR DIRECT /end RECORD_LAYOUT
/begin RECORD_LAYOUT KfAxUbAyUbSstxUbSstyUwWUb ALIGNMENT_BYTE 1 ALIGNMENT_WORD 2 ALIGNMENT_LONG 4 ALIGNMENT_FLOAT32_IEEE 4 ALIGNMENT_FLOAT64_IEEE 4 NO_AXIS_PTS_X 1 UBYTE NO_AXIS_PTS_Y 2 UBYTE AXIS_PTS_X 3 UBYTE INDEX_INCR DIRECT AXIS_PTS_Y 4 UWORD INDEX_INCR DIRECT FNC_VALUES 5 UBYTE COLUMN_DIR DIRECT /end RECORD_LAYOUT
/begin RECORD_LAYOUT KlAUbSstUbWUw_Static ALIGNMENT_BYTE 1 ALIGNMENT_WORD 2 ALIGNMENT_LONG 4 ALIGNMENT_FLOAT32_IEEE 4 ALIGNMENT_FLOAT64_IEEE 4 NO_AXIS_PTS_X 1 UBYTE AXIS_PTS_X 2 UBYTE INDEX_INCR DIRECT FNC_VALUES 3 UWORD COLUMN_DIR DIRECT STATIC_RECORD_LAYOUT /end RECORD_LAYOUT
/begin RECORD_LAYOUT RB_Curve_S8_U16_Static ALIGNMENT_BYTE 1 ALIGNMENT_WORD 2 ALIGNMENT_LONG 4 ALIGNMENT_FLOAT32_IEEE 4 ALIGNMENT_FLOAT64_IEEE 4 NO_AXIS_PTS_X 1 SBYTE AXIS_PTS_X 2 SBYTE INDEX_INCR DIRECT FNC_VALUES 3 UWORD COLUMN_DIR DIRECT STATIC_RECORD_LAYOUT /end RECORD_LAYOUT
/end MODULE
/end PROJECT
